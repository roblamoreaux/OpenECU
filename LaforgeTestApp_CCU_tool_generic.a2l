ASAP2_VERSION 1 31
/begin PROJECT LaForge_CCU_TestApp "Test Application for LaForge TC367"
/begin HEADER "Dana" VERSION "0_3_1" /end HEADER
/begin MODULE OpenECU_TC367_001 ""
/* Scalar measurable for DDE 'AnyECUWakeSignal'. */
/begin MEASUREMENT AnyECUWakeSignal "OR of Ignition>Threshold, CANWAKE, PilotWake, or internal PowerHold" UBYTE CU_ANYECUWAKESIGNAL 1 100 0.0 1.0 ECU_ADDRESS 0x70019f0e BYTE_ORDER MSB_LAST /end MEASUREMENT
/begin COMPU_METHOD CU_ANYECUWAKESIGNAL "Conversion method for AnyECUWakeSignal" RAT_FUNC "%10.0" "(not defined)" COEFFS 0.000000 1.000000 -0.000000 0.000000 0.000000 1.000000 /end COMPU_METHOD
/* Scalar measurable for DDE 'CANBusStatus'. */
/begin MEASUREMENT CANBusStatus "(not defined)" FLOAT32_IEEE CU_CANBUSSTATUS 1 100 0.0 1.0 ECU_ADDRESS 0x70019f6c BYTE_ORDER MSB_LAST /end MEASUREMENT
/begin COMPU_METHOD CU_CANBUSSTATUS "Conversion method for CANBusStatus" RAT_FUNC "%10.0" "(not defined)" COEFFS 0.000000 1.000000 -0.000000 0.000000 0.000000 1.000000 /end COMPU_METHOD
/* Scalar measurable for DDE 'CmdCANAWAKE'. */
/begin MEASUREMENT CmdCANAWAKE "EcuRunning OR NotShutdownFromLowBatt" UBYTE CU_CMDCANAWAKE 1 100 0.0 255.0 ECU_ADDRESS 0x7001a15c BYTE_ORDER MSB_LAST /end MEASUREMENT
/begin COMPU_METHOD CU_CMDCANAWAKE "Conversion method for CmdCANAWAKE" RAT_FUNC "%10.0" "(not defined)" COEFFS 0.000000 1.000000 -0.000000 0.000000 0.000000 1.000000 /end COMPU_METHOD
/* Scalar measurable for DDE 'DynamicModeEn'. */
/begin MEASUREMENT DynamicModeEn "Flag that indicated whether dynamic mode is enabled from the Service Discovery and Detail Parser" UBYTE CU_DYNAMICMODEEN 1 100 0.0 1.0 ECU_ADDRESS 0x70017c97 BYTE_ORDER MSB_LAST /end MEASUREMENT
/begin COMPU_METHOD CU_DYNAMICMODEEN "Conversion method for DynamicModeEn" RAT_FUNC "%10.0" "b" COEFFS 0.000000 1.000000 -0.000000 0.000000 0.000000 1.000000 /end COMPU_METHOD
/* Scalar measurable for DDE 'EcuRunning'. */
/begin MEASUREMENT EcuRunning "Signal for ECU running flag." UBYTE CU_ECURUNNING 1 100 0.0 1.0 ECU_ADDRESS 0x70019ecd BYTE_ORDER MSB_LAST /end MEASUREMENT
/begin COMPU_METHOD CU_ECURUNNING "Conversion method for EcuRunning" RAT_FUNC "%10.0" "(not defined)" COEFFS 0.000000 1.000000 -0.000000 0.000000 0.000000 1.000000 /end COMPU_METHOD
/* Scalar measurable for DDE 'HostAllChargeRelaysClosed'. */
/begin MEASUREMENT HostAllChargeRelaysClosed "(not defined)" UBYTE CU_HOSTALLCHARGERELAYSCLOSED 1 100 0.0 1.0 ECU_ADDRESS 0x70017dcd BYTE_ORDER MSB_LAST /end MEASUREMENT
/begin COMPU_METHOD CU_HOSTALLCHARGERELAYSCLOSED "Conversion method for HostAllChargeRelaysClosed" RAT_FUNC "%10.0" "b" COEFFS 0.000000 1.000000 -0.000000 0.000000 0.000000 1.000000 /end COMPU_METHOD
/* Scalar measurable for DDE 'HostChargeInletLockStatus'. */
/begin MEASUREMENT HostChargeInletLockStatus "(not defined)" UBYTE CU_HOSTCHARGEINLETLOCKSTATUS 1 100 0.0 1.0 ECU_ADDRESS 0x70017c53 BYTE_ORDER MSB_LAST /end MEASUREMENT
/begin COMPU_METHOD CU_HOSTCHARGEINLETLOCKSTATUS "Conversion method for HostChargeInletLockStatus" RAT_FUNC "%10.0" "b" COEFFS 0.000000 1.000000 -0.000000 0.000000 0.000000 1.000000 /end COMPU_METHOD
/* Scalar measurable for DDE 'HostDesiredEgyTrnsfrMde'. */
/begin MEASUREMENT HostDesiredEgyTrnsfrMde "Exported global for desired energy transfer mode priority from Host (post-override)." UBYTE CU_HOSTDESIREDEGYTRNSFRMDE 1 100 0.0 255.0 ECU_ADDRESS 0x70017d8e BYTE_ORDER MSB_LAST /end MEASUREMENT
/begin COMPU_METHOD CU_HOSTDESIREDEGYTRNSFRMDE "Conversion method for HostDesiredEgyTrnsfrMde" RAT_FUNC "%10.0" "e" COEFFS 0.000000 1.000000 -0.000000 0.000000 0.000000 1.000000 /end COMPU_METHOD
/* Scalar measurable for DDE 'Iso2AuthEvseProcessing'. */
/begin MEASUREMENT Iso2AuthEvseProcessing "Indicates that the EVSE has either finished or still in process of finishing the processing that was started after the AuthorizationReq message" UBYTE CU_ISO2AUTHEVSEPROCESSING 1 100 0.0 255.0 ECU_ADDRESS 0x70017ecc BYTE_ORDER MSB_LAST /end MEASUREMENT
/begin COMPU_METHOD CU_ISO2AUTHEVSEPROCESSING "Conversion method for Iso2AuthEvseProcessing" RAT_FUNC "%10.0" "1" COEFFS 0.000000 1.000000 -0.000000 0.000000 0.000000 1.000000 /end COMPU_METHOD
/* Scalar measurable for DDE 'Iso2AuthEvseStatPres'. */
/begin MEASUREMENT Iso2AuthEvseStatPres "Indicates the presence of the EVSENotificationMaxDelay and EVSENotification parameters in the AuthorizationRes message" UBYTE CU_ISO2AUTHEVSESTATPRES 1 100 0.0 1.0 ECU_ADDRESS 0x70018327 BYTE_ORDER MSB_LAST /end MEASUREMENT
/begin COMPU_METHOD CU_ISO2AUTHEVSESTATPRES "Conversion method for Iso2AuthEvseStatPres" RAT_FUNC "%10.0" "b" COEFFS 0.000000 1.000000 -0.000000 0.000000 0.000000 1.000000 /end COMPU_METHOD
/* Scalar measurable for DDE 'Iso2AuthNotif'. */
/begin MEASUREMENT Iso2AuthNotif "Indicates action SECC wants the EVSE to perform in the Authorization message" UBYTE CU_ISO2AUTHNOTIF 1 100 0.0 255.0 ECU_ADDRESS 0x70017e30 BYTE_ORDER MSB_LAST /end MEASUREMENT
/begin COMPU_METHOD CU_ISO2AUTHNOTIF "Conversion method for Iso2AuthNotif" RAT_FUNC "%10.0" "1" COEFFS 0.000000 1.000000 -0.000000 0.000000 0.000000 1.000000 /end COMPU_METHOD
/* Scalar measurable for DDE 'Iso2AuthNotifMaxDelay'. */
/begin MEASUREMENT Iso2AuthNotifMaxDelay "Indicates the time until the SECC expects the EVCC to react on the EVSENotification action set in the AuthorizationRes message" UWORD CU_ISO2AUTHNOTIFMAXDELAY 1 100 0.0 65535.0 ECU_ADDRESS 0x70018282 BYTE_ORDER MSB_LAST /end MEASUREMENT
/begin COMPU_METHOD CU_ISO2AUTHNOTIFMAXDELAY "Conversion method for Iso2AuthNotifMaxDelay" RAT_FUNC "%10.0" "1" COEFFS 0.000000 1.000000 -0.000000 0.000000 0.000000 1.000000 /end COMPU_METHOD
/* Scalar measurable for DDE 'Iso2AuthRescode'. */
/begin MEASUREMENT Iso2AuthRescode "for ISOv2 AuthorizationRes message: indicates the acknowledgment status of this V2G messages received by the SECC." UBYTE CU_ISO2AUTHRESCODE 1 100 0.0 255.0 ECU_ADDRESS 0x70017d94 BYTE_ORDER MSB_LAST /end MEASUREMENT
/begin COMPU_METHOD CU_ISO2AUTHRESCODE "Conversion method for Iso2AuthRescode" RAT_FUNC "%10.0" "1" COEFFS 0.000000 1.000000 -0.000000 0.000000 0.000000 1.000000 /end COMPU_METHOD
/* Scalar measurable for DDE 'Iso2AuthRxTrg'. */
/begin MEASUREMENT Iso2AuthRxTrg "Trigger flag that on a rising edge indicates the event for receiving the PLC (V2G) AuthorizationRes message from the EVSE" UBYTE CU_ISO2AUTHRXTRG 1 100 0.0 1.0 ECU_ADDRESS 0x700181c0 BYTE_ORDER MSB_LAST /end MEASUREMENT
/begin COMPU_METHOD CU_ISO2AUTHRXTRG "Conversion method for Iso2AuthRxTrg" RAT_FUNC "%10.0" "b" COEFFS 0.000000 1.000000 -0.000000 0.000000 0.000000 1.000000 /end COMPU_METHOD
/* Scalar measurable for DDE 'Iso2BPTCtrlEvseCrntLimAchvd'. */
/begin MEASUREMENT Iso2BPTCtrlEvseCrntLimAchvd "for ISOv2 DC_BPTControlRes message: Indicates that the charger is at its current limit" UBYTE CU_ISO2BPTCTRLEVSECRNTLIMACHVD 1 100 0.0 1.0 ECU_ADDRESS 0x70017ca4 BYTE_ORDER MSB_LAST /end MEASUREMENT
/begin COMPU_METHOD CU_ISO2BPTCTRLEVSECRNTLIMACHVD "Conversion method for Iso2BPTCtrlEvseCrntLimAchvd" RAT_FUNC "%10.0" "b" COEFFS 0.000000 1.000000 -0.000000 0.000000 0.000000 1.000000 /end COMPU_METHOD
/* Scalar measurable for DDE 'Iso2BPTCtrlEvseIdLen'. */
/begin MEASUREMENT Iso2BPTCtrlEvseIdLen "for ISOv2 DC_BPTControlRes message: Actual number of characters in the EVSE ID" UBYTE CU_ISO2BPTCTRLEVSEIDLEN 1 100 0.0 255.0 ECU_ADDRESS 0x70017c1e BYTE_ORDER MSB_LAST /end MEASUREMENT
/begin COMPU_METHOD CU_ISO2BPTCTRLEVSEIDLEN "Conversion method for Iso2BPTCtrlEvseIdLen" RAT_FUNC "%10.0" "1" COEFFS 0.000000 1.000000 -0.000000 0.000000 0.000000 1.000000 /end COMPU_METHOD
/* Scalar measurable for DDE 'Iso2BPTCtrlEvseId[0]'. */
/begin MEASUREMENT Iso2BPTCtrlEvseId[0] "for ISOv2 DC_BPTControlRes message: The ID that uniquely identifies the EVSE. Format is defined in the ISO 15118 ED2 Spec Annex H" UBYTE CU_ISO2BPTCTRLEVSEID[0] 1 100 0.0 255.0 ECU_ADDRESS 0x700180f5 BYTE_ORDER MSB_LAST /end MEASUREMENT
/begin COMPU_METHOD CU_ISO2BPTCTRLEVSEID[0] "Conversion method for Iso2BPTCtrlEvseId[0]" RAT_FUNC "%10.0" "1" COEFFS 0.000000 1.000000 -0.000000 0.000000 0.000000 1.000000 /end COMPU_METHOD
/* Scalar measurable for DDE 'Iso2BPTCtrlEvseId[10]'. */
/begin MEASUREMENT Iso2BPTCtrlEvseId[10] "for ISOv2 DC_BPTControlRes message: The ID that uniquely identifies the EVSE. Format is defined in the ISO 15118 ED2 Spec Annex H" UBYTE CU_ISO2BPTCTRLEVSEID[10] 1 100 0.0 255.0 ECU_ADDRESS 0x700180ff BYTE_ORDER MSB_LAST /end MEASUREMENT
/begin COMPU_METHOD CU_ISO2BPTCTRLEVSEID[10] "Conversion method for Iso2BPTCtrlEvseId[10]" RAT_FUNC "%10.0" "1" COEFFS 0.000000 1.000000 -0.000000 0.000000 0.000000 1.000000 /end COMPU_METHOD
/* Scalar measurable for DDE 'Iso2BPTCtrlEvseId[11]'. */
/begin MEASUREMENT Iso2BPTCtrlEvseId[11] "for ISOv2 DC_BPTControlRes message: The ID that uniquely identifies the EVSE. Format is defined in the ISO 15118 ED2 Spec Annex H" UBYTE CU_ISO2BPTCTRLEVSEID[11] 1 100 0.0 255.0 ECU_ADDRESS 0x70018100 BYTE_ORDER MSB_LAST /end MEASUREMENT
/begin COMPU_METHOD CU_ISO2BPTCTRLEVSEID[11] "Conversion method for Iso2BPTCtrlEvseId[11]" RAT_FUNC "%10.0" "1" COEFFS 0.000000 1.000000 -0.000000 0.000000 0.000000 1.000000 /end COMPU_METHOD
/* Scalar measurable for DDE 'Iso2BPTCtrlEvseId[12]'. */
/begin MEASUREMENT Iso2BPTCtrlEvseId[12] "for ISOv2 DC_BPTControlRes message: The ID that uniquely identifies the EVSE. Format is defined in the ISO 15118 ED2 Spec Annex H" UBYTE CU_ISO2BPTCTRLEVSEID[12] 1 100 0.0 255.0 ECU_ADDRESS 0x70018101 BYTE_ORDER MSB_LAST /end MEASUREMENT
/begin COMPU_METHOD CU_ISO2BPTCTRLEVSEID[12] "Conversion method for Iso2BPTCtrlEvseId[12]" RAT_FUNC "%10.0" "1" COEFFS 0.000000 1.000000 -0.000000 0.000000 0.000000 1.000000 /end COMPU_METHOD
/* Scalar measurable for DDE 'Iso2BPTCtrlEvseId[13]'. */
/begin MEASUREMENT Iso2BPTCtrlEvseId[13] "for ISOv2 DC_BPTControlRes message: The ID that uniquely identifies the EVSE. Format is defined in the ISO 15118 ED2 Spec Annex H" UBYTE CU_ISO2BPTCTRLEVSEID[13] 1 100 0.0 255.0 ECU_ADDRESS 0x70018102 BYTE_ORDER MSB_LAST /end MEASUREMENT
/begin COMPU_METHOD CU_ISO2BPTCTRLEVSEID[13] "Conversion method for Iso2BPTCtrlEvseId[13]" RAT_FUNC "%10.0" "1" COEFFS 0.000000 1.000000 -0.000000 0.000000 0.000000 1.000000 /end COMPU_METHOD
/* Scalar measurable for DDE 'Iso2BPTCtrlEvseId[14]'. */
/begin MEASUREMENT Iso2BPTCtrlEvseId[14] "for ISOv2 DC_BPTControlRes message: The ID that uniquely identifies the EVSE. Format is defined in the ISO 15118 ED2 Spec Annex H" UBYTE CU_ISO2BPTCTRLEVSEID[14] 1 100 0.0 255.0 ECU_ADDRESS 0x70018103 BYTE_ORDER MSB_LAST /end MEASUREMENT
/begin COMPU_METHOD CU_ISO2BPTCTRLEVSEID[14] "Conversion method for Iso2BPTCtrlEvseId[14]" RAT_FUNC "%10.0" "1" COEFFS 0.000000 1.000000 -0.000000 0.000000 0.000000 1.000000 /end COMPU_METHOD
/* Scalar measurable for DDE 'Iso2BPTCtrlEvseId[15]'. */
/begin MEASUREMENT Iso2BPTCtrlEvseId[15] "for ISOv2 DC_BPTControlRes message: The ID that uniquely identifies the EVSE. Format is defined in the ISO 15118 ED2 Spec Annex H" UBYTE CU_ISO2BPTCTRLEVSEID[15] 1 100 0.0 255.0 ECU_ADDRESS 0x70018104 BYTE_ORDER MSB_LAST /end MEASUREMENT
/begin COMPU_METHOD CU_ISO2BPTCTRLEVSEID[15] "Conversion method for Iso2BPTCtrlEvseId[15]" RAT_FUNC "%10.0" "1" COEFFS 0.000000 1.000000 -0.000000 0.000000 0.000000 1.000000 /end COMPU_METHOD
/* Scalar measurable for DDE 'Iso2BPTCtrlEvseId[16]'. */
/begin MEASUREMENT Iso2BPTCtrlEvseId[16] "for ISOv2 DC_BPTControlRes message: The ID that uniquely identifies the EVSE. Format is defined in the ISO 15118 ED2 Spec Annex H" UBYTE CU_ISO2BPTCTRLEVSEID[16] 1 100 0.0 255.0 ECU_ADDRESS 0x70018105 BYTE_ORDER MSB_LAST /end MEASUREMENT
/begin COMPU_METHOD CU_ISO2BPTCTRLEVSEID[16] "Conversion method for Iso2BPTCtrlEvseId[16]" RAT_FUNC "%10.0" "1" COEFFS 0.000000 1.000000 -0.000000 0.000000 0.000000 1.000000 /end COMPU_METHOD
/* Scalar measurable for DDE 'Iso2BPTCtrlEvseId[17]'. */
/begin MEASUREMENT Iso2BPTCtrlEvseId[17] "for ISOv2 DC_BPTControlRes message: The ID that uniquely identifies the EVSE. Format is defined in the ISO 15118 ED2 Spec Annex H" UBYTE CU_ISO2BPTCTRLEVSEID[17] 1 100 0.0 255.0 ECU_ADDRESS 0x70018106 BYTE_ORDER MSB_LAST /end MEASUREMENT
/begin COMPU_METHOD CU_ISO2BPTCTRLEVSEID[17] "Conversion method for Iso2BPTCtrlEvseId[17]" RAT_FUNC "%10.0" "1" COEFFS 0.000000 1.000000 -0.000000 0.000000 0.000000 1.000000 /end COMPU_METHOD
/* Scalar measurable for DDE 'Iso2BPTCtrlEvseId[18]'. */
/begin MEASUREMENT Iso2BPTCtrlEvseId[18] "for ISOv2 DC_BPTControlRes message: The ID that uniquely identifies the EVSE. Format is defined in the ISO 15118 ED2 Spec Annex H" UBYTE CU_ISO2BPTCTRLEVSEID[18] 1 100 0.0 255.0 ECU_ADDRESS 0x70018107 BYTE_ORDER MSB_LAST /end MEASUREMENT
/begin COMPU_METHOD CU_ISO2BPTCTRLEVSEID[18] "Conversion method for Iso2BPTCtrlEvseId[18]" RAT_FUNC "%10.0" "1" COEFFS 0.000000 1.000000 -0.000000 0.000000 0.000000 1.000000 /end COMPU_METHOD
/* Scalar measurable for DDE 'Iso2BPTCtrlEvseId[19]'. */
/begin MEASUREMENT Iso2BPTCtrlEvseId[19] "for ISOv2 DC_BPTControlRes message: The ID that uniquely identifies the EVSE. Format is defined in the ISO 15118 ED2 Spec Annex H" UBYTE CU_ISO2BPTCTRLEVSEID[19] 1 100 0.0 255.0 ECU_ADDRESS 0x70018108 BYTE_ORDER MSB_LAST /end MEASUREMENT
/begin COMPU_METHOD CU_ISO2BPTCTRLEVSEID[19] "Conversion method for Iso2BPTCtrlEvseId[19]" RAT_FUNC "%10.0" "1" COEFFS 0.000000 1.000000 -0.000000 0.000000 0.000000 1.000000 /end COMPU_METHOD
/* Scalar measurable for DDE 'Iso2BPTCtrlEvseId[1]'. */
/begin MEASUREMENT Iso2BPTCtrlEvseId[1] "for ISOv2 DC_BPTControlRes message: The ID that uniquely identifies the EVSE. Format is defined in the ISO 15118 ED2 Spec Annex H" UBYTE CU_ISO2BPTCTRLEVSEID[1] 1 100 0.0 255.0 ECU_ADDRESS 0x700180f6 BYTE_ORDER MSB_LAST /end MEASUREMENT
/begin COMPU_METHOD CU_ISO2BPTCTRLEVSEID[1] "Conversion method for Iso2BPTCtrlEvseId[1]" RAT_FUNC "%10.0" "1" COEFFS 0.000000 1.000000 -0.000000 0.000000 0.000000 1.000000 /end COMPU_METHOD
/* Scalar measurable for DDE 'Iso2BPTCtrlEvseId[20]'. */
/begin MEASUREMENT Iso2BPTCtrlEvseId[20] "for ISOv2 DC_BPTControlRes message: The ID that uniquely identifies the EVSE. Format is defined in the ISO 15118 ED2 Spec Annex H" UBYTE CU_ISO2BPTCTRLEVSEID[20] 1 100 0.0 255.0 ECU_ADDRESS 0x70018109 BYTE_ORDER MSB_LAST /end MEASUREMENT
/begin COMPU_METHOD CU_ISO2BPTCTRLEVSEID[20] "Conversion method for Iso2BPTCtrlEvseId[20]" RAT_FUNC "%10.0" "1" COEFFS 0.000000 1.000000 -0.000000 0.000000 0.000000 1.000000 /end COMPU_METHOD
/* Scalar measurable for DDE 'Iso2BPTCtrlEvseId[21]'. */
/begin MEASUREMENT Iso2BPTCtrlEvseId[21] "for ISOv2 DC_BPTControlRes message: The ID that uniquely identifies the EVSE. Format is defined in the ISO 15118 ED2 Spec Annex H" UBYTE CU_ISO2BPTCTRLEVSEID[21] 1 100 0.0 255.0 ECU_ADDRESS 0x7001810a BYTE_ORDER MSB_LAST /end MEASUREMENT
/begin COMPU_METHOD CU_ISO2BPTCTRLEVSEID[21] "Conversion method for Iso2BPTCtrlEvseId[21]" RAT_FUNC "%10.0" "1" COEFFS 0.000000 1.000000 -0.000000 0.000000 0.000000 1.000000 /end COMPU_METHOD
/* Scalar measurable for DDE 'Iso2BPTCtrlEvseId[22]'. */
/begin MEASUREMENT Iso2BPTCtrlEvseId[22] "for ISOv2 DC_BPTControlRes message: The ID that uniquely identifies the EVSE. Format is defined in the ISO 15118 ED2 Spec Annex H" UBYTE CU_ISO2BPTCTRLEVSEID[22] 1 100 0.0 255.0 ECU_ADDRESS 0x7001810b BYTE_ORDER MSB_LAST /end MEASUREMENT
/begin COMPU_METHOD CU_ISO2BPTCTRLEVSEID[22] "Conversion method for Iso2BPTCtrlEvseId[22]" RAT_FUNC "%10.0" "1" COEFFS 0.000000 1.000000 -0.000000 0.000000 0.000000 1.000000 /end COMPU_METHOD
/* Scalar measurable for DDE 'Iso2BPTCtrlEvseId[23]'. */
/begin MEASUREMENT Iso2BPTCtrlEvseId[23] "for ISOv2 DC_BPTControlRes message: The ID that uniquely identifies the EVSE. Format is defined in the ISO 15118 ED2 Spec Annex H" UBYTE CU_ISO2BPTCTRLEVSEID[23] 1 100 0.0 255.0 ECU_ADDRESS 0x7001810c BYTE_ORDER MSB_LAST /end MEASUREMENT
/begin COMPU_METHOD CU_ISO2BPTCTRLEVSEID[23] "Conversion method for Iso2BPTCtrlEvseId[23]" RAT_FUNC "%10.0" "1" COEFFS 0.000000 1.000000 -0.000000 0.000000 0.000000 1.000000 /end COMPU_METHOD
/* Scalar measurable for DDE 'Iso2BPTCtrlEvseId[24]'. */
/begin MEASUREMENT Iso2BPTCtrlEvseId[24] "for ISOv2 DC_BPTControlRes message: The ID that uniquely identifies the EVSE. Format is defined in the ISO 15118 ED2 Spec Annex H" UBYTE CU_ISO2BPTCTRLEVSEID[24] 1 100 0.0 255.0 ECU_ADDRESS 0x7001810d BYTE_ORDER MSB_LAST /end MEASUREMENT
/begin COMPU_METHOD CU_ISO2BPTCTRLEVSEID[24] "Conversion method for Iso2BPTCtrlEvseId[24]" RAT_FUNC "%10.0" "1" COEFFS 0.000000 1.000000 -0.000000 0.000000 0.000000 1.000000 /end COMPU_METHOD
/* Scalar measurable for DDE 'Iso2BPTCtrlEvseId[25]'. */
/begin MEASUREMENT Iso2BPTCtrlEvseId[25] "for ISOv2 DC_BPTControlRes message: The ID that uniquely identifies the EVSE. Format is defined in the ISO 15118 ED2 Spec Annex H" UBYTE CU_ISO2BPTCTRLEVSEID[25] 1 100 0.0 255.0 ECU_ADDRESS 0x7001810e BYTE_ORDER MSB_LAST /end MEASUREMENT
/begin COMPU_METHOD CU_ISO2BPTCTRLEVSEID[25] "Conversion method for Iso2BPTCtrlEvseId[25]" RAT_FUNC "%10.0" "1" COEFFS 0.000000 1.000000 -0.000000 0.000000 0.000000 1.000000 /end COMPU_METHOD
/* Scalar measurable for DDE 'Iso2BPTCtrlEvseId[26]'. */
/begin MEASUREMENT Iso2BPTCtrlEvseId[26] "for ISOv2 DC_BPTControlRes message: The ID that uniquely identifies the EVSE. Format is defined in the ISO 15118 ED2 Spec Annex H" UBYTE CU_ISO2BPTCTRLEVSEID[26] 1 100 0.0 255.0 ECU_ADDRESS 0x7001810f BYTE_ORDER MSB_LAST /end MEASUREMENT
/begin COMPU_METHOD CU_ISO2BPTCTRLEVSEID[26] "Conversion method for Iso2BPTCtrlEvseId[26]" RAT_FUNC "%10.0" "1" COEFFS 0.000000 1.000000 -0.000000 0.000000 0.000000 1.000000 /end COMPU_METHOD
/* Scalar measurable for DDE 'Iso2BPTCtrlEvseId[27]'. */
/begin MEASUREMENT Iso2BPTCtrlEvseId[27] "for ISOv2 DC_BPTControlRes message: The ID that uniquely identifies the EVSE. Format is defined in the ISO 15118 ED2 Spec Annex H" UBYTE CU_ISO2BPTCTRLEVSEID[27] 1 100 0.0 255.0 ECU_ADDRESS 0x70018110 BYTE_ORDER MSB_LAST /end MEASUREMENT
/begin COMPU_METHOD CU_ISO2BPTCTRLEVSEID[27] "Conversion method for Iso2BPTCtrlEvseId[27]" RAT_FUNC "%10.0" "1" COEFFS 0.000000 1.000000 -0.000000 0.000000 0.000000 1.000000 /end COMPU_METHOD
/* Scalar measurable for DDE 'Iso2BPTCtrlEvseId[28]'. */
/begin MEASUREMENT Iso2BPTCtrlEvseId[28] "for ISOv2 DC_BPTControlRes message: The ID that uniquely identifies the EVSE. Format is defined in the ISO 15118 ED2 Spec Annex H" UBYTE CU_ISO2BPTCTRLEVSEID[28] 1 100 0.0 255.0 ECU_ADDRESS 0x70018111 BYTE_ORDER MSB_LAST /end MEASUREMENT
/begin COMPU_METHOD CU_ISO2BPTCTRLEVSEID[28] "Conversion method for Iso2BPTCtrlEvseId[28]" RAT_FUNC "%10.0" "1" COEFFS 0.000000 1.000000 -0.000000 0.000000 0.000000 1.000000 /end COMPU_METHOD
/* Scalar measurable for DDE 'Iso2BPTCtrlEvseId[29]'. */
/begin MEASUREMENT Iso2BPTCtrlEvseId[29] "for ISOv2 DC_BPTControlRes message: The ID that uniquely identifies the EVSE. Format is defined in the ISO 15118 ED2 Spec Annex H" UBYTE CU_ISO2BPTCTRLEVSEID[29] 1 100 0.0 255.0 ECU_ADDRESS 0x70018112 BYTE_ORDER MSB_LAST /end MEASUREMENT
/begin COMPU_METHOD CU_ISO2BPTCTRLEVSEID[29] "Conversion method for Iso2BPTCtrlEvseId[29]" RAT_FUNC "%10.0" "1" COEFFS 0.000000 1.000000 -0.000000 0.000000 0.000000 1.000000 /end COMPU_METHOD
/* Scalar measurable for DDE 'Iso2BPTCtrlEvseId[2]'. */
/begin MEASUREMENT Iso2BPTCtrlEvseId[2] "for ISOv2 DC_BPTControlRes message: The ID that uniquely identifies the EVSE. Format is defined in the ISO 15118 ED2 Spec Annex H" UBYTE CU_ISO2BPTCTRLEVSEID[2] 1 100 0.0 255.0 ECU_ADDRESS 0x700180f7 BYTE_ORDER MSB_LAST /end MEASUREMENT
/begin COMPU_METHOD CU_ISO2BPTCTRLEVSEID[2] "Conversion method for Iso2BPTCtrlEvseId[2]" RAT_FUNC "%10.0" "1" COEFFS 0.000000 1.000000 -0.000000 0.000000 0.000000 1.000000 /end COMPU_METHOD
/* Scalar measurable for DDE 'Iso2BPTCtrlEvseId[30]'. */
/begin MEASUREMENT Iso2BPTCtrlEvseId[30] "for ISOv2 DC_BPTControlRes message: The ID that uniquely identifies the EVSE. Format is defined in the ISO 15118 ED2 Spec Annex H" UBYTE CU_ISO2BPTCTRLEVSEID[30] 1 100 0.0 255.0 ECU_ADDRESS 0x70018113 BYTE_ORDER MSB_LAST /end MEASUREMENT
/begin COMPU_METHOD CU_ISO2BPTCTRLEVSEID[30] "Conversion method for Iso2BPTCtrlEvseId[30]" RAT_FUNC "%10.0" "1" COEFFS 0.000000 1.000000 -0.000000 0.000000 0.000000 1.000000 /end COMPU_METHOD
/* Scalar measurable for DDE 'Iso2BPTCtrlEvseId[31]'. */
/begin MEASUREMENT Iso2BPTCtrlEvseId[31] "for ISOv2 DC_BPTControlRes message: The ID that uniquely identifies the EVSE. Format is defined in the ISO 15118 ED2 Spec Annex H" UBYTE CU_ISO2BPTCTRLEVSEID[31] 1 100 0.0 255.0 ECU_ADDRESS 0x70018114 BYTE_ORDER MSB_LAST /end MEASUREMENT
/begin COMPU_METHOD CU_ISO2BPTCTRLEVSEID[31] "Conversion method for Iso2BPTCtrlEvseId[31]" RAT_FUNC "%10.0" "1" COEFFS 0.000000 1.000000 -0.000000 0.000000 0.000000 1.000000 /end COMPU_METHOD
/* Scalar measurable for DDE 'Iso2BPTCtrlEvseId[32]'. */
/begin MEASUREMENT Iso2BPTCtrlEvseId[32] "for ISOv2 DC_BPTControlRes message: The ID that uniquely identifies the EVSE. Format is defined in the ISO 15118 ED2 Spec Annex H" UBYTE CU_ISO2BPTCTRLEVSEID[32] 1 100 0.0 255.0 ECU_ADDRESS 0x70018115 BYTE_ORDER MSB_LAST /end MEASUREMENT
/begin COMPU_METHOD CU_ISO2BPTCTRLEVSEID[32] "Conversion method for Iso2BPTCtrlEvseId[32]" RAT_FUNC "%10.0" "1" COEFFS 0.000000 1.000000 -0.000000 0.000000 0.000000 1.000000 /end COMPU_METHOD
/* Scalar measurable for DDE 'Iso2BPTCtrlEvseId[33]'. */
/begin MEASUREMENT Iso2BPTCtrlEvseId[33] "for ISOv2 DC_BPTControlRes message: The ID that uniquely identifies the EVSE. Format is defined in the ISO 15118 ED2 Spec Annex H" UBYTE CU_ISO2BPTCTRLEVSEID[33] 1 100 0.0 255.0 ECU_ADDRESS 0x70018116 BYTE_ORDER MSB_LAST /end MEASUREMENT
/begin COMPU_METHOD CU_ISO2BPTCTRLEVSEID[33] "Conversion method for Iso2BPTCtrlEvseId[33]" RAT_FUNC "%10.0" "1" COEFFS 0.000000 1.000000 -0.000000 0.000000 0.000000 1.000000 /end COMPU_METHOD
/* Scalar measurable for DDE 'Iso2BPTCtrlEvseId[34]'. */
/begin MEASUREMENT Iso2BPTCtrlEvseId[34] "for ISOv2 DC_BPTControlRes message: The ID that uniquely identifies the EVSE. Format is defined in the ISO 15118 ED2 Spec Annex H" UBYTE CU_ISO2BPTCTRLEVSEID[34] 1 100 0.0 255.0 ECU_ADDRESS 0x70018117 BYTE_ORDER MSB_LAST /end MEASUREMENT
/begin COMPU_METHOD CU_ISO2BPTCTRLEVSEID[34] "Conversion method for Iso2BPTCtrlEvseId[34]" RAT_FUNC "%10.0" "1" COEFFS 0.000000 1.000000 -0.000000 0.000000 0.000000 1.000000 /end COMPU_METHOD
/* Scalar measurable for DDE 'Iso2BPTCtrlEvseId[35]'. */
/begin MEASUREMENT Iso2BPTCtrlEvseId[35] "for ISOv2 DC_BPTControlRes message: The ID that uniquely identifies the EVSE. Format is defined in the ISO 15118 ED2 Spec Annex H" UBYTE CU_ISO2BPTCTRLEVSEID[35] 1 100 0.0 255.0 ECU_ADDRESS 0x70018118 BYTE_ORDER MSB_LAST /end MEASUREMENT
/begin COMPU_METHOD CU_ISO2BPTCTRLEVSEID[35] "Conversion method for Iso2BPTCtrlEvseId[35]" RAT_FUNC "%10.0" "1" COEFFS 0.000000 1.000000 -0.000000 0.000000 0.000000 1.000000 /end COMPU_METHOD
/* Scalar measurable for DDE 'Iso2BPTCtrlEvseId[36]'. */
/begin MEASUREMENT Iso2BPTCtrlEvseId[36] "for ISOv2 DC_BPTControlRes message: The ID that uniquely identifies the EVSE. Format is defined in the ISO 15118 ED2 Spec Annex H" UBYTE CU_ISO2BPTCTRLEVSEID[36] 1 100 0.0 255.0 ECU_ADDRESS 0x70018119 BYTE_ORDER MSB_LAST /end MEASUREMENT
/begin COMPU_METHOD CU_ISO2BPTCTRLEVSEID[36] "Conversion method for Iso2BPTCtrlEvseId[36]" RAT_FUNC "%10.0" "1" COEFFS 0.000000 1.000000 -0.000000 0.000000 0.000000 1.000000 /end COMPU_METHOD
/* Scalar measurable for DDE 'Iso2BPTCtrlEvseId[37]'. */
/begin MEASUREMENT Iso2BPTCtrlEvseId[37] "for ISOv2 DC_BPTControlRes message: The ID that uniquely identifies the EVSE. Format is defined in the ISO 15118 ED2 Spec Annex H" UBYTE CU_ISO2BPTCTRLEVSEID[37] 1 100 0.0 255.0 ECU_ADDRESS 0x7001811a BYTE_ORDER MSB_LAST /end MEASUREMENT
/begin COMPU_METHOD CU_ISO2BPTCTRLEVSEID[37] "Conversion method for Iso2BPTCtrlEvseId[37]" RAT_FUNC "%10.0" "1" COEFFS 0.000000 1.000000 -0.000000 0.000000 0.000000 1.000000 /end COMPU_METHOD
/* Scalar measurable for DDE 'Iso2BPTCtrlEvseId[3]'. */
/begin MEASUREMENT Iso2BPTCtrlEvseId[3] "for ISOv2 DC_BPTControlRes message: The ID that uniquely identifies the EVSE. Format is defined in the ISO 15118 ED2 Spec Annex H" UBYTE CU_ISO2BPTCTRLEVSEID[3] 1 100 0.0 255.0 ECU_ADDRESS 0x700180f8 BYTE_ORDER MSB_LAST /end MEASUREMENT
/begin COMPU_METHOD CU_ISO2BPTCTRLEVSEID[3] "Conversion method for Iso2BPTCtrlEvseId[3]" RAT_FUNC "%10.0" "1" COEFFS 0.000000 1.000000 -0.000000 0.000000 0.000000 1.000000 /end COMPU_METHOD
/* Scalar measurable for DDE 'Iso2BPTCtrlEvseId[4]'. */
/begin MEASUREMENT Iso2BPTCtrlEvseId[4] "for ISOv2 DC_BPTControlRes message: The ID that uniquely identifies the EVSE. Format is defined in the ISO 15118 ED2 Spec Annex H" UBYTE CU_ISO2BPTCTRLEVSEID[4] 1 100 0.0 255.0 ECU_ADDRESS 0x700180f9 BYTE_ORDER MSB_LAST /end MEASUREMENT
/begin COMPU_METHOD CU_ISO2BPTCTRLEVSEID[4] "Conversion method for Iso2BPTCtrlEvseId[4]" RAT_FUNC "%10.0" "1" COEFFS 0.000000 1.000000 -0.000000 0.000000 0.000000 1.000000 /end COMPU_METHOD
/* Scalar measurable for DDE 'Iso2BPTCtrlEvseId[5]'. */
/begin MEASUREMENT Iso2BPTCtrlEvseId[5] "for ISOv2 DC_BPTControlRes message: The ID that uniquely identifies the EVSE. Format is defined in the ISO 15118 ED2 Spec Annex H" UBYTE CU_ISO2BPTCTRLEVSEID[5] 1 100 0.0 255.0 ECU_ADDRESS 0x700180fa BYTE_ORDER MSB_LAST /end MEASUREMENT
/begin COMPU_METHOD CU_ISO2BPTCTRLEVSEID[5] "Conversion method for Iso2BPTCtrlEvseId[5]" RAT_FUNC "%10.0" "1" COEFFS 0.000000 1.000000 -0.000000 0.000000 0.000000 1.000000 /end COMPU_METHOD
/* Scalar measurable for DDE 'Iso2BPTCtrlEvseId[6]'. */
/begin MEASUREMENT Iso2BPTCtrlEvseId[6] "for ISOv2 DC_BPTControlRes message: The ID that uniquely identifies the EVSE. Format is defined in the ISO 15118 ED2 Spec Annex H" UBYTE CU_ISO2BPTCTRLEVSEID[6] 1 100 0.0 255.0 ECU_ADDRESS 0x700180fb BYTE_ORDER MSB_LAST /end MEASUREMENT
/begin COMPU_METHOD CU_ISO2BPTCTRLEVSEID[6] "Conversion method for Iso2BPTCtrlEvseId[6]" RAT_FUNC "%10.0" "1" COEFFS 0.000000 1.000000 -0.000000 0.000000 0.000000 1.000000 /end COMPU_METHOD
/* Scalar measurable for DDE 'Iso2BPTCtrlEvseId[7]'. */
/begin MEASUREMENT Iso2BPTCtrlEvseId[7] "for ISOv2 DC_BPTControlRes message: The ID that uniquely identifies the EVSE. Format is defined in the ISO 15118 ED2 Spec Annex H" UBYTE CU_ISO2BPTCTRLEVSEID[7] 1 100 0.0 255.0 ECU_ADDRESS 0x700180fc BYTE_ORDER MSB_LAST /end MEASUREMENT
/begin COMPU_METHOD CU_ISO2BPTCTRLEVSEID[7] "Conversion method for Iso2BPTCtrlEvseId[7]" RAT_FUNC "%10.0" "1" COEFFS 0.000000 1.000000 -0.000000 0.000000 0.000000 1.000000 /end COMPU_METHOD
/* Scalar measurable for DDE 'Iso2BPTCtrlEvseId[8]'. */
/begin MEASUREMENT Iso2BPTCtrlEvseId[8] "for ISOv2 DC_BPTControlRes message: The ID that uniquely identifies the EVSE. Format is defined in the ISO 15118 ED2 Spec Annex H" UBYTE CU_ISO2BPTCTRLEVSEID[8] 1 100 0.0 255.0 ECU_ADDRESS 0x700180fd BYTE_ORDER MSB_LAST /end MEASUREMENT
/begin COMPU_METHOD CU_ISO2BPTCTRLEVSEID[8] "Conversion method for Iso2BPTCtrlEvseId[8]" RAT_FUNC "%10.0" "1" COEFFS 0.000000 1.000000 -0.000000 0.000000 0.000000 1.000000 /end COMPU_METHOD
/* Scalar measurable for DDE 'Iso2BPTCtrlEvseId[9]'. */
/begin MEASUREMENT Iso2BPTCtrlEvseId[9] "for ISOv2 DC_BPTControlRes message: The ID that uniquely identifies the EVSE. Format is defined in the ISO 15118 ED2 Spec Annex H" UBYTE CU_ISO2BPTCTRLEVSEID[9] 1 100 0.0 255.0 ECU_ADDRESS 0x700180fe BYTE_ORDER MSB_LAST /end MEASUREMENT
/begin COMPU_METHOD CU_ISO2BPTCTRLEVSEID[9] "Conversion method for Iso2BPTCtrlEvseId[9]" RAT_FUNC "%10.0" "1" COEFFS 0.000000 1.000000 -0.000000 0.000000 0.000000 1.000000 /end COMPU_METHOD
/* Scalar measurable for DDE 'Iso2BPTCtrlEvseMaxChgCrnt'. */
/begin MEASUREMENT Iso2BPTCtrlEvseMaxChgCrnt "for ISOv2 DC_BPTControlRes message: Indicates the maximum charge current the EVSE can deliver" FLOAT32_IEEE CU_ISO2BPTCTRLEVSEMAXCHGCRNT 1 100 -3.40282346639e+38 3.40282346639e+38 ECU_ADDRESS 0x70017fc4 BYTE_ORDER MSB_LAST /end MEASUREMENT
/begin COMPU_METHOD CU_ISO2BPTCTRLEVSEMAXCHGCRNT "Conversion method for Iso2BPTCtrlEvseMaxChgCrnt" RAT_FUNC "%10.0" "%" COEFFS 0.000000 1.000000 -0.000000 0.000000 0.000000 1.000000 /end COMPU_METHOD
/* Scalar measurable for DDE 'Iso2BPTCtrlEvseMaxChgCrntPres'. */
/begin MEASUREMENT Iso2BPTCtrlEvseMaxChgCrntPres "for ISOv2 DC_BPTControlRes message: Indicates the presence of the Iso2BPTCtrlEvseMaxChgCrnt parameter." UBYTE CU_ISO2BPTCTRLEVSEMAXCHGCRNTPR0 1 100 0.0 1.0 ECU_ADDRESS 0x70018444 BYTE_ORDER MSB_LAST /end MEASUREMENT
/begin COMPU_METHOD CU_ISO2BPTCTRLEVSEMAXCHGCRNTPR0 "Conversion method for Iso2BPTCtrlEvseMaxChgCrntPres" RAT_FUNC "%10.0" "b" COEFFS 0.000000 1.000000 -0.000000 0.000000 0.000000 1.000000 /end COMPU_METHOD
/* Scalar measurable for DDE 'Iso2BPTCtrlEvseMaxChgPwr'. */
/begin MEASUREMENT Iso2BPTCtrlEvseMaxChgPwr "for ISOv2 DC_BPTControlRes message: Indicates the maximum charge power the EVSE can deliver." FLOAT32_IEEE CU_ISO2BPTCTRLEVSEMAXCHGPWR 1 100 -3.40282346639e+38 3.40282346639e+38 ECU_ADDRESS 0x70017f10 BYTE_ORDER MSB_LAST /end MEASUREMENT
/begin COMPU_METHOD CU_ISO2BPTCTRLEVSEMAXCHGPWR "Conversion method for Iso2BPTCtrlEvseMaxChgPwr" RAT_FUNC "%10.0" "%" COEFFS 0.000000 1.000000 -0.000000 0.000000 0.000000 1.000000 /end COMPU_METHOD
/* Scalar measurable for DDE 'Iso2BPTCtrlEvseMaxChgPwrPres'. */
/begin MEASUREMENT Iso2BPTCtrlEvseMaxChgPwrPres "for ISOv2 DC_BPTControlRes message: Indicates the presence of the Iso2BPTCtrlEvseMaxChgPwr parameter." UBYTE CU_ISO2BPTCTRLEVSEMAXCHGPWRPRES 1 100 0.0 1.0 ECU_ADDRESS 0x70018381 BYTE_ORDER MSB_LAST /end MEASUREMENT
/begin COMPU_METHOD CU_ISO2BPTCTRLEVSEMAXCHGPWRPRES "Conversion method for Iso2BPTCtrlEvseMaxChgPwrPres" RAT_FUNC "%10.0" "b" COEFFS 0.000000 1.000000 -0.000000 0.000000 0.000000 1.000000 /end COMPU_METHOD
/* Scalar measurable for DDE 'Iso2BPTCtrlEvseMaxDisChgCrnt'. */
/begin MEASUREMENT Iso2BPTCtrlEvseMaxDisChgCrnt "for ISOv2 DC_BPTControlRes message: Indicates the maximum discharge current the EVSE can deliver." FLOAT32_IEEE CU_ISO2BPTCTRLEVSEMAXDISCHGCRNT 1 100 -3.40282346639e+38 3.40282346639e+38 ECU_ADDRESS 0x70017e84 BYTE_ORDER MSB_LAST /end MEASUREMENT
/begin COMPU_METHOD CU_ISO2BPTCTRLEVSEMAXDISCHGCRNT "Conversion method for Iso2BPTCtrlEvseMaxDisChgCrnt" RAT_FUNC "%10.0" "%" COEFFS 0.000000 1.000000 -0.000000 0.000000 0.000000 1.000000 /end COMPU_METHOD
/* Scalar measurable for DDE 'Iso2BPTCtrlEvseMaxDisChgPwr'. */
/begin MEASUREMENT Iso2BPTCtrlEvseMaxDisChgPwr "for ISOv2 DC_BPTControlRes message: Indicates the maximum discharge power the EVSE can deliver." FLOAT32_IEEE CU_ISO2BPTCTRLEVSEMAXDISCHGPWR 1 100 -3.40282346639e+38 3.40282346639e+38 ECU_ADDRESS 0x700182cc BYTE_ORDER MSB_LAST /end MEASUREMENT
/begin COMPU_METHOD CU_ISO2BPTCTRLEVSEMAXDISCHGPWR "Conversion method for Iso2BPTCtrlEvseMaxDisChgPwr" RAT_FUNC "%10.0" "%" COEFFS 0.000000 1.000000 -0.000000 0.000000 0.000000 1.000000 /end COMPU_METHOD
/* Scalar measurable for DDE 'Iso2BPTCtrlEvseMaxVolt'. */
/begin MEASUREMENT Iso2BPTCtrlEvseMaxVolt "for ISOv2 DC_BPTControlRes message: Indicates the maximum voltage the EVSE can deliver" FLOAT32_IEEE CU_ISO2BPTCTRLEVSEMAXVOLT 1 100 -3.40282346639e+38 3.40282346639e+38 ECU_ADDRESS 0x70017ddc BYTE_ORDER MSB_LAST /end MEASUREMENT
/begin COMPU_METHOD CU_ISO2BPTCTRLEVSEMAXVOLT "Conversion method for Iso2BPTCtrlEvseMaxVolt" RAT_FUNC "%10.0" "%" COEFFS 0.000000 1.000000 -0.000000 0.000000 0.000000 1.000000 /end COMPU_METHOD
/* Scalar measurable for DDE 'Iso2BPTCtrlEvseMaxVoltPres'. */
/begin MEASUREMENT Iso2BPTCtrlEvseMaxVoltPres "for ISOv2 DC_BPTControlRes message: Indicates the presence of the Iso2BPTCtrlEvseMaxVolt parameter" UBYTE CU_ISO2BPTCTRLEVSEMAXVOLTPRES 1 100 0.0 1.0 ECU_ADDRESS 0x70018237 BYTE_ORDER MSB_LAST /end MEASUREMENT
/begin COMPU_METHOD CU_ISO2BPTCTRLEVSEMAXVOLTPRES "Conversion method for Iso2BPTCtrlEvseMaxVoltPres" RAT_FUNC "%10.0" "b" COEFFS 0.000000 1.000000 -0.000000 0.000000 0.000000 1.000000 /end COMPU_METHOD
/* Scalar measurable for DDE 'Iso2BPTCtrlEvseMinVolt'. */
/begin MEASUREMENT Iso2BPTCtrlEvseMinVolt "for ISOv2 DC_BPTControlRes message: Indicates the minimum voltage the EVSE can deliver." FLOAT32_IEEE CU_ISO2BPTCTRLEVSEMINVOLT 1 100 -3.40282346639e+38 3.40282346639e+38 ECU_ADDRESS 0x70017d34 BYTE_ORDER MSB_LAST /end MEASUREMENT
/begin COMPU_METHOD CU_ISO2BPTCTRLEVSEMINVOLT "Conversion method for Iso2BPTCtrlEvseMinVolt" RAT_FUNC "%10.0" "%" COEFFS 0.000000 1.000000 -0.000000 0.000000 0.000000 1.000000 /end COMPU_METHOD
/* Scalar measurable for DDE 'Iso2BPTCtrlEvseMinVoltPres'. */
/begin MEASUREMENT Iso2BPTCtrlEvseMinVoltPres "for ISOv2 DC_BPTControlRes message: Indicates the presence of the Iso2BPTCtrlEvseMinVolt parameter" UBYTE CU_ISO2BPTCTRLEVSEMINVOLTPRES 1 100 0.0 1.0 ECU_ADDRESS 0x70018186 BYTE_ORDER MSB_LAST /end MEASUREMENT
/begin COMPU_METHOD CU_ISO2BPTCTRLEVSEMINVOLTPRES "Conversion method for Iso2BPTCtrlEvseMinVoltPres" RAT_FUNC "%10.0" "b" COEFFS 0.000000 1.000000 -0.000000 0.000000 0.000000 1.000000 /end COMPU_METHOD
/* Scalar measurable for DDE 'Iso2BPTCtrlEvsePresCrnt'. */
/begin MEASUREMENT Iso2BPTCtrlEvsePresCrnt "for ISOv2 DC_BPTControlRes message: Indicates the measured High Voltage DC (HVDC) current at the output of the DC Supply through the charge coupler" FLOAT32_IEEE CU_ISO2BPTCTRLEVSEPRESCRNT 1 100 -3.40282346639e+38 3.40282346639e+38 ECU_ADDRESS 0x70017c5c BYTE_ORDER MSB_LAST /end MEASUREMENT
/begin COMPU_METHOD CU_ISO2BPTCTRLEVSEPRESCRNT "Conversion method for Iso2BPTCtrlEvsePresCrnt" RAT_FUNC "%10.0" "%" COEFFS 0.000000 1.000000 -0.000000 0.000000 0.000000 1.000000 /end COMPU_METHOD
/* Scalar measurable for DDE 'Iso2BPTCtrlEvsePresVolt'. */
/begin MEASUREMENT Iso2BPTCtrlEvsePresVolt "for ISOv2 DC_BPTControlRes message: Indicates the measured High Voltage DC (HVDC) voltage at the output of the DC Supply" FLOAT32_IEEE CU_ISO2BPTCTRLEVSEPRESVOLT 1 100 -3.40282346639e+38 3.40282346639e+38 ECU_ADDRESS 0x70018048 BYTE_ORDER MSB_LAST /end MEASUREMENT
/begin COMPU_METHOD CU_ISO2BPTCTRLEVSEPRESVOLT "Conversion method for Iso2BPTCtrlEvsePresVolt" RAT_FUNC "%10.0" "%" COEFFS 0.000000 1.000000 -0.000000 0.000000 0.000000 1.000000 /end COMPU_METHOD
/* Scalar measurable for DDE 'Iso2BPTCtrlEvseStatPres'. */
/begin MEASUREMENT Iso2BPTCtrlEvseStatPres "Indicates the presence of the EVSENotificationMaxDelay and EVSENotification parameters in the DC_BPTControlRes message" UBYTE CU_ISO2BPTCTRLEVSESTATPRES 1 100 0.0 1.0 ECU_ADDRESS 0x70018482 BYTE_ORDER MSB_LAST /end MEASUREMENT
/begin COMPU_METHOD CU_ISO2BPTCTRLEVSESTATPRES "Conversion method for Iso2BPTCtrlEvseStatPres" RAT_FUNC "%10.0" "b" COEFFS 0.000000 1.000000 -0.000000 0.000000 0.000000 1.000000 /end COMPU_METHOD
/* Scalar measurable for DDE 'Iso2BPTCtrlEvseVoltLimAchvd'. */
/begin MEASUREMENT Iso2BPTCtrlEvseVoltLimAchvd "for ISOv2 DC_BPTControlRes message: Indicates hat the charger is at its voltage limit" UBYTE CU_ISO2BPTCTRLEVSEVOLTLIMACHVD 1 100 0.0 1.0 ECU_ADDRESS 0x70017f80 BYTE_ORDER MSB_LAST /end MEASUREMENT
/begin COMPU_METHOD CU_ISO2BPTCTRLEVSEVOLTLIMACHVD "Conversion method for Iso2BPTCtrlEvseVoltLimAchvd" RAT_FUNC "%10.0" "b" COEFFS 0.000000 1.000000 -0.000000 0.000000 0.000000 1.000000 /end COMPU_METHOD
/* Scalar measurable for DDE 'Iso2BPTCtrlMaxDisChgCrntPres'. */
/begin MEASUREMENT Iso2BPTCtrlMaxDisChgCrntPres "for ISOv2 DC_BPTControlRes message: Indicates the presence of the Iso2BPTCtrlEvseMaxDisChgCrnt parameter." UBYTE CU_ISO2BPTCTRLMAXDISCHGCRNTPRES 1 100 0.0 1.0 ECU_ADDRESS 0x700183bc BYTE_ORDER MSB_LAST /end MEASUREMENT
/begin COMPU_METHOD CU_ISO2BPTCTRLMAXDISCHGCRNTPRES "Conversion method for Iso2BPTCtrlMaxDisChgCrntPres" RAT_FUNC "%10.0" "b" COEFFS 0.000000 1.000000 -0.000000 0.000000 0.000000 1.000000 /end COMPU_METHOD
/* Scalar measurable for DDE 'Iso2BPTCtrlMaxDisChgPwrPres'. */
/begin MEASUREMENT Iso2BPTCtrlMaxDisChgPwrPres "for ISOv2 DC_BPTControlRes message: Indicates the presence of the Iso2BPTCtrlEvseMaxDisChgPwr parameter." UBYTE CU_ISO2BPTCTRLMAXDISCHGPWRPRES 1 100 0.0 1.0 ECU_ADDRESS 0x70017ecd BYTE_ORDER MSB_LAST /end MEASUREMENT
/begin COMPU_METHOD CU_ISO2BPTCTRLMAXDISCHGPWRPRES "Conversion method for Iso2BPTCtrlMaxDisChgPwrPres" RAT_FUNC "%10.0" "b" COEFFS 0.000000 1.000000 -0.000000 0.000000 0.000000 1.000000 /end COMPU_METHOD
/* Scalar measurable for DDE 'Iso2BPTCtrlNotif'. */
/begin MEASUREMENT Iso2BPTCtrlNotif "Indicates action SECC wants the EVSE to perform in the DC_BPTControlRes message" UBYTE CU_ISO2BPTCTRLNOTIF 1 100 0.0 255.0 ECU_ADDRESS 0x70018328 BYTE_ORDER MSB_LAST /end MEASUREMENT
/begin COMPU_METHOD CU_ISO2BPTCTRLNOTIF "Conversion method for Iso2BPTCtrlNotif" RAT_FUNC "%10.0" "1" COEFFS 0.000000 1.000000 -0.000000 0.000000 0.000000 1.000000 /end COMPU_METHOD
/* Scalar measurable for DDE 'Iso2BPTCtrlNotifMaxDelay'. */
/begin MEASUREMENT Iso2BPTCtrlNotifMaxDelay "Indicates the time until the SECC expects the EVCC to react on the EVSENotification action set in the DC_BPTControlRes message" UWORD CU_ISO2BPTCTRLNOTIFMAXDELAY 1 100 0.0 65535.0 ECU_ADDRESS 0x70017e32 BYTE_ORDER MSB_LAST /end MEASUREMENT
/begin COMPU_METHOD CU_ISO2BPTCTRLNOTIFMAXDELAY "Conversion method for Iso2BPTCtrlNotifMaxDelay" RAT_FUNC "%10.0" "1" COEFFS 0.000000 1.000000 -0.000000 0.000000 0.000000 1.000000 /end COMPU_METHOD
/* Scalar measurable for DDE 'Iso2BPTCtrlRescode'. */
/begin MEASUREMENT Iso2BPTCtrlRescode "for ISOv2 DC_BPTControlRes message: indicates the acknowledgment status of this V2G messages received by the SECC." UBYTE CU_ISO2BPTCTRLRESCODE 1 100 0.0 255.0 ECU_ADDRESS 0x70018284 BYTE_ORDER MSB_LAST /end MEASUREMENT
/begin COMPU_METHOD CU_ISO2BPTCTRLRESCODE "Conversion method for Iso2BPTCtrlRescode" RAT_FUNC "%10.0" "1" COEFFS 0.000000 1.000000 -0.000000 0.000000 0.000000 1.000000 /end COMPU_METHOD
/* Scalar measurable for DDE 'Iso2BPTCtrlRxTrg'. */
/begin MEASUREMENT Iso2BPTCtrlRxTrg "Trigger flag that on a rising edge indicates the event for receiving the PLC (V2G) DC_BPTControlRes message from the EVSE" UBYTE CU_ISO2BPTCTRLRXTRG 1 100 0.0 1.0 ECU_ADDRESS 0x70017d95 BYTE_ORDER MSB_LAST /end MEASUREMENT
/begin COMPU_METHOD CU_ISO2BPTCTRLRXTRG "Conversion method for Iso2BPTCtrlRxTrg" RAT_FUNC "%10.0" "b" COEFFS 0.000000 1.000000 -0.000000 0.000000 0.000000 1.000000 /end COMPU_METHOD
/* Scalar measurable for DDE 'Iso2BPTCtrlSaSchTupId'. */
/begin MEASUREMENT Iso2BPTCtrlSaSchTupId "for ISOv2 DC_BPTControlRes message: Represents the unique identifier within a charging session for a SAScheduleTuple element" UBYTE CU_ISO2BPTCTRLSASCHTUPID 1 100 0.0 255.0 ECU_ADDRESS 0x700181c1 BYTE_ORDER MSB_LAST /end MEASUREMENT
/begin COMPU_METHOD CU_ISO2BPTCTRLSASCHTUPID "Conversion method for Iso2BPTCtrlSaSchTupId" RAT_FUNC "%10.0" "1" COEFFS 0.000000 1.000000 -0.000000 0.000000 0.000000 1.000000 /end COMPU_METHOD
/* Scalar measurable for DDE 'Iso2BPTCtrlSaSchTupIdPres'. */
/begin MEASUREMENT Iso2BPTCtrlSaSchTupIdPres "for ISOv2 DC_BPTControlRes message: Indicates the presence of the SA Schedule Tuple ID parameter." UBYTE CU_ISO2BPTCTRLSASCHTUPIDPRES 1 100 0.0 1.0 ECU_ADDRESS 0x70017ca5 BYTE_ORDER MSB_LAST /end MEASUREMENT
/begin COMPU_METHOD CU_ISO2BPTCTRLSASCHTUPIDPRES "Conversion method for Iso2BPTCtrlSaSchTupIdPres" RAT_FUNC "%10.0" "b" COEFFS 0.000000 1.000000 -0.000000 0.000000 0.000000 1.000000 /end COMPU_METHOD
/* Scalar measurable for DDE 'Iso2CblChkEvseProcessing'. */
/begin MEASUREMENT Iso2CblChkEvseProcessing "Indicates that the EVSE has either finished or still in process of finishing the processing that was started after the AuthorizationReq message" UBYTE CU_ISO2CBLCHKEVSEPROCESSING 1 100 0.0 255.0 ECU_ADDRESS 0x7001811b BYTE_ORDER MSB_LAST /end MEASUREMENT
/begin COMPU_METHOD CU_ISO2CBLCHKEVSEPROCESSING "Conversion method for Iso2CblChkEvseProcessing" RAT_FUNC "%10.0" "1" COEFFS 0.000000 1.000000 -0.000000 0.000000 0.000000 1.000000 /end COMPU_METHOD
/* Scalar measurable for DDE 'Iso2CblChkEvseStatPres'. */
/begin MEASUREMENT Iso2CblChkEvseStatPres "Indicates the presence of the EVSENotificationMaxDelay and EVSENotification parameters in the CableCheckRes message" UBYTE CU_ISO2CBLCHKEVSESTATPRES 1 100 0.0 1.0 ECU_ADDRESS 0x70017c1f BYTE_ORDER MSB_LAST /end MEASUREMENT
/begin COMPU_METHOD CU_ISO2CBLCHKEVSESTATPRES "Conversion method for Iso2CblChkEvseStatPres" RAT_FUNC "%10.0" "b" COEFFS 0.000000 1.000000 -0.000000 0.000000 0.000000 1.000000 /end COMPU_METHOD
/* Scalar measurable for DDE 'Iso2CblChkNotif'. */
/begin MEASUREMENT Iso2CblChkNotif "Indicates action SECC wants the EVSE to perform in the CableCheckRes message" UBYTE CU_ISO2CBLCHKNOTIF 1 100 0.0 255.0 ECU_ADDRESS 0x70017fc8 BYTE_ORDER MSB_LAST /end MEASUREMENT
/begin COMPU_METHOD CU_ISO2CBLCHKNOTIF "Conversion method for Iso2CblChkNotif" RAT_FUNC "%10.0" "1" COEFFS 0.000000 1.000000 -0.000000 0.000000 0.000000 1.000000 /end COMPU_METHOD
/* Scalar measurable for DDE 'Iso2CblChkNotifMaxDelay'. */
/begin MEASUREMENT Iso2CblChkNotifMaxDelay "Indicates the time until the SECC expects the EVCC to react on the EVSENotification action set in the CableCheckRes message" UWORD CU_ISO2CBLCHKNOTIFMAXDELAY 1 100 0.0 65535.0 ECU_ADDRESS 0x70018446 BYTE_ORDER MSB_LAST /end MEASUREMENT
/begin COMPU_METHOD CU_ISO2CBLCHKNOTIFMAXDELAY "Conversion method for Iso2CblChkNotifMaxDelay" RAT_FUNC "%10.0" "1" COEFFS 0.000000 1.000000 -0.000000 0.000000 0.000000 1.000000 /end COMPU_METHOD
/* Scalar measurable for DDE 'Iso2CblChkRescode'. */
/begin MEASUREMENT Iso2CblChkRescode "for ISOv2 CableCheckRes message: indicates the acknowledgment status of this V2G messages received by the SECC." UBYTE CU_ISO2CBLCHKRESCODE 1 100 0.0 255.0 ECU_ADDRESS 0x70017f14 BYTE_ORDER MSB_LAST /end MEASUREMENT
/begin COMPU_METHOD CU_ISO2CBLCHKRESCODE "Conversion method for Iso2CblChkRescode" RAT_FUNC "%10.0" "1" COEFFS 0.000000 1.000000 -0.000000 0.000000 0.000000 1.000000 /end COMPU_METHOD
/* Scalar measurable for DDE 'Iso2CblChkRxTrg'. */
/begin MEASUREMENT Iso2CblChkRxTrg "Trigger flag that on a rising edge indicates the event for receiving the PLC (V2G) CableCheckRes message from the EVSE" UBYTE CU_ISO2CBLCHKRXTRG 1 100 0.0 1.0 ECU_ADDRESS 0x70018382 BYTE_ORDER MSB_LAST /end MEASUREMENT
/begin COMPU_METHOD CU_ISO2CBLCHKRXTRG "Conversion method for Iso2CblChkRxTrg" RAT_FUNC "%10.0" "b" COEFFS 0.000000 1.000000 -0.000000 0.000000 0.000000 1.000000 /end COMPU_METHOD
/* Scalar measurable for DDE 'Iso2ChgParDiscDcBptParPres'. */
/begin MEASUREMENT Iso2ChgParDiscDcBptParPres "Indicates the presence of the element that is used by the SECC for initiating the target setting process for DC BPT charging" UBYTE CU_ISO2CHGPARDISCDCBPTPARPRES 1 100 0.0 1.0 ECU_ADDRESS 0x70017e88 BYTE_ORDER MSB_LAST /end MEASUREMENT
/begin COMPU_METHOD CU_ISO2CHGPARDISCDCBPTPARPRES "Conversion method for Iso2ChgParDiscDcBptParPres" RAT_FUNC "%10.0" "b" COEFFS 0.000000 1.000000 -0.000000 0.000000 0.000000 1.000000 /end COMPU_METHOD
/* Scalar measurable for DDE 'Iso2ChgParDiscDcChgParPres'. */
/begin MEASUREMENT Iso2ChgParDiscDcChgParPres "Indicates the presence of the element that is used by the SECC for initiating the target setting process for DC charging" UBYTE CU_ISO2CHGPARDISCDCCHGPARPRES 1 100 0.0 1.0 ECU_ADDRESS 0x700182d0 BYTE_ORDER MSB_LAST /end MEASUREMENT
/begin COMPU_METHOD CU_ISO2CHGPARDISCDCCHGPARPRES "Conversion method for Iso2ChgParDiscDcChgParPres" RAT_FUNC "%10.0" "b" COEFFS 0.000000 1.000000 -0.000000 0.000000 0.000000 1.000000 /end COMPU_METHOD
/* Scalar measurable for DDE 'Iso2ChgParDiscEvseProcessing'. */
/begin MEASUREMENT Iso2ChgParDiscEvseProcessing "Indicates that the EVSE has either finished or still in process of finishing the processing that was started after the ChargeParameterDiscovery message" UBYTE CU_ISO2CHGPARDISCEVSEPROCESSING 1 100 0.0 255.0 ECU_ADDRESS 0x70017de0 BYTE_ORDER MSB_LAST /end MEASUREMENT
/begin COMPU_METHOD CU_ISO2CHGPARDISCEVSEPROCESSING "Conversion method for Iso2ChgParDiscEvseProcessing" RAT_FUNC "%10.0" "1" COEFFS 0.000000 1.000000 -0.000000 0.000000 0.000000 1.000000 /end COMPU_METHOD
/* Scalar measurable for DDE 'Iso2ChgParDiscEvseStatPres'. */
/begin MEASUREMENT Iso2ChgParDiscEvseStatPres "Indicates the presence of the EVSENotificationMaxDelay and EVSENotification parameters in the ChargeParameterDiscovery message" UBYTE CU_ISO2CHGPARDISCEVSESTATPRES 1 100 0.0 1.0 ECU_ADDRESS 0x70018238 BYTE_ORDER MSB_LAST /end MEASUREMENT
/begin COMPU_METHOD CU_ISO2CHGPARDISCEVSESTATPRES "Conversion method for Iso2ChgParDiscEvseStatPres" RAT_FUNC "%10.0" "b" COEFFS 0.000000 1.000000 -0.000000 0.000000 0.000000 1.000000 /end COMPU_METHOD
/* Scalar measurable for DDE 'Iso2ChgParDiscNotif'. */
/begin MEASUREMENT Iso2ChgParDiscNotif "Indicates action SECC wants the EVSE to perform in the ChargeParameterDiscovery message" UBYTE CU_ISO2CHGPARDISCNOTIF 1 100 0.0 255.0 ECU_ADDRESS 0x70017d38 BYTE_ORDER MSB_LAST /end MEASUREMENT
/begin COMPU_METHOD CU_ISO2CHGPARDISCNOTIF "Conversion method for Iso2ChgParDiscNotif" RAT_FUNC "%10.0" "1" COEFFS 0.000000 1.000000 -0.000000 0.000000 0.000000 1.000000 /end COMPU_METHOD
/* Scalar measurable for DDE 'Iso2ChgParDiscNotifMaxDelay'. */
/begin MEASUREMENT Iso2ChgParDiscNotifMaxDelay "Indicates the time until the SECC expects the EVCC to react on the EVSENotification action set in the ChargeParameterDiscovery message" UWORD CU_ISO2CHGPARDISCNOTIFMAXDELAY 1 100 0.0 65535.0 ECU_ADDRESS 0x70018188 BYTE_ORDER MSB_LAST /end MEASUREMENT
/begin COMPU_METHOD CU_ISO2CHGPARDISCNOTIFMAXDELAY "Conversion method for Iso2ChgParDiscNotifMaxDelay" RAT_FUNC "%10.0" "1" COEFFS 0.000000 1.000000 -0.000000 0.000000 0.000000 1.000000 /end COMPU_METHOD
/* Scalar measurable for DDE 'Iso2ChgParDiscRescode'. */
/begin MEASUREMENT Iso2ChgParDiscRescode "for ISOv2 ChargeParameterDiscovery message: indicates the acknowledgment status of this V2G messages received by the SECC." UBYTE CU_ISO2CHGPARDISCRESCODE 1 100 0.0 255.0 ECU_ADDRESS 0x70017c60 BYTE_ORDER MSB_LAST /end MEASUREMENT
/begin COMPU_METHOD CU_ISO2CHGPARDISCRESCODE "Conversion method for Iso2ChgParDiscRescode" RAT_FUNC "%10.0" "1" COEFFS 0.000000 1.000000 -0.000000 0.000000 0.000000 1.000000 /end COMPU_METHOD
/* Scalar measurable for DDE 'Iso2ChgParDiscRxTrg'. */
/begin MEASUREMENT Iso2ChgParDiscRxTrg "Trigger flag that on a rising edge indicates the event for receiving the PLC (V2G) ChargeParameterDiscovery message from the EVSE" UBYTE CU_ISO2CHGPARDISCRXTRG 1 100 0.0 1.0 ECU_ADDRESS 0x7001804c BYTE_ORDER MSB_LAST /end MEASUREMENT
/begin COMPU_METHOD CU_ISO2CHGPARDISCRXTRG "Conversion method for Iso2ChgParDiscRxTrg" RAT_FUNC "%10.0" "b" COEFFS 0.000000 1.000000 -0.000000 0.000000 0.000000 1.000000 /end COMPU_METHOD
/* Scalar measurable for DDE 'Iso2ChgParDiscSaSchListSize'. */
/begin MEASUREMENT Iso2ChgParDiscSaSchListSize "Indicates the number of SAScheduleTuple elements that have been received by the EV" UBYTE CU_ISO2CHGPARDISCSASCHLISTSIZE 1 100 0.0 255.0 ECU_ADDRESS 0x70018483 BYTE_ORDER MSB_LAST /end MEASUREMENT
/begin COMPU_METHOD CU_ISO2CHGPARDISCSASCHLISTSIZE "Conversion method for Iso2ChgParDiscSaSchListSize" RAT_FUNC "%10.0" "1" COEFFS 0.000000 1.000000 -0.000000 0.000000 0.000000 1.000000 /end COMPU_METHOD
/* Scalar measurable for DDE 'Iso2CrntDmdEvseCrntLimAchvd'. */
/begin MEASUREMENT Iso2CrntDmdEvseCrntLimAchvd "Indicates that the charger is at its current limit" UBYTE CU_ISO2CRNTDMDEVSECRNTLIMACHVD 1 100 0.0 1.0 ECU_ADDRESS 0x70017f81 BYTE_ORDER MSB_LAST /end MEASUREMENT
/begin COMPU_METHOD CU_ISO2CRNTDMDEVSECRNTLIMACHVD "Conversion method for Iso2CrntDmdEvseCrntLimAchvd" RAT_FUNC "%10.0" "b" COEFFS 0.000000 1.000000 -0.000000 0.000000 0.000000 1.000000 /end COMPU_METHOD
/* Scalar measurable for DDE 'Iso2CrntDmdEvseIdLen'. */
/begin MEASUREMENT Iso2CrntDmdEvseIdLen "Actual number of characters in the EVSE ID" UBYTE CU_ISO2CRNTDMDEVSEIDLEN 1 100 0.0 255.0 ECU_ADDRESS 0x700183fd BYTE_ORDER MSB_LAST /end MEASUREMENT
/begin COMPU_METHOD CU_ISO2CRNTDMDEVSEIDLEN "Conversion method for Iso2CrntDmdEvseIdLen" RAT_FUNC "%10.0" "1" COEFFS 0.000000 1.000000 -0.000000 0.000000 0.000000 1.000000 /end COMPU_METHOD
/* Scalar measurable for DDE 'Iso2CrntDmdEvseId[0]'. */
/begin MEASUREMENT Iso2CrntDmdEvseId[0] "The ID that uniquely identifies the EVSE. Format is defined in the ISO 15118 ED2 Spec Annex H" UBYTE CU_ISO2CRNTDMDEVSEID[0] 1 100 0.0 255.0 ECU_ADDRESS 0x70017cbd BYTE_ORDER MSB_LAST /end MEASUREMENT
/begin COMPU_METHOD CU_ISO2CRNTDMDEVSEID[0] "Conversion method for Iso2CrntDmdEvseId[0]" RAT_FUNC "%10.0" "1" COEFFS 0.000000 1.000000 -0.000000 0.000000 0.000000 1.000000 /end COMPU_METHOD
/* Scalar measurable for DDE 'Iso2CrntDmdEvseId[10]'. */
/begin MEASUREMENT Iso2CrntDmdEvseId[10] "The ID that uniquely identifies the EVSE. Format is defined in the ISO 15118 ED2 Spec Annex H" UBYTE CU_ISO2CRNTDMDEVSEID[10] 1 100 0.0 255.0 ECU_ADDRESS 0x70017cc7 BYTE_ORDER MSB_LAST /end MEASUREMENT
/begin COMPU_METHOD CU_ISO2CRNTDMDEVSEID[10] "Conversion method for Iso2CrntDmdEvseId[10]" RAT_FUNC "%10.0" "1" COEFFS 0.000000 1.000000 -0.000000 0.000000 0.000000 1.000000 /end COMPU_METHOD
/* Scalar measurable for DDE 'Iso2CrntDmdEvseId[11]'. */
/begin MEASUREMENT Iso2CrntDmdEvseId[11] "The ID that uniquely identifies the EVSE. Format is defined in the ISO 15118 ED2 Spec Annex H" UBYTE CU_ISO2CRNTDMDEVSEID[11] 1 100 0.0 255.0 ECU_ADDRESS 0x70017cc8 BYTE_ORDER MSB_LAST /end MEASUREMENT
/begin COMPU_METHOD CU_ISO2CRNTDMDEVSEID[11] "Conversion method for Iso2CrntDmdEvseId[11]" RAT_FUNC "%10.0" "1" COEFFS 0.000000 1.000000 -0.000000 0.000000 0.000000 1.000000 /end COMPU_METHOD
/* Scalar measurable for DDE 'Iso2CrntDmdEvseId[12]'. */
/begin MEASUREMENT Iso2CrntDmdEvseId[12] "The ID that uniquely identifies the EVSE. Format is defined in the ISO 15118 ED2 Spec Annex H" UBYTE CU_ISO2CRNTDMDEVSEID[12] 1 100 0.0 255.0 ECU_ADDRESS 0x70017cc9 BYTE_ORDER MSB_LAST /end MEASUREMENT
/begin COMPU_METHOD CU_ISO2CRNTDMDEVSEID[12] "Conversion method for Iso2CrntDmdEvseId[12]" RAT_FUNC "%10.0" "1" COEFFS 0.000000 1.000000 -0.000000 0.000000 0.000000 1.000000 /end COMPU_METHOD
/* Scalar measurable for DDE 'Iso2CrntDmdEvseId[13]'. */
/begin MEASUREMENT Iso2CrntDmdEvseId[13] "The ID that uniquely identifies the EVSE. Format is defined in the ISO 15118 ED2 Spec Annex H" UBYTE CU_ISO2CRNTDMDEVSEID[13] 1 100 0.0 255.0 ECU_ADDRESS 0x70017cca BYTE_ORDER MSB_LAST /end MEASUREMENT
/begin COMPU_METHOD CU_ISO2CRNTDMDEVSEID[13] "Conversion method for Iso2CrntDmdEvseId[13]" RAT_FUNC "%10.0" "1" COEFFS 0.000000 1.000000 -0.000000 0.000000 0.000000 1.000000 /end COMPU_METHOD
/* Scalar measurable for DDE 'Iso2CrntDmdEvseId[14]'. */
/begin MEASUREMENT Iso2CrntDmdEvseId[14] "The ID that uniquely identifies the EVSE. Format is defined in the ISO 15118 ED2 Spec Annex H" UBYTE CU_ISO2CRNTDMDEVSEID[14] 1 100 0.0 255.0 ECU_ADDRESS 0x70017ccb BYTE_ORDER MSB_LAST /end MEASUREMENT
/begin COMPU_METHOD CU_ISO2CRNTDMDEVSEID[14] "Conversion method for Iso2CrntDmdEvseId[14]" RAT_FUNC "%10.0" "1" COEFFS 0.000000 1.000000 -0.000000 0.000000 0.000000 1.000000 /end COMPU_METHOD
/* Scalar measurable for DDE 'Iso2CrntDmdEvseId[15]'. */
/begin MEASUREMENT Iso2CrntDmdEvseId[15] "The ID that uniquely identifies the EVSE. Format is defined in the ISO 15118 ED2 Spec Annex H" UBYTE CU_ISO2CRNTDMDEVSEID[15] 1 100 0.0 255.0 ECU_ADDRESS 0x70017ccc BYTE_ORDER MSB_LAST /end MEASUREMENT
/begin COMPU_METHOD CU_ISO2CRNTDMDEVSEID[15] "Conversion method for Iso2CrntDmdEvseId[15]" RAT_FUNC "%10.0" "1" COEFFS 0.000000 1.000000 -0.000000 0.000000 0.000000 1.000000 /end COMPU_METHOD
/* Scalar measurable for DDE 'Iso2CrntDmdEvseId[16]'. */
/begin MEASUREMENT Iso2CrntDmdEvseId[16] "The ID that uniquely identifies the EVSE. Format is defined in the ISO 15118 ED2 Spec Annex H" UBYTE CU_ISO2CRNTDMDEVSEID[16] 1 100 0.0 255.0 ECU_ADDRESS 0x70017ccd BYTE_ORDER MSB_LAST /end MEASUREMENT
/begin COMPU_METHOD CU_ISO2CRNTDMDEVSEID[16] "Conversion method for Iso2CrntDmdEvseId[16]" RAT_FUNC "%10.0" "1" COEFFS 0.000000 1.000000 -0.000000 0.000000 0.000000 1.000000 /end COMPU_METHOD
/* Scalar measurable for DDE 'Iso2CrntDmdEvseId[17]'. */
/begin MEASUREMENT Iso2CrntDmdEvseId[17] "The ID that uniquely identifies the EVSE. Format is defined in the ISO 15118 ED2 Spec Annex H" UBYTE CU_ISO2CRNTDMDEVSEID[17] 1 100 0.0 255.0 ECU_ADDRESS 0x70017cce BYTE_ORDER MSB_LAST /end MEASUREMENT
/begin COMPU_METHOD CU_ISO2CRNTDMDEVSEID[17] "Conversion method for Iso2CrntDmdEvseId[17]" RAT_FUNC "%10.0" "1" COEFFS 0.000000 1.000000 -0.000000 0.000000 0.000000 1.000000 /end COMPU_METHOD
/* Scalar measurable for DDE 'Iso2CrntDmdEvseId[18]'. */
/begin MEASUREMENT Iso2CrntDmdEvseId[18] "The ID that uniquely identifies the EVSE. Format is defined in the ISO 15118 ED2 Spec Annex H" UBYTE CU_ISO2CRNTDMDEVSEID[18] 1 100 0.0 255.0 ECU_ADDRESS 0x70017ccf BYTE_ORDER MSB_LAST /end MEASUREMENT
/begin COMPU_METHOD CU_ISO2CRNTDMDEVSEID[18] "Conversion method for Iso2CrntDmdEvseId[18]" RAT_FUNC "%10.0" "1" COEFFS 0.000000 1.000000 -0.000000 0.000000 0.000000 1.000000 /end COMPU_METHOD
/* Scalar measurable for DDE 'Iso2CrntDmdEvseId[19]'. */
/begin MEASUREMENT Iso2CrntDmdEvseId[19] "The ID that uniquely identifies the EVSE. Format is defined in the ISO 15118 ED2 Spec Annex H" UBYTE CU_ISO2CRNTDMDEVSEID[19] 1 100 0.0 255.0 ECU_ADDRESS 0x70017cd0 BYTE_ORDER MSB_LAST /end MEASUREMENT
/begin COMPU_METHOD CU_ISO2CRNTDMDEVSEID[19] "Conversion method for Iso2CrntDmdEvseId[19]" RAT_FUNC "%10.0" "1" COEFFS 0.000000 1.000000 -0.000000 0.000000 0.000000 1.000000 /end COMPU_METHOD
/* Scalar measurable for DDE 'Iso2CrntDmdEvseId[1]'. */
/begin MEASUREMENT Iso2CrntDmdEvseId[1] "The ID that uniquely identifies the EVSE. Format is defined in the ISO 15118 ED2 Spec Annex H" UBYTE CU_ISO2CRNTDMDEVSEID[1] 1 100 0.0 255.0 ECU_ADDRESS 0x70017cbe BYTE_ORDER MSB_LAST /end MEASUREMENT
/begin COMPU_METHOD CU_ISO2CRNTDMDEVSEID[1] "Conversion method for Iso2CrntDmdEvseId[1]" RAT_FUNC "%10.0" "1" COEFFS 0.000000 1.000000 -0.000000 0.000000 0.000000 1.000000 /end COMPU_METHOD
/* Scalar measurable for DDE 'Iso2CrntDmdEvseId[20]'. */
/begin MEASUREMENT Iso2CrntDmdEvseId[20] "The ID that uniquely identifies the EVSE. Format is defined in the ISO 15118 ED2 Spec Annex H" UBYTE CU_ISO2CRNTDMDEVSEID[20] 1 100 0.0 255.0 ECU_ADDRESS 0x70017cd1 BYTE_ORDER MSB_LAST /end MEASUREMENT
/begin COMPU_METHOD CU_ISO2CRNTDMDEVSEID[20] "Conversion method for Iso2CrntDmdEvseId[20]" RAT_FUNC "%10.0" "1" COEFFS 0.000000 1.000000 -0.000000 0.000000 0.000000 1.000000 /end COMPU_METHOD
/* Scalar measurable for DDE 'Iso2CrntDmdEvseId[21]'. */
/begin MEASUREMENT Iso2CrntDmdEvseId[21] "The ID that uniquely identifies the EVSE. Format is defined in the ISO 15118 ED2 Spec Annex H" UBYTE CU_ISO2CRNTDMDEVSEID[21] 1 100 0.0 255.0 ECU_ADDRESS 0x70017cd2 BYTE_ORDER MSB_LAST /end MEASUREMENT
/begin COMPU_METHOD CU_ISO2CRNTDMDEVSEID[21] "Conversion method for Iso2CrntDmdEvseId[21]" RAT_FUNC "%10.0" "1" COEFFS 0.000000 1.000000 -0.000000 0.000000 0.000000 1.000000 /end COMPU_METHOD
/* Scalar measurable for DDE 'Iso2CrntDmdEvseId[22]'. */
/begin MEASUREMENT Iso2CrntDmdEvseId[22] "The ID that uniquely identifies the EVSE. Format is defined in the ISO 15118 ED2 Spec Annex H" UBYTE CU_ISO2CRNTDMDEVSEID[22] 1 100 0.0 255.0 ECU_ADDRESS 0x70017cd3 BYTE_ORDER MSB_LAST /end MEASUREMENT
/begin COMPU_METHOD CU_ISO2CRNTDMDEVSEID[22] "Conversion method for Iso2CrntDmdEvseId[22]" RAT_FUNC "%10.0" "1" COEFFS 0.000000 1.000000 -0.000000 0.000000 0.000000 1.000000 /end COMPU_METHOD
/* Scalar measurable for DDE 'Iso2CrntDmdEvseId[23]'. */
/begin MEASUREMENT Iso2CrntDmdEvseId[23] "The ID that uniquely identifies the EVSE. Format is defined in the ISO 15118 ED2 Spec Annex H" UBYTE CU_ISO2CRNTDMDEVSEID[23] 1 100 0.0 255.0 ECU_ADDRESS 0x70017cd4 BYTE_ORDER MSB_LAST /end MEASUREMENT
/begin COMPU_METHOD CU_ISO2CRNTDMDEVSEID[23] "Conversion method for Iso2CrntDmdEvseId[23]" RAT_FUNC "%10.0" "1" COEFFS 0.000000 1.000000 -0.000000 0.000000 0.000000 1.000000 /end COMPU_METHOD
/* Scalar measurable for DDE 'Iso2CrntDmdEvseId[24]'. */
/begin MEASUREMENT Iso2CrntDmdEvseId[24] "The ID that uniquely identifies the EVSE. Format is defined in the ISO 15118 ED2 Spec Annex H" UBYTE CU_ISO2CRNTDMDEVSEID[24] 1 100 0.0 255.0 ECU_ADDRESS 0x70017cd5 BYTE_ORDER MSB_LAST /end MEASUREMENT
/begin COMPU_METHOD CU_ISO2CRNTDMDEVSEID[24] "Conversion method for Iso2CrntDmdEvseId[24]" RAT_FUNC "%10.0" "1" COEFFS 0.000000 1.000000 -0.000000 0.000000 0.000000 1.000000 /end COMPU_METHOD
/* Scalar measurable for DDE 'Iso2CrntDmdEvseId[25]'. */
/begin MEASUREMENT Iso2CrntDmdEvseId[25] "The ID that uniquely identifies the EVSE. Format is defined in the ISO 15118 ED2 Spec Annex H" UBYTE CU_ISO2CRNTDMDEVSEID[25] 1 100 0.0 255.0 ECU_ADDRESS 0x70017cd6 BYTE_ORDER MSB_LAST /end MEASUREMENT
/begin COMPU_METHOD CU_ISO2CRNTDMDEVSEID[25] "Conversion method for Iso2CrntDmdEvseId[25]" RAT_FUNC "%10.0" "1" COEFFS 0.000000 1.000000 -0.000000 0.000000 0.000000 1.000000 /end COMPU_METHOD
/* Scalar measurable for DDE 'Iso2CrntDmdEvseId[26]'. */
/begin MEASUREMENT Iso2CrntDmdEvseId[26] "The ID that uniquely identifies the EVSE. Format is defined in the ISO 15118 ED2 Spec Annex H" UBYTE CU_ISO2CRNTDMDEVSEID[26] 1 100 0.0 255.0 ECU_ADDRESS 0x70017cd7 BYTE_ORDER MSB_LAST /end MEASUREMENT
/begin COMPU_METHOD CU_ISO2CRNTDMDEVSEID[26] "Conversion method for Iso2CrntDmdEvseId[26]" RAT_FUNC "%10.0" "1" COEFFS 0.000000 1.000000 -0.000000 0.000000 0.000000 1.000000 /end COMPU_METHOD
/* Scalar measurable for DDE 'Iso2CrntDmdEvseId[27]'. */
/begin MEASUREMENT Iso2CrntDmdEvseId[27] "The ID that uniquely identifies the EVSE. Format is defined in the ISO 15118 ED2 Spec Annex H" UBYTE CU_ISO2CRNTDMDEVSEID[27] 1 100 0.0 255.0 ECU_ADDRESS 0x70017cd8 BYTE_ORDER MSB_LAST /end MEASUREMENT
/begin COMPU_METHOD CU_ISO2CRNTDMDEVSEID[27] "Conversion method for Iso2CrntDmdEvseId[27]" RAT_FUNC "%10.0" "1" COEFFS 0.000000 1.000000 -0.000000 0.000000 0.000000 1.000000 /end COMPU_METHOD
/* Scalar measurable for DDE 'Iso2CrntDmdEvseId[28]'. */
/begin MEASUREMENT Iso2CrntDmdEvseId[28] "The ID that uniquely identifies the EVSE. Format is defined in the ISO 15118 ED2 Spec Annex H" UBYTE CU_ISO2CRNTDMDEVSEID[28] 1 100 0.0 255.0 ECU_ADDRESS 0x70017cd9 BYTE_ORDER MSB_LAST /end MEASUREMENT
/begin COMPU_METHOD CU_ISO2CRNTDMDEVSEID[28] "Conversion method for Iso2CrntDmdEvseId[28]" RAT_FUNC "%10.0" "1" COEFFS 0.000000 1.000000 -0.000000 0.000000 0.000000 1.000000 /end COMPU_METHOD
/* Scalar measurable for DDE 'Iso2CrntDmdEvseId[29]'. */
/begin MEASUREMENT Iso2CrntDmdEvseId[29] "The ID that uniquely identifies the EVSE. Format is defined in the ISO 15118 ED2 Spec Annex H" UBYTE CU_ISO2CRNTDMDEVSEID[29] 1 100 0.0 255.0 ECU_ADDRESS 0x70017cda BYTE_ORDER MSB_LAST /end MEASUREMENT
/begin COMPU_METHOD CU_ISO2CRNTDMDEVSEID[29] "Conversion method for Iso2CrntDmdEvseId[29]" RAT_FUNC "%10.0" "1" COEFFS 0.000000 1.000000 -0.000000 0.000000 0.000000 1.000000 /end COMPU_METHOD
/* Scalar measurable for DDE 'Iso2CrntDmdEvseId[2]'. */
/begin MEASUREMENT Iso2CrntDmdEvseId[2] "The ID that uniquely identifies the EVSE. Format is defined in the ISO 15118 ED2 Spec Annex H" UBYTE CU_ISO2CRNTDMDEVSEID[2] 1 100 0.0 255.0 ECU_ADDRESS 0x70017cbf BYTE_ORDER MSB_LAST /end MEASUREMENT
/begin COMPU_METHOD CU_ISO2CRNTDMDEVSEID[2] "Conversion method for Iso2CrntDmdEvseId[2]" RAT_FUNC "%10.0" "1" COEFFS 0.000000 1.000000 -0.000000 0.000000 0.000000 1.000000 /end COMPU_METHOD
/* Scalar measurable for DDE 'Iso2CrntDmdEvseId[30]'. */
/begin MEASUREMENT Iso2CrntDmdEvseId[30] "The ID that uniquely identifies the EVSE. Format is defined in the ISO 15118 ED2 Spec Annex H" UBYTE CU_ISO2CRNTDMDEVSEID[30] 1 100 0.0 255.0 ECU_ADDRESS 0x70017cdb BYTE_ORDER MSB_LAST /end MEASUREMENT
/begin COMPU_METHOD CU_ISO2CRNTDMDEVSEID[30] "Conversion method for Iso2CrntDmdEvseId[30]" RAT_FUNC "%10.0" "1" COEFFS 0.000000 1.000000 -0.000000 0.000000 0.000000 1.000000 /end COMPU_METHOD
/* Scalar measurable for DDE 'Iso2CrntDmdEvseId[31]'. */
/begin MEASUREMENT Iso2CrntDmdEvseId[31] "The ID that uniquely identifies the EVSE. Format is defined in the ISO 15118 ED2 Spec Annex H" UBYTE CU_ISO2CRNTDMDEVSEID[31] 1 100 0.0 255.0 ECU_ADDRESS 0x70017cdc BYTE_ORDER MSB_LAST /end MEASUREMENT
/begin COMPU_METHOD CU_ISO2CRNTDMDEVSEID[31] "Conversion method for Iso2CrntDmdEvseId[31]" RAT_FUNC "%10.0" "1" COEFFS 0.000000 1.000000 -0.000000 0.000000 0.000000 1.000000 /end COMPU_METHOD
/* Scalar measurable for DDE 'Iso2CrntDmdEvseId[32]'. */
/begin MEASUREMENT Iso2CrntDmdEvseId[32] "The ID that uniquely identifies the EVSE. Format is defined in the ISO 15118 ED2 Spec Annex H" UBYTE CU_ISO2CRNTDMDEVSEID[32] 1 100 0.0 255.0 ECU_ADDRESS 0x70017cdd BYTE_ORDER MSB_LAST /end MEASUREMENT
/begin COMPU_METHOD CU_ISO2CRNTDMDEVSEID[32] "Conversion method for Iso2CrntDmdEvseId[32]" RAT_FUNC "%10.0" "1" COEFFS 0.000000 1.000000 -0.000000 0.000000 0.000000 1.000000 /end COMPU_METHOD
/* Scalar measurable for DDE 'Iso2CrntDmdEvseId[33]'. */
/begin MEASUREMENT Iso2CrntDmdEvseId[33] "The ID that uniquely identifies the EVSE. Format is defined in the ISO 15118 ED2 Spec Annex H" UBYTE CU_ISO2CRNTDMDEVSEID[33] 1 100 0.0 255.0 ECU_ADDRESS 0x70017cde BYTE_ORDER MSB_LAST /end MEASUREMENT
/begin COMPU_METHOD CU_ISO2CRNTDMDEVSEID[33] "Conversion method for Iso2CrntDmdEvseId[33]" RAT_FUNC "%10.0" "1" COEFFS 0.000000 1.000000 -0.000000 0.000000 0.000000 1.000000 /end COMPU_METHOD
/* Scalar measurable for DDE 'Iso2CrntDmdEvseId[34]'. */
/begin MEASUREMENT Iso2CrntDmdEvseId[34] "The ID that uniquely identifies the EVSE. Format is defined in the ISO 15118 ED2 Spec Annex H" UBYTE CU_ISO2CRNTDMDEVSEID[34] 1 100 0.0 255.0 ECU_ADDRESS 0x70017cdf BYTE_ORDER MSB_LAST /end MEASUREMENT
/begin COMPU_METHOD CU_ISO2CRNTDMDEVSEID[34] "Conversion method for Iso2CrntDmdEvseId[34]" RAT_FUNC "%10.0" "1" COEFFS 0.000000 1.000000 -0.000000 0.000000 0.000000 1.000000 /end COMPU_METHOD
/* Scalar measurable for DDE 'Iso2CrntDmdEvseId[35]'. */
/begin MEASUREMENT Iso2CrntDmdEvseId[35] "The ID that uniquely identifies the EVSE. Format is defined in the ISO 15118 ED2 Spec Annex H" UBYTE CU_ISO2CRNTDMDEVSEID[35] 1 100 0.0 255.0 ECU_ADDRESS 0x70017ce0 BYTE_ORDER MSB_LAST /end MEASUREMENT
/begin COMPU_METHOD CU_ISO2CRNTDMDEVSEID[35] "Conversion method for Iso2CrntDmdEvseId[35]" RAT_FUNC "%10.0" "1" COEFFS 0.000000 1.000000 -0.000000 0.000000 0.000000 1.000000 /end COMPU_METHOD
/* Scalar measurable for DDE 'Iso2CrntDmdEvseId[36]'. */
/begin MEASUREMENT Iso2CrntDmdEvseId[36] "The ID that uniquely identifies the EVSE. Format is defined in the ISO 15118 ED2 Spec Annex H" UBYTE CU_ISO2CRNTDMDEVSEID[36] 1 100 0.0 255.0 ECU_ADDRESS 0x70017ce1 BYTE_ORDER MSB_LAST /end MEASUREMENT
/begin COMPU_METHOD CU_ISO2CRNTDMDEVSEID[36] "Conversion method for Iso2CrntDmdEvseId[36]" RAT_FUNC "%10.0" "1" COEFFS 0.000000 1.000000 -0.000000 0.000000 0.000000 1.000000 /end COMPU_METHOD
/* Scalar measurable for DDE 'Iso2CrntDmdEvseId[37]'. */
/begin MEASUREMENT Iso2CrntDmdEvseId[37] "The ID that uniquely identifies the EVSE. Format is defined in the ISO 15118 ED2 Spec Annex H" UBYTE CU_ISO2CRNTDMDEVSEID[37] 1 100 0.0 255.0 ECU_ADDRESS 0x70017ce2 BYTE_ORDER MSB_LAST /end MEASUREMENT
/begin COMPU_METHOD CU_ISO2CRNTDMDEVSEID[37] "Conversion method for Iso2CrntDmdEvseId[37]" RAT_FUNC "%10.0" "1" COEFFS 0.000000 1.000000 -0.000000 0.000000 0.000000 1.000000 /end COMPU_METHOD
/* Scalar measurable for DDE 'Iso2CrntDmdEvseId[3]'. */
/begin MEASUREMENT Iso2CrntDmdEvseId[3] "The ID that uniquely identifies the EVSE. Format is defined in the ISO 15118 ED2 Spec Annex H" UBYTE CU_ISO2CRNTDMDEVSEID[3] 1 100 0.0 255.0 ECU_ADDRESS 0x70017cc0 BYTE_ORDER MSB_LAST /end MEASUREMENT
/begin COMPU_METHOD CU_ISO2CRNTDMDEVSEID[3] "Conversion method for Iso2CrntDmdEvseId[3]" RAT_FUNC "%10.0" "1" COEFFS 0.000000 1.000000 -0.000000 0.000000 0.000000 1.000000 /end COMPU_METHOD
/* Scalar measurable for DDE 'Iso2CrntDmdEvseId[4]'. */
/begin MEASUREMENT Iso2CrntDmdEvseId[4] "The ID that uniquely identifies the EVSE. Format is defined in the ISO 15118 ED2 Spec Annex H" UBYTE CU_ISO2CRNTDMDEVSEID[4] 1 100 0.0 255.0 ECU_ADDRESS 0x70017cc1 BYTE_ORDER MSB_LAST /end MEASUREMENT
/begin COMPU_METHOD CU_ISO2CRNTDMDEVSEID[4] "Conversion method for Iso2CrntDmdEvseId[4]" RAT_FUNC "%10.0" "1" COEFFS 0.000000 1.000000 -0.000000 0.000000 0.000000 1.000000 /end COMPU_METHOD
/* Scalar measurable for DDE 'Iso2CrntDmdEvseId[5]'. */
/begin MEASUREMENT Iso2CrntDmdEvseId[5] "The ID that uniquely identifies the EVSE. Format is defined in the ISO 15118 ED2 Spec Annex H" UBYTE CU_ISO2CRNTDMDEVSEID[5] 1 100 0.0 255.0 ECU_ADDRESS 0x70017cc2 BYTE_ORDER MSB_LAST /end MEASUREMENT
/begin COMPU_METHOD CU_ISO2CRNTDMDEVSEID[5] "Conversion method for Iso2CrntDmdEvseId[5]" RAT_FUNC "%10.0" "1" COEFFS 0.000000 1.000000 -0.000000 0.000000 0.000000 1.000000 /end COMPU_METHOD
/* Scalar measurable for DDE 'Iso2CrntDmdEvseId[6]'. */
/begin MEASUREMENT Iso2CrntDmdEvseId[6] "The ID that uniquely identifies the EVSE. Format is defined in the ISO 15118 ED2 Spec Annex H" UBYTE CU_ISO2CRNTDMDEVSEID[6] 1 100 0.0 255.0 ECU_ADDRESS 0x70017cc3 BYTE_ORDER MSB_LAST /end MEASUREMENT
/begin COMPU_METHOD CU_ISO2CRNTDMDEVSEID[6] "Conversion method for Iso2CrntDmdEvseId[6]" RAT_FUNC "%10.0" "1" COEFFS 0.000000 1.000000 -0.000000 0.000000 0.000000 1.000000 /end COMPU_METHOD
/* Scalar measurable for DDE 'Iso2CrntDmdEvseId[7]'. */
/begin MEASUREMENT Iso2CrntDmdEvseId[7] "The ID that uniquely identifies the EVSE. Format is defined in the ISO 15118 ED2 Spec Annex H" UBYTE CU_ISO2CRNTDMDEVSEID[7] 1 100 0.0 255.0 ECU_ADDRESS 0x70017cc4 BYTE_ORDER MSB_LAST /end MEASUREMENT
/begin COMPU_METHOD CU_ISO2CRNTDMDEVSEID[7] "Conversion method for Iso2CrntDmdEvseId[7]" RAT_FUNC "%10.0" "1" COEFFS 0.000000 1.000000 -0.000000 0.000000 0.000000 1.000000 /end COMPU_METHOD
/* Scalar measurable for DDE 'Iso2CrntDmdEvseId[8]'. */
/begin MEASUREMENT Iso2CrntDmdEvseId[8] "The ID that uniquely identifies the EVSE. Format is defined in the ISO 15118 ED2 Spec Annex H" UBYTE CU_ISO2CRNTDMDEVSEID[8] 1 100 0.0 255.0 ECU_ADDRESS 0x70017cc5 BYTE_ORDER MSB_LAST /end MEASUREMENT
/begin COMPU_METHOD CU_ISO2CRNTDMDEVSEID[8] "Conversion method for Iso2CrntDmdEvseId[8]" RAT_FUNC "%10.0" "1" COEFFS 0.000000 1.000000 -0.000000 0.000000 0.000000 1.000000 /end COMPU_METHOD
/* Scalar measurable for DDE 'Iso2CrntDmdEvseId[9]'. */
/begin MEASUREMENT Iso2CrntDmdEvseId[9] "The ID that uniquely identifies the EVSE. Format is defined in the ISO 15118 ED2 Spec Annex H" UBYTE CU_ISO2CRNTDMDEVSEID[9] 1 100 0.0 255.0 ECU_ADDRESS 0x70017cc6 BYTE_ORDER MSB_LAST /end MEASUREMENT
/begin COMPU_METHOD CU_ISO2CRNTDMDEVSEID[9] "Conversion method for Iso2CrntDmdEvseId[9]" RAT_FUNC "%10.0" "1" COEFFS 0.000000 1.000000 -0.000000 0.000000 0.000000 1.000000 /end COMPU_METHOD
/* Scalar measurable for DDE 'Iso2CrntDmdEvseMaxCrntLim'. */
/begin MEASUREMENT Iso2CrntDmdEvseMaxCrntLim "Indicates the maximum current the EVSE can deliver." FLOAT32_IEEE CU_ISO2CRNTDMDEVSEMAXCRNTLIM 1 100 -3.40282346639e+38 3.40282346639e+38 ECU_ADDRESS 0x70018268 BYTE_ORDER MSB_LAST /end MEASUREMENT
/begin COMPU_METHOD CU_ISO2CRNTDMDEVSEMAXCRNTLIM "Conversion method for Iso2CrntDmdEvseMaxCrntLim" RAT_FUNC "%10.0" "%" COEFFS 0.000000 1.000000 -0.000000 0.000000 0.000000 1.000000 /end COMPU_METHOD
/* Scalar measurable for DDE 'Iso2CrntDmdEvseMaxCrntLimPres'. */
/begin MEASUREMENT Iso2CrntDmdEvseMaxCrntLimPres "Indicates the presence of the EvseMaxCrntLimit parameter." UBYTE CU_ISO2CRNTDMDEVSEMAXCRNTLIMPR0 1 100 0.0 1.0 ECU_ADDRESS 0x70017f15 BYTE_ORDER MSB_LAST /end MEASUREMENT
/begin COMPU_METHOD CU_ISO2CRNTDMDEVSEMAXCRNTLIMPR0 "Conversion method for Iso2CrntDmdEvseMaxCrntLimPres" RAT_FUNC "%10.0" "b" COEFFS 0.000000 1.000000 -0.000000 0.000000 0.000000 1.000000 /end COMPU_METHOD
/* Scalar measurable for DDE 'Iso2CrntDmdEvseMaxPwrLim'. */
/begin MEASUREMENT Iso2CrntDmdEvseMaxPwrLim "Indicates the maximum power the EVSE can deliver." FLOAT32_IEEE CU_ISO2CRNTDMDEVSEMAXPWRLIM 1 100 -3.40282346639e+38 3.40282346639e+38 ECU_ADDRESS 0x70018290 BYTE_ORDER MSB_LAST /end MEASUREMENT
/begin COMPU_METHOD CU_ISO2CRNTDMDEVSEMAXPWRLIM "Conversion method for Iso2CrntDmdEvseMaxPwrLim" RAT_FUNC "%10.0" "%" COEFFS 0.000000 1.000000 -0.000000 0.000000 0.000000 1.000000 /end COMPU_METHOD
/* Scalar measurable for DDE 'Iso2CrntDmdEvseMaxPwrLimPres'. */
/begin MEASUREMENT Iso2CrntDmdEvseMaxPwrLimPres "Indicates the presence of the EvseMaxPwrLimit parameter." UBYTE CU_ISO2CRNTDMDEVSEMAXPWRLIMPRES 1 100 0.0 1.0 ECU_ADDRESS 0x70017c7a BYTE_ORDER MSB_LAST /end MEASUREMENT
/begin COMPU_METHOD CU_ISO2CRNTDMDEVSEMAXPWRLIMPRES "Conversion method for Iso2CrntDmdEvseMaxPwrLimPres" RAT_FUNC "%10.0" "b" COEFFS 0.000000 1.000000 -0.000000 0.000000 0.000000 1.000000 /end COMPU_METHOD
/* Scalar measurable for DDE 'Iso2CrntDmdEvseMaxVoltLim'. */
/begin MEASUREMENT Iso2CrntDmdEvseMaxVoltLim "Indicates the maximum voltage the EVSE can deliver" FLOAT32_IEEE CU_ISO2CRNTDMDEVSEMAXVOLTLIM 1 100 -3.40282346639e+38 3.40282346639e+38 ECU_ADDRESS 0x70018398 BYTE_ORDER MSB_LAST /end MEASUREMENT
/begin COMPU_METHOD CU_ISO2CRNTDMDEVSEMAXVOLTLIM "Conversion method for Iso2CrntDmdEvseMaxVoltLim" RAT_FUNC "%10.0" "%" COEFFS 0.000000 1.000000 -0.000000 0.000000 0.000000 1.000000 /end COMPU_METHOD
/* Scalar measurable for DDE 'Iso2CrntDmdEvseMaxVoltLimPres'. */
/begin MEASUREMENT Iso2CrntDmdEvseMaxVoltLimPres "Indicates the presence of the EvseMaxVoltLimit parameter." UBYTE CU_ISO2CRNTDMDEVSEMAXVOLTLIMPR0 1 100 0.0 1.0 ECU_ADDRESS 0x700181f0 BYTE_ORDER MSB_LAST /end MEASUREMENT
/begin COMPU_METHOD CU_ISO2CRNTDMDEVSEMAXVOLTLIMPR0 "Conversion method for Iso2CrntDmdEvseMaxVoltLimPres" RAT_FUNC "%10.0" "b" COEFFS 0.000000 1.000000 -0.000000 0.000000 0.000000 1.000000 /end COMPU_METHOD
/* Scalar measurable for DDE 'Iso2CrntDmdEvsePresCrnt'. */
/begin MEASUREMENT Iso2CrntDmdEvsePresCrnt "Indicates the measured High Voltage DC (HVDC) current at the output of the DC Supply through the charge coupler" FLOAT32_IEEE CU_ISO2CRNTDMDEVSEPRESCRNT 1 100 -3.40282346639e+38 3.40282346639e+38 ECU_ADDRESS 0x70017fa0 BYTE_ORDER MSB_LAST /end MEASUREMENT
/begin COMPU_METHOD CU_ISO2CRNTDMDEVSEPRESCRNT "Conversion method for Iso2CrntDmdEvsePresCrnt" RAT_FUNC "%10.0" "%" COEFFS 0.000000 1.000000 -0.000000 0.000000 0.000000 1.000000 /end COMPU_METHOD
/* Scalar measurable for DDE 'Iso2CrntDmdEvsePresVolt'. */
/begin MEASUREMENT Iso2CrntDmdEvsePresVolt "Indicates the measured High Voltage DC (HVDC) voltage at the output of the DC Supply." FLOAT32_IEEE CU_ISO2CRNTDMDEVSEPRESVOLT 1 100 -3.40282346639e+38 3.40282346639e+38 ECU_ADDRESS 0x70017d3c BYTE_ORDER MSB_LAST /end MEASUREMENT
/begin COMPU_METHOD CU_ISO2CRNTDMDEVSEPRESVOLT "Conversion method for Iso2CrntDmdEvsePresVolt" RAT_FUNC "%10.0" "%" COEFFS 0.000000 1.000000 -0.000000 0.000000 0.000000 1.000000 /end COMPU_METHOD
/* Scalar measurable for DDE 'Iso2CrntDmdEvsePwrLimAchvd'. */
/begin MEASUREMENT Iso2CrntDmdEvsePwrLimAchvd "Indicates that the charger is at its power limit" UBYTE CU_ISO2CRNTDMDEVSEPWRLIMACHVD 1 100 0.0 1.0 ECU_ADDRESS 0x70017fd4 BYTE_ORDER MSB_LAST /end MEASUREMENT
/begin COMPU_METHOD CU_ISO2CRNTDMDEVSEPWRLIMACHVD "Conversion method for Iso2CrntDmdEvsePwrLimAchvd" RAT_FUNC "%10.0" "b" COEFFS 0.000000 1.000000 -0.000000 0.000000 0.000000 1.000000 /end COMPU_METHOD
/* Scalar measurable for DDE 'Iso2CrntDmdEvseStatPres'. */
/begin MEASUREMENT Iso2CrntDmdEvseStatPres "Indicates the presence of the EVSENotificationMaxDelay and EVSENotification parameters in the CurrentDemandRes message" UBYTE CU_ISO2CRNTDMDEVSESTATPRES 1 100 0.0 1.0 ECU_ADDRESS 0x70018349 BYTE_ORDER MSB_LAST /end MEASUREMENT
/begin COMPU_METHOD CU_ISO2CRNTDMDEVSESTATPRES "Conversion method for Iso2CrntDmdEvseStatPres" RAT_FUNC "%10.0" "b" COEFFS 0.000000 1.000000 -0.000000 0.000000 0.000000 1.000000 /end COMPU_METHOD
/* Scalar measurable for DDE 'Iso2CrntDmdEvseVoltLimAchvd'. */
/begin MEASUREMENT Iso2CrntDmdEvseVoltLimAchvd "Indicates that the charger is at its voltage limit" UBYTE CU_ISO2CRNTDMDEVSEVOLTLIMACHVD 1 100 0.0 1.0 ECU_ADDRESS 0x700181a1 BYTE_ORDER MSB_LAST /end MEASUREMENT
/begin COMPU_METHOD CU_ISO2CRNTDMDEVSEVOLTLIMACHVD "Conversion method for Iso2CrntDmdEvseVoltLimAchvd" RAT_FUNC "%10.0" "b" COEFFS 0.000000 1.000000 -0.000000 0.000000 0.000000 1.000000 /end COMPU_METHOD
/* Scalar measurable for DDE 'Iso2CrntDmdNotif'. */
/begin MEASUREMENT Iso2CrntDmdNotif "Indicates action SECC wants the EVSE to perform in the CurrentDemandRes message" UBYTE CU_ISO2CRNTDMDNOTIF 1 100 0.0 255.0 ECU_ADDRESS 0x70017f58 BYTE_ORDER MSB_LAST /end MEASUREMENT
/begin COMPU_METHOD CU_ISO2CRNTDMDNOTIF "Conversion method for Iso2CrntDmdNotif" RAT_FUNC "%10.0" "1" COEFFS 0.000000 1.000000 -0.000000 0.000000 0.000000 1.000000 /end COMPU_METHOD
/* Scalar measurable for DDE 'Iso2CrntDmdNotifMaxDelay'. */
/begin MEASUREMENT Iso2CrntDmdNotifMaxDelay "Indicates the time until the SECC expects the EVCC to react on the EVSENotification action set in the CurrentDemandRes message" UWORD CU_ISO2CRNTDMDNOTIFMAXDELAY 1 100 0.0 65535.0 ECU_ADDRESS 0x70017db6 BYTE_ORDER MSB_LAST /end MEASUREMENT
/begin COMPU_METHOD CU_ISO2CRNTDMDNOTIFMAXDELAY "Conversion method for Iso2CrntDmdNotifMaxDelay" RAT_FUNC "%10.0" "1" COEFFS 0.000000 1.000000 -0.000000 0.000000 0.000000 1.000000 /end COMPU_METHOD
/* Scalar measurable for DDE 'Iso2CrntDmdRescode'. */
/begin MEASUREMENT Iso2CrntDmdRescode "for ISOv2 CurrentDemandRes message: indicates the acknowledgment status of this V2G messages received by the SECC." UBYTE CU_ISO2CRNTDMDRESCODE 1 100 0.0 255.0 ECU_ADDRESS 0x700183be BYTE_ORDER MSB_LAST /end MEASUREMENT
/begin COMPU_METHOD CU_ISO2CRNTDMDRESCODE "Conversion method for Iso2CrntDmdRescode" RAT_FUNC "%10.0" "1" COEFFS 0.000000 1.000000 -0.000000 0.000000 0.000000 1.000000 /end COMPU_METHOD
/* Scalar measurable for DDE 'Iso2CrntDmdRxTrg'. */
/begin MEASUREMENT Iso2CrntDmdRxTrg "Trigger flag that on a rising edge indicates the event for receiving the PLC (V2G) CurrentDemandRes message from the EVSE" UBYTE CU_ISO2CRNTDMDRXTRG 1 100 0.0 1.0 ECU_ADDRESS 0x70017de9 BYTE_ORDER MSB_LAST /end MEASUREMENT
/begin COMPU_METHOD CU_ISO2CRNTDMDRXTRG "Conversion method for Iso2CrntDmdRxTrg" RAT_FUNC "%10.0" "b" COEFFS 0.000000 1.000000 -0.000000 0.000000 0.000000 1.000000 /end COMPU_METHOD
/* Scalar measurable for DDE 'Iso2CrntDmdSASchTupId'. */
/begin MEASUREMENT Iso2CrntDmdSASchTupId "Represents the unique identifier within a charging session for a SAScheduleTuple element" UBYTE CU_ISO2CRNTDMDSASCHTUPID 1 100 0.0 255.0 ECU_ADDRESS 0x70018150 BYTE_ORDER MSB_LAST /end MEASUREMENT
/begin COMPU_METHOD CU_ISO2CRNTDMDSASCHTUPID "Conversion method for Iso2CrntDmdSASchTupId" RAT_FUNC "%10.0" "1" COEFFS 0.000000 1.000000 -0.000000 0.000000 0.000000 1.000000 /end COMPU_METHOD
/* Scalar measurable for DDE 'Iso2CrntDmdSASchTupIdPres'. */
/begin MEASUREMENT Iso2CrntDmdSASchTupIdPres "Indicates the presence of the SA Schedule Tuple ID parameter." UBYTE CU_ISO2CRNTDMDSASCHTUPIDPRES 1 100 0.0 1.0 ECU_ADDRESS 0x70017ee9 BYTE_ORDER MSB_LAST /end MEASUREMENT
/begin COMPU_METHOD CU_ISO2CRNTDMDSASCHTUPIDPRES "Conversion method for Iso2CrntDmdSASchTupIdPres" RAT_FUNC "%10.0" "b" COEFFS 0.000000 1.000000 -0.000000 0.000000 0.000000 1.000000 /end COMPU_METHOD
/* Scalar measurable for DDE 'Iso2EvseIdLen'. */
/begin MEASUREMENT Iso2EvseIdLen "Number of bytes in EVSE ID" UBYTE CU_ISO2EVSEIDLEN 1 100 0.0 255.0 ECU_ADDRESS 0x70017ed8 BYTE_ORDER MSB_LAST /end MEASUREMENT
/begin COMPU_METHOD CU_ISO2EVSEIDLEN "Conversion method for Iso2EvseIdLen" RAT_FUNC "%10.0" "1" COEFFS 0.000000 1.000000 -0.000000 0.000000 0.000000 1.000000 /end COMPU_METHOD
/* Scalar measurable for DDE 'Iso2EvseId[0]'. */
/begin MEASUREMENT Iso2EvseId[0] "The ID that uniquely identifies the EVSE. Format is defined in the ISO 15118 ED2 Spec Annex H" UBYTE CU_ISO2EVSEID[0] 1 100 0.0 255.0 ECU_ADDRESS 0x70017cf4 BYTE_ORDER MSB_LAST /end MEASUREMENT
/begin COMPU_METHOD CU_ISO2EVSEID[0] "Conversion method for Iso2EvseId[0]" RAT_FUNC "%10.0" "1" COEFFS 0.000000 1.000000 -0.000000 0.000000 0.000000 1.000000 /end COMPU_METHOD
/* Scalar measurable for DDE 'Iso2EvseId[10]'. */
/begin MEASUREMENT Iso2EvseId[10] "The ID that uniquely identifies the EVSE. Format is defined in the ISO 15118 ED2 Spec Annex H" UBYTE CU_ISO2EVSEID[10] 1 100 0.0 255.0 ECU_ADDRESS 0x70017cfe BYTE_ORDER MSB_LAST /end MEASUREMENT
/begin COMPU_METHOD CU_ISO2EVSEID[10] "Conversion method for Iso2EvseId[10]" RAT_FUNC "%10.0" "1" COEFFS 0.000000 1.000000 -0.000000 0.000000 0.000000 1.000000 /end COMPU_METHOD
/* Scalar measurable for DDE 'Iso2EvseId[11]'. */
/begin MEASUREMENT Iso2EvseId[11] "The ID that uniquely identifies the EVSE. Format is defined in the ISO 15118 ED2 Spec Annex H" UBYTE CU_ISO2EVSEID[11] 1 100 0.0 255.0 ECU_ADDRESS 0x70017cff BYTE_ORDER MSB_LAST /end MEASUREMENT
/begin COMPU_METHOD CU_ISO2EVSEID[11] "Conversion method for Iso2EvseId[11]" RAT_FUNC "%10.0" "1" COEFFS 0.000000 1.000000 -0.000000 0.000000 0.000000 1.000000 /end COMPU_METHOD
/* Scalar measurable for DDE 'Iso2EvseId[12]'. */
/begin MEASUREMENT Iso2EvseId[12] "The ID that uniquely identifies the EVSE. Format is defined in the ISO 15118 ED2 Spec Annex H" UBYTE CU_ISO2EVSEID[12] 1 100 0.0 255.0 ECU_ADDRESS 0x70017d00 BYTE_ORDER MSB_LAST /end MEASUREMENT
/begin COMPU_METHOD CU_ISO2EVSEID[12] "Conversion method for Iso2EvseId[12]" RAT_FUNC "%10.0" "1" COEFFS 0.000000 1.000000 -0.000000 0.000000 0.000000 1.000000 /end COMPU_METHOD
/* Scalar measurable for DDE 'Iso2EvseId[13]'. */
/begin MEASUREMENT Iso2EvseId[13] "The ID that uniquely identifies the EVSE. Format is defined in the ISO 15118 ED2 Spec Annex H" UBYTE CU_ISO2EVSEID[13] 1 100 0.0 255.0 ECU_ADDRESS 0x70017d01 BYTE_ORDER MSB_LAST /end MEASUREMENT
/begin COMPU_METHOD CU_ISO2EVSEID[13] "Conversion method for Iso2EvseId[13]" RAT_FUNC "%10.0" "1" COEFFS 0.000000 1.000000 -0.000000 0.000000 0.000000 1.000000 /end COMPU_METHOD
/* Scalar measurable for DDE 'Iso2EvseId[14]'. */
/begin MEASUREMENT Iso2EvseId[14] "The ID that uniquely identifies the EVSE. Format is defined in the ISO 15118 ED2 Spec Annex H" UBYTE CU_ISO2EVSEID[14] 1 100 0.0 255.0 ECU_ADDRESS 0x70017d02 BYTE_ORDER MSB_LAST /end MEASUREMENT
/begin COMPU_METHOD CU_ISO2EVSEID[14] "Conversion method for Iso2EvseId[14]" RAT_FUNC "%10.0" "1" COEFFS 0.000000 1.000000 -0.000000 0.000000 0.000000 1.000000 /end COMPU_METHOD
/* Scalar measurable for DDE 'Iso2EvseId[15]'. */
/begin MEASUREMENT Iso2EvseId[15] "The ID that uniquely identifies the EVSE. Format is defined in the ISO 15118 ED2 Spec Annex H" UBYTE CU_ISO2EVSEID[15] 1 100 0.0 255.0 ECU_ADDRESS 0x70017d03 BYTE_ORDER MSB_LAST /end MEASUREMENT
/begin COMPU_METHOD CU_ISO2EVSEID[15] "Conversion method for Iso2EvseId[15]" RAT_FUNC "%10.0" "1" COEFFS 0.000000 1.000000 -0.000000 0.000000 0.000000 1.000000 /end COMPU_METHOD
/* Scalar measurable for DDE 'Iso2EvseId[16]'. */
/begin MEASUREMENT Iso2EvseId[16] "The ID that uniquely identifies the EVSE. Format is defined in the ISO 15118 ED2 Spec Annex H" UBYTE CU_ISO2EVSEID[16] 1 100 0.0 255.0 ECU_ADDRESS 0x70017d04 BYTE_ORDER MSB_LAST /end MEASUREMENT
/begin COMPU_METHOD CU_ISO2EVSEID[16] "Conversion method for Iso2EvseId[16]" RAT_FUNC "%10.0" "1" COEFFS 0.000000 1.000000 -0.000000 0.000000 0.000000 1.000000 /end COMPU_METHOD
/* Scalar measurable for DDE 'Iso2EvseId[17]'. */
/begin MEASUREMENT Iso2EvseId[17] "The ID that uniquely identifies the EVSE. Format is defined in the ISO 15118 ED2 Spec Annex H" UBYTE CU_ISO2EVSEID[17] 1 100 0.0 255.0 ECU_ADDRESS 0x70017d05 BYTE_ORDER MSB_LAST /end MEASUREMENT
/begin COMPU_METHOD CU_ISO2EVSEID[17] "Conversion method for Iso2EvseId[17]" RAT_FUNC "%10.0" "1" COEFFS 0.000000 1.000000 -0.000000 0.000000 0.000000 1.000000 /end COMPU_METHOD
/* Scalar measurable for DDE 'Iso2EvseId[18]'. */
/begin MEASUREMENT Iso2EvseId[18] "The ID that uniquely identifies the EVSE. Format is defined in the ISO 15118 ED2 Spec Annex H" UBYTE CU_ISO2EVSEID[18] 1 100 0.0 255.0 ECU_ADDRESS 0x70017d06 BYTE_ORDER MSB_LAST /end MEASUREMENT
/begin COMPU_METHOD CU_ISO2EVSEID[18] "Conversion method for Iso2EvseId[18]" RAT_FUNC "%10.0" "1" COEFFS 0.000000 1.000000 -0.000000 0.000000 0.000000 1.000000 /end COMPU_METHOD
/* Scalar measurable for DDE 'Iso2EvseId[19]'. */
/begin MEASUREMENT Iso2EvseId[19] "The ID that uniquely identifies the EVSE. Format is defined in the ISO 15118 ED2 Spec Annex H" UBYTE CU_ISO2EVSEID[19] 1 100 0.0 255.0 ECU_ADDRESS 0x70017d07 BYTE_ORDER MSB_LAST /end MEASUREMENT
/begin COMPU_METHOD CU_ISO2EVSEID[19] "Conversion method for Iso2EvseId[19]" RAT_FUNC "%10.0" "1" COEFFS 0.000000 1.000000 -0.000000 0.000000 0.000000 1.000000 /end COMPU_METHOD
/* Scalar measurable for DDE 'Iso2EvseId[1]'. */
/begin MEASUREMENT Iso2EvseId[1] "The ID that uniquely identifies the EVSE. Format is defined in the ISO 15118 ED2 Spec Annex H" UBYTE CU_ISO2EVSEID[1] 1 100 0.0 255.0 ECU_ADDRESS 0x70017cf5 BYTE_ORDER MSB_LAST /end MEASUREMENT
/begin COMPU_METHOD CU_ISO2EVSEID[1] "Conversion method for Iso2EvseId[1]" RAT_FUNC "%10.0" "1" COEFFS 0.000000 1.000000 -0.000000 0.000000 0.000000 1.000000 /end COMPU_METHOD
/* Scalar measurable for DDE 'Iso2EvseId[20]'. */
/begin MEASUREMENT Iso2EvseId[20] "The ID that uniquely identifies the EVSE. Format is defined in the ISO 15118 ED2 Spec Annex H" UBYTE CU_ISO2EVSEID[20] 1 100 0.0 255.0 ECU_ADDRESS 0x70017d08 BYTE_ORDER MSB_LAST /end MEASUREMENT
/begin COMPU_METHOD CU_ISO2EVSEID[20] "Conversion method for Iso2EvseId[20]" RAT_FUNC "%10.0" "1" COEFFS 0.000000 1.000000 -0.000000 0.000000 0.000000 1.000000 /end COMPU_METHOD
/* Scalar measurable for DDE 'Iso2EvseId[21]'. */
/begin MEASUREMENT Iso2EvseId[21] "The ID that uniquely identifies the EVSE. Format is defined in the ISO 15118 ED2 Spec Annex H" UBYTE CU_ISO2EVSEID[21] 1 100 0.0 255.0 ECU_ADDRESS 0x70017d09 BYTE_ORDER MSB_LAST /end MEASUREMENT
/begin COMPU_METHOD CU_ISO2EVSEID[21] "Conversion method for Iso2EvseId[21]" RAT_FUNC "%10.0" "1" COEFFS 0.000000 1.000000 -0.000000 0.000000 0.000000 1.000000 /end COMPU_METHOD
/* Scalar measurable for DDE 'Iso2EvseId[22]'. */
/begin MEASUREMENT Iso2EvseId[22] "The ID that uniquely identifies the EVSE. Format is defined in the ISO 15118 ED2 Spec Annex H" UBYTE CU_ISO2EVSEID[22] 1 100 0.0 255.0 ECU_ADDRESS 0x70017d0a BYTE_ORDER MSB_LAST /end MEASUREMENT
/begin COMPU_METHOD CU_ISO2EVSEID[22] "Conversion method for Iso2EvseId[22]" RAT_FUNC "%10.0" "1" COEFFS 0.000000 1.000000 -0.000000 0.000000 0.000000 1.000000 /end COMPU_METHOD
/* Scalar measurable for DDE 'Iso2EvseId[23]'. */
/begin MEASUREMENT Iso2EvseId[23] "The ID that uniquely identifies the EVSE. Format is defined in the ISO 15118 ED2 Spec Annex H" UBYTE CU_ISO2EVSEID[23] 1 100 0.0 255.0 ECU_ADDRESS 0x70017d0b BYTE_ORDER MSB_LAST /end MEASUREMENT
/begin COMPU_METHOD CU_ISO2EVSEID[23] "Conversion method for Iso2EvseId[23]" RAT_FUNC "%10.0" "1" COEFFS 0.000000 1.000000 -0.000000 0.000000 0.000000 1.000000 /end COMPU_METHOD
/* Scalar measurable for DDE 'Iso2EvseId[24]'. */
/begin MEASUREMENT Iso2EvseId[24] "The ID that uniquely identifies the EVSE. Format is defined in the ISO 15118 ED2 Spec Annex H" UBYTE CU_ISO2EVSEID[24] 1 100 0.0 255.0 ECU_ADDRESS 0x70017d0c BYTE_ORDER MSB_LAST /end MEASUREMENT
/begin COMPU_METHOD CU_ISO2EVSEID[24] "Conversion method for Iso2EvseId[24]" RAT_FUNC "%10.0" "1" COEFFS 0.000000 1.000000 -0.000000 0.000000 0.000000 1.000000 /end COMPU_METHOD
/* Scalar measurable for DDE 'Iso2EvseId[25]'. */
/begin MEASUREMENT Iso2EvseId[25] "The ID that uniquely identifies the EVSE. Format is defined in the ISO 15118 ED2 Spec Annex H" UBYTE CU_ISO2EVSEID[25] 1 100 0.0 255.0 ECU_ADDRESS 0x70017d0d BYTE_ORDER MSB_LAST /end MEASUREMENT
/begin COMPU_METHOD CU_ISO2EVSEID[25] "Conversion method for Iso2EvseId[25]" RAT_FUNC "%10.0" "1" COEFFS 0.000000 1.000000 -0.000000 0.000000 0.000000 1.000000 /end COMPU_METHOD
/* Scalar measurable for DDE 'Iso2EvseId[26]'. */
/begin MEASUREMENT Iso2EvseId[26] "The ID that uniquely identifies the EVSE. Format is defined in the ISO 15118 ED2 Spec Annex H" UBYTE CU_ISO2EVSEID[26] 1 100 0.0 255.0 ECU_ADDRESS 0x70017d0e BYTE_ORDER MSB_LAST /end MEASUREMENT
/begin COMPU_METHOD CU_ISO2EVSEID[26] "Conversion method for Iso2EvseId[26]" RAT_FUNC "%10.0" "1" COEFFS 0.000000 1.000000 -0.000000 0.000000 0.000000 1.000000 /end COMPU_METHOD
/* Scalar measurable for DDE 'Iso2EvseId[27]'. */
/begin MEASUREMENT Iso2EvseId[27] "The ID that uniquely identifies the EVSE. Format is defined in the ISO 15118 ED2 Spec Annex H" UBYTE CU_ISO2EVSEID[27] 1 100 0.0 255.0 ECU_ADDRESS 0x70017d0f BYTE_ORDER MSB_LAST /end MEASUREMENT
/begin COMPU_METHOD CU_ISO2EVSEID[27] "Conversion method for Iso2EvseId[27]" RAT_FUNC "%10.0" "1" COEFFS 0.000000 1.000000 -0.000000 0.000000 0.000000 1.000000 /end COMPU_METHOD
/* Scalar measurable for DDE 'Iso2EvseId[28]'. */
/begin MEASUREMENT Iso2EvseId[28] "The ID that uniquely identifies the EVSE. Format is defined in the ISO 15118 ED2 Spec Annex H" UBYTE CU_ISO2EVSEID[28] 1 100 0.0 255.0 ECU_ADDRESS 0x70017d10 BYTE_ORDER MSB_LAST /end MEASUREMENT
/begin COMPU_METHOD CU_ISO2EVSEID[28] "Conversion method for Iso2EvseId[28]" RAT_FUNC "%10.0" "1" COEFFS 0.000000 1.000000 -0.000000 0.000000 0.000000 1.000000 /end COMPU_METHOD
/* Scalar measurable for DDE 'Iso2EvseId[29]'. */
/begin MEASUREMENT Iso2EvseId[29] "The ID that uniquely identifies the EVSE. Format is defined in the ISO 15118 ED2 Spec Annex H" UBYTE CU_ISO2EVSEID[29] 1 100 0.0 255.0 ECU_ADDRESS 0x70017d11 BYTE_ORDER MSB_LAST /end MEASUREMENT
/begin COMPU_METHOD CU_ISO2EVSEID[29] "Conversion method for Iso2EvseId[29]" RAT_FUNC "%10.0" "1" COEFFS 0.000000 1.000000 -0.000000 0.000000 0.000000 1.000000 /end COMPU_METHOD
/* Scalar measurable for DDE 'Iso2EvseId[2]'. */
/begin MEASUREMENT Iso2EvseId[2] "The ID that uniquely identifies the EVSE. Format is defined in the ISO 15118 ED2 Spec Annex H" UBYTE CU_ISO2EVSEID[2] 1 100 0.0 255.0 ECU_ADDRESS 0x70017cf6 BYTE_ORDER MSB_LAST /end MEASUREMENT
/begin COMPU_METHOD CU_ISO2EVSEID[2] "Conversion method for Iso2EvseId[2]" RAT_FUNC "%10.0" "1" COEFFS 0.000000 1.000000 -0.000000 0.000000 0.000000 1.000000 /end COMPU_METHOD
/* Scalar measurable for DDE 'Iso2EvseId[30]'. */
/begin MEASUREMENT Iso2EvseId[30] "The ID that uniquely identifies the EVSE. Format is defined in the ISO 15118 ED2 Spec Annex H" UBYTE CU_ISO2EVSEID[30] 1 100 0.0 255.0 ECU_ADDRESS 0x70017d12 BYTE_ORDER MSB_LAST /end MEASUREMENT
/begin COMPU_METHOD CU_ISO2EVSEID[30] "Conversion method for Iso2EvseId[30]" RAT_FUNC "%10.0" "1" COEFFS 0.000000 1.000000 -0.000000 0.000000 0.000000 1.000000 /end COMPU_METHOD
/* Scalar measurable for DDE 'Iso2EvseId[31]'. */
/begin MEASUREMENT Iso2EvseId[31] "The ID that uniquely identifies the EVSE. Format is defined in the ISO 15118 ED2 Spec Annex H" UBYTE CU_ISO2EVSEID[31] 1 100 0.0 255.0 ECU_ADDRESS 0x70017d13 BYTE_ORDER MSB_LAST /end MEASUREMENT
/begin COMPU_METHOD CU_ISO2EVSEID[31] "Conversion method for Iso2EvseId[31]" RAT_FUNC "%10.0" "1" COEFFS 0.000000 1.000000 -0.000000 0.000000 0.000000 1.000000 /end COMPU_METHOD
/* Scalar measurable for DDE 'Iso2EvseId[32]'. */
/begin MEASUREMENT Iso2EvseId[32] "The ID that uniquely identifies the EVSE. Format is defined in the ISO 15118 ED2 Spec Annex H" UBYTE CU_ISO2EVSEID[32] 1 100 0.0 255.0 ECU_ADDRESS 0x70017d14 BYTE_ORDER MSB_LAST /end MEASUREMENT
/begin COMPU_METHOD CU_ISO2EVSEID[32] "Conversion method for Iso2EvseId[32]" RAT_FUNC "%10.0" "1" COEFFS 0.000000 1.000000 -0.000000 0.000000 0.000000 1.000000 /end COMPU_METHOD
/* Scalar measurable for DDE 'Iso2EvseId[33]'. */
/begin MEASUREMENT Iso2EvseId[33] "The ID that uniquely identifies the EVSE. Format is defined in the ISO 15118 ED2 Spec Annex H" UBYTE CU_ISO2EVSEID[33] 1 100 0.0 255.0 ECU_ADDRESS 0x70017d15 BYTE_ORDER MSB_LAST /end MEASUREMENT
/begin COMPU_METHOD CU_ISO2EVSEID[33] "Conversion method for Iso2EvseId[33]" RAT_FUNC "%10.0" "1" COEFFS 0.000000 1.000000 -0.000000 0.000000 0.000000 1.000000 /end COMPU_METHOD
/* Scalar measurable for DDE 'Iso2EvseId[34]'. */
/begin MEASUREMENT Iso2EvseId[34] "The ID that uniquely identifies the EVSE. Format is defined in the ISO 15118 ED2 Spec Annex H" UBYTE CU_ISO2EVSEID[34] 1 100 0.0 255.0 ECU_ADDRESS 0x70017d16 BYTE_ORDER MSB_LAST /end MEASUREMENT
/begin COMPU_METHOD CU_ISO2EVSEID[34] "Conversion method for Iso2EvseId[34]" RAT_FUNC "%10.0" "1" COEFFS 0.000000 1.000000 -0.000000 0.000000 0.000000 1.000000 /end COMPU_METHOD
/* Scalar measurable for DDE 'Iso2EvseId[35]'. */
/begin MEASUREMENT Iso2EvseId[35] "The ID that uniquely identifies the EVSE. Format is defined in the ISO 15118 ED2 Spec Annex H" UBYTE CU_ISO2EVSEID[35] 1 100 0.0 255.0 ECU_ADDRESS 0x70017d17 BYTE_ORDER MSB_LAST /end MEASUREMENT
/begin COMPU_METHOD CU_ISO2EVSEID[35] "Conversion method for Iso2EvseId[35]" RAT_FUNC "%10.0" "1" COEFFS 0.000000 1.000000 -0.000000 0.000000 0.000000 1.000000 /end COMPU_METHOD
/* Scalar measurable for DDE 'Iso2EvseId[36]'. */
/begin MEASUREMENT Iso2EvseId[36] "The ID that uniquely identifies the EVSE. Format is defined in the ISO 15118 ED2 Spec Annex H" UBYTE CU_ISO2EVSEID[36] 1 100 0.0 255.0 ECU_ADDRESS 0x70017d18 BYTE_ORDER MSB_LAST /end MEASUREMENT
/begin COMPU_METHOD CU_ISO2EVSEID[36] "Conversion method for Iso2EvseId[36]" RAT_FUNC "%10.0" "1" COEFFS 0.000000 1.000000 -0.000000 0.000000 0.000000 1.000000 /end COMPU_METHOD
/* Scalar measurable for DDE 'Iso2EvseId[37]'. */
/begin MEASUREMENT Iso2EvseId[37] "The ID that uniquely identifies the EVSE. Format is defined in the ISO 15118 ED2 Spec Annex H" UBYTE CU_ISO2EVSEID[37] 1 100 0.0 255.0 ECU_ADDRESS 0x70017d19 BYTE_ORDER MSB_LAST /end MEASUREMENT
/begin COMPU_METHOD CU_ISO2EVSEID[37] "Conversion method for Iso2EvseId[37]" RAT_FUNC "%10.0" "1" COEFFS 0.000000 1.000000 -0.000000 0.000000 0.000000 1.000000 /end COMPU_METHOD
/* Scalar measurable for DDE 'Iso2EvseId[3]'. */
/begin MEASUREMENT Iso2EvseId[3] "The ID that uniquely identifies the EVSE. Format is defined in the ISO 15118 ED2 Spec Annex H" UBYTE CU_ISO2EVSEID[3] 1 100 0.0 255.0 ECU_ADDRESS 0x70017cf7 BYTE_ORDER MSB_LAST /end MEASUREMENT
/begin COMPU_METHOD CU_ISO2EVSEID[3] "Conversion method for Iso2EvseId[3]" RAT_FUNC "%10.0" "1" COEFFS 0.000000 1.000000 -0.000000 0.000000 0.000000 1.000000 /end COMPU_METHOD
/* Scalar measurable for DDE 'Iso2EvseId[4]'. */
/begin MEASUREMENT Iso2EvseId[4] "The ID that uniquely identifies the EVSE. Format is defined in the ISO 15118 ED2 Spec Annex H" UBYTE CU_ISO2EVSEID[4] 1 100 0.0 255.0 ECU_ADDRESS 0x70017cf8 BYTE_ORDER MSB_LAST /end MEASUREMENT
/begin COMPU_METHOD CU_ISO2EVSEID[4] "Conversion method for Iso2EvseId[4]" RAT_FUNC "%10.0" "1" COEFFS 0.000000 1.000000 -0.000000 0.000000 0.000000 1.000000 /end COMPU_METHOD
/* Scalar measurable for DDE 'Iso2EvseId[5]'. */
/begin MEASUREMENT Iso2EvseId[5] "The ID that uniquely identifies the EVSE. Format is defined in the ISO 15118 ED2 Spec Annex H" UBYTE CU_ISO2EVSEID[5] 1 100 0.0 255.0 ECU_ADDRESS 0x70017cf9 BYTE_ORDER MSB_LAST /end MEASUREMENT
/begin COMPU_METHOD CU_ISO2EVSEID[5] "Conversion method for Iso2EvseId[5]" RAT_FUNC "%10.0" "1" COEFFS 0.000000 1.000000 -0.000000 0.000000 0.000000 1.000000 /end COMPU_METHOD
/* Scalar measurable for DDE 'Iso2EvseId[6]'. */
/begin MEASUREMENT Iso2EvseId[6] "The ID that uniquely identifies the EVSE. Format is defined in the ISO 15118 ED2 Spec Annex H" UBYTE CU_ISO2EVSEID[6] 1 100 0.0 255.0 ECU_ADDRESS 0x70017cfa BYTE_ORDER MSB_LAST /end MEASUREMENT
/begin COMPU_METHOD CU_ISO2EVSEID[6] "Conversion method for Iso2EvseId[6]" RAT_FUNC "%10.0" "1" COEFFS 0.000000 1.000000 -0.000000 0.000000 0.000000 1.000000 /end COMPU_METHOD
/* Scalar measurable for DDE 'Iso2EvseId[7]'. */
/begin MEASUREMENT Iso2EvseId[7] "The ID that uniquely identifies the EVSE. Format is defined in the ISO 15118 ED2 Spec Annex H" UBYTE CU_ISO2EVSEID[7] 1 100 0.0 255.0 ECU_ADDRESS 0x70017cfb BYTE_ORDER MSB_LAST /end MEASUREMENT
/begin COMPU_METHOD CU_ISO2EVSEID[7] "Conversion method for Iso2EvseId[7]" RAT_FUNC "%10.0" "1" COEFFS 0.000000 1.000000 -0.000000 0.000000 0.000000 1.000000 /end COMPU_METHOD
/* Scalar measurable for DDE 'Iso2EvseId[8]'. */
/begin MEASUREMENT Iso2EvseId[8] "The ID that uniquely identifies the EVSE. Format is defined in the ISO 15118 ED2 Spec Annex H" UBYTE CU_ISO2EVSEID[8] 1 100 0.0 255.0 ECU_ADDRESS 0x70017cfc BYTE_ORDER MSB_LAST /end MEASUREMENT
/begin COMPU_METHOD CU_ISO2EVSEID[8] "Conversion method for Iso2EvseId[8]" RAT_FUNC "%10.0" "1" COEFFS 0.000000 1.000000 -0.000000 0.000000 0.000000 1.000000 /end COMPU_METHOD
/* Scalar measurable for DDE 'Iso2EvseId[9]'. */
/begin MEASUREMENT Iso2EvseId[9] "The ID that uniquely identifies the EVSE. Format is defined in the ISO 15118 ED2 Spec Annex H" UBYTE CU_ISO2EVSEID[9] 1 100 0.0 255.0 ECU_ADDRESS 0x70017cfd BYTE_ORDER MSB_LAST /end MEASUREMENT
/begin COMPU_METHOD CU_ISO2EVSEID[9] "Conversion method for Iso2EvseId[9]" RAT_FUNC "%10.0" "1" COEFFS 0.000000 1.000000 -0.000000 0.000000 0.000000 1.000000 /end COMPU_METHOD
/* Scalar measurable for DDE 'Iso2PmtSelEvseStatPres'. */
/begin MEASUREMENT Iso2PmtSelEvseStatPres "Indicates the presence of the EVSENotificationMaxDelay and EVSENotification parameters in the PaymentServiceSelectionRes message" UBYTE CU_ISO2PMTSELEVSESTATPRES 1 100 0.0 1.0 ECU_ADDRESS 0x70018248 BYTE_ORDER MSB_LAST /end MEASUREMENT
/begin COMPU_METHOD CU_ISO2PMTSELEVSESTATPRES "Conversion method for Iso2PmtSelEvseStatPres" RAT_FUNC "%10.0" "b" COEFFS 0.000000 1.000000 -0.000000 0.000000 0.000000 1.000000 /end COMPU_METHOD
/* Scalar measurable for DDE 'Iso2PmtSelNotif'. */
/begin MEASUREMENT Iso2PmtSelNotif "Indicates action SECC wants the EVSE to perform in the PaymentServiceSelectionRes message" UBYTE CU_ISO2PMTSELNOTIF 1 100 0.0 255.0 ECU_ADDRESS 0x70017c2d BYTE_ORDER MSB_LAST /end MEASUREMENT
/begin COMPU_METHOD CU_ISO2PMTSELNOTIF "Conversion method for Iso2PmtSelNotif" RAT_FUNC "%10.0" "1" COEFFS 0.000000 1.000000 -0.000000 0.000000 0.000000 1.000000 /end COMPU_METHOD
/* Scalar measurable for DDE 'Iso2PmtSelNotifMaxDelay'. */
/begin MEASUREMENT Iso2PmtSelNotifMaxDelay "Indicates the time until the SECC expects the EVCC to react on the EVSENotification action set in the PaymentServiceSelectionRes message" UWORD CU_ISO2PMTSELNOTIFMAXDELAY 1 100 0.0 65535.0 ECU_ADDRESS 0x70018358 BYTE_ORDER MSB_LAST /end MEASUREMENT
/begin COMPU_METHOD CU_ISO2PMTSELNOTIFMAXDELAY "Conversion method for Iso2PmtSelNotifMaxDelay" RAT_FUNC "%10.0" "1" COEFFS 0.000000 1.000000 -0.000000 0.000000 0.000000 1.000000 /end COMPU_METHOD
/* Scalar measurable for DDE 'Iso2PmtSelRescode'. */
/begin MEASUREMENT Iso2PmtSelRescode "for ISOv2 PaymentServiceSelectionRes message: indicates the acknowledgment status of this V2G messages received by the SECC." UBYTE CU_ISO2PMTSELRESCODE 1 100 0.0 255.0 ECU_ADDRESS 0x700181a9 BYTE_ORDER MSB_LAST /end MEASUREMENT
/begin COMPU_METHOD CU_ISO2PMTSELRESCODE "Conversion method for Iso2PmtSelRescode" RAT_FUNC "%10.0" "1" COEFFS 0.000000 1.000000 -0.000000 0.000000 0.000000 1.000000 /end COMPU_METHOD
/* Scalar measurable for DDE 'Iso2PmtSelRxTrg'. */
/begin MEASUREMENT Iso2PmtSelRxTrg "Trigger flag that on a rising edge indicates the event for receiving the PLC (V2G) PaymentServiceSelectionRes message from the EVSE" UBYTE CU_ISO2PMTSELRXTRG 1 100 0.0 1.0 ECU_ADDRESS 0x70017f64 BYTE_ORDER MSB_LAST /end MEASUREMENT
/begin COMPU_METHOD CU_ISO2PMTSELRXTRG "Conversion method for Iso2PmtSelRxTrg" RAT_FUNC "%10.0" "b" COEFFS 0.000000 1.000000 -0.000000 0.000000 0.000000 1.000000 /end COMPU_METHOD
/* Scalar measurable for DDE 'Iso2PreChgEvsePresVolt'. */
/begin MEASUREMENT Iso2PreChgEvsePresVolt "Indicates the measured High Voltage DC (HVDC) voltage at the output of the DC Supply." FLOAT32_IEEE CU_ISO2PRECHGEVSEPRESVOLT 1 100 -3.40282346639e+38 3.40282346639e+38 ECU_ADDRESS 0x700181cc BYTE_ORDER MSB_LAST /end MEASUREMENT
/begin COMPU_METHOD CU_ISO2PRECHGEVSEPRESVOLT "Conversion method for Iso2PreChgEvsePresVolt" RAT_FUNC "%10.0" "%" COEFFS 0.000000 1.000000 -0.000000 0.000000 0.000000 1.000000 /end COMPU_METHOD
/* Scalar measurable for DDE 'Iso2PreChgEvseStatPres'. */
/begin MEASUREMENT Iso2PreChgEvseStatPres "Indicates the presence of the EVSENotificationMaxDelay and EVSENotification parameters in the PreChargeRes message" UBYTE CU_ISO2PRECHGEVSESTATPRES 1 100 0.0 1.0 ECU_ADDRESS 0x70018492 BYTE_ORDER MSB_LAST /end MEASUREMENT
/begin COMPU_METHOD CU_ISO2PRECHGEVSESTATPRES "Conversion method for Iso2PreChgEvseStatPres" RAT_FUNC "%10.0" "b" COEFFS 0.000000 1.000000 -0.000000 0.000000 0.000000 1.000000 /end COMPU_METHOD
/* Scalar measurable for DDE 'Iso2PreChgNotif'. */
/begin MEASUREMENT Iso2PreChgNotif "Indicates action SECC wants the EVSE to perform in the PreChargeRes message" UBYTE CU_ISO2PRECHGNOTIF 1 100 0.0 255.0 ECU_ADDRESS 0x70017e9d BYTE_ORDER MSB_LAST /end MEASUREMENT
/begin COMPU_METHOD CU_ISO2PRECHGNOTIF "Conversion method for Iso2PreChgNotif" RAT_FUNC "%10.0" "1" COEFFS 0.000000 1.000000 -0.000000 0.000000 0.000000 1.000000 /end COMPU_METHOD
/* Scalar measurable for DDE 'Iso2PreChgNotifMaxDelay'. */
/begin MEASUREMENT Iso2PreChgNotifMaxDelay "Indicates the time until the SECC expects the EVCC to react on the EVSENotification action set in the PreChargeRes message" UWORD CU_ISO2PRECHGNOTIFMAXDELAY 1 100 0.0 65535.0 ECU_ADDRESS 0x70017ce4 BYTE_ORDER MSB_LAST /end MEASUREMENT
/begin COMPU_METHOD CU_ISO2PRECHGNOTIFMAXDELAY "Conversion method for Iso2PreChgNotifMaxDelay" RAT_FUNC "%10.0" "1" COEFFS 0.000000 1.000000 -0.000000 0.000000 0.000000 1.000000 /end COMPU_METHOD
/* Scalar measurable for DDE 'Iso2PreChgRescode'. */
/begin MEASUREMENT Iso2PreChgRescode "for ISOv2 PreChargeRes message: indicates the acknowledgment status of this V2G messages received by the SECC." UBYTE CU_ISO2PRECHGRESCODE 1 100 0.0 255.0 ECU_ADDRESS 0x700183ff BYTE_ORDER MSB_LAST /end MEASUREMENT
/begin COMPU_METHOD CU_ISO2PRECHGRESCODE "Conversion method for Iso2PreChgRescode" RAT_FUNC "%10.0" "1" COEFFS 0.000000 1.000000 -0.000000 0.000000 0.000000 1.000000 /end COMPU_METHOD
/* Scalar measurable for DDE 'Iso2PreChgRxTrg'. */
/begin MEASUREMENT Iso2PreChgRxTrg "Trigger flag that on a rising edge indicates the event for receiving the PLC (V2G) PreChargeRes message from the EVSE" UBYTE CU_ISO2PRECHGRXTRG 1 100 0.0 1.0 ECU_ADDRESS 0x7001826d BYTE_ORDER MSB_LAST /end MEASUREMENT
/begin COMPU_METHOD CU_ISO2PRECHGRXTRG "Conversion method for Iso2PreChgRxTrg" RAT_FUNC "%10.0" "b" COEFFS 0.000000 1.000000 -0.000000 0.000000 0.000000 1.000000 /end COMPU_METHOD
/* Scalar measurable for DDE 'Iso2PwrDelivEvseProcessing'. */
/begin MEASUREMENT Iso2PwrDelivEvseProcessing "Indicates that the EVSE has either finished or still in process of finishing the processing that was started after the AuthorizationReq message" UBYTE CU_ISO2PWRDELIVEVSEPROCESSING 1 100 0.0 255.0 ECU_ADDRESS 0x70018450 BYTE_ORDER MSB_LAST /end MEASUREMENT
/begin COMPU_METHOD CU_ISO2PWRDELIVEVSEPROCESSING "Conversion method for Iso2PwrDelivEvseProcessing" RAT_FUNC "%10.0" "1" COEFFS 0.000000 1.000000 -0.000000 0.000000 0.000000 1.000000 /end COMPU_METHOD
/* Scalar measurable for DDE 'Iso2PwrDelivEvseStatPres'. */
/begin MEASUREMENT Iso2PwrDelivEvseStatPres "Indicates the presence of the EVSENotificationMaxDelay and EVSENotification parameters in the PowerDeliveryRes message" UBYTE CU_ISO2PWRDELIVEVSESTATPRES 1 100 0.0 1.0 ECU_ADDRESS 0x70017e39 BYTE_ORDER MSB_LAST /end MEASUREMENT
/begin COMPU_METHOD CU_ISO2PWRDELIVEVSESTATPRES "Conversion method for Iso2PwrDelivEvseStatPres" RAT_FUNC "%10.0" "b" COEFFS 0.000000 1.000000 -0.000000 0.000000 0.000000 1.000000 /end COMPU_METHOD
/* Scalar measurable for DDE 'Iso2PwrDelivNotif'. */
/begin MEASUREMENT Iso2PwrDelivNotif "Indicates action SECC wants the EVSE to perform in the PowerDeliveryRes message" UBYTE CU_ISO2PWRDELIVNOTIF 1 100 0.0 255.0 ECU_ADDRESS 0x700181a0 BYTE_ORDER MSB_LAST /end MEASUREMENT
/begin COMPU_METHOD CU_ISO2PWRDELIVNOTIF "Conversion method for Iso2PwrDelivNotif" RAT_FUNC "%10.0" "1" COEFFS 0.000000 1.000000 -0.000000 0.000000 0.000000 1.000000 /end COMPU_METHOD
/* Scalar measurable for DDE 'Iso2PwrDelivNotifMaxDelay'. */
/begin MEASUREMENT Iso2PwrDelivNotifMaxDelay "Indicates the time until the SECC expects the EVCC to react on the EVSENotification action set in the PowerDeliveryRes message" UWORD CU_ISO2PWRDELIVNOTIFMAXDELAY 1 100 0.0 65535.0 ECU_ADDRESS 0x70017f56 BYTE_ORDER MSB_LAST /end MEASUREMENT
/begin COMPU_METHOD CU_ISO2PWRDELIVNOTIFMAXDELAY "Conversion method for Iso2PwrDelivNotifMaxDelay" RAT_FUNC "%10.0" "1" COEFFS 0.000000 1.000000 -0.000000 0.000000 0.000000 1.000000 /end COMPU_METHOD
/* Scalar measurable for DDE 'Iso2PwrDelivRescode'. */
/begin MEASUREMENT Iso2PwrDelivRescode "for ISOv2 PowerDeliveryRes message: indicates the acknowledgment status of this V2G messages received by the SECC." UBYTE CU_ISO2PWRDELIVRESCODE 1 100 0.0 255.0 ECU_ADDRESS 0x70017db4 BYTE_ORDER MSB_LAST /end MEASUREMENT
/begin COMPU_METHOD CU_ISO2PWRDELIVRESCODE "Conversion method for Iso2PwrDelivRescode" RAT_FUNC "%10.0" "1" COEFFS 0.000000 1.000000 -0.000000 0.000000 0.000000 1.000000 /end COMPU_METHOD
/* Scalar measurable for DDE 'Iso2PwrDelivRxTrg'. */
/begin MEASUREMENT Iso2PwrDelivRxTrg "Trigger flag that on a rising edge indicates the event for receiving the PLC (V2G) PowerDeliveryRes message from the EVSE" UBYTE CU_ISO2PWRDELIVRXTRG 1 100 0.0 1.0 ECU_ADDRESS 0x700183bd BYTE_ORDER MSB_LAST /end MEASUREMENT
/begin COMPU_METHOD CU_ISO2PWRDELIVRXTRG "Conversion method for Iso2PwrDelivRxTrg" RAT_FUNC "%10.0" "b" COEFFS 0.000000 1.000000 -0.000000 0.000000 0.000000 1.000000 /end COMPU_METHOD
/* Scalar measurable for DDE 'Iso2SesSetupNotif'. */
/begin MEASUREMENT Iso2SesSetupNotif "Indicates action SECC wants the EVSE to perform in the SessionSetupRes message" UBYTE CU_ISO2SESSETUPNOTIF 1 100 0.0 255.0 ECU_ADDRESS 0x70017de8 BYTE_ORDER MSB_LAST /end MEASUREMENT
/begin COMPU_METHOD CU_ISO2SESSETUPNOTIF "Conversion method for Iso2SesSetupNotif" RAT_FUNC "%10.0" "1" COEFFS 0.000000 1.000000 -0.000000 0.000000 0.000000 1.000000 /end COMPU_METHOD
/* Scalar measurable for DDE 'Iso2SesSetupNotifMaxDelay'. */
/begin MEASUREMENT Iso2SesSetupNotifMaxDelay "Indicates the time until the SECC expects the EVCC to react on the EVSENotification action set in the SessionSetupRes message" UWORD CU_ISO2SESSETUPNOTIFMAXDELAY 1 100 0.0 65535.0 ECU_ADDRESS 0x7001814e BYTE_ORDER MSB_LAST /end MEASUREMENT
/begin COMPU_METHOD CU_ISO2SESSETUPNOTIFMAXDELAY "Conversion method for Iso2SesSetupNotifMaxDelay" RAT_FUNC "%10.0" "1" COEFFS 0.000000 1.000000 -0.000000 0.000000 0.000000 1.000000 /end COMPU_METHOD
/* Scalar measurable for DDE 'Iso2SesSetupRescode'. */
/begin MEASUREMENT Iso2SesSetupRescode "for ISOv2 SessionSetupRes message: indicates the acknowledgment status of this V2G messages received by the SECC." UBYTE CU_ISO2SESSETUPRESCODE 1 100 0.0 255.0 ECU_ADDRESS 0x700183f4 BYTE_ORDER MSB_LAST /end MEASUREMENT
/begin COMPU_METHOD CU_ISO2SESSETUPRESCODE "Conversion method for Iso2SesSetupRescode" RAT_FUNC "%10.0" "1" COEFFS 0.000000 1.000000 -0.000000 0.000000 0.000000 1.000000 /end COMPU_METHOD
/* Scalar measurable for DDE 'Iso2SesSetupRxTrg'. */
/begin MEASUREMENT Iso2SesSetupRxTrg "Trigger flag that on a rising edge indicates the event for receiving the PLC (V2G) SessionSetupRes message from the EVSE" UBYTE CU_ISO2SESSETUPRXTRG 1 100 0.0 1.0 ECU_ADDRESS 0x7001825d BYTE_ORDER MSB_LAST /end MEASUREMENT
/begin COMPU_METHOD CU_ISO2SESSETUPRXTRG "Conversion method for Iso2SesSetupRxTrg" RAT_FUNC "%10.0" "b" COEFFS 0.000000 1.000000 -0.000000 0.000000 0.000000 1.000000 /end COMPU_METHOD
/* Scalar measurable for DDE 'Iso2SesSetupTimestmp'. */
/begin MEASUREMENT Iso2SesSetupTimestmp "Timestamp of the current SECC time using the Unix Time Stamp format." SLONG CU_ISO2SESSETUPTIMESTMP 1 100 0.0 2147483647.0 ECU_ADDRESS 0x70018000 BYTE_ORDER MSB_LAST /end MEASUREMENT
/begin COMPU_METHOD CU_ISO2SESSETUPTIMESTMP "Conversion method for Iso2SesSetupTimestmp" RAT_FUNC "%10.0" "1" COEFFS 0.000000 1.000000 -0.000000 0.000000 0.000000 1.000000 /end COMPU_METHOD
/* Scalar measurable for DDE 'Iso2SesSetupTimestmpPres'. */
/begin MEASUREMENT Iso2SesSetupTimestmpPres "Indicates the presence of the EVSETimeStamp parameter" UBYTE CU_ISO2SESSETUPTIMESTMPPRES 1 100 0.0 1.0 ECU_ADDRESS 0x70017d96 BYTE_ORDER MSB_LAST /end MEASUREMENT
/begin COMPU_METHOD CU_ISO2SESSETUPTIMESTMPPRES "Conversion method for Iso2SesSetupTimestmpPres" RAT_FUNC "%10.0" "b" COEFFS 0.000000 1.000000 -0.000000 0.000000 0.000000 1.000000 /end COMPU_METHOD
/* Scalar measurable for DDE 'Iso2SesStopEvseStatPres'. */
/begin MEASUREMENT Iso2SesStopEvseStatPres "Indicates the presence of the EVSENotificationMaxDelay and EVSENotification parameters in the SessionStopRes message" UBYTE CU_ISO2SESSTOPEVSESTATPRES 1 100 0.0 1.0 ECU_ADDRESS 0x70018055 BYTE_ORDER MSB_LAST /end MEASUREMENT
/begin COMPU_METHOD CU_ISO2SESSTOPEVSESTATPRES "Conversion method for Iso2SesStopEvseStatPres" RAT_FUNC "%10.0" "b" COEFFS 0.000000 1.000000 -0.000000 0.000000 0.000000 1.000000 /end COMPU_METHOD
/* Scalar measurable for DDE 'Iso2SesStopNotif'. */
/begin MEASUREMENT Iso2SesStopNotif "Indicates action SECC wants the EVSE to perform in the SessionStopRes message" UBYTE CU_ISO2SESSTOPNOTIF 1 100 0.0 255.0 ECU_ADDRESS 0x70018390 BYTE_ORDER MSB_LAST /end MEASUREMENT
/begin COMPU_METHOD CU_ISO2SESSTOPNOTIF "Conversion method for Iso2SesStopNotif" RAT_FUNC "%10.0" "1" COEFFS 0.000000 1.000000 -0.000000 0.000000 0.000000 1.000000 /end COMPU_METHOD
/* Scalar measurable for DDE 'Iso2SesStopNotifMaxDelay'. */
/begin MEASUREMENT Iso2SesStopNotifMaxDelay "Indicates the time until the SECC expects the EVCC to react on the EVSENotification action set in the SessionStopRes message" UWORD CU_ISO2SESSTOPNOTIFMAXDELAY 1 100 0.0 65535.0 ECU_ADDRESS 0x70017dac BYTE_ORDER MSB_LAST /end MEASUREMENT
/begin COMPU_METHOD CU_ISO2SESSTOPNOTIFMAXDELAY "Conversion method for Iso2SesStopNotifMaxDelay" RAT_FUNC "%10.0" "1" COEFFS 0.000000 1.000000 -0.000000 0.000000 0.000000 1.000000 /end COMPU_METHOD
/* Scalar measurable for DDE 'Iso2SesStopRescode'. */
/begin MEASUREMENT Iso2SesStopRescode "for ISOv2 SessionStopRes message: indicates the acknowledgment status of this V2G messages received by the SECC." UBYTE CU_ISO2SESSTOPRESCODE 1 100 0.0 255.0 ECU_ADDRESS 0x7001849d BYTE_ORDER MSB_LAST /end MEASUREMENT
/begin COMPU_METHOD CU_ISO2SESSTOPRESCODE "Conversion method for Iso2SesStopRescode" RAT_FUNC "%10.0" "1" COEFFS 0.000000 1.000000 -0.000000 0.000000 0.000000 1.000000 /end COMPU_METHOD
/* Scalar measurable for DDE 'Iso2SesStopRxTrg'. */
/begin MEASUREMENT Iso2SesStopRxTrg "Trigger flag that on a rising edge indicates the event for receiving the PLC (V2G) SessionStopRes message from the EVSE" UBYTE CU_ISO2SESSTOPRXTRG 1 100 0.0 1.0 ECU_ADDRESS 0x70018309 BYTE_ORDER MSB_LAST /end MEASUREMENT
/begin COMPU_METHOD CU_ISO2SESSTOPRXTRG "Conversion method for Iso2SesStopRxTrg" RAT_FUNC "%10.0" "b" COEFFS 0.000000 1.000000 -0.000000 0.000000 0.000000 1.000000 /end COMPU_METHOD
/* Scalar measurable for DDE 'Iso2SvcDetailEvseMaxDelay'. */
/begin MEASUREMENT Iso2SvcDetailEvseMaxDelay "Indicates the time until the SECC expects the EVCC to react on the EVSENotification action set in the ServiceDetailRes message" UWORD CU_ISO2SVCDETAILEVSEMAXDELAY 1 100 0.0 65535.0 ECU_ADDRESS 0x70017fca BYTE_ORDER MSB_LAST /end MEASUREMENT
/begin COMPU_METHOD CU_ISO2SVCDETAILEVSEMAXDELAY "Conversion method for Iso2SvcDetailEvseMaxDelay" RAT_FUNC "%10.0" "1" COEFFS 0.000000 1.000000 -0.000000 0.000000 0.000000 1.000000 /end COMPU_METHOD
/* Scalar measurable for DDE 'Iso2SvcDetailEvseStatPres'. */
/begin MEASUREMENT Iso2SvcDetailEvseStatPres "Indicates the presence of the EVSENotificationMaxDelay and EVSENotification parameters in the ServiceDetailRes message" UBYTE CU_ISO2SVCDETAILEVSESTATPRES 1 100 0.0 1.0 ECU_ADDRESS 0x70018341 BYTE_ORDER MSB_LAST /end MEASUREMENT
/begin COMPU_METHOD CU_ISO2SVCDETAILEVSESTATPRES "Conversion method for Iso2SvcDetailEvseStatPres" RAT_FUNC "%10.0" "b" COEFFS 0.000000 1.000000 -0.000000 0.000000 0.000000 1.000000 /end COMPU_METHOD
/* Scalar measurable for DDE 'Iso2SvcDetailNotif'. */
/begin MEASUREMENT Iso2SvcDetailNotif "Indicates action SECC wants the EVSE to perform in the ServiceDetailRes message" UBYTE CU_ISO2SVCDETAILNOTIF 1 100 0.0 255.0 ECU_ADDRESS 0x70017d4a BYTE_ORDER MSB_LAST /end MEASUREMENT
/begin COMPU_METHOD CU_ISO2SVCDETAILNOTIF "Conversion method for Iso2SvcDetailNotif" RAT_FUNC "%10.0" "1" COEFFS 0.000000 1.000000 -0.000000 0.000000 0.000000 1.000000 /end COMPU_METHOD
/* Scalar measurable for DDE 'Iso2SvcDetailRescode'. */
/begin MEASUREMENT Iso2SvcDetailRescode "for ISOv2 ServiceDetailRes message: indicates the acknowledgment status of this V2G messages received by the SECC." UBYTE CU_ISO2SVCDETAILRESCODE 1 100 0.0 255.0 ECU_ADDRESS 0x7001845d BYTE_ORDER MSB_LAST /end MEASUREMENT
/begin COMPU_METHOD CU_ISO2SVCDETAILRESCODE "Conversion method for Iso2SvcDetailRescode" RAT_FUNC "%10.0" "1" COEFFS 0.000000 1.000000 -0.000000 0.000000 0.000000 1.000000 /end COMPU_METHOD
/* Scalar measurable for DDE 'Iso2SvcDetailRxTrg'. */
/begin MEASUREMENT Iso2SvcDetailRxTrg "Trigger flag that on a rising edge indicates the event for receiving the PLC (V2G) ServiceDetailRes message from the EVSE" UBYTE CU_ISO2SVCDETAILRXTRG 1 100 0.0 1.0 ECU_ADDRESS 0x700182a6 BYTE_ORDER MSB_LAST /end MEASUREMENT
/begin COMPU_METHOD CU_ISO2SVCDETAILRXTRG "Conversion method for Iso2SvcDetailRxTrg" RAT_FUNC "%10.0" "b" COEFFS 0.000000 1.000000 -0.000000 0.000000 0.000000 1.000000 /end COMPU_METHOD
/* Scalar measurable for DDE 'Iso2SvcDetailSvcId'. */
/begin MEASUREMENT Iso2SvcDetailSvcId "Identifies a service which has been offered by the SECC in the ServiceDiscoveryRes message" UWORD CU_ISO2SVCDETAILSVCID 1 100 0.0 65535.0 ECU_ADDRESS 0x70018098 BYTE_ORDER MSB_LAST /end MEASUREMENT
/begin COMPU_METHOD CU_ISO2SVCDETAILSVCID "Conversion method for Iso2SvcDetailSvcId" RAT_FUNC "%10.0" "1" COEFFS 0.000000 1.000000 -0.000000 0.000000 0.000000 1.000000 /end COMPU_METHOD
/* Scalar measurable for DDE 'Iso2SvcDetailSvcParamSetLen'. */
/begin MEASUREMENT Iso2SvcDetailSvcParamSetLen "Actual number of elements in the ServiceParameterList parameter of the ServiceDetailRes message" UBYTE CU_ISO2SVCDETAILSVCPARAMSETLEN 1 100 0.0 255.0 ECU_ADDRESS 0x70017de1 BYTE_ORDER MSB_LAST /end MEASUREMENT
/begin COMPU_METHOD CU_ISO2SVCDETAILSVCPARAMSETLEN "Conversion method for Iso2SvcDetailSvcParamSetLen" RAT_FUNC "%10.0" "1" COEFFS 0.000000 1.000000 -0.000000 0.000000 0.000000 1.000000 /end COMPU_METHOD
/* Scalar measurable for DDE 'Iso2SvcDetailSvcParamSetSizes[0]'. */
/begin MEASUREMENT Iso2SvcDetailSvcParamSetSizes[1 "Indicates the array that holds the array length of each parameter in each parameter set. \n(i.e holds the array length of ServiceDetailRes -> ServiceParameterList -> ParameterSet -> Parameter)" UBYTE CU_ISO2SVCDETAILSVCPARAMSETSIZ1 1 100 0.0 255.0 ECU_ADDRESS 0x70018148 BYTE_ORDER MSB_LAST /end MEASUREMENT
/begin COMPU_METHOD CU_ISO2SVCDETAILSVCPARAMSETSIZ1 "Conversion method for Iso2SvcDetailSvcParamSetSizes[0]" RAT_FUNC "%10.0" "1" COEFFS 0.000000 1.000000 -0.000000 0.000000 0.000000 1.000000 /end COMPU_METHOD
/* Scalar measurable for DDE 'Iso2SvcDetailSvcParamSetSizes[1]'. */
/begin MEASUREMENT Iso2SvcDetailSvcParamSetSizes[2 "Indicates the array that holds the array length of each parameter in each parameter set. \n(i.e holds the array length of ServiceDetailRes -> ServiceParameterList -> ParameterSet -> Parameter)" UBYTE CU_ISO2SVCDETAILSVCPARAMSETSIZ2 1 100 0.0 255.0 ECU_ADDRESS 0x70018149 BYTE_ORDER MSB_LAST /end MEASUREMENT
/begin COMPU_METHOD CU_ISO2SVCDETAILSVCPARAMSETSIZ2 "Conversion method for Iso2SvcDetailSvcParamSetSizes[1]" RAT_FUNC "%10.0" "1" COEFFS 0.000000 1.000000 -0.000000 0.000000 0.000000 1.000000 /end COMPU_METHOD
/* Scalar measurable for DDE 'Iso2SvcDetailSvcParamSetSizes[2]'. */
/begin MEASUREMENT Iso2SvcDetailSvcParamSetSizes[0 "Indicates the array that holds the array length of each parameter in each parameter set. \n(i.e holds the array length of ServiceDetailRes -> ServiceParameterList -> ParameterSet -> Parameter)" UBYTE CU_ISO2SVCDETAILSVCPARAMSETSIZ0 1 100 0.0 255.0 ECU_ADDRESS 0x7001814a BYTE_ORDER MSB_LAST /end MEASUREMENT
/begin COMPU_METHOD CU_ISO2SVCDETAILSVCPARAMSETSIZ0 "Conversion method for Iso2SvcDetailSvcParamSetSizes[2]" RAT_FUNC "%10.0" "1" COEFFS 0.000000 1.000000 -0.000000 0.000000 0.000000 1.000000 /end COMPU_METHOD
/* Scalar measurable for DDE 'Iso2SvcDetailSvcParamSetSizes[3]'. */
/begin MEASUREMENT Iso2SvcDetailSvcParamSetSizes[3 "Indicates the array that holds the array length of each parameter in each parameter set. \n(i.e holds the array length of ServiceDetailRes -> ServiceParameterList -> ParameterSet -> Parameter)" UBYTE CU_ISO2SVCDETAILSVCPARAMSETSIZ3 1 100 0.0 255.0 ECU_ADDRESS 0x7001814b BYTE_ORDER MSB_LAST /end MEASUREMENT
/begin COMPU_METHOD CU_ISO2SVCDETAILSVCPARAMSETSIZ3 "Conversion method for Iso2SvcDetailSvcParamSetSizes[3]" RAT_FUNC "%10.0" "1" COEFFS 0.000000 1.000000 -0.000000 0.000000 0.000000 1.000000 /end COMPU_METHOD
/* Scalar measurable for DDE 'Iso2SvcDetailSvcParamSetSizes[4]'. */
/begin MEASUREMENT Iso2SvcDetailSvcParamSetSizes[4 "Indicates the array that holds the array length of each parameter in each parameter set. \n(i.e holds the array length of ServiceDetailRes -> ServiceParameterList -> ParameterSet -> Parameter)" UBYTE CU_ISO2SVCDETAILSVCPARAMSETSIZ4 1 100 0.0 255.0 ECU_ADDRESS 0x7001814c BYTE_ORDER MSB_LAST /end MEASUREMENT
/begin COMPU_METHOD CU_ISO2SVCDETAILSVCPARAMSETSIZ4 "Conversion method for Iso2SvcDetailSvcParamSetSizes[4]" RAT_FUNC "%10.0" "1" COEFFS 0.000000 1.000000 -0.000000 0.000000 0.000000 1.000000 /end COMPU_METHOD
/* Scalar measurable for DDE 'Iso2SvcDiscEgyTrnsLen'. */
/begin MEASUREMENT Iso2SvcDiscEgyTrnsLen "Actual number of elements in the Iso2SvcDiscEnergyTransferSvcIds and Iso2SvcDiscEnergyTransferSvcFreeSvc lists" UBYTE CU_ISO2SVCDISCEGYTRNSLEN 1 100 0.0 255.0 ECU_ADDRESS 0x700183ed BYTE_ORDER MSB_LAST /end MEASUREMENT
/begin COMPU_METHOD CU_ISO2SVCDISCEGYTRNSLEN "Conversion method for Iso2SvcDiscEgyTrnsLen" RAT_FUNC "%10.0" "1" COEFFS 0.000000 1.000000 -0.000000 0.000000 0.000000 1.000000 /end COMPU_METHOD
/* Scalar measurable for DDE 'Iso2SvcDiscEgyTrnsSvcFreeSvc[0]'. */
/begin MEASUREMENT Iso2SvcDiscEgyTrnsSvcFreeSvc[0] "Indicates a list of booleans that denote if a service at a index is free of charge or not." UBYTE CU_ISO2SVCDISCEGYTRNSSVCFREESV2 1 100 0.0 1.0 ECU_ADDRESS 0x70018254 BYTE_ORDER MSB_LAST /end MEASUREMENT
/begin COMPU_METHOD CU_ISO2SVCDISCEGYTRNSSVCFREESV2 "Conversion method for Iso2SvcDiscEgyTrnsSvcFreeSvc[0]" RAT_FUNC "%10.0" "1" COEFFS 0.000000 1.000000 -0.000000 0.000000 0.000000 1.000000 /end COMPU_METHOD
/* Scalar measurable for DDE 'Iso2SvcDiscEgyTrnsSvcFreeSvc[1]'. */
/begin MEASUREMENT Iso2SvcDiscEgyTrnsSvcFreeSvc[1] "Indicates a list of booleans that denote if a service at a index is free of charge or not." UBYTE CU_ISO2SVCDISCEGYTRNSSVCFREESV7 1 100 0.0 1.0 ECU_ADDRESS 0x70018255 BYTE_ORDER MSB_LAST /end MEASUREMENT
/begin COMPU_METHOD CU_ISO2SVCDISCEGYTRNSSVCFREESV7 "Conversion method for Iso2SvcDiscEgyTrnsSvcFreeSvc[1]" RAT_FUNC "%10.0" "1" COEFFS 0.000000 1.000000 -0.000000 0.000000 0.000000 1.000000 /end COMPU_METHOD
/* Scalar measurable for DDE 'Iso2SvcDiscEgyTrnsSvcFreeSvc[2]'. */
/begin MEASUREMENT Iso2SvcDiscEgyTrnsSvcFreeSvc[2] "Indicates a list of booleans that denote if a service at a index is free of charge or not." UBYTE CU_ISO2SVCDISCEGYTRNSSVCFREESV1 1 100 0.0 1.0 ECU_ADDRESS 0x70018256 BYTE_ORDER MSB_LAST /end MEASUREMENT
/begin COMPU_METHOD CU_ISO2SVCDISCEGYTRNSSVCFREESV1 "Conversion method for Iso2SvcDiscEgyTrnsSvcFreeSvc[2]" RAT_FUNC "%10.0" "1" COEFFS 0.000000 1.000000 -0.000000 0.000000 0.000000 1.000000 /end COMPU_METHOD
/* Scalar measurable for DDE 'Iso2SvcDiscEgyTrnsSvcFreeSvc[3]'. */
/begin MEASUREMENT Iso2SvcDiscEgyTrnsSvcFreeSvc[3] "Indicates a list of booleans that denote if a service at a index is free of charge or not." UBYTE CU_ISO2SVCDISCEGYTRNSSVCFREESV0 1 100 0.0 1.0 ECU_ADDRESS 0x70018257 BYTE_ORDER MSB_LAST /end MEASUREMENT
/begin COMPU_METHOD CU_ISO2SVCDISCEGYTRNSSVCFREESV0 "Conversion method for Iso2SvcDiscEgyTrnsSvcFreeSvc[3]" RAT_FUNC "%10.0" "1" COEFFS 0.000000 1.000000 -0.000000 0.000000 0.000000 1.000000 /end COMPU_METHOD
/* Scalar measurable for DDE 'Iso2SvcDiscEgyTrnsSvcFreeSvc[4]'. */
/begin MEASUREMENT Iso2SvcDiscEgyTrnsSvcFreeSvc[4] "Indicates a list of booleans that denote if a service at a index is free of charge or not." UBYTE CU_ISO2SVCDISCEGYTRNSSVCFREESV4 1 100 0.0 1.0 ECU_ADDRESS 0x70018258 BYTE_ORDER MSB_LAST /end MEASUREMENT
/begin COMPU_METHOD CU_ISO2SVCDISCEGYTRNSSVCFREESV4 "Conversion method for Iso2SvcDiscEgyTrnsSvcFreeSvc[4]" RAT_FUNC "%10.0" "1" COEFFS 0.000000 1.000000 -0.000000 0.000000 0.000000 1.000000 /end COMPU_METHOD
/* Scalar measurable for DDE 'Iso2SvcDiscEgyTrnsSvcFreeSvc[5]'. */
/begin MEASUREMENT Iso2SvcDiscEgyTrnsSvcFreeSvc[5] "Indicates a list of booleans that denote if a service at a index is free of charge or not." UBYTE CU_ISO2SVCDISCEGYTRNSSVCFREESV3 1 100 0.0 1.0 ECU_ADDRESS 0x70018259 BYTE_ORDER MSB_LAST /end MEASUREMENT
/begin COMPU_METHOD CU_ISO2SVCDISCEGYTRNSSVCFREESV3 "Conversion method for Iso2SvcDiscEgyTrnsSvcFreeSvc[5]" RAT_FUNC "%10.0" "1" COEFFS 0.000000 1.000000 -0.000000 0.000000 0.000000 1.000000 /end COMPU_METHOD
/* Scalar measurable for DDE 'Iso2SvcDiscEgyTrnsSvcFreeSvc[6]'. */
/begin MEASUREMENT Iso2SvcDiscEgyTrnsSvcFreeSvc[6] "Indicates a list of booleans that denote if a service at a index is free of charge or not." UBYTE CU_ISO2SVCDISCEGYTRNSSVCFREESV6 1 100 0.0 1.0 ECU_ADDRESS 0x7001825a BYTE_ORDER MSB_LAST /end MEASUREMENT
/begin COMPU_METHOD CU_ISO2SVCDISCEGYTRNSSVCFREESV6 "Conversion method for Iso2SvcDiscEgyTrnsSvcFreeSvc[6]" RAT_FUNC "%10.0" "1" COEFFS 0.000000 1.000000 -0.000000 0.000000 0.000000 1.000000 /end COMPU_METHOD
/* Scalar measurable for DDE 'Iso2SvcDiscEgyTrnsSvcFreeSvc[7]'. */
/begin MEASUREMENT Iso2SvcDiscEgyTrnsSvcFreeSvc[7] "Indicates a list of booleans that denote if a service at a index is free of charge or not." UBYTE CU_ISO2SVCDISCEGYTRNSSVCFREESV5 1 100 0.0 1.0 ECU_ADDRESS 0x7001825b BYTE_ORDER MSB_LAST /end MEASUREMENT
/begin COMPU_METHOD CU_ISO2SVCDISCEGYTRNSSVCFREESV5 "Conversion method for Iso2SvcDiscEgyTrnsSvcFreeSvc[7]" RAT_FUNC "%10.0" "1" COEFFS 0.000000 1.000000 -0.000000 0.000000 0.000000 1.000000 /end COMPU_METHOD
/* Scalar measurable for DDE 'Iso2SvcDiscEgyTrnsSvcIds[0]'. */
/begin MEASUREMENT Iso2SvcDiscEgyTrnsSvcIds[0] "Indicates the list of service IDs of the available charging and BPT services supported by the EVSE" UWORD CU_ISO2SVCDISCEGYTRNSSVCIDS[0] 1 100 0.0 65535.0 ECU_ADDRESS 0x70017fee BYTE_ORDER MSB_LAST /end MEASUREMENT
/begin COMPU_METHOD CU_ISO2SVCDISCEGYTRNSSVCIDS[0] "Conversion method for Iso2SvcDiscEgyTrnsSvcIds[0]" RAT_FUNC "%10.0" "1" COEFFS 0.000000 1.000000 -0.000000 0.000000 0.000000 1.000000 /end COMPU_METHOD
/* Scalar measurable for DDE 'Iso2SvcDiscEgyTrnsSvcIds[1]'. */
/begin MEASUREMENT Iso2SvcDiscEgyTrnsSvcIds[1] "Indicates the list of service IDs of the available charging and BPT services supported by the EVSE" UWORD CU_ISO2SVCDISCEGYTRNSSVCIDS[1] 1 100 0.0 65535.0 ECU_ADDRESS 0x70017ff0 BYTE_ORDER MSB_LAST /end MEASUREMENT
/begin COMPU_METHOD CU_ISO2SVCDISCEGYTRNSSVCIDS[1] "Conversion method for Iso2SvcDiscEgyTrnsSvcIds[1]" RAT_FUNC "%10.0" "1" COEFFS 0.000000 1.000000 -0.000000 0.000000 0.000000 1.000000 /end COMPU_METHOD
/* Scalar measurable for DDE 'Iso2SvcDiscEgyTrnsSvcIds[2]'. */
/begin MEASUREMENT Iso2SvcDiscEgyTrnsSvcIds[2] "Indicates the list of service IDs of the available charging and BPT services supported by the EVSE" UWORD CU_ISO2SVCDISCEGYTRNSSVCIDS[2] 1 100 0.0 65535.0 ECU_ADDRESS 0x70017ff2 BYTE_ORDER MSB_LAST /end MEASUREMENT
/begin COMPU_METHOD CU_ISO2SVCDISCEGYTRNSSVCIDS[2] "Conversion method for Iso2SvcDiscEgyTrnsSvcIds[2]" RAT_FUNC "%10.0" "1" COEFFS 0.000000 1.000000 -0.000000 0.000000 0.000000 1.000000 /end COMPU_METHOD
/* Scalar measurable for DDE 'Iso2SvcDiscEgyTrnsSvcIds[3]'. */
/begin MEASUREMENT Iso2SvcDiscEgyTrnsSvcIds[3] "Indicates the list of service IDs of the available charging and BPT services supported by the EVSE" UWORD CU_ISO2SVCDISCEGYTRNSSVCIDS[3] 1 100 0.0 65535.0 ECU_ADDRESS 0x70017ff4 BYTE_ORDER MSB_LAST /end MEASUREMENT
/begin COMPU_METHOD CU_ISO2SVCDISCEGYTRNSSVCIDS[3] "Conversion method for Iso2SvcDiscEgyTrnsSvcIds[3]" RAT_FUNC "%10.0" "1" COEFFS 0.000000 1.000000 -0.000000 0.000000 0.000000 1.000000 /end COMPU_METHOD
/* Scalar measurable for DDE 'Iso2SvcDiscEgyTrnsSvcIds[4]'. */
/begin MEASUREMENT Iso2SvcDiscEgyTrnsSvcIds[4] "Indicates the list of service IDs of the available charging and BPT services supported by the EVSE" UWORD CU_ISO2SVCDISCEGYTRNSSVCIDS[4] 1 100 0.0 65535.0 ECU_ADDRESS 0x70017ff6 BYTE_ORDER MSB_LAST /end MEASUREMENT
/begin COMPU_METHOD CU_ISO2SVCDISCEGYTRNSSVCIDS[4] "Conversion method for Iso2SvcDiscEgyTrnsSvcIds[4]" RAT_FUNC "%10.0" "1" COEFFS 0.000000 1.000000 -0.000000 0.000000 0.000000 1.000000 /end COMPU_METHOD
/* Scalar measurable for DDE 'Iso2SvcDiscEgyTrnsSvcIds[5]'. */
/begin MEASUREMENT Iso2SvcDiscEgyTrnsSvcIds[5] "Indicates the list of service IDs of the available charging and BPT services supported by the EVSE" UWORD CU_ISO2SVCDISCEGYTRNSSVCIDS[5] 1 100 0.0 65535.0 ECU_ADDRESS 0x70017ff8 BYTE_ORDER MSB_LAST /end MEASUREMENT
/begin COMPU_METHOD CU_ISO2SVCDISCEGYTRNSSVCIDS[5] "Conversion method for Iso2SvcDiscEgyTrnsSvcIds[5]" RAT_FUNC "%10.0" "1" COEFFS 0.000000 1.000000 -0.000000 0.000000 0.000000 1.000000 /end COMPU_METHOD
/* Scalar measurable for DDE 'Iso2SvcDiscEgyTrnsSvcIds[6]'. */
/begin MEASUREMENT Iso2SvcDiscEgyTrnsSvcIds[6] "Indicates the list of service IDs of the available charging and BPT services supported by the EVSE" UWORD CU_ISO2SVCDISCEGYTRNSSVCIDS[6] 1 100 0.0 65535.0 ECU_ADDRESS 0x70017ffa BYTE_ORDER MSB_LAST /end MEASUREMENT
/begin COMPU_METHOD CU_ISO2SVCDISCEGYTRNSSVCIDS[6] "Conversion method for Iso2SvcDiscEgyTrnsSvcIds[6]" RAT_FUNC "%10.0" "1" COEFFS 0.000000 1.000000 -0.000000 0.000000 0.000000 1.000000 /end COMPU_METHOD
/* Scalar measurable for DDE 'Iso2SvcDiscEgyTrnsSvcIds[7]'. */
/begin MEASUREMENT Iso2SvcDiscEgyTrnsSvcIds[7] "Indicates the list of service IDs of the available charging and BPT services supported by the EVSE" UWORD CU_ISO2SVCDISCEGYTRNSSVCIDS[7] 1 100 0.0 65535.0 ECU_ADDRESS 0x70017ffc BYTE_ORDER MSB_LAST /end MEASUREMENT
/begin COMPU_METHOD CU_ISO2SVCDISCEGYTRNSSVCIDS[7] "Conversion method for Iso2SvcDiscEgyTrnsSvcIds[7]" RAT_FUNC "%10.0" "1" COEFFS 0.000000 1.000000 -0.000000 0.000000 0.000000 1.000000 /end COMPU_METHOD
/* Scalar measurable for DDE 'Iso2SvcDiscEvseStatPres'. */
/begin MEASUREMENT Iso2SvcDiscEvseStatPres "Indicates the presence of the EVSENotificationMaxDelay and EVSENotification parameters in the ServiceDiscoveryRes message" UBYTE CU_ISO2SVCDISCEVSESTATPRES 1 100 0.0 1.0 ECU_ADDRESS 0x70017e62 BYTE_ORDER MSB_LAST /end MEASUREMENT
/begin COMPU_METHOD CU_ISO2SVCDISCEVSESTATPRES "Conversion method for Iso2SvcDiscEvseStatPres" RAT_FUNC "%10.0" "b" COEFFS 0.000000 1.000000 -0.000000 0.000000 0.000000 1.000000 /end COMPU_METHOD
/* Scalar measurable for DDE 'Iso2SvcDiscNotif'. */
/begin MEASUREMENT Iso2SvcDiscNotif "Indicates action SECC wants the EVSE to perform in the ServiceDiscoveryRes message" UBYTE CU_ISO2SVCDISCNOTIF 1 100 0.0 255.0 ECU_ADDRESS 0x70018484 BYTE_ORDER MSB_LAST /end MEASUREMENT
/begin COMPU_METHOD CU_ISO2SVCDISCNOTIF "Conversion method for Iso2SvcDiscNotif" RAT_FUNC "%10.0" "1" COEFFS 0.000000 1.000000 -0.000000 0.000000 0.000000 1.000000 /end COMPU_METHOD
/* Scalar measurable for DDE 'Iso2SvcDiscNotifMaxDelay'. */
/begin MEASUREMENT Iso2SvcDiscNotifMaxDelay "Indicates the time until the SECC expects the EVCC to react on the EVSENotification action set in the ServiceDiscoveryRes message" UWORD CU_ISO2SVCDISCNOTIFMAXDELAY 1 100 0.0 65535.0 ECU_ADDRESS 0x70017e94 BYTE_ORDER MSB_LAST /end MEASUREMENT
/begin COMPU_METHOD CU_ISO2SVCDISCNOTIFMAXDELAY "Conversion method for Iso2SvcDiscNotifMaxDelay" RAT_FUNC "%10.0" "1" COEFFS 0.000000 1.000000 -0.000000 0.000000 0.000000 1.000000 /end COMPU_METHOD
/* Scalar measurable for DDE 'Iso2SvcDiscRescode'. */
/begin MEASUREMENT Iso2SvcDiscRescode "for ISOv2 ServiceDiscoveryRes message: indicates the acknowledgment status of this V2G messages received by the SECC." UBYTE CU_ISO2SVCDISCRESCODE 1 100 0.0 255.0 ECU_ADDRESS 0x700181dc BYTE_ORDER MSB_LAST /end MEASUREMENT
/begin COMPU_METHOD CU_ISO2SVCDISCRESCODE "Conversion method for Iso2SvcDiscRescode" RAT_FUNC "%10.0" "1" COEFFS 0.000000 1.000000 -0.000000 0.000000 0.000000 1.000000 /end COMPU_METHOD
/* Scalar measurable for DDE 'Iso2SvcDiscRxTrg'. */
/begin MEASUREMENT Iso2SvcDiscRxTrg "Trigger flag that on a rising edge indicates the event for receiving the PLC (V2G) ServiceDiscoveryRes message from the EVSE" UBYTE CU_ISO2SVCDISCRXTRG 1 100 0.0 1.0 ECU_ADDRESS 0x70017f91 BYTE_ORDER MSB_LAST /end MEASUREMENT
/begin COMPU_METHOD CU_ISO2SVCDISCRXTRG "Conversion method for Iso2SvcDiscRxTrg" RAT_FUNC "%10.0" "b" COEFFS 0.000000 1.000000 -0.000000 0.000000 0.000000 1.000000 /end COMPU_METHOD
/* Scalar measurable for DDE 'Iso2SvcDiscVasListLen'. */
/begin MEASUREMENT Iso2SvcDiscVasListLen "Actual number of elements in the Iso2SvcDiscVasListIds and Iso2SvcDiscVasListFreeSvc lists" UBYTE CU_ISO2SVCDISCVASLISTLEN 1 100 0.0 255.0 ECU_ADDRESS 0x70017e08 BYTE_ORDER MSB_LAST /end MEASUREMENT
/begin COMPU_METHOD CU_ISO2SVCDISCVASLISTLEN "Conversion method for Iso2SvcDiscVasListLen" RAT_FUNC "%10.0" "1" COEFFS 0.000000 1.000000 -0.000000 0.000000 0.000000 1.000000 /end COMPU_METHOD
/* Scalar measurable for DDE 'Iso2WeldDetEvsePresVolt'. */
/begin MEASUREMENT Iso2WeldDetEvsePresVolt "Indicates the measured High Voltage DC (HVDC) voltage at the output of the DC Supply." FLOAT32_IEEE CU_ISO2WELDDETEVSEPRESVOLT 1 100 -3.40282346639e+38 3.40282346639e+38 ECU_ADDRESS 0x70017c40 BYTE_ORDER MSB_LAST /end MEASUREMENT
/begin COMPU_METHOD CU_ISO2WELDDETEVSEPRESVOLT "Conversion method for Iso2WeldDetEvsePresVolt" RAT_FUNC "%10.0" "%" COEFFS 0.000000 1.000000 -0.000000 0.000000 0.000000 1.000000 /end COMPU_METHOD
/* Scalar measurable for DDE 'Iso2WeldDetEvseStatPres'. */
/begin MEASUREMENT Iso2WeldDetEvseStatPres "Indicates the presence of the EVSENotificationMaxDelay and EVSENotification parameters in the WeldingDetectionRes message" UBYTE CU_ISO2WELDDETEVSESTATPRES 1 100 0.0 1.0 ECU_ADDRESS 0x70017e35 BYTE_ORDER MSB_LAST /end MEASUREMENT
/begin COMPU_METHOD CU_ISO2WELDDETEVSESTATPRES "Conversion method for Iso2WeldDetEvseStatPres" RAT_FUNC "%10.0" "b" COEFFS 0.000000 1.000000 -0.000000 0.000000 0.000000 1.000000 /end COMPU_METHOD
/* Scalar measurable for DDE 'Iso2WeldDetNotif'. */
/begin MEASUREMENT Iso2WeldDetNotif "Indicates action SECC wants the EVSE to perform in the WeldingDetectionRes message" UBYTE CU_ISO2WELDDETNOTIF 1 100 0.0 255.0 ECU_ADDRESS 0x70018194 BYTE_ORDER MSB_LAST /end MEASUREMENT
/begin COMPU_METHOD CU_ISO2WELDDETNOTIF "Conversion method for Iso2WeldDetNotif" RAT_FUNC "%10.0" "1" COEFFS 0.000000 1.000000 -0.000000 0.000000 0.000000 1.000000 /end COMPU_METHOD
/* Scalar measurable for DDE 'Iso2WeldDetNotifMaxDelay'. */
/begin MEASUREMENT Iso2WeldDetNotifMaxDelay "Indicates the time until the SECC expects the EVCC to react on the EVSENotification action set in the WeldingDetectionRes message" UWORD CU_ISO2WELDDETNOTIFMAXDELAY 1 100 0.0 65535.0 ECU_ADDRESS 0x7001845a BYTE_ORDER MSB_LAST /end MEASUREMENT
/begin COMPU_METHOD CU_ISO2WELDDETNOTIFMAXDELAY "Conversion method for Iso2WeldDetNotifMaxDelay" RAT_FUNC "%10.0" "1" COEFFS 0.000000 1.000000 -0.000000 0.000000 0.000000 1.000000 /end COMPU_METHOD
/* Scalar measurable for DDE 'Iso2WeldDetRescode'. */
/begin MEASUREMENT Iso2WeldDetRescode "for ISOv2 WeldingDetectionRes message: indicates the acknowledgment status of this V2G messages received by the SECC." UBYTE CU_ISO2WELDDETRESCODE 1 100 0.0 255.0 ECU_ADDRESS 0x700182a4 BYTE_ORDER MSB_LAST /end MEASUREMENT
/begin COMPU_METHOD CU_ISO2WELDDETRESCODE "Conversion method for Iso2WeldDetRescode" RAT_FUNC "%10.0" "1" COEFFS 0.000000 1.000000 -0.000000 0.000000 0.000000 1.000000 /end COMPU_METHOD
/* Scalar measurable for DDE 'Iso2WeldDetRxTrg'. */
/begin MEASUREMENT Iso2WeldDetRxTrg "Trigger flag that on a rising edge indicates the event for receiving the PLC (V2G) WeldingDetectionRes message from the EVSE" UBYTE CU_ISO2WELDDETRXTRG 1 100 0.0 1.0 ECU_ADDRESS 0x70018095 BYTE_ORDER MSB_LAST /end MEASUREMENT
/begin COMPU_METHOD CU_ISO2WELDDETRXTRG "Conversion method for Iso2WeldDetRxTrg" RAT_FUNC "%10.0" "b" COEFFS 0.000000 1.000000 -0.000000 0.000000 0.000000 1.000000 /end COMPU_METHOD
/* Scalar measurable for DDE 'NotEcuRunning'. */
/begin MEASUREMENT NotEcuRunning "Not ECU running flag." UBYTE CU_NOTECURUNNING 1 100 0.0 1.0 ECU_ADDRESS 0x7001a14d BYTE_ORDER MSB_LAST /end MEASUREMENT
/begin COMPU_METHOD CU_NOTECURUNNING "Conversion method for NotEcuRunning" RAT_FUNC "%10.0" "(not defined)" COEFFS 0.000000 1.000000 -0.000000 0.000000 0.000000 1.000000 /end COMPU_METHOD
/* Scalar measurable for DDE 'NotShutdownFromLowBatt'. */
/begin MEASUREMENT NotShutdownFromLowBatt "(not defined)" UBYTE CU_NOTSHUTDOWNFROMLOWBATT 1 100 0.0 255.0 ECU_ADDRESS 0x70019fbe BYTE_ORDER MSB_LAST /end MEASUREMENT
/begin COMPU_METHOD CU_NOTSHUTDOWNFROMLOWBATT "Conversion method for NotShutdownFromLowBatt" RAT_FUNC "%10.0" "(not defined)" COEFFS 0.000000 1.000000 -0.000000 0.000000 0.000000 1.000000 /end COMPU_METHOD
/* Scalar measurable for DDE 'ParamSetIdSelected'. */
/begin MEASUREMENT ParamSetIdSelected "Selected Parameter Set Id from the Service Discovery and Detail Parser" UWORD CU_PARAMSETIDSELECTED 1 100 0.0 65535.0 ECU_ADDRESS 0x70017eb2 BYTE_ORDER MSB_LAST /end MEASUREMENT
/begin COMPU_METHOD CU_PARAMSETIDSELECTED "Conversion method for ParamSetIdSelected" RAT_FUNC "%10.0" "NU" COEFFS 0.000000 1.000000 -0.000000 0.000000 0.000000 1.000000 /end COMPU_METHOD
/* Scalar measurable for DDE 'PregEcuDateOfManufactureAvailable'. */
/begin MEASUREMENT PregEcuDateOfManufactureAvaila0 "(not defined)" UBYTE CU_PREGECUDATEOFMANUFACTUREAVA0 1 100 0.0 255.0 ECU_ADDRESS 0x7001a15d BYTE_ORDER MSB_LAST /end MEASUREMENT
/begin COMPU_METHOD CU_PREGECUDATEOFMANUFACTUREAVA0 "Conversion method for PregEcuDateOfManufactureAvailable" RAT_FUNC "%10.0" "(not defined)" COEFFS 0.000000 1.000000 -0.000000 0.000000 0.000000 1.000000 /end COMPU_METHOD
/* Scalar measurable for DDE 'PregEcuDateOfManufactureDay'. */
/begin MEASUREMENT PregEcuDateOfManufactureDay "(not defined)" UBYTE CU_PREGECUDATEOFMANUFACTUREDAY 1 100 0.0 255.0 ECU_ADDRESS 0x70019ff8 BYTE_ORDER MSB_LAST /end MEASUREMENT
/begin COMPU_METHOD CU_PREGECUDATEOFMANUFACTUREDAY "Conversion method for PregEcuDateOfManufactureDay" RAT_FUNC "%10.0" "(not defined)" COEFFS 0.000000 1.000000 -0.000000 0.000000 0.000000 1.000000 /end COMPU_METHOD
/* Scalar measurable for DDE 'PregEcuDateOfManufactureMonth'. */
/begin MEASUREMENT PregEcuDateOfManufactureMonth "(not defined)" UBYTE CU_PREGECUDATEOFMANUFACTUREMON0 1 100 0.0 255.0 ECU_ADDRESS 0x7001a186 BYTE_ORDER MSB_LAST /end MEASUREMENT
/begin COMPU_METHOD CU_PREGECUDATEOFMANUFACTUREMON0 "Conversion method for PregEcuDateOfManufactureMonth" RAT_FUNC "%10.0" "(not defined)" COEFFS 0.000000 1.000000 -0.000000 0.000000 0.000000 1.000000 /end COMPU_METHOD
/* Scalar measurable for DDE 'PregEcuDateOfManufactureShift'. */
/begin MEASUREMENT PregEcuDateOfManufactureShift "(not defined)" UBYTE CU_PREGECUDATEOFMANUFACTURESHI0 1 100 0.0 255.0 ECU_ADDRESS 0x7001a019 BYTE_ORDER MSB_LAST /end MEASUREMENT
/begin COMPU_METHOD CU_PREGECUDATEOFMANUFACTURESHI0 "Conversion method for PregEcuDateOfManufactureShift" RAT_FUNC "%10.0" "(not defined)" COEFFS 0.000000 1.000000 -0.000000 0.000000 0.000000 1.000000 /end COMPU_METHOD
/* Scalar measurable for DDE 'PregEcuDateOfManufactureYear'. */
/begin MEASUREMENT PregEcuDateOfManufactureYear "(not defined)" UWORD CU_PREGECUDATEOFMANUFACTUREYEAR 1 100 0.0 65535.0 ECU_ADDRESS 0x70019eae BYTE_ORDER MSB_LAST /end MEASUREMENT
/begin COMPU_METHOD CU_PREGECUDATEOFMANUFACTUREYEAR "Conversion method for PregEcuDateOfManufactureYear" RAT_FUNC "%10.0" "(not defined)" COEFFS 0.000000 1.000000 -0.000000 0.000000 0.000000 1.000000 /end COMPU_METHOD
/* Scalar measurable for DDE 'PregEcuEngineeringPartNumberAvailable'. */
/begin MEASUREMENT PregEcuEngineeringPartNumberAv0 "(not defined)" UBYTE CU_PREGECUENGINEERINGPARTNUMBE2 1 100 0.0 255.0 ECU_ADDRESS 0x70019fe4 BYTE_ORDER MSB_LAST /end MEASUREMENT
/begin COMPU_METHOD CU_PREGECUENGINEERINGPARTNUMBE2 "Conversion method for PregEcuEngineeringPartNumberAvailable" RAT_FUNC "%10.0" "(not defined)" COEFFS 0.000000 1.000000 -0.000000 0.000000 0.000000 1.000000 /end COMPU_METHOD
/* Scalar measurable for DDE 'PregEcuEngineeringPartNumberID'. */
/begin MEASUREMENT PregEcuEngineeringPartNumberID "(not defined)" UBYTE CU_PREGECUENGINEERINGPARTNUMBE1 1 100 0.0 255.0 ECU_ADDRESS 0x7001a170 BYTE_ORDER MSB_LAST /end MEASUREMENT
/begin COMPU_METHOD CU_PREGECUENGINEERINGPARTNUMBE1 "Conversion method for PregEcuEngineeringPartNumberID" RAT_FUNC "%10.0" "(not defined)" COEFFS 0.000000 1.000000 -0.000000 0.000000 0.000000 1.000000 /end COMPU_METHOD
/* Scalar measurable for DDE 'PregEcuEngineeringPartNumberPart'. */
/begin MEASUREMENT PregEcuEngineeringPartNumberPa0 "(not defined)" ULONG CU_PREGECUENGINEERINGPARTNUMBE3 1 100 0.0 4294967295.0 ECU_ADDRESS 0x7001a004 BYTE_ORDER MSB_LAST /end MEASUREMENT
/begin COMPU_METHOD CU_PREGECUENGINEERINGPARTNUMBE3 "Conversion method for PregEcuEngineeringPartNumberPart" RAT_FUNC "%10.0" "(not defined)" COEFFS 0.000000 1.000000 -0.000000 0.000000 0.000000 1.000000 /end COMPU_METHOD
/* Scalar measurable for DDE 'PregEcuEngineeringPartNumberPrefix'. */
/begin MEASUREMENT PregEcuEngineeringPartNumberPr0 "(not defined)" UBYTE CU_PREGECUENGINEERINGPARTNUMBE0 1 100 0.0 255.0 ECU_ADDRESS 0x70019f0d BYTE_ORDER MSB_LAST /end MEASUREMENT
/begin COMPU_METHOD CU_PREGECUENGINEERINGPARTNUMBE0 "Conversion method for PregEcuEngineeringPartNumberPrefix" RAT_FUNC "%10.0" "(not defined)" COEFFS 0.000000 1.000000 -0.000000 0.000000 0.000000 1.000000 /end COMPU_METHOD
/* Scalar measurable for DDE 'PregEcuFactoryBuildTypeA'. */
/begin MEASUREMENT PregEcuFactoryBuildTypeA "(not defined)" UBYTE CU_PREGECUFACTORYBUILDTYPEA 1 100 0.0 255.0 ECU_ADDRESS 0x7001a0a0 BYTE_ORDER MSB_LAST /end MEASUREMENT
/begin COMPU_METHOD CU_PREGECUFACTORYBUILDTYPEA "Conversion method for PregEcuFactoryBuildTypeA" RAT_FUNC "%10.0" "(not defined)" COEFFS 0.000000 1.000000 -0.000000 0.000000 0.000000 1.000000 /end COMPU_METHOD
/* Scalar measurable for DDE 'PregEcuFactoryBuildTypeAvailable'. */
/begin MEASUREMENT PregEcuFactoryBuildTypeAvailab0 "(not defined)" UBYTE CU_PREGECUFACTORYBUILDTYPEAVAI0 1 100 0.0 255.0 ECU_ADDRESS 0x70019f30 BYTE_ORDER MSB_LAST /end MEASUREMENT
/begin COMPU_METHOD CU_PREGECUFACTORYBUILDTYPEAVAI0 "Conversion method for PregEcuFactoryBuildTypeAvailable" RAT_FUNC "%10.0" "(not defined)" COEFFS 0.000000 1.000000 -0.000000 0.000000 0.000000 1.000000 /end COMPU_METHOD
/* Scalar measurable for DDE 'PregEcuFactoryBuildTypeB'. */
/begin MEASUREMENT PregEcuFactoryBuildTypeB "(not defined)" UBYTE CU_PREGECUFACTORYBUILDTYPEB 1 100 0.0 255.0 ECU_ADDRESS 0x7001a0c4 BYTE_ORDER MSB_LAST /end MEASUREMENT
/begin COMPU_METHOD CU_PREGECUFACTORYBUILDTYPEB "Conversion method for PregEcuFactoryBuildTypeB" RAT_FUNC "%10.0" "(not defined)" COEFFS 0.000000 1.000000 -0.000000 0.000000 0.000000 1.000000 /end COMPU_METHOD
/* Scalar measurable for DDE 'PregEcuFactoryIdA'. */
/begin MEASUREMENT PregEcuFactoryIdA "(not defined)" UBYTE CU_PREGECUFACTORYIDA 1 100 0.0 255.0 ECU_ADDRESS 0x70019f48 BYTE_ORDER MSB_LAST /end MEASUREMENT
/begin COMPU_METHOD CU_PREGECUFACTORYIDA "Conversion method for PregEcuFactoryIdA" RAT_FUNC "%10.0" "(not defined)" COEFFS 0.000000 1.000000 -0.000000 0.000000 0.000000 1.000000 /end COMPU_METHOD
/* Scalar measurable for DDE 'PregEcuFactoryIdB'. */
/begin MEASUREMENT PregEcuFactoryIdB "(not defined)" UBYTE CU_PREGECUFACTORYIDB 1 100 0.0 255.0 ECU_ADDRESS 0x7001a0da BYTE_ORDER MSB_LAST /end MEASUREMENT
/begin COMPU_METHOD CU_PREGECUFACTORYIDB "Conversion method for PregEcuFactoryIdB" RAT_FUNC "%10.0" "(not defined)" COEFFS 0.000000 1.000000 -0.000000 0.000000 0.000000 1.000000 /end COMPU_METHOD
/* Scalar measurable for DDE 'PregEcuFactoryPartA'. */
/begin MEASUREMENT PregEcuFactoryPartA "(not defined)" UWORD CU_PREGECUFACTORYPARTA 1 100 0.0 65535.0 ECU_ADDRESS 0x70019f66 BYTE_ORDER MSB_LAST /end MEASUREMENT
/begin COMPU_METHOD CU_PREGECUFACTORYPARTA "Conversion method for PregEcuFactoryPartA" RAT_FUNC "%10.0" "(not defined)" COEFFS 0.000000 1.000000 -0.000000 0.000000 0.000000 1.000000 /end COMPU_METHOD
/* Scalar measurable for DDE 'PregEcuFactoryPartB'. */
/begin MEASUREMENT PregEcuFactoryPartB "(not defined)" UWORD CU_PREGECUFACTORYPARTB 1 100 0.0 65535.0 ECU_ADDRESS 0x7001a0fc BYTE_ORDER MSB_LAST /end MEASUREMENT
/begin COMPU_METHOD CU_PREGECUFACTORYPARTB "Conversion method for PregEcuFactoryPartB" RAT_FUNC "%10.0" "(not defined)" COEFFS 0.000000 1.000000 -0.000000 0.000000 0.000000 1.000000 /end COMPU_METHOD
/* Scalar measurable for DDE 'PregEcuFactoryPartNumAvailable'. */
/begin MEASUREMENT PregEcuFactoryPartNumAvailable "(not defined)" UBYTE CU_PREGECUFACTORYPARTNUMAVAILA0 1 100 0.0 255.0 ECU_ADDRESS 0x70019f90 BYTE_ORDER MSB_LAST /end MEASUREMENT
/begin COMPU_METHOD CU_PREGECUFACTORYPARTNUMAVAILA0 "Conversion method for PregEcuFactoryPartNumAvailable" RAT_FUNC "%10.0" "(not defined)" COEFFS 0.000000 1.000000 -0.000000 0.000000 0.000000 1.000000 /end COMPU_METHOD
/* Scalar measurable for DDE 'PregEcuLowerWordSerialNumber'. */
/begin MEASUREMENT PregEcuLowerWordSerialNumber "(not defined)" ULONG CU_PREGECULOWERWORDSERIALNUMBER 1 100 0.0 4294967295.0 ECU_ADDRESS 0x7001a114 BYTE_ORDER MSB_LAST /end MEASUREMENT
/begin COMPU_METHOD CU_PREGECULOWERWORDSERIALNUMBER "Conversion method for PregEcuLowerWordSerialNumber" RAT_FUNC "%10.0" "(not defined)" COEFFS 0.000000 1.000000 -0.000000 0.000000 0.000000 1.000000 /end COMPU_METHOD
/* Scalar measurable for DDE 'PregEcuLowerWordSerialNumberAvailable'. */
/begin MEASUREMENT PregEcuLowerWordSerialNumberAv0 "(not defined)" UBYTE CU_PREGECULOWERWORDSERIALNUMBE0 1 100 0.0 255.0 ECU_ADDRESS 0x70019fad BYTE_ORDER MSB_LAST /end MEASUREMENT
/begin COMPU_METHOD CU_PREGECULOWERWORDSERIALNUMBE0 "Conversion method for PregEcuLowerWordSerialNumberAvailable" RAT_FUNC "%10.0" "(not defined)" COEFFS 0.000000 1.000000 -0.000000 0.000000 0.000000 1.000000 /end COMPU_METHOD
/* Scalar measurable for DDE 'PregEcuPcbIssue'. */
/begin MEASUREMENT PregEcuPcbIssue "(not defined)" UBYTE CU_PREGECUPCBISSUE 1 100 0.0 255.0 ECU_ADDRESS 0x70019ec5 BYTE_ORDER MSB_LAST /end MEASUREMENT
/begin COMPU_METHOD CU_PREGECUPCBISSUE "Conversion method for PregEcuPcbIssue" RAT_FUNC "%10.0" "(not defined)" COEFFS 0.000000 1.000000 -0.000000 0.000000 0.000000 1.000000 /end COMPU_METHOD
/* Scalar measurable for DDE 'PregEcuPcbIssueAvailable'. */
/begin MEASUREMENT PregEcuPcbIssueAvailable "(not defined)" UBYTE CU_PREGECUPCBISSUEAVAILABLE 1 100 0.0 255.0 ECU_ADDRESS 0x7001a04e BYTE_ORDER MSB_LAST /end MEASUREMENT
/begin COMPU_METHOD CU_PREGECUPCBISSUEAVAILABLE "Conversion method for PregEcuPcbIssueAvailable" RAT_FUNC "%10.0" "(not defined)" COEFFS 0.000000 1.000000 -0.000000 0.000000 0.000000 1.000000 /end COMPU_METHOD
/* Scalar measurable for DDE 'PregEcuPcbMod'. */
/begin MEASUREMENT PregEcuPcbMod "(not defined)" UBYTE CU_PREGECUPCBMOD 1 100 0.0 255.0 ECU_ADDRESS 0x70019edd BYTE_ORDER MSB_LAST /end MEASUREMENT
/begin COMPU_METHOD CU_PREGECUPCBMOD "Conversion method for PregEcuPcbMod" RAT_FUNC "%10.0" "(not defined)" COEFFS 0.000000 1.000000 -0.000000 0.000000 0.000000 1.000000 /end COMPU_METHOD
/* Scalar measurable for DDE 'PregEcuSerialNumberInfoAvailable'. */
/begin MEASUREMENT PregEcuSerialNumberInfoAvailab0 "(not defined)" UBYTE CU_PREGECUSERIALNUMBERINFOAVAI0 1 100 0.0 255.0 ECU_ADDRESS 0x7001a071 BYTE_ORDER MSB_LAST /end MEASUREMENT
/begin COMPU_METHOD CU_PREGECUSERIALNUMBERINFOAVAI0 "Conversion method for PregEcuSerialNumberInfoAvailable" RAT_FUNC "%10.0" "(not defined)" COEFFS 0.000000 1.000000 -0.000000 0.000000 0.000000 1.000000 /end COMPU_METHOD
/* Scalar measurable for DDE 'PregEcuSerialNumberInfoFirstKey'. */
/begin MEASUREMENT PregEcuSerialNumberInfoFirstKey "(not defined)" UBYTE CU_PREGECUSERIALNUMBERINFOFIRS0 1 100 0.0 255.0 ECU_ADDRESS 0x70019efe BYTE_ORDER MSB_LAST /end MEASUREMENT
/begin COMPU_METHOD CU_PREGECUSERIALNUMBERINFOFIRS0 "Conversion method for PregEcuSerialNumberInfoFirstKey" RAT_FUNC "%10.0" "(not defined)" COEFFS 0.000000 1.000000 -0.000000 0.000000 0.000000 1.000000 /end COMPU_METHOD
/* Scalar measurable for DDE 'PregEcuSerialNumberInfoLength'. */
/begin MEASUREMENT PregEcuSerialNumberInfoLength "(not defined)" UBYTE CU_PREGECUSERIALNUMBERINFOLENG0 1 100 0.0 255.0 ECU_ADDRESS 0x7001a08e BYTE_ORDER MSB_LAST /end MEASUREMENT
/begin COMPU_METHOD CU_PREGECUSERIALNUMBERINFOLENG0 "Conversion method for PregEcuSerialNumberInfoLength" RAT_FUNC "%10.0" "(not defined)" COEFFS 0.000000 1.000000 -0.000000 0.000000 0.000000 1.000000 /end COMPU_METHOD
/* Scalar measurable for DDE 'PregEcuUpperWordSerialAvailable'. */
/begin MEASUREMENT PregEcuUpperWordSerialAvailable "(not defined)" UBYTE CU_PREGECUUPPERWORDSERIALAVAIL0 1 100 0.0 255.0 ECU_ADDRESS 0x70019f1d BYTE_ORDER MSB_LAST /end MEASUREMENT
/begin COMPU_METHOD CU_PREGECUUPPERWORDSERIALAVAIL0 "Conversion method for PregEcuUpperWordSerialAvailable" RAT_FUNC "%10.0" "(not defined)" COEFFS 0.000000 1.000000 -0.000000 0.000000 0.000000 1.000000 /end COMPU_METHOD
/* Scalar measurable for DDE 'PregEcuUpperWordSerialNumber'. */
/begin MEASUREMENT PregEcuUpperWordSerialNumber "(not defined)" ULONG CU_PREGECUUPPERWORDSERIALNUMBER 1 100 0.0 4294967295.0 ECU_ADDRESS 0x7001a058 BYTE_ORDER MSB_LAST /end MEASUREMENT
/begin COMPU_METHOD CU_PREGECUUPPERWORDSERIALNUMBER "Conversion method for PregEcuUpperWordSerialNumber" RAT_FUNC "%10.0" "(not defined)" COEFFS 0.000000 1.000000 -0.000000 0.000000 0.000000 1.000000 /end COMPU_METHOD
/* Scalar measurable for DDE 'ServiceIdSelected'. */
/begin MEASUREMENT ServiceIdSelected "Selected Service Id from the Service Discovery and Detail Parser" UWORD CU_SERVICEIDSELECTED 1 100 0.0 65535.0 ECU_ADDRESS 0x70018142 BYTE_ORDER MSB_LAST /end MEASUREMENT
/begin COMPU_METHOD CU_SERVICEIDSELECTED "Conversion method for ServiceIdSelected" RAT_FUNC "%10.0" "NU" COEFFS 0.000000 1.000000 -0.000000 0.000000 0.000000 1.000000 /end COMPU_METHOD
/* Scalar measurable for DDE 'ShutdownCmd'. */
/begin MEASUREMENT ShutdownCmd "ShutdownFromLowBatt OR NotEcuRunning" UBYTE CU_SHUTDOWNCMD 1 100 0.0 255.0 ECU_ADDRESS 0x70019eec BYTE_ORDER MSB_LAST /end MEASUREMENT
/begin COMPU_METHOD CU_SHUTDOWNCMD "Conversion method for ShutdownCmd" RAT_FUNC "%10.0" "(not defined)" COEFFS 0.000000 1.000000 -0.000000 0.000000 0.000000 1.000000 /end COMPU_METHOD
/* Scalar measurable for DDE 'ShutdownDelayed'. */
/begin MEASUREMENT ShutdownDelayed "Shutdown signal after first delay (goes to TLT9255 sleep request then additional delay before disable power hold)" UBYTE CU_SHUTDOWNDELAYED 1 100 0.0 1.0 ECU_ADDRESS 0x7001a081 BYTE_ORDER MSB_LAST /end MEASUREMENT
/begin COMPU_METHOD CU_SHUTDOWNDELAYED "Conversion method for ShutdownDelayed" RAT_FUNC "%10.0" "(not defined)" COEFFS 0.000000 1.000000 -0.000000 0.000000 0.000000 1.000000 /end COMPU_METHOD
/* Scalar measurable for DDE 'ShutdownFromLowBatt'. */
/begin MEASUREMENT ShutdownFromLowBatt "VBatFilt < genc_VBatShutdownThreshold" UBYTE CU_SHUTDOWNFROMLOWBATT 1 100 0.0 255.0 ECU_ADDRESS 0x70019f91 BYTE_ORDER MSB_LAST /end MEASUREMENT
/begin COMPU_METHOD CU_SHUTDOWNFROMLOWBATT "Conversion method for ShutdownFromLowBatt" RAT_FUNC "%10.0" "(not defined)" COEFFS 0.000000 1.000000 -0.000000 0.000000 0.000000 1.000000 /end COMPU_METHOD
/* Scalar measurable for DDE 'SvcSearchSt'. */
/begin MEASUREMENT SvcSearchSt "Service Discovery and Detail Parser Search Status" SLONG CU_SVCSEARCHST 1 100 -2147483648.0 2147483647.0 ECU_ADDRESS 0x70017c30 BYTE_ORDER MSB_LAST /end MEASUREMENT
/begin COMPU_METHOD CU_SVCSEARCHST "Conversion method for SvcSearchSt" TAB_VERB "%12.0" "enum" COMPU_TAB_REF CT_SVCSEARCHST /end COMPU_METHOD
/begin COMPU_VTAB CT_SVCSEARCHST "Conversion method for SvcSearchSt" TAB_VERB 5 0 "SEARCH_ONGOING" 1 "WAIT_FOR_SVCDETAIL" 2 "FINISHED_NO_RESULT" 3 "SEARCH_FINISHED" 4 "SEARCH_STARTUP" /end COMPU_VTAB
/* Scalar measurable for DDE 'SysCpuLoading'. */
/begin MEASUREMENT SysCpuLoading "CPU Loading in percentage of the HCU" FLOAT32_IEEE CU_SYSCPULOADING 1 100 0.0 1000.0 ECU_ADDRESS 0x70018360 BYTE_ORDER MSB_LAST /end MEASUREMENT
/begin COMPU_METHOD CU_SYSCPULOADING "Conversion method for SysCpuLoading" RAT_FUNC "%10.0" "%" COEFFS 0.000000 1.000000 -0.000000 0.000000 0.000000 1.000000 /end COMPU_METHOD
/* Scalar measurable for DDE 'SysResetType'. */
/begin MEASUREMENT SysResetType "System Reset Type" UBYTE CU_SYSRESETTYPE 1 100 0.0 250.0 ECU_ADDRESS 0x700181ab BYTE_ORDER MSB_LAST /end MEASUREMENT
/begin COMPU_METHOD CU_SYSRESETTYPE "Conversion method for SysResetType" RAT_FUNC "%10.0" "1" COEFFS 0.000000 1.000000 -0.000000 0.000000 0.000000 1.000000 /end COMPU_METHOD
/* Scalar measurable for DDE 'SysStackUsed'. */
/begin MEASUREMENT SysStackUsed "Stack used on the M560" ULONG CU_SYSSTACKUSED 1 100 0.0 100000.0 ECU_ADDRESS 0x0 BYTE_ORDER MSB_LAST /end MEASUREMENT
/begin COMPU_METHOD CU_SYSSTACKUSED "Conversion method for SysStackUsed" RAT_FUNC "%10.0" "1" COEFFS 0.000000 1.000000 -0.000000 0.000000 0.000000 1.000000 /end COMPU_METHOD
/* Scalar measurable for DDE 'SysTaskDurLoopA'. */
/begin MEASUREMENT SysTaskDurLoopA "Task Duration for the task with sampling time LoopA_SC" ULONG CU_SYSTASKDURLOOPA 1 100 0.0 10000.0 ECU_ADDRESS 0x70017da0 BYTE_ORDER MSB_LAST /end MEASUREMENT
/begin COMPU_METHOD CU_SYSTASKDURLOOPA "Conversion method for SysTaskDurLoopA" RAT_FUNC "%10.0" "s" COEFFS 0.000000 1.000000 -0.000000 0.000000 0.000000 1.000000 /end COMPU_METHOD
/* Scalar measurable for DDE 'SysTaskDurLoopB'. */
/begin MEASUREMENT SysTaskDurLoopB "Task Duration for the task with sampling time LoopB_SC" ULONG CU_SYSTASKDURLOOPB 1 100 0.0 10000.0 ECU_ADDRESS 0x70018084 BYTE_ORDER MSB_LAST /end MEASUREMENT
/begin COMPU_METHOD CU_SYSTASKDURLOOPB "Conversion method for SysTaskDurLoopB" RAT_FUNC "%10.0" "s" COEFFS 0.000000 1.000000 -0.000000 0.000000 0.000000 1.000000 /end COMPU_METHOD
/* Scalar measurable for DDE 'SysTaskDurLoopC'. */
/begin MEASUREMENT SysTaskDurLoopC "Task Duration for the task with sampling time LoopC_SC" ULONG CU_SYSTASKDURLOOPC 1 100 0.0 10000.0 ECU_ADDRESS 0x70017ea0 BYTE_ORDER MSB_LAST /end MEASUREMENT
/begin COMPU_METHOD CU_SYSTASKDURLOOPC "Conversion method for SysTaskDurLoopC" RAT_FUNC "%10.0" "s" COEFFS 0.000000 1.000000 -0.000000 0.000000 0.000000 1.000000 /end COMPU_METHOD
/* Scalar measurable for DDE 'SysTaskDurLoopCcs'. */
/begin MEASUREMENT SysTaskDurLoopCcs "Task Duration for the task with sampling time LoopCcs_SC" ULONG CU_SYSTASKDURLOOPCCS 1 100 0.0 10000.0 ECU_ADDRESS 0x70017ce8 BYTE_ORDER MSB_LAST /end MEASUREMENT
/begin COMPU_METHOD CU_SYSTASKDURLOOPCCS "Conversion method for SysTaskDurLoopCcs" RAT_FUNC "%10.0" "s" COEFFS 0.000000 1.000000 -0.000000 0.000000 0.000000 1.000000 /end COMPU_METHOD
/* Scalar measurable for DDE 'SysTaskPeriodOverrunLoopA'. */
/begin MEASUREMENT SysTaskPeriodOverrunLoopA "Overruns of the task with sampling time LoopA_SC" UBYTE CU_SYSTASKPERIODOVERRUNLOOPA 1 100 0.0 255.0 ECU_ADDRESS 0x70018426 BYTE_ORDER MSB_LAST /end MEASUREMENT
/begin COMPU_METHOD CU_SYSTASKPERIODOVERRUNLOOPA "Conversion method for SysTaskPeriodOverrunLoopA" RAT_FUNC "%10.0" "cnt" COEFFS 0.000000 1.000000 -0.000000 0.000000 0.000000 1.000000 /end COMPU_METHOD
/* Scalar measurable for DDE 'SysTaskPeriodOverrunLoopB'. */
/begin MEASUREMENT SysTaskPeriodOverrunLoopB "Overruns of the task with sampling time LoopB_SC" UBYTE CU_SYSTASKPERIODOVERRUNLOOPB 1 100 0.0 255.0 ECU_ADDRESS 0x70017d40 BYTE_ORDER MSB_LAST /end MEASUREMENT
/begin COMPU_METHOD CU_SYSTASKPERIODOVERRUNLOOPB "Conversion method for SysTaskPeriodOverrunLoopB" RAT_FUNC "%10.0" "cnt" COEFFS 0.000000 1.000000 -0.000000 0.000000 0.000000 1.000000 /end COMPU_METHOD
/* Scalar measurable for DDE 'SysTimeSinceWakeMillisecond'. */
/begin MEASUREMENT SysTimeSinceWakeMillisecond "The Time (millisecond) since the ECU is waked up and started to run the application software." ULONG CU_SYSTIMESINCEWAKEMILLISECOND 1 100 0.0 4294967295.0 ECU_ADDRESS 0x70017fd8 BYTE_ORDER MSB_LAST /end MEASUREMENT
/begin COMPU_METHOD CU_SYSTIMESINCEWAKEMILLISECOND "Conversion method for SysTimeSinceWakeMillisecond" RAT_FUNC "%10.0" "ms" COEFFS 0.000000 1.000000 -0.000000 0.000000 0.000000 1.000000 /end COMPU_METHOD
/* Scalar measurable for DDE 'SysTimeSinceWakeSecond'. */
/begin MEASUREMENT SysTimeSinceWakeSecond "The Time (seconds) since the ECU is waked up and started to run the application software." ULONG CU_SYSTIMESINCEWAKESECOND 1 100 0.0 4294967295.0 ECU_ADDRESS 0x7001834c BYTE_ORDER MSB_LAST /end MEASUREMENT
/begin COMPU_METHOD CU_SYSTIMESINCEWAKESECOND "Conversion method for SysTimeSinceWakeSecond" RAT_FUNC "%10.0" "s" COEFFS 0.000000 1.000000 -0.000000 0.000000 0.000000 1.000000 /end COMPU_METHOD
/* Scalar measurable for DDE 'V2gEcuConnectionSt'. */
/begin MEASUREMENT V2gEcuConnectionSt "Internal Signal to read the V2G connection Status" UBYTE CU_V2GECUCONNECTIONST 1 100 0.0 255.0 ECU_ADDRESS 0x700181a2 BYTE_ORDER MSB_LAST /end MEASUREMENT
/begin COMPU_METHOD CU_V2GECUCONNECTIONST "Conversion method for V2gEcuConnectionSt" RAT_FUNC "%10.0" "1" COEFFS 0.000000 1.000000 -0.000000 0.000000 0.000000 1.000000 /end COMPU_METHOD
/* Scalar measurable for DDE 'V2gEcuPlcChipStatus'. */
/begin MEASUREMENT V2gEcuPlcChipStatus "Internal Signal to read the PLC Chip status" UBYTE CU_V2GECUPLCCHIPSTATUS 1 100 0.0 255.0 ECU_ADDRESS 0x70017f59 BYTE_ORDER MSB_LAST /end MEASUREMENT
/begin COMPU_METHOD CU_V2GECUPLCCHIPSTATUS "Conversion method for V2gEcuPlcChipStatus" RAT_FUNC "%10.0" "1" COEFFS 0.000000 1.000000 -0.000000 0.000000 0.000000 1.000000 /end COMPU_METHOD
/* Scalar measurable for DDE 'V2gEcuPlcLinkStatus'. */
/begin MEASUREMENT V2gEcuPlcLinkStatus "Internal Signal to read the Link Status when establishing the PLC link between EV and EVSE" UBYTE CU_V2GECUPLCLINKSTATUS 1 100 0.0 255.0 ECU_ADDRESS 0x70017db8 BYTE_ORDER MSB_LAST /end MEASUREMENT
/begin COMPU_METHOD CU_V2GECUPLCLINKSTATUS "Conversion method for V2gEcuPlcLinkStatus" RAT_FUNC "%10.0" "1" COEFFS 0.000000 1.000000 -0.000000 0.000000 0.000000 1.000000 /end COMPU_METHOD
/* Scalar measurable for DDE 'V2gEcuQcaErrCode'. */
/begin MEASUREMENT V2gEcuQcaErrCode "Internal Signal to read the QCA chip error code when establishing the PLC link between EV and EVSE" UBYTE CU_V2GECUQCAERRCODE 1 100 0.0 255.0 ECU_ADDRESS 0x70017f83 BYTE_ORDER MSB_LAST /end MEASUREMENT
/begin COMPU_METHOD CU_V2GECUQCAERRCODE "Conversion method for V2gEcuQcaErrCode" RAT_FUNC "%10.0" "1" COEFFS 0.000000 1.000000 -0.000000 0.000000 0.000000 1.000000 /end COMPU_METHOD
/* Scalar measurable for DDE 'V2gEcuSlacEvseAvgAttenuation'. */
/begin MEASUREMENT V2gEcuSlacEvseAvgAttenuation "Internal Signal to read the average attenuation value reported by EVSE when establishing the PLC link between EV and EVSE" FLOAT32_IEEE CU_V2GECUSLACEVSEAVGATTENUATION 1 100 -10000.0 10000.0 ECU_ADDRESS 0x700182e0 BYTE_ORDER MSB_LAST /end MEASUREMENT
/begin COMPU_METHOD CU_V2GECUSLACEVSEAVGATTENUATION "Conversion method for V2gEcuSlacEvseAvgAttenuation" RAT_FUNC "%10.0" "1" COEFFS 0.000000 1.000000 -0.000000 0.000000 0.000000 1.000000 /end COMPU_METHOD
/* Scalar measurable for DDE 'V2gEcuSlacSessionState'. */
/begin MEASUREMENT V2gEcuSlacSessionState "Internal Signal to read the SLAC Session State during establishing the PLC link between EV and EVSE" UBYTE CU_V2GECUSLACSESSIONSTATE 1 100 0.0 255.0 ECU_ADDRESS 0x70017cbc BYTE_ORDER MSB_LAST /end MEASUREMENT
/begin COMPU_METHOD CU_V2GECUSLACSESSIONSTATE "Conversion method for V2gEcuSlacSessionState" RAT_FUNC "%10.0" "1" COEFFS 0.000000 1.000000 -0.000000 0.000000 0.000000 1.000000 /end COMPU_METHOD
/* Scalar measurable for DDE 'V2gEcuSlacState'. */
/begin MEASUREMENT V2gEcuSlacState "Internal Signal to read the SLAC state during establishing the PLC link between EV and EVSE" UBYTE CU_V2GECUSLACSTATE 1 100 0.0 255.0 ECU_ADDRESS 0x700183fc BYTE_ORDER MSB_LAST /end MEASUREMENT
/begin COMPU_METHOD CU_V2GECUSLACSTATE "Conversion method for V2gEcuSlacState" RAT_FUNC "%10.0" "1" COEFFS 0.000000 1.000000 -0.000000 0.000000 0.000000 1.000000 /end COMPU_METHOD
/* Scalar measurable for DDE 'V2gEcuTcpStatus'. */
/begin MEASUREMENT V2gEcuTcpStatus "Internal Signal to read the TCP status when establishing the PLC link between EV and EVSE" UBYTE CU_V2GECUTCPSTATUS 1 100 0.0 255.0 ECU_ADDRESS 0x70018264 BYTE_ORDER MSB_LAST /end MEASUREMENT
/begin COMPU_METHOD CU_V2GECUTCPSTATUS "Conversion method for V2gEcuTcpStatus" RAT_FUNC "%10.0" "1" COEFFS 0.000000 1.000000 -0.000000 0.000000 0.000000 1.000000 /end COMPU_METHOD
/* Scalar measurable for DDE 'V2gEcuUnmatchedSlacPhase'. */
/begin MEASUREMENT V2gEcuUnmatchedSlacPhase "Internal Signal to read the SLAC phase during establishing the PLC link between EV and EVSE" UBYTE CU_V2GECUUNMATCHEDSLACPHASE 1 100 0.0 255.0 ECU_ADDRESS 0x70018008 BYTE_ORDER MSB_LAST /end MEASUREMENT
/begin COMPU_METHOD CU_V2GECUUNMATCHEDSLACPHASE "Conversion method for V2gEcuUnmatchedSlacPhase" RAT_FUNC "%10.0" "1" COEFFS 0.000000 1.000000 -0.000000 0.000000 0.000000 1.000000 /end COMPU_METHOD
/* Scalar measurable for DDE 'V2gEcuV2gConnectionErrCode'. */
/begin MEASUREMENT V2gEcuV2gConnectionErrCode "Internal Signal to read the connection error code when establishing the PLC link between EV and EVSE" UBYTE CU_V2GECUV2GCONNECTIONERRCODE 1 100 0.0 255.0 ECU_ADDRESS 0x7001828d BYTE_ORDER MSB_LAST /end MEASUREMENT
/begin COMPU_METHOD CU_V2GECUV2GCONNECTIONERRCODE "Conversion method for V2gEcuV2gConnectionErrCode" RAT_FUNC "%10.0" "1" COEFFS 0.000000 1.000000 -0.000000 0.000000 0.000000 1.000000 /end COMPU_METHOD
/* Scalar measurable for DDE 'V2gEvccIpAddress[0]'. */
/begin MEASUREMENT V2gEvccIpAddress[0] "V2G connection information" UWORD CU_V2GEVCCIPADDRESS[0] 1 100 0.0 65535.0 ECU_ADDRESS 0x70017c6a BYTE_ORDER MSB_LAST /end MEASUREMENT
/begin COMPU_METHOD CU_V2GEVCCIPADDRESS[0] "Conversion method for V2gEvccIpAddress[0]" RAT_FUNC "%10.0" "1" COEFFS 0.000000 1.000000 -0.000000 0.000000 0.000000 1.000000 /end COMPU_METHOD
/* Scalar measurable for DDE 'V2gEvccIpAddress[1]'. */
/begin MEASUREMENT V2gEvccIpAddress[1] "V2G connection information" UWORD CU_V2GEVCCIPADDRESS[1] 1 100 0.0 65535.0 ECU_ADDRESS 0x70017c6c BYTE_ORDER MSB_LAST /end MEASUREMENT
/begin COMPU_METHOD CU_V2GEVCCIPADDRESS[1] "Conversion method for V2gEvccIpAddress[1]" RAT_FUNC "%10.0" "1" COEFFS 0.000000 1.000000 -0.000000 0.000000 0.000000 1.000000 /end COMPU_METHOD
/* Scalar measurable for DDE 'V2gEvccIpAddress[2]'. */
/begin MEASUREMENT V2gEvccIpAddress[2] "V2G connection information" UWORD CU_V2GEVCCIPADDRESS[2] 1 100 0.0 65535.0 ECU_ADDRESS 0x70017c6e BYTE_ORDER MSB_LAST /end MEASUREMENT
/begin COMPU_METHOD CU_V2GEVCCIPADDRESS[2] "Conversion method for V2gEvccIpAddress[2]" RAT_FUNC "%10.0" "1" COEFFS 0.000000 1.000000 -0.000000 0.000000 0.000000 1.000000 /end COMPU_METHOD
/* Scalar measurable for DDE 'V2gEvccIpAddress[3]'. */
/begin MEASUREMENT V2gEvccIpAddress[3] "V2G connection information" UWORD CU_V2GEVCCIPADDRESS[3] 1 100 0.0 65535.0 ECU_ADDRESS 0x70017c70 BYTE_ORDER MSB_LAST /end MEASUREMENT
/begin COMPU_METHOD CU_V2GEVCCIPADDRESS[3] "Conversion method for V2gEvccIpAddress[3]" RAT_FUNC "%10.0" "1" COEFFS 0.000000 1.000000 -0.000000 0.000000 0.000000 1.000000 /end COMPU_METHOD
/* Scalar measurable for DDE 'V2gEvccIpAddress[4]'. */
/begin MEASUREMENT V2gEvccIpAddress[4] "V2G connection information" UWORD CU_V2GEVCCIPADDRESS[4] 1 100 0.0 65535.0 ECU_ADDRESS 0x70017c72 BYTE_ORDER MSB_LAST /end MEASUREMENT
/begin COMPU_METHOD CU_V2GEVCCIPADDRESS[4] "Conversion method for V2gEvccIpAddress[4]" RAT_FUNC "%10.0" "1" COEFFS 0.000000 1.000000 -0.000000 0.000000 0.000000 1.000000 /end COMPU_METHOD
/* Scalar measurable for DDE 'V2gEvccIpAddress[5]'. */
/begin MEASUREMENT V2gEvccIpAddress[5] "V2G connection information" UWORD CU_V2GEVCCIPADDRESS[5] 1 100 0.0 65535.0 ECU_ADDRESS 0x70017c74 BYTE_ORDER MSB_LAST /end MEASUREMENT
/begin COMPU_METHOD CU_V2GEVCCIPADDRESS[5] "Conversion method for V2gEvccIpAddress[5]" RAT_FUNC "%10.0" "1" COEFFS 0.000000 1.000000 -0.000000 0.000000 0.000000 1.000000 /end COMPU_METHOD
/* Scalar measurable for DDE 'V2gEvccIpAddress[6]'. */
/begin MEASUREMENT V2gEvccIpAddress[6] "V2G connection information" UWORD CU_V2GEVCCIPADDRESS[6] 1 100 0.0 65535.0 ECU_ADDRESS 0x70017c76 BYTE_ORDER MSB_LAST /end MEASUREMENT
/begin COMPU_METHOD CU_V2GEVCCIPADDRESS[6] "Conversion method for V2gEvccIpAddress[6]" RAT_FUNC "%10.0" "1" COEFFS 0.000000 1.000000 -0.000000 0.000000 0.000000 1.000000 /end COMPU_METHOD
/* Scalar measurable for DDE 'V2gEvccIpAddress[7]'. */
/begin MEASUREMENT V2gEvccIpAddress[7] "V2G connection information" UWORD CU_V2GEVCCIPADDRESS[7] 1 100 0.0 65535.0 ECU_ADDRESS 0x70017c78 BYTE_ORDER MSB_LAST /end MEASUREMENT
/begin COMPU_METHOD CU_V2GEVCCIPADDRESS[7] "Conversion method for V2gEvccIpAddress[7]" RAT_FUNC "%10.0" "1" COEFFS 0.000000 1.000000 -0.000000 0.000000 0.000000 1.000000 /end COMPU_METHOD
/* Scalar measurable for DDE 'V2gEvccMacAddress[0]'. */
/begin MEASUREMENT V2gEvccMacAddress[0] "V2G connection information" UBYTE CU_V2GEVCCMACADDRESS[0] 1 100 0.0 255.0 ECU_ADDRESS 0x70017f47 BYTE_ORDER MSB_LAST /end MEASUREMENT
/begin COMPU_METHOD CU_V2GEVCCMACADDRESS[0] "Conversion method for V2gEvccMacAddress[0]" RAT_FUNC "%10.0" "1" COEFFS 0.000000 1.000000 -0.000000 0.000000 0.000000 1.000000 /end COMPU_METHOD
/* Scalar measurable for DDE 'V2gEvccMacAddress[1]'. */
/begin MEASUREMENT V2gEvccMacAddress[1] "V2G connection information" UBYTE CU_V2GEVCCMACADDRESS[1] 1 100 0.0 255.0 ECU_ADDRESS 0x70017f48 BYTE_ORDER MSB_LAST /end MEASUREMENT
/begin COMPU_METHOD CU_V2GEVCCMACADDRESS[1] "Conversion method for V2gEvccMacAddress[1]" RAT_FUNC "%10.0" "1" COEFFS 0.000000 1.000000 -0.000000 0.000000 0.000000 1.000000 /end COMPU_METHOD
/* Scalar measurable for DDE 'V2gEvccMacAddress[2]'. */
/begin MEASUREMENT V2gEvccMacAddress[2] "V2G connection information" UBYTE CU_V2GEVCCMACADDRESS[2] 1 100 0.0 255.0 ECU_ADDRESS 0x70017f49 BYTE_ORDER MSB_LAST /end MEASUREMENT
/begin COMPU_METHOD CU_V2GEVCCMACADDRESS[2] "Conversion method for V2gEvccMacAddress[2]" RAT_FUNC "%10.0" "1" COEFFS 0.000000 1.000000 -0.000000 0.000000 0.000000 1.000000 /end COMPU_METHOD
/* Scalar measurable for DDE 'V2gEvccMacAddress[3]'. */
/begin MEASUREMENT V2gEvccMacAddress[3] "V2G connection information" UBYTE CU_V2GEVCCMACADDRESS[3] 1 100 0.0 255.0 ECU_ADDRESS 0x70017f4a BYTE_ORDER MSB_LAST /end MEASUREMENT
/begin COMPU_METHOD CU_V2GEVCCMACADDRESS[3] "Conversion method for V2gEvccMacAddress[3]" RAT_FUNC "%10.0" "1" COEFFS 0.000000 1.000000 -0.000000 0.000000 0.000000 1.000000 /end COMPU_METHOD
/* Scalar measurable for DDE 'V2gEvccMacAddress[4]'. */
/begin MEASUREMENT V2gEvccMacAddress[4] "V2G connection information" UBYTE CU_V2GEVCCMACADDRESS[4] 1 100 0.0 255.0 ECU_ADDRESS 0x70017f4b BYTE_ORDER MSB_LAST /end MEASUREMENT
/begin COMPU_METHOD CU_V2GEVCCMACADDRESS[4] "Conversion method for V2gEvccMacAddress[4]" RAT_FUNC "%10.0" "1" COEFFS 0.000000 1.000000 -0.000000 0.000000 0.000000 1.000000 /end COMPU_METHOD
/* Scalar measurable for DDE 'V2gEvccMacAddress[5]'. */
/begin MEASUREMENT V2gEvccMacAddress[5] "V2G connection information" UBYTE CU_V2GEVCCMACADDRESS[5] 1 100 0.0 255.0 ECU_ADDRESS 0x70017f4c BYTE_ORDER MSB_LAST /end MEASUREMENT
/begin COMPU_METHOD CU_V2GEVCCMACADDRESS[5] "Conversion method for V2gEvccMacAddress[5]" RAT_FUNC "%10.0" "1" COEFFS 0.000000 1.000000 -0.000000 0.000000 0.000000 1.000000 /end COMPU_METHOD
/* Scalar measurable for DDE 'V2gEvccTcpPortNumber'. */
/begin MEASUREMENT V2gEvccTcpPortNumber "V2G connection information" UWORD CU_V2GEVCCTCPPORTNUMBER 1 100 0.0 65535.0 ECU_ADDRESS 0x70017db0 BYTE_ORDER MSB_LAST /end MEASUREMENT
/begin COMPU_METHOD CU_V2GEVCCTCPPORTNUMBER "Conversion method for V2gEvccTcpPortNumber" RAT_FUNC "%10.0" "1" COEFFS 0.000000 1.000000 -0.000000 0.000000 0.000000 1.000000 /end COMPU_METHOD
/* Scalar measurable for DDE 'V2gEvseIpAddress[0]'. */
/begin MEASUREMENT V2gEvseIpAddress[0] "V2G connection information" UWORD CU_V2GEVSEIPADDRESS[0] 1 100 0.0 65535.0 ECU_ADDRESS 0x700184a4 BYTE_ORDER MSB_LAST /end MEASUREMENT
/begin COMPU_METHOD CU_V2GEVSEIPADDRESS[0] "Conversion method for V2gEvseIpAddress[0]" RAT_FUNC "%10.0" "1" COEFFS 0.000000 1.000000 -0.000000 0.000000 0.000000 1.000000 /end COMPU_METHOD
/* Scalar measurable for DDE 'V2gEvseIpAddress[1]'. */
/begin MEASUREMENT V2gEvseIpAddress[1] "V2G connection information" UWORD CU_V2GEVSEIPADDRESS[1] 1 100 0.0 65535.0 ECU_ADDRESS 0x700184a6 BYTE_ORDER MSB_LAST /end MEASUREMENT
/begin COMPU_METHOD CU_V2GEVSEIPADDRESS[1] "Conversion method for V2gEvseIpAddress[1]" RAT_FUNC "%10.0" "1" COEFFS 0.000000 1.000000 -0.000000 0.000000 0.000000 1.000000 /end COMPU_METHOD
/* Scalar measurable for DDE 'V2gEvseIpAddress[2]'. */
/begin MEASUREMENT V2gEvseIpAddress[2] "V2G connection information" UWORD CU_V2GEVSEIPADDRESS[2] 1 100 0.0 65535.0 ECU_ADDRESS 0x700184a8 BYTE_ORDER MSB_LAST /end MEASUREMENT
/begin COMPU_METHOD CU_V2GEVSEIPADDRESS[2] "Conversion method for V2gEvseIpAddress[2]" RAT_FUNC "%10.0" "1" COEFFS 0.000000 1.000000 -0.000000 0.000000 0.000000 1.000000 /end COMPU_METHOD
/* Scalar measurable for DDE 'V2gEvseIpAddress[3]'. */
/begin MEASUREMENT V2gEvseIpAddress[3] "V2G connection information" UWORD CU_V2GEVSEIPADDRESS[3] 1 100 0.0 65535.0 ECU_ADDRESS 0x700184aa BYTE_ORDER MSB_LAST /end MEASUREMENT
/begin COMPU_METHOD CU_V2GEVSEIPADDRESS[3] "Conversion method for V2gEvseIpAddress[3]" RAT_FUNC "%10.0" "1" COEFFS 0.000000 1.000000 -0.000000 0.000000 0.000000 1.000000 /end COMPU_METHOD
/* Scalar measurable for DDE 'V2gEvseIpAddress[4]'. */
/begin MEASUREMENT V2gEvseIpAddress[4] "V2G connection information" UWORD CU_V2GEVSEIPADDRESS[4] 1 100 0.0 65535.0 ECU_ADDRESS 0x700184ac BYTE_ORDER MSB_LAST /end MEASUREMENT
/begin COMPU_METHOD CU_V2GEVSEIPADDRESS[4] "Conversion method for V2gEvseIpAddress[4]" RAT_FUNC "%10.0" "1" COEFFS 0.000000 1.000000 -0.000000 0.000000 0.000000 1.000000 /end COMPU_METHOD
/* Scalar measurable for DDE 'V2gEvseIpAddress[5]'. */
/begin MEASUREMENT V2gEvseIpAddress[5] "V2G connection information" UWORD CU_V2GEVSEIPADDRESS[5] 1 100 0.0 65535.0 ECU_ADDRESS 0x700184ae BYTE_ORDER MSB_LAST /end MEASUREMENT
/begin COMPU_METHOD CU_V2GEVSEIPADDRESS[5] "Conversion method for V2gEvseIpAddress[5]" RAT_FUNC "%10.0" "1" COEFFS 0.000000 1.000000 -0.000000 0.000000 0.000000 1.000000 /end COMPU_METHOD
/* Scalar measurable for DDE 'V2gEvseIpAddress[6]'. */
/begin MEASUREMENT V2gEvseIpAddress[6] "V2G connection information" UWORD CU_V2GEVSEIPADDRESS[6] 1 100 0.0 65535.0 ECU_ADDRESS 0x700184b0 BYTE_ORDER MSB_LAST /end MEASUREMENT
/begin COMPU_METHOD CU_V2GEVSEIPADDRESS[6] "Conversion method for V2gEvseIpAddress[6]" RAT_FUNC "%10.0" "1" COEFFS 0.000000 1.000000 -0.000000 0.000000 0.000000 1.000000 /end COMPU_METHOD
/* Scalar measurable for DDE 'V2gEvseIpAddress[7]'. */
/begin MEASUREMENT V2gEvseIpAddress[7] "V2G connection information" UWORD CU_V2GEVSEIPADDRESS[7] 1 100 0.0 65535.0 ECU_ADDRESS 0x700184b2 BYTE_ORDER MSB_LAST /end MEASUREMENT
/begin COMPU_METHOD CU_V2GEVSEIPADDRESS[7] "Conversion method for V2gEvseIpAddress[7]" RAT_FUNC "%10.0" "1" COEFFS 0.000000 1.000000 -0.000000 0.000000 0.000000 1.000000 /end COMPU_METHOD
/* Scalar measurable for DDE 'V2gEvseMacAddress[0]'. */
/begin MEASUREMENT V2gEvseMacAddress[0] "V2G connection information" UBYTE CU_V2GEVSEMACADDRESS[0] 1 100 0.0 255.0 ECU_ADDRESS 0x70018310 BYTE_ORDER MSB_LAST /end MEASUREMENT
/begin COMPU_METHOD CU_V2GEVSEMACADDRESS[0] "Conversion method for V2gEvseMacAddress[0]" RAT_FUNC "%10.0" "1" COEFFS 0.000000 1.000000 -0.000000 0.000000 0.000000 1.000000 /end COMPU_METHOD
/* Scalar measurable for DDE 'V2gEvseMacAddress[1]'. */
/begin MEASUREMENT V2gEvseMacAddress[1] "V2G connection information" UBYTE CU_V2GEVSEMACADDRESS[1] 1 100 0.0 255.0 ECU_ADDRESS 0x70018311 BYTE_ORDER MSB_LAST /end MEASUREMENT
/begin COMPU_METHOD CU_V2GEVSEMACADDRESS[1] "Conversion method for V2gEvseMacAddress[1]" RAT_FUNC "%10.0" "1" COEFFS 0.000000 1.000000 -0.000000 0.000000 0.000000 1.000000 /end COMPU_METHOD
/* Scalar measurable for DDE 'V2gEvseMacAddress[2]'. */
/begin MEASUREMENT V2gEvseMacAddress[2] "V2G connection information" UBYTE CU_V2GEVSEMACADDRESS[2] 1 100 0.0 255.0 ECU_ADDRESS 0x70018312 BYTE_ORDER MSB_LAST /end MEASUREMENT
/begin COMPU_METHOD CU_V2GEVSEMACADDRESS[2] "Conversion method for V2gEvseMacAddress[2]" RAT_FUNC "%10.0" "1" COEFFS 0.000000 1.000000 -0.000000 0.000000 0.000000 1.000000 /end COMPU_METHOD
/* Scalar measurable for DDE 'V2gEvseMacAddress[3]'. */
/begin MEASUREMENT V2gEvseMacAddress[3] "V2G connection information" UBYTE CU_V2GEVSEMACADDRESS[3] 1 100 0.0 255.0 ECU_ADDRESS 0x70018313 BYTE_ORDER MSB_LAST /end MEASUREMENT
/begin COMPU_METHOD CU_V2GEVSEMACADDRESS[3] "Conversion method for V2gEvseMacAddress[3]" RAT_FUNC "%10.0" "1" COEFFS 0.000000 1.000000 -0.000000 0.000000 0.000000 1.000000 /end COMPU_METHOD
/* Scalar measurable for DDE 'V2gEvseMacAddress[4]'. */
/begin MEASUREMENT V2gEvseMacAddress[4] "V2G connection information" UBYTE CU_V2GEVSEMACADDRESS[4] 1 100 0.0 255.0 ECU_ADDRESS 0x70018314 BYTE_ORDER MSB_LAST /end MEASUREMENT
/begin COMPU_METHOD CU_V2GEVSEMACADDRESS[4] "Conversion method for V2gEvseMacAddress[4]" RAT_FUNC "%10.0" "1" COEFFS 0.000000 1.000000 -0.000000 0.000000 0.000000 1.000000 /end COMPU_METHOD
/* Scalar measurable for DDE 'V2gEvseMacAddress[5]'. */
/begin MEASUREMENT V2gEvseMacAddress[5] "V2G connection information" UBYTE CU_V2GEVSEMACADDRESS[5] 1 100 0.0 255.0 ECU_ADDRESS 0x70018315 BYTE_ORDER MSB_LAST /end MEASUREMENT
/begin COMPU_METHOD CU_V2GEVSEMACADDRESS[5] "Conversion method for V2gEvseMacAddress[5]" RAT_FUNC "%10.0" "1" COEFFS 0.000000 1.000000 -0.000000 0.000000 0.000000 1.000000 /end COMPU_METHOD
/* Scalar measurable for DDE 'V2gEvseTcpPortNumber'. */
/begin MEASUREMENT V2gEvseTcpPortNumber "V2G connection information" UWORD CU_V2GEVSETCPPORTNUMBER 1 100 0.0 65535.0 ECU_ADDRESS 0x70017c22 BYTE_ORDER MSB_LAST /end MEASUREMENT
/begin COMPU_METHOD CU_V2GEVSETCPPORTNUMBER "Conversion method for V2gEvseTcpPortNumber" RAT_FUNC "%10.0" "1" COEFFS 0.000000 1.000000 -0.000000 0.000000 0.000000 1.000000 /end COMPU_METHOD
/* Scalar measurable for DDE 'ccu_cpu_loading'. */
/begin MEASUREMENT ccu_cpu_loading "CPU loading seen in last 50ms" UBYTE CU_CCU_CPU_LOADING 1 100 0.0 0.0 ECU_ADDRESS 0x70019ee5 BYTE_ORDER MSB_LAST /end MEASUREMENT
/begin COMPU_METHOD CU_CCU_CPU_LOADING "Conversion method for ccu_cpu_loading" RAT_FUNC "%10.0" "%" COEFFS 0.000000 1.000000 -0.000000 0.000000 0.000000 1.000000 /end COMPU_METHOD
/* Scalar measurable for DDE 'ccu_cpu_loading_max'. */
/begin MEASUREMENT ccu_cpu_loading_max "Maximum CPU loading seen in any 50ms period" UBYTE CU_CCU_CPU_LOADING_MAX 1 100 0.0 0.0 ECU_ADDRESS 0x7001a002 BYTE_ORDER MSB_LAST /end MEASUREMENT
/begin COMPU_METHOD CU_CCU_CPU_LOADING_MAX "Conversion method for ccu_cpu_loading_max" RAT_FUNC "%10.0" "%" COEFFS 0.000000 1.000000 -0.000000 0.000000 0.000000 1.000000 /end COMPU_METHOD
/* Scalar measurable for DDE 'ccu_stack_used'. */
/begin MEASUREMENT ccu_stack_used "Amount of used stack" ULONG CU_CCU_STACK_USED 1 100 0.0 0.0 ECU_ADDRESS 0x0 BYTE_ORDER MSB_LAST /end MEASUREMENT
/begin COMPU_METHOD CU_CCU_STACK_USED "Conversion method for ccu_stack_used" RAT_FUNC "%10.0" "bytes" COEFFS 0.000000 1.000000 -0.000000 0.000000 0.000000 1.000000 /end COMPU_METHOD
/* Scalar measurable for DDE 'ccu_task_duration_1s'. */
/begin MEASUREMENT ccu_task_duration_1s "Duration of 1s task (last measured valued)" ULONG CU_CCU_TASK_DURATION_1S 1 100 0.0 0.0 ECU_ADDRESS 0x7001a0c0 BYTE_ORDER MSB_LAST /end MEASUREMENT
/begin COMPU_METHOD CU_CCU_TASK_DURATION_1S "Conversion method for ccu_task_duration_1s" RAT_FUNC "%10.0" "microseconds" COEFFS 0.000000 1.000000 -0.000000 0.000000 0.000000 1.000000 /end COMPU_METHOD
/* Scalar measurable for DDE 'ccu_task_duration_1s_max'. */
/begin MEASUREMENT ccu_task_duration_1s_max "Duration of 1s task (maximum since power up)" ULONG CU_CCU_TASK_DURATION_1S_MAX 1 100 0.0 0.0 ECU_ADDRESS 0x70019ea8 BYTE_ORDER MSB_LAST /end MEASUREMENT
/begin COMPU_METHOD CU_CCU_TASK_DURATION_1S_MAX "Conversion method for ccu_task_duration_1s_max" RAT_FUNC "%10.0" "microseconds" COEFFS 0.000000 1.000000 -0.000000 0.000000 0.000000 1.000000 /end COMPU_METHOD
/* Scalar measurable for DDE 'mpl_app_build_day'. */
/begin MEASUREMENT mpl_app_build_day "Date application was built in days." UWORD CU_MPL_APP_BUILD_DAY 1 100 0.0 65535.0 ECU_ADDRESS 0x70016088 BYTE_ORDER MSB_LAST /end MEASUREMENT
/begin COMPU_METHOD CU_MPL_APP_BUILD_DAY "Conversion method for mpl_app_build_day" RAT_FUNC "%10.0" "(not defined)" COEFFS 0.000000 1.000000 -0.000000 0.000000 0.000000 1.000000 /end COMPU_METHOD
/* Scalar measurable for DDE 'mpl_app_build_hour'. */
/begin MEASUREMENT mpl_app_build_hour "Time application was built in hours" UWORD CU_MPL_APP_BUILD_HOUR 1 100 0.0 65535.0 ECU_ADDRESS 0x7001608a BYTE_ORDER MSB_LAST /end MEASUREMENT
/begin COMPU_METHOD CU_MPL_APP_BUILD_HOUR "Conversion method for mpl_app_build_hour" RAT_FUNC "%10.0" "(not defined)" COEFFS 0.000000 1.000000 -0.000000 0.000000 0.000000 1.000000 /end COMPU_METHOD
/* Scalar measurable for DDE 'mpl_app_build_min'. */
/begin MEASUREMENT mpl_app_build_min "Time application was built in minutes" UWORD CU_MPL_APP_BUILD_MIN 1 100 0.0 65535.0 ECU_ADDRESS 0x7001608c BYTE_ORDER MSB_LAST /end MEASUREMENT
/begin COMPU_METHOD CU_MPL_APP_BUILD_MIN "Conversion method for mpl_app_build_min" RAT_FUNC "%10.0" "(not defined)" COEFFS 0.000000 1.000000 -0.000000 0.000000 0.000000 1.000000 /end COMPU_METHOD
/* Scalar measurable for DDE 'mpl_app_build_month'. */
/begin MEASUREMENT mpl_app_build_month "Date application was built in months." UWORD CU_MPL_APP_BUILD_MONTH 1 100 0.0 65535.0 ECU_ADDRESS 0x70016086 BYTE_ORDER MSB_LAST /end MEASUREMENT
/begin COMPU_METHOD CU_MPL_APP_BUILD_MONTH "Conversion method for mpl_app_build_month" RAT_FUNC "%10.0" "(not defined)" COEFFS 0.000000 1.000000 -0.000000 0.000000 0.000000 1.000000 /end COMPU_METHOD
/* Scalar measurable for DDE 'mpl_app_build_sec'. */
/begin MEASUREMENT mpl_app_build_sec "Time application was built in seconds" UWORD CU_MPL_APP_BUILD_SEC 1 100 0.0 65535.0 ECU_ADDRESS 0x7001608e BYTE_ORDER MSB_LAST /end MEASUREMENT
/begin COMPU_METHOD CU_MPL_APP_BUILD_SEC "Conversion method for mpl_app_build_sec" RAT_FUNC "%10.0" "(not defined)" COEFFS 0.000000 1.000000 -0.000000 0.000000 0.000000 1.000000 /end COMPU_METHOD
/* Scalar measurable for DDE 'mpl_app_build_year'. */
/begin MEASUREMENT mpl_app_build_year "Date application was built in years." UWORD CU_MPL_APP_BUILD_YEAR 1 100 0.0 65535.0 ECU_ADDRESS 0x70016084 BYTE_ORDER MSB_LAST /end MEASUREMENT
/begin COMPU_METHOD CU_MPL_APP_BUILD_YEAR "Conversion method for mpl_app_build_year" RAT_FUNC "%10.0" "(not defined)" COEFFS 0.000000 1.000000 -0.000000 0.000000 0.000000 1.000000 /end COMPU_METHOD
/* Scalar measurable for DDE 'mpl_app_ver_major'. */
/begin MEASUREMENT mpl_app_ver_major "App major version number" UWORD CU_MPL_APP_VER_MAJOR 1 100 0.0 65535.0 ECU_ADDRESS 0x80136aca BYTE_ORDER MSB_LAST /end MEASUREMENT
/begin COMPU_METHOD CU_MPL_APP_VER_MAJOR "Conversion method for mpl_app_ver_major" RAT_FUNC "%10.0" "(not defined)" COEFFS 0.000000 1.000000 -0.000000 0.000000 0.000000 1.000000 /end COMPU_METHOD
/* Scalar measurable for DDE 'mpl_app_ver_minor'. */
/begin MEASUREMENT mpl_app_ver_minor "App minor version number" UWORD CU_MPL_APP_VER_MINOR 1 100 0.0 65535.0 ECU_ADDRESS 0x80136ac8 BYTE_ORDER MSB_LAST /end MEASUREMENT
/begin COMPU_METHOD CU_MPL_APP_VER_MINOR "Conversion method for mpl_app_ver_minor" RAT_FUNC "%10.0" "(not defined)" COEFFS 0.000000 1.000000 -0.000000 0.000000 0.000000 1.000000 /end COMPU_METHOD
/* Scalar measurable for DDE 'mpl_app_ver_sub'. */
/begin MEASUREMENT mpl_app_ver_sub "App sub-minor version number" UWORD CU_MPL_APP_VER_SUB 1 100 0.0 65535.0 ECU_ADDRESS 0x80136ac6 BYTE_ORDER MSB_LAST /end MEASUREMENT
/begin COMPU_METHOD CU_MPL_APP_VER_SUB "Conversion method for mpl_app_ver_sub" RAT_FUNC "%10.0" "(not defined)" COEFFS 0.000000 1.000000 -0.000000 0.000000 0.000000 1.000000 /end COMPU_METHOD
/* Scalar measurable for DDE 'mpl_boot_build_day'. */
/begin MEASUREMENT mpl_boot_build_day "Boot build day" UWORD CU_MPL_BOOT_BUILD_DAY 1 100 0.0 65535.0 ECU_ADDRESS 0x70013d1e BYTE_ORDER MSB_LAST /end MEASUREMENT
/begin COMPU_METHOD CU_MPL_BOOT_BUILD_DAY "Conversion method for mpl_boot_build_day" RAT_FUNC "%10.0" "(not defined)" COEFFS 0.000000 1.000000 -0.000000 0.000000 0.000000 1.000000 /end COMPU_METHOD
/* Scalar measurable for DDE 'mpl_boot_build_month'. */
/begin MEASUREMENT mpl_boot_build_month "Boot build month" UWORD CU_MPL_BOOT_BUILD_MONTH 1 100 0.0 65535.0 ECU_ADDRESS 0x70013d1c BYTE_ORDER MSB_LAST /end MEASUREMENT
/begin COMPU_METHOD CU_MPL_BOOT_BUILD_MONTH "Conversion method for mpl_boot_build_month" RAT_FUNC "%10.0" "(not defined)" COEFFS 0.000000 1.000000 -0.000000 0.000000 0.000000 1.000000 /end COMPU_METHOD
/* Scalar measurable for DDE 'mpl_boot_build_year'. */
/begin MEASUREMENT mpl_boot_build_year "Boot build year" UWORD CU_MPL_BOOT_BUILD_YEAR 1 100 0.0 65535.0 ECU_ADDRESS 0x70013d1a BYTE_ORDER MSB_LAST /end MEASUREMENT
/begin COMPU_METHOD CU_MPL_BOOT_BUILD_YEAR "Conversion method for mpl_boot_build_year" RAT_FUNC "%10.0" "(not defined)" COEFFS 0.000000 1.000000 -0.000000 0.000000 0.000000 1.000000 /end COMPU_METHOD
/* Scalar measurable for DDE 'mpl_boot_part_num_group'. */
/begin MEASUREMENT mpl_boot_part_num_group "Boot Group ID number in the part number" UBYTE CU_MPL_BOOT_PART_NUM_GROUP 1 100 0.0 255.0 ECU_ADDRESS 0x70013d19 BYTE_ORDER MSB_LAST /end MEASUREMENT
/begin COMPU_METHOD CU_MPL_BOOT_PART_NUM_GROUP "Conversion method for mpl_boot_part_num_group" RAT_FUNC "%10.0" "(not defined)" COEFFS 0.000000 1.000000 -0.000000 0.000000 0.000000 1.000000 /end COMPU_METHOD
/* Scalar measurable for DDE 'mpl_boot_part_num_id'. */
/begin MEASUREMENT mpl_boot_part_num_id "Boot Part ID in the part number" ULONG CU_MPL_BOOT_PART_NUM_ID 1 100 0.0 4294967295.0 ECU_ADDRESS 0x70013d14 BYTE_ORDER MSB_LAST /end MEASUREMENT
/begin COMPU_METHOD CU_MPL_BOOT_PART_NUM_ID "Conversion method for mpl_boot_part_num_id" RAT_FUNC "%10.0" "(not defined)" COEFFS 0.000000 1.000000 -0.000000 0.000000 0.000000 1.000000 /end COMPU_METHOD
/* Scalar measurable for DDE 'mpl_boot_part_num_issue'. */
/begin MEASUREMENT mpl_boot_part_num_issue "Boot Issue Number in the part number" UWORD CU_MPL_BOOT_PART_NUM_ISSUE 1 100 0.0 65535.0 ECU_ADDRESS 0x70013d12 BYTE_ORDER MSB_LAST /end MEASUREMENT
/begin COMPU_METHOD CU_MPL_BOOT_PART_NUM_ISSUE "Conversion method for mpl_boot_part_num_issue" RAT_FUNC "%10.0" "(not defined)" COEFFS 0.000000 1.000000 -0.000000 0.000000 0.000000 1.000000 /end COMPU_METHOD
/* Scalar measurable for DDE 'mpl_boot_part_num_letter'. */
/begin MEASUREMENT mpl_boot_part_num_letter "Boot Group Letter in the part number" UBYTE CU_MPL_BOOT_PART_NUM_LETTER 1 100 0.0 255.0 ECU_ADDRESS 0x70013d18 BYTE_ORDER MSB_LAST /end MEASUREMENT
/begin COMPU_METHOD CU_MPL_BOOT_PART_NUM_LETTER "Conversion method for mpl_boot_part_num_letter" RAT_FUNC "%10.0" "(not defined)" COEFFS 0.000000 1.000000 -0.000000 0.000000 0.000000 1.000000 /end COMPU_METHOD
/* Scalar measurable for DDE 'mpl_boot_ver_major'. */
/begin MEASUREMENT mpl_boot_ver_major "Boot major version number" UWORD CU_MPL_BOOT_VER_MAJOR 1 100 0.0 65535.0 ECU_ADDRESS 0x70013d24 BYTE_ORDER MSB_LAST /end MEASUREMENT
/begin COMPU_METHOD CU_MPL_BOOT_VER_MAJOR "Conversion method for mpl_boot_ver_major" RAT_FUNC "%10.0" "(not defined)" COEFFS 0.000000 1.000000 -0.000000 0.000000 0.000000 1.000000 /end COMPU_METHOD
/* Scalar measurable for DDE 'mpl_boot_ver_minor'. */
/begin MEASUREMENT mpl_boot_ver_minor "Boot minor version number" UWORD CU_MPL_BOOT_VER_MINOR 1 100 0.0 65535.0 ECU_ADDRESS 0x70013d22 BYTE_ORDER MSB_LAST /end MEASUREMENT
/begin COMPU_METHOD CU_MPL_BOOT_VER_MINOR "Conversion method for mpl_boot_ver_minor" RAT_FUNC "%10.0" "(not defined)" COEFFS 0.000000 1.000000 -0.000000 0.000000 0.000000 1.000000 /end COMPU_METHOD
/* Scalar measurable for DDE 'mpl_boot_ver_sub'. */
/begin MEASUREMENT mpl_boot_ver_sub "Boot sub minor version number" UWORD CU_MPL_BOOT_VER_SUB 1 100 0.0 65535.0 ECU_ADDRESS 0x70013d20 BYTE_ORDER MSB_LAST /end MEASUREMENT
/begin COMPU_METHOD CU_MPL_BOOT_VER_SUB "Conversion method for mpl_boot_ver_sub" RAT_FUNC "%10.0" "(not defined)" COEFFS 0.000000 1.000000 -0.000000 0.000000 0.000000 1.000000 /end COMPU_METHOD
/* Scalar measurable for DDE 'mpl_bspi_task.stack.isr.status'. */
/begin MEASUREMENT mpl_bspi_task.stack.isr.status "Current status of stack performance measurement for task: bspi_task" SLONG CU_MPL_BSPI_TASK.STACK.ISR.STA0 1 100 0.0 255.0 ECU_ADDRESS 0x70017290 BYTE_ORDER MSB_LAST /end MEASUREMENT
/begin COMPU_METHOD CU_MPL_BSPI_TASK.STACK.ISR.STA0 "Conversion method for mpl_bspi_task.stack.isr.status" TAB_VERB "%12.0" "(not defined)" COMPU_TAB_REF CT_MPL_BSPI_TASK.STACK.ISR.STA0 /end COMPU_METHOD
/begin COMPU_VTAB CT_MPL_BSPI_TASK.STACK.ISR.STA0 "Conversion method for mpl_bspi_task.stack.isr.status" TAB_VERB 5 0 "PKN_TASK_STK_STAT_NR_IN_PROG" 1 "PKN_TASK_STACK_DATA_STATUS_VALID" 2 "PKN_TASK_STK_STAT_NR_GROW_SPEC" 3 "PKN_TASK_STK_STAT_NR_ALLOC_SPEC" 4 "PKN_TASK_STK_STAT_NR_INV_SPEC" /end COMPU_VTAB
/* Scalar measurable for DDE 'mpl_bspi_task.stack.isr.used'. */
/begin MEASUREMENT mpl_bspi_task.stack.isr.used "Used bytes of interrupt stack for task named: bspi_task" ULONG CU_MPL_BSPI_TASK.STACK.ISR.USED 1 100 0.0 4294967295.0 ECU_ADDRESS 0x7001728c BYTE_ORDER MSB_LAST /end MEASUREMENT
/begin COMPU_METHOD CU_MPL_BSPI_TASK.STACK.ISR.USED "Conversion method for mpl_bspi_task.stack.isr.used" RAT_FUNC "%10.0" "bytes" COEFFS 0.000000 1.000000 -0.000000 0.000000 0.000000 1.000000 /end COMPU_METHOD
/* Scalar measurable for DDE 'mpl_bspi_task.stack.task.status'. */
/begin MEASUREMENT mpl_bspi_task.stack.task.status "Current status of stack performance measurement for task: bspi_task" SLONG CU_MPL_BSPI_TASK.STACK.TASK.ST0 1 100 0.0 255.0 ECU_ADDRESS 0x700172a0 BYTE_ORDER MSB_LAST /end MEASUREMENT
/begin COMPU_METHOD CU_MPL_BSPI_TASK.STACK.TASK.ST0 "Conversion method for mpl_bspi_task.stack.task.status" TAB_VERB "%12.0" "(not defined)" COMPU_TAB_REF CT_MPL_BSPI_TASK.STACK.TASK.ST0 /end COMPU_METHOD
/begin COMPU_VTAB CT_MPL_BSPI_TASK.STACK.TASK.ST0 "Conversion method for mpl_bspi_task.stack.task.status" TAB_VERB 5 0 "PKN_TASK_STK_STAT_NR_IN_PROG" 1 "PKN_TASK_STACK_DATA_STATUS_VALID" 2 "PKN_TASK_STK_STAT_NR_GROW_SPEC" 3 "PKN_TASK_STK_STAT_NR_ALLOC_SPEC" 4 "PKN_TASK_STK_STAT_NR_INV_SPEC" /end COMPU_VTAB
/* Scalar measurable for DDE 'mpl_bspi_task.stack.task.used'. */
/begin MEASUREMENT mpl_bspi_task.stack.task.used "Used bytes of task stack for task named: bspi_task" ULONG CU_MPL_BSPI_TASK.STACK.TASK.US0 1 100 0.0 4294967295.0 ECU_ADDRESS 0x7001729c BYTE_ORDER MSB_LAST /end MEASUREMENT
/begin COMPU_METHOD CU_MPL_BSPI_TASK.STACK.TASK.US0 "Conversion method for mpl_bspi_task.stack.task.used" RAT_FUNC "%10.0" "bytes" COEFFS 0.000000 1.000000 -0.000000 0.000000 0.000000 1.000000 /end COMPU_METHOD
/* Scalar measurable for DDE 'mpl_bspi_task.timing.max_task_time'. */
/begin MEASUREMENT mpl_bspi_task.timing.max_task_0 "Maximum duration of task since reset: bspi_task" ULONG CU_MPL_BSPI_TASK.TIMING.MAX_TA0 1 100 0.0 42949672.0 ECU_ADDRESS 0x7001caa8 BYTE_ORDER MSB_LAST /end MEASUREMENT
/begin COMPU_METHOD CU_MPL_BSPI_TASK.TIMING.MAX_TA0 "Conversion method for mpl_bspi_task.timing.max_task_time" RAT_FUNC "%10.0" "microseconds" COEFFS 0.000000 100.000000 -0.000000 0.000000 0.000000 1.000000 /end COMPU_METHOD
/begin FUNCTION V2G_RX_ISO15118ED2 "Group /ByModelHeirarchy/LaforgeTestApp_CCU/Core0-TestApp/V2G/OE_CCS/V2gRx/V2G_RX_ISO15118ED2" /begin SUB_FUNCTION Iso2Rx_DcEvseBiDirPar Iso2Rx_DcEvseChgPar Subsystem9 /end SUB_FUNCTION
 /begin LOC_MEASUREMENT DynamicModeEn Iso2AuthEvseProcessing Iso2AuthEvseStatPres Iso2AuthNotif Iso2AuthNotifMaxDelay Iso2AuthRescode Iso2AuthRxTrg Iso2BPTCtrlEvseCrntLimAchvd Iso2BPTCtrlEvseIdLen Iso2BPTCtrlEvseId[0] Iso2BPTCtrlEvseId[10] Iso2BPTCtrlEvseId[11] Iso2BPTCtrlEvseId[12] Iso2BPTCtrlEvseId[13] Iso2BPTCtrlEvseId[14] Iso2BPTCtrlEvseId[15] Iso2BPTCtrlEvseId[16] Iso2BPTCtrlEvseId[17] Iso2BPTCtrlEvseId[18] Iso2BPTCtrlEvseId[19] Iso2BPTCtrlEvseId[1] Iso2BPTCtrlEvseId[20] Iso2BPTCtrlEvseId[21] Iso2BPTCtrlEvseId[22] Iso2BPTCtrlEvseId[23] Iso2BPTCtrlEvseId[24] Iso2BPTCtrlEvseId[25] Iso2BPTCtrlEvseId[26] Iso2BPTCtrlEvseId[27] Iso2BPTCtrlEvseId[28] Iso2BPTCtrlEvseId[29] Iso2BPTCtrlEvseId[2] Iso2BPTCtrlEvseId[30] Iso2BPTCtrlEvseId[31] Iso2BPTCtrlEvseId[32] Iso2BPTCtrlEvseId[33] Iso2BPTCtrlEvseId[34] Iso2BPTCtrlEvseId[35] Iso2BPTCtrlEvseId[36] Iso2BPTCtrlEvseId[37] Iso2BPTCtrlEvseId[3] Iso2BPTCtrlEvseId[4] Iso2BPTCtrlEvseId[5] Iso2BPTCtrlEvseId[6] Iso2BPTCtrlEvseId[7] Iso2BPTCtrlEvseId[8] Iso2BPTCtrlEvseId[9] Iso2BPTCtrlEvseMaxChgCrnt Iso2BPTCtrlEvseMaxChgCrntPres Iso2BPTCtrlEvseMaxChgPwr Iso2BPTCtrlEvseMaxChgPwrPres Iso2BPTCtrlEvseMaxDisChgCrnt Iso2BPTCtrlEvseMaxDisChgPwr Iso2BPTCtrlEvseMaxVolt Iso2BPTCtrlEvseMaxVoltPres Iso2BPTCtrlEvseMinVolt Iso2BPTCtrlEvseMinVoltPres Iso2BPTCtrlEvsePresCrnt Iso2BPTCtrlEvsePresVolt Iso2BPTCtrlEvseStatPres Iso2BPTCtrlEvseVoltLimAchvd Iso2BPTCtrlMaxDisChgCrntPres Iso2BPTCtrlMaxDisChgPwrPres Iso2BPTCtrlNotif Iso2BPTCtrlNotifMaxDelay Iso2BPTCtrlRescode Iso2BPTCtrlRxTrg Iso2BPTCtrlSaSchTupId Iso2BPTCtrlSaSchTupIdPres Iso2CblChkEvseProcessing Iso2CblChkEvseStatPres Iso2CblChkNotif Iso2CblChkNotifMaxDelay Iso2CblChkRescode Iso2CblChkRxTrg Iso2ChgParDiscDcBptParPres Iso2ChgParDiscDcChgParPres Iso2ChgParDiscEvseProcessing Iso2ChgParDiscEvseStatPres Iso2ChgParDiscNotif Iso2ChgParDiscNotifMaxDelay Iso2ChgParDiscRescode Iso2ChgParDiscRxTrg Iso2ChgParDiscSaSchListSize Iso2CrntDmdEvseCrntLimAchvd Iso2CrntDmdEvseIdLen Iso2CrntDmdEvseId[0] Iso2CrntDmdEvseId[10] Iso2CrntDmdEvseId[11] Iso2CrntDmdEvseId[12] Iso2CrntDmdEvseId[13] Iso2CrntDmdEvseId[14] Iso2CrntDmdEvseId[15] Iso2CrntDmdEvseId[16] Iso2CrntDmdEvseId[17] Iso2CrntDmdEvseId[18] Iso2CrntDmdEvseId[19] Iso2CrntDmdEvseId[1] Iso2CrntDmdEvseId[20] Iso2CrntDmdEvseId[21] Iso2CrntDmdEvseId[22] Iso2CrntDmdEvseId[23] Iso2CrntDmdEvseId[24] Iso2CrntDmdEvseId[25] Iso2CrntDmdEvseId[26] Iso2CrntDmdEvseId[27] Iso2CrntDmdEvseId[28] Iso2CrntDmdEvseId[29] Iso2CrntDmdEvseId[2] Iso2CrntDmdEvseId[30] Iso2CrntDmdEvseId[31] Iso2CrntDmdEvseId[32] Iso2CrntDmdEvseId[33] Iso2CrntDmdEvseId[34] Iso2CrntDmdEvseId[35] Iso2CrntDmdEvseId[36] Iso2CrntDmdEvseId[37] Iso2CrntDmdEvseId[3] Iso2CrntDmdEvseId[4] Iso2CrntDmdEvseId[5] Iso2CrntDmdEvseId[6] Iso2CrntDmdEvseId[7] Iso2CrntDmdEvseId[8] Iso2CrntDmdEvseId[9] Iso2CrntDmdEvseMaxCrntLim Iso2CrntDmdEvseMaxCrntLimPres Iso2CrntDmdEvseMaxPwrLim Iso2CrntDmdEvseMaxPwrLimPres Iso2CrntDmdEvseMaxVoltLim Iso2CrntDmdEvseMaxVoltLimPres Iso2CrntDmdEvsePresCrnt Iso2CrntDmdEvsePresVolt Iso2CrntDmdEvsePwrLimAchvd Iso2CrntDmdEvseStatPres Iso2CrntDmdEvseVoltLimAchvd Iso2CrntDmdNotif Iso2CrntDmdNotifMaxDelay Iso2CrntDmdRescode Iso2CrntDmdRxTrg Iso2CrntDmdSASchTupId Iso2CrntDmdSASchTupIdPres Iso2EvseIdLen Iso2EvseId[0] Iso2EvseId[10] Iso2EvseId[11] Iso2EvseId[12] Iso2EvseId[13] Iso2EvseId[14] Iso2EvseId[15] Iso2EvseId[16] Iso2EvseId[17] Iso2EvseId[18] Iso2EvseId[19] Iso2EvseId[1] Iso2EvseId[20] Iso2EvseId[21] Iso2EvseId[22] Iso2EvseId[23] Iso2EvseId[24] Iso2EvseId[25] Iso2EvseId[26] Iso2EvseId[27] Iso2EvseId[28] Iso2EvseId[29] Iso2EvseId[2] Iso2EvseId[30] Iso2EvseId[31] Iso2EvseId[32] Iso2EvseId[33] Iso2EvseId[34] Iso2EvseId[35] Iso2EvseId[36] Iso2EvseId[37] Iso2EvseId[3] Iso2EvseId[4] Iso2EvseId[5] Iso2EvseId[6] Iso2EvseId[7] Iso2EvseId[8] Iso2EvseId[9] Iso2PmtSelEvseStatPres Iso2PmtSelNotif Iso2PmtSelNotifMaxDelay Iso2PmtSelRescode Iso2PmtSelRxTrg Iso2PreChgEvsePresVolt Iso2PreChgEvseStatPres Iso2PreChgNotif Iso2PreChgNotifMaxDelay Iso2PreChgRescode Iso2PreChgRxTrg Iso2PwrDelivEvseProcessing Iso2PwrDelivEvseStatPres Iso2PwrDelivNotif Iso2PwrDelivNotifMaxDelay Iso2PwrDelivRescode Iso2PwrDelivRxTrg Iso2SesSetupNotif Iso2SesSetupNotifMaxDelay Iso2SesSetupRescode Iso2SesSetupRxTrg Iso2SesSetupTimestmp Iso2SesSetupTimestmpPres Iso2SesStopEvseStatPres Iso2SesStopNotif Iso2SesStopNotifMaxDelay Iso2SesStopRescode Iso2SesStopRxTrg Iso2SvcDetailEvseMaxDelay Iso2SvcDetailEvseStatPres Iso2SvcDetailNotif Iso2SvcDetailRescode Iso2SvcDetailRxTrg Iso2SvcDetailSvcId Iso2SvcDetailSvcParamSetLen Iso2SvcDetailSvcParamSetSizes[1 Iso2SvcDetailSvcParamSetSizes[2 Iso2SvcDetailSvcParamSetSizes[0 Iso2SvcDetailSvcParamSetSizes[3 Iso2SvcDetailSvcParamSetSizes[4 Iso2SvcDiscEgyTrnsLen Iso2SvcDiscEgyTrnsSvcFreeSvc[0] Iso2SvcDiscEgyTrnsSvcFreeSvc[1] Iso2SvcDiscEgyTrnsSvcFreeSvc[2] Iso2SvcDiscEgyTrnsSvcFreeSvc[3] Iso2SvcDiscEgyTrnsSvcFreeSvc[4] Iso2SvcDiscEgyTrnsSvcFreeSvc[5] Iso2SvcDiscEgyTrnsSvcFreeSvc[6] Iso2SvcDiscEgyTrnsSvcFreeSvc[7] Iso2SvcDiscEgyTrnsSvcIds[0] Iso2SvcDiscEgyTrnsSvcIds[1] Iso2SvcDiscEgyTrnsSvcIds[2] Iso2SvcDiscEgyTrnsSvcIds[3] Iso2SvcDiscEgyTrnsSvcIds[4] Iso2SvcDiscEgyTrnsSvcIds[5] Iso2SvcDiscEgyTrnsSvcIds[6] Iso2SvcDiscEgyTrnsSvcIds[7] Iso2SvcDiscEvseStatPres Iso2SvcDiscNotif Iso2SvcDiscNotifMaxDelay Iso2SvcDiscRescode Iso2SvcDiscRxTrg Iso2SvcDiscVasListLen Iso2WeldDetEvsePresVolt Iso2WeldDetEvseStatPres Iso2WeldDetNotif Iso2WeldDetNotifMaxDelay Iso2WeldDetRescode Iso2WeldDetRxTrg ParamSetIdSelected ServiceIdSelected SvcSearchSt /end LOC_MEASUREMENT
/end FUNCTION
/begin FUNCTION V2gRx "Group /ByModelHeirarchy/LaforgeTestApp_CCU/Core0-TestApp/V2G/OE_CCS/V2gRx"
 /begin SUB_FUNCTION OVR_AndExport1 OVR_AndExport18 OVR_AndExport26 OVR_AndExport38 OVR_AndExport391 V2G_RX_DINSPEC70121 V2G_RX_ISO15118ED1 V2G_RX_ISO15118ED2 /end SUB_FUNCTION
 /begin LOC_MEASUREMENT V2gEcuConnectionSt V2gEcuPlcChipStatus V2gEcuPlcLinkStatus V2gEcuQcaErrCode V2gEcuSlacEvseAvgAttenuation V2gEcuSlacSessionState V2gEcuSlacState V2gEcuTcpStatus V2gEcuUnmatchedSlacPhase V2gEcuV2gConnectionErrCode V2gEvccIpAddress[0] V2gEvccIpAddress[1] V2gEvccIpAddress[2] V2gEvccIpAddress[3] V2gEvccIpAddress[4] V2gEvccIpAddress[5] V2gEvccIpAddress[6] V2gEvccIpAddress[7] V2gEvccMacAddress[0] V2gEvccMacAddress[1] V2gEvccMacAddress[2] V2gEvccMacAddress[3] V2gEvccMacAddress[4] V2gEvccMacAddress[5] V2gEvccTcpPortNumber V2gEvseIpAddress[0] V2gEvseIpAddress[1] V2gEvseIpAddress[2] V2gEvseIpAddress[3] V2gEvseIpAddress[4] V2gEvseIpAddress[5] V2gEvseIpAddress[6] V2gEvseIpAddress[7] V2gEvseMacAddress[0] V2gEvseMacAddress[1] V2gEvseMacAddress[2] V2gEvseMacAddress[3] V2gEvseMacAddress[4] V2gEvseMacAddress[5] V2gEvseTcpPortNumber /end LOC_MEASUREMENT
/end FUNCTION
/begin FUNCTION OE_CCS "Group /ByModelHeirarchy/LaforgeTestApp_CCU/Core0-TestApp/V2G/OE_CCS"
 /begin SUB_FUNCTION Arbitration CTL CcsVersion FLT IPR OUT OVR_AndExport17 OVR_AndExport103 OVR_AndExport114 OVR_AndExport123 OVR_AndExport134 OVR_AndExport142 OVR_AndExport152 OVR_AndExport162 OVR_AndExport172 OVR_AndExport182 OVR_AndExport192 OVR_AndExport25 OVR_AndExport202 OVR_AndExport212 OVR_AndExport224 OVR_AndExport232 OVR_AndExport242 OVR_AndExport252 OVR_AndExport262 OVR_AndExport272 OVR_AndExport282 OVR_AndExport292 OVR_AndExport36 OVR_AndExport302 OVR_AndExport312 OVR_AndExport322 OVR_AndExport331 OVR_AndExport341 OVR_AndExport351 OVR_AndExport36 OVR_AndExport37 OVR_AndExport45 OVR_AndExport43 OVR_AndExport44 OVR_AndExport45 OVR_AndExport46 OVR_AndExport47 OVR_AndExport48 OVR_AndExport49 OVR_AndExport54 OVR_AndExport50 OVR_AndExport51 OVR_AndExport52 OVR_AndExport53 OVR_AndExport54 OVR_AndExport55 OVR_AndExport56 OVR_AndExport57 OVR_AndExport58 OVR_AndExport59 OVR_AndExport64 OVR_AndExport60 OVR_AndExport74 OVR_AndExport84 OVR_AndExport95 V2gRx /end SUB_FUNCTION
 /begin LOC_MEASUREMENT HostDesiredEgyTrnsfrMde /end LOC_MEASUREMENT
/end FUNCTION
/begin FUNCTION SystemInfo "Group /ByModelHeirarchy/LaforgeTestApp_CCU/Core0-TestApp/V2G/SystemInfo"
 /begin LOC_MEASUREMENT SysCpuLoading SysResetType SysStackUsed SysTaskDurLoopA SysTaskDurLoopB SysTaskDurLoopC SysTaskDurLoopCcs SysTaskPeriodOverrunLoopA SysTaskPeriodOverrunLoopB SysTimeSinceWakeMillisecond SysTimeSinceWakeSecond /end LOC_MEASUREMENT
 /begin REF_CHARACTERISTIC SysModuleReset_C /end REF_CHARACTERISTIC
/end FUNCTION
/begin FUNCTION V2G "Group /ByModelHeirarchy/LaforgeTestApp_CCU/Core0-TestApp/V2G"
 /begin SUB_FUNCTION BatteryModel CtlEcu DigitalDebounce1 DigitalDebounce2 DigitalDebounce3 DigitalDebounce4 EVSE_OutInterface InpDigital1 OE_CCS SystemInfo /end SUB_FUNCTION
 /begin LOC_MEASUREMENT HostAllChargeRelaysClosed HostChargeInletLockStatus /end LOC_MEASUREMENT
 /begin REF_CHARACTERISTIC HostAllChargeRelaysClosedDelay0 HostBptModePriority_C HostChargeEmergStop_C HostChargeInletLockStatusDelay0 HostChargeNormalStop_C HostChgPortCrntAcEn_C HostChgPortCrntAc_C HostChgPortCrntDcValid_C HostChgPortCrntDc_C HostChgPortVoltAcEn_C HostChgPortVoltAc_C HostChgPortVoltDcValid_C HostChgPortVoltDc_C HostChgRlyWeldCheckDoneDelay_C HostDepartureTime_C HostDesiredEgyTransferMode_C HostDinProtocolEnable_C HostDinProtocolPriority_C HostDynamicModePriority_C HostEvCrntMaxLim_C HostEvCrntMinLim_C HostEvDchgCrntMaxLim_C HostEvDchgCrntMinLim_C HostEvDchgPwrMaxLim_C HostEvDchgPwrMinLim_C HostEvEgyCapacity_C HostEvEgyMax_C HostEvEgyMin_C HostEvEgyReqAmount_C HostEvIsolCheckDisabledDelay_C HostEvPwrMaxLim_C HostEvPwrMinLim_C HostEvTargetCrnt_C HostEvTargetVolt_C HostEvVoltMaxLim_C HostEvVoltMinLim_C HostIgnoreIsolWarning_C HostIso1ProtocolEnable_C HostIso1ProtocolPriority_C HostIso2ProtocolEnable_C HostIso2ProtocolPriority_C HostRelayWeldCheckEn_C HostRemainTimeToBulkSoc_C HostRemainTimeToFullSoc_C HostRessBulkSoc_C HostRessFullSoc_C /end REF_CHARACTERISTIC
/end FUNCTION
/begin FUNCTION WakeSleepMgmt "Group /ByModelHeirarchy/LaforgeTestApp_CCU/Core0-TestApp/WakeSleepMgmt"
 /begin LOC_MEASUREMENT AnyECUWakeSignal CmdCANAWAKE EcuRunning NotEcuRunning NotShutdownFromLowBatt ShutdownCmd ShutdownDelayed ShutdownFromLowBatt /end LOC_MEASUREMENT
 /begin REF_CHARACTERISTIC dotc_DsblPowerHold dotc_Enbl_OverrideCanawake dotc_Enbl_OverrideDsblPwrHld dotc_Enbl_OverrideShutdown dotc_Enbl_OverrideTlt9255 dotc_PowerHold dotc_ShutdownSignal dotc_p00_6_canawake dotc_tlt9255_SleepRequest genc_IgnitionEnableThreshold genc_ShutdownDelay genc_VBatShutdownThreshold /end REF_CHARACTERISTIC
/end FUNCTION
/begin FUNCTION ECU_Registers "Group /ByModelHeirarchy/LaforgeTestApp_CCU/Core0-TestApp/config_and_status/ECU_Registers"
 /begin LOC_MEASUREMENT PregEcuDateOfManufactureAvaila0 PregEcuDateOfManufactureDay PregEcuDateOfManufactureMonth PregEcuDateOfManufactureShift PregEcuDateOfManufactureYear PregEcuEngineeringPartNumberAv0 PregEcuEngineeringPartNumberID PregEcuEngineeringPartNumberPa0 PregEcuEngineeringPartNumberPr0 PregEcuFactoryBuildTypeA PregEcuFactoryBuildTypeAvailab0 PregEcuFactoryBuildTypeB PregEcuFactoryIdA PregEcuFactoryIdB PregEcuFactoryPartA PregEcuFactoryPartB PregEcuFactoryPartNumAvailable PregEcuLowerWordSerialNumber PregEcuLowerWordSerialNumberAv0 PregEcuPcbIssue PregEcuPcbIssueAvailable PregEcuPcbMod PregEcuSerialNumberInfoAvailab0 PregEcuSerialNumberInfoFirstKey PregEcuSerialNumberInfoLength PregEcuUpperWordSerialAvailable PregEcuUpperWordSerialNumber /end LOC_MEASUREMENT
/end FUNCTION
/begin FUNCTION CPU_Status "Group /ByModelHeirarchy/LaforgeTestApp_CCU/Core0-TestApp/config_and_status/ECU_Status/CPU_Status"
 /begin LOC_MEASUREMENT ccu_cpu_loading ccu_cpu_loading_max ccu_stack_used ccu_task_duration_1s ccu_task_duration_1s_max /end LOC_MEASUREMENT
/end FUNCTION
/begin FUNCTION ECU_Status "Group /ByModelHeirarchy/LaforgeTestApp_CCU/Core0-TestApp/config_and_status/ECU_Status" /begin SUB_FUNCTION CPU_Status /end SUB_FUNCTION /begin LOC_MEASUREMENT CANBusStatus /end LOC_MEASUREMENT /end FUNCTION
/begin FUNCTION config_and_status "Group /ByModelHeirarchy/LaforgeTestApp_CCU/Core0-TestApp/config_and_status" /begin SUB_FUNCTION ECU_Registers ECU_Status /end SUB_FUNCTION /end FUNCTION
/begin FUNCTION Core0_TestApp "Group /ByModelHeirarchy/LaforgeTestApp_CCU/Core0-TestApp"
 /begin SUB_FUNCTION Analog_Inputs CAN_bus_loader CAN_FD_Msgs Charge_Pilot Digital_Inputs Digital_Outputs HBridge_Outputs PSU_Control V2G WakeSleepMgmt config_and_status /end SUB_FUNCTION
/end FUNCTION
/begin FUNCTION LaforgeTestApp_CCU "Group /ByModelHeirarchy/LaforgeTestApp_CCU" /begin SUB_FUNCTION Core0_TestApp /end SUB_FUNCTION /end FUNCTION
/begin FUNCTION ByModelHeirarchy "Group /ByModelHeirarchy" /begin SUB_FUNCTION LaforgeTestApp_CCU /end SUB_FUNCTION /end FUNCTION
/begin FUNCTION Arrays "Group /ByType/Arrays"
 /begin REF_CHARACTERISTIC CANFDData_C CANLoadBytes_V CcsOprChgProfileEntryDuration_0 CcsOprChgProfileEntryMaxPwr_CA CcsOprChgProfileEntryStrt_CA SimRessProfileSoc_Ax SimRessProfileVolt_Ay TLF35584RqstCmd_C TLF35584UserData_C V2gRxSigEvseIdOv_C V2gTxSupSvcIdsOv_C /end REF_CHARACTERISTIC
/end FUNCTION
/begin FUNCTION Automatic "Group /ByType/Automatic"
 /begin LOC_MEASUREMENT mpl_app_build_day mpl_app_build_hour mpl_app_build_min mpl_app_build_month mpl_app_build_sec mpl_app_build_year mpl_app_ver_major mpl_app_ver_minor mpl_app_ver_sub mpl_boot_build_day mpl_boot_build_month mpl_boot_build_year mpl_boot_part_num_group mpl_boot_part_num_id mpl_boot_part_num_issue mpl_boot_part_num_letter mpl_boot_ver_major mpl_boot_ver_minor mpl_boot_ver_sub mpl_bspi_task.stack.isr.status mpl_bspi_task.stack.isr.used mpl_bspi_task.stack.task.status mpl_bspi_task.stack.task.used mpl_bspi_task.timing.max_task_0 /end LOC_MEASUREMENT
 /begin REF_CHARACTERISTIC isoc_emissions_report_min_sev isoc_override_service_03 isoc_override_service_07 isoc_override_service_0a isoc_uds_dtc_format_id mpls_app_build_time mpls_app_copyright mpls_app_description mpls_app_name mpls_app_version mpls_plat_build_time mpls_plat_copyright mpls_plat_target mpls_plat_version pj1939c_node_addr_0 /end REF_CHARACTERISTIC
/end FUNCTION
/end MODULE
/end PROJECT
