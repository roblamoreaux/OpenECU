ASAP2_VERSION 1 31
/begin PROJECT LaForge_CCU_TestApp "Test Application for LaForge TC367"
/begin HEADER "Dana" VERSION "0_3_1" /end HEADER
/begin MODULE OpenECU_TC367_001 ""
/* Scalar measurable for DDE 'CcsFltCpWrd'. */
/begin MEASUREMENT CcsFltCpWrd "Fault word that contains all confirmed fault flags defined for Control PilotDutycycle" UBYTE CU_CCSFLTCPWRD 1 100 0.0 255.0 ECU_ADDRESS 0x700184bd BYTE_ORDER MSB_LAST /end MEASUREMENT
/begin COMPU_METHOD CU_CCSFLTCPWRD "Conversion method for CcsFltCpWrd" RAT_FUNC "%10.0" "1" COEFFS 0.000000 1.000000 -0.000000 0.000000 0.000000 1.000000 /end COMPU_METHOD
/* Scalar measurable for DDE 'CcsFltEvseSupPrtclWrd'. */
/begin MEASUREMENT CcsFltEvseSupPrtclWrd "Fault word that contains all confirmed fault flags defined for V2G received signal EVSE Supported Protocol" UBYTE CU_CCSFLTEVSESUPPRTCLWRD 1 100 0.0 255.0 ECU_ADDRESS 0x70017fa9 BYTE_ORDER MSB_LAST /end MEASUREMENT
/begin COMPU_METHOD CU_CCSFLTEVSESUPPRTCLWRD "Conversion method for CcsFltEvseSupPrtclWrd" RAT_FUNC "%10.0" "1" COEFFS 0.000000 1.000000 -0.000000 0.000000 0.000000 1.000000 /end COMPU_METHOD
/* Scalar measurable for DDE 'CcsFltInternalFaultsWrd'. */
/begin MEASUREMENT CcsFltInternalFaultsWrd "Fault word that contains all confirmed fault flags defined for Internal faults" UBYTE CU_CCSFLTINTERNALFAULTSWRD 1 100 0.0 255.0 ECU_ADDRESS 0x70018428 BYTE_ORDER MSB_LAST /end MEASUREMENT
/begin COMPU_METHOD CU_CCSFLTINTERNALFAULTSWRD "Conversion method for CcsFltInternalFaultsWrd" RAT_FUNC "%10.0" "1" COEFFS 0.000000 1.000000 -0.000000 0.000000 0.000000 1.000000 /end COMPU_METHOD
/* Scalar measurable for DDE 'CcsFltLinkWrd'. */
/begin MEASUREMENT CcsFltLinkWrd "Fault word that contains all confirmed fault flags defined for V2G Communication Link" UBYTE CU_CCSFLTLINKWRD 1 100 0.0 255.0 ECU_ADDRESS 0x70017ef5 BYTE_ORDER MSB_LAST /end MEASUREMENT
/begin COMPU_METHOD CU_CCSFLTLINKWRD "Conversion method for CcsFltLinkWrd" RAT_FUNC "%10.0" "1" COEFFS 0.000000 1.000000 -0.000000 0.000000 0.000000 1.000000 /end COMPU_METHOD
/* Scalar measurable for DDE 'CcsFltPpWrd'. */
/begin MEASUREMENT CcsFltPpWrd "Fault word that contains all confirmed fault flags defined for Proximity Pilot Voltage" UBYTE CU_CCSFLTPPWRD 1 100 0.0 255.0 ECU_ADDRESS 0x7001836d BYTE_ORDER MSB_LAST /end MEASUREMENT
/begin COMPU_METHOD CU_CCSFLTPPWRD "Conversion method for CcsFltPpWrd" RAT_FUNC "%10.0" "1" COEFFS 0.000000 1.000000 -0.000000 0.000000 0.000000 1.000000 /end COMPU_METHOD
/* Scalar measurable for DDE 'CcsFltRxEgyTrnsTypeWrd'. */
/begin MEASUREMENT CcsFltRxEgyTrnsTypeWrd "Fault word that contains all confirmed fault flags defined for V2G received signal Energy Transfer Type" UBYTE CU_CCSFLTRXEGYTRNSTYPEWRD 1 100 0.0 255.0 ECU_ADDRESS 0x70017e6a BYTE_ORDER MSB_LAST /end MEASUREMENT
/begin COMPU_METHOD CU_CCSFLTRXEGYTRNSTYPEWRD "Conversion method for CcsFltRxEgyTrnsTypeWrd" RAT_FUNC "%10.0" "1" COEFFS 0.000000 1.000000 -0.000000 0.000000 0.000000 1.000000 /end COMPU_METHOD
/* Scalar measurable for DDE 'CcsFltRxEvVoltWrd'. */
/begin MEASUREMENT CcsFltRxEvVoltWrd "Fault word that contains all confirmed fault flags defined for Host EV Voltage" UBYTE CU_CCSFLTRXEVVOLTWRD 1 100 0.0 255.0 ECU_ADDRESS 0x700182b4 BYTE_ORDER MSB_LAST /end MEASUREMENT
/begin COMPU_METHOD CU_CCSFLTRXEVVOLTWRD "Conversion method for CcsFltRxEvVoltWrd" RAT_FUNC "%10.0" "1" COEFFS 0.000000 1.000000 -0.000000 0.000000 0.000000 1.000000 /end COMPU_METHOD
/* Scalar measurable for DDE 'CcsFltRxEvseCrntWrd'. */
/begin MEASUREMENT CcsFltRxEvseCrntWrd "Fault word that contains all confirmed fault flags defined for V2G EVSE Current" UBYTE CU_CCSFLTRXEVSECRNTWRD 1 100 0.0 255.0 ECU_ADDRESS 0x70017dbb BYTE_ORDER MSB_LAST /end MEASUREMENT
/begin COMPU_METHOD CU_CCSFLTRXEVSECRNTWRD "Conversion method for CcsFltRxEvseCrntWrd" RAT_FUNC "%10.0" "1" COEFFS 0.000000 1.000000 -0.000000 0.000000 0.000000 1.000000 /end COMPU_METHOD
/* Scalar measurable for DDE 'CcsFltRxEvseIsolStWrd'. */
/begin MEASUREMENT CcsFltRxEvseIsolStWrd "Fault word that contains all confirmed fault flags defined for V2G received signal EVSE Isolation Status" UBYTE CU_CCSFLTRXEVSEISOLSTWRD 1 100 0.0 255.0 ECU_ADDRESS 0x70018200 BYTE_ORDER MSB_LAST /end MEASUREMENT
/begin COMPU_METHOD CU_CCSFLTRXEVSEISOLSTWRD "Conversion method for CcsFltRxEvseIsolStWrd" RAT_FUNC "%10.0" "1" COEFFS 0.000000 1.000000 -0.000000 0.000000 0.000000 1.000000 /end COMPU_METHOD
/* Scalar measurable for DDE 'CcsFltRxEvseProcStWrd'. */
/begin MEASUREMENT CcsFltRxEvseProcStWrd "Fault word that contains all confirmed fault flags defined for V2G received signal EVSE Processing Status" UBYTE CU_CCSFLTRXEVSEPROCSTWRD 1 100 0.0 255.0 ECU_ADDRESS 0x70017d1c BYTE_ORDER MSB_LAST /end MEASUREMENT
/begin COMPU_METHOD CU_CCSFLTRXEVSEPROCSTWRD "Conversion method for CcsFltRxEvseProcStWrd" RAT_FUNC "%10.0" "1" COEFFS 0.000000 1.000000 -0.000000 0.000000 0.000000 1.000000 /end COMPU_METHOD
/* Scalar measurable for DDE 'CcsFltRxEvsePwrWrd'. */
/begin MEASUREMENT CcsFltRxEvsePwrWrd "Fault word that contains all confirmed fault flags related to EVSE Power" UBYTE CU_CCSFLTRXEVSEPWRWRD 1 100 0.0 255.0 ECU_ADDRESS 0x70018172 BYTE_ORDER MSB_LAST /end MEASUREMENT
/begin COMPU_METHOD CU_CCSFLTRXEVSEPWRWRD "Conversion method for CcsFltRxEvsePwrWrd" RAT_FUNC "%10.0" "1" COEFFS 0.000000 1.000000 -0.000000 0.000000 0.000000 1.000000 /end COMPU_METHOD
/* Scalar measurable for DDE 'CcsFltRxEvseStCodeWrd'. */
/begin MEASUREMENT CcsFltRxEvseStCodeWrd "Fault word that contains all confirmed fault flags defined for V2G received signal EVSE Status Code" UBYTE CU_CCSFLTRXEVSESTCODEWRD 1 100 0.0 255.0 ECU_ADDRESS 0x70017c47 BYTE_ORDER MSB_LAST /end MEASUREMENT
/begin COMPU_METHOD CU_CCSFLTRXEVSESTCODEWRD "Conversion method for CcsFltRxEvseStCodeWrd" RAT_FUNC "%10.0" "1" COEFFS 0.000000 1.000000 -0.000000 0.000000 0.000000 1.000000 /end COMPU_METHOD
/* Scalar measurable for DDE 'CcsFltRxEvseVoltWrd'. */
/begin MEASUREMENT CcsFltRxEvseVoltWrd "Fault word that contains all confirmed fault flags defined for V2G EVSE Voltage" UBYTE CU_CCSFLTRXEVSEVOLTWRD 1 100 0.0 255.0 ECU_ADDRESS 0x7001800b BYTE_ORDER MSB_LAST /end MEASUREMENT
/begin COMPU_METHOD CU_CCSFLTRXEVSEVOLTWRD "Conversion method for CcsFltRxEvseVoltWrd" RAT_FUNC "%10.0" "1" COEFFS 0.000000 1.000000 -0.000000 0.000000 0.000000 1.000000 /end COMPU_METHOD
/* Scalar measurable for DDE 'CcsFltSeqWrd'. */
/begin MEASUREMENT CcsFltSeqWrd "Fault word that contains all confirmed fault flags defined for V2G Performance (Sequence) Timeout Precharge" UBYTE CU_CCSFLTSEQWRD 1 100 0.0 255.0 ECU_ADDRESS 0x70018472 BYTE_ORDER MSB_LAST /end MEASUREMENT
/begin COMPU_METHOD CU_CCSFLTSEQWRD "Conversion method for CcsFltSeqWrd" RAT_FUNC "%10.0" "1" COEFFS 0.000000 1.000000 -0.000000 0.000000 0.000000 1.000000 /end COMPU_METHOD
/* Scalar measurable for DDE 'CcsFltStopFltResponse'. */
/begin MEASUREMENT CcsFltStopFltResponse "Identifies the the state machine fault reaction" SLONG CU_CCSFLTSTOPFLTRESPONSE 1 100 -2147483648.0 2147483647.0 ECU_ADDRESS 0x70017f68 BYTE_ORDER MSB_LAST /end MEASUREMENT
/begin COMPU_METHOD CU_CCSFLTSTOPFLTRESPONSE "Conversion method for CcsFltStopFltResponse" TAB_VERB "%12.0" "enum" COMPU_TAB_REF CT_CCSFLTSTOPFLTRESPONSE /end COMPU_METHOD
/begin COMPU_VTAB CT_CCSFLTSTOPFLTRESPONSE "Conversion method for CcsFltStopFltResponse" TAB_VERB 4 0 "NO_FAULT_CONTINUE" 1 "NO_FAULT_NORMAL_STOP" 2 "FAULT_NONCRITICAL_STOP" 3 "FAULT_EMERGENCY_STOP" /end COMPU_VTAB
/* Scalar measurable for DDE 'CcsFltV2gMsgWrd'. */
/begin MEASUREMENT CcsFltV2gMsgWrd "Fault word that contains all confirmed fault flags defined for V2G Response message Timeout" UBYTE CU_CCSFLTV2GMSGWRD 1 100 0.0 255.0 ECU_ADDRESS 0x700183ac BYTE_ORDER MSB_LAST /end MEASUREMENT
/begin COMPU_METHOD CU_CCSFLTV2GMSGWRD "Conversion method for CcsFltV2gMsgWrd" RAT_FUNC "%10.0" "1" COEFFS 0.000000 1.000000 -0.000000 0.000000 0.000000 1.000000 /end COMPU_METHOD
/* Scalar measurable for DDE 'CcsIprAcdAvlbMaxAcChgCrnt'. */
/begin MEASUREMENT CcsIprAcdAvlbMaxAcChgCrnt "The final calculated maximum available AC current from PWM dutycycle of EVSE Pilot signal (based on SAE J1772) and Charging state-machine and proximity signal state" FLOAT32_IEEE CU_CCSIPRACDAVLBMAXACCHGCRNT 1 100 0.0 200.0 ECU_ADDRESS 0x70017eb8 BYTE_ORDER MSB_LAST /end MEASUREMENT
/begin COMPU_METHOD CU_CCSIPRACDAVLBMAXACCHGCRNT "Conversion method for CcsIprAcdAvlbMaxAcChgCrnt" RAT_FUNC "%10.0" "A" COEFFS 0.000000 1.000000 -0.000000 0.000000 0.000000 1.000000 /end COMPU_METHOD
/* Scalar measurable for DDE 'CcsIprAcdAvlbMaxAcChgCrntPwm'. */
/begin MEASUREMENT CcsIprAcdAvlbMaxAcChgCrntPwm "The calculated maximum available AC current from PWM dutycycle of EVSE Pilot signal (based on SAE J1772)" FLOAT32_IEEE CU_CCSIPRACDAVLBMAXACCHGCRNTPWM 1 100 0.0 200.0 ECU_ADDRESS 0x70018318 BYTE_ORDER MSB_LAST /end MEASUREMENT
/begin COMPU_METHOD CU_CCSIPRACDAVLBMAXACCHGCRNTPWM "Conversion method for CcsIprAcdAvlbMaxAcChgCrntPwm" RAT_FUNC "%10.0" "A" COEFFS 0.000000 1.000000 -0.000000 0.000000 0.000000 1.000000 /end COMPU_METHOD
/* Scalar measurable for DDE 'CcsIprChgPortCrntDc'. */
/begin MEASUREMENT CcsIprChgPortCrntDc "Interpreted value of charging DC current at the charge inlet port" FLOAT32_IEEE CU_CCSIPRCHGPORTCRNTDC 1 100 0.0 196605.0 ECU_ADDRESS 0x70017e1c BYTE_ORDER MSB_LAST /end MEASUREMENT
/begin COMPU_METHOD CU_CCSIPRCHGPORTCRNTDC "Conversion method for CcsIprChgPortCrntDc" RAT_FUNC "%10.0" "A" COEFFS 0.000000 1.000000 -0.000000 0.000000 0.000000 1.000000 /end COMPU_METHOD
/* Scalar measurable for DDE 'CcsIprChgPortVoltDc'. */
/begin MEASUREMENT CcsIprChgPortVoltDc "Interpreted value of charging DC voltage at the charge inlet port" FLOAT32_IEEE CU_CCSIPRCHGPORTVOLTDC 1 100 0.0 196605.0 ECU_ADDRESS 0x70018270 BYTE_ORDER MSB_LAST /end MEASUREMENT
/begin COMPU_METHOD CU_CCSIPRCHGPORTVOLTDC "Conversion method for CcsIprChgPortVoltDc" RAT_FUNC "%10.0" "V" COEFFS 0.000000 1.000000 -0.000000 0.000000 0.000000 1.000000 /end COMPU_METHOD
/* Scalar measurable for DDE 'CcsIprCpChargingMode'. */
/begin MEASUREMENT CcsIprCpChargingMode "The determined enumerated charging mode based on dutycycle of pilot signal" SLONG CU_CCSIPRCPCHARGINGMODE 1 100 -2147483648.0 2147483647.0 ECU_ADDRESS 0x70017d80 BYTE_ORDER MSB_LAST /end MEASUREMENT
/begin COMPU_METHOD CU_CCSIPRCPCHARGINGMODE "Conversion method for CcsIprCpChargingMode" TAB_VERB "%12.0" "enum" COMPU_TAB_REF CT_CCSIPRCPCHARGINGMODE /end COMPU_METHOD
/begin COMPU_VTAB CT_CCSIPRCPCHARGINGMODE "Conversion method for CcsIprCpChargingMode" TAB_VERB 4 0 "CHARGINGMODE_UNKNOWN" 1 "CHARGINGMODE_DC" 2 "CHARGINGMODE_AC" 3 "CHARGINGMODE_ERROR" /end COMPU_VTAB
/* Scalar measurable for DDE 'CcsIprCpDutcycAc'. */
/begin MEASUREMENT CcsIprCpDutcycAc "Indicator that the EVSE Pilot signal has a dutycycle in valid range for AC charging" UBYTE CU_CCSIPRCPDUTCYCAC 1 100 0.0 1.0 ECU_ADDRESS 0x700181af BYTE_ORDER MSB_LAST /end MEASUREMENT
/begin COMPU_METHOD CU_CCSIPRCPDUTCYCAC "Conversion method for CcsIprCpDutcycAc" RAT_FUNC "%10.0" "b" COEFFS 0.000000 1.000000 -0.000000 0.000000 0.000000 1.000000 /end COMPU_METHOD
/* Scalar measurable for DDE 'CcsIprCpDutcycPct5'. */
/begin MEASUREMENT CcsIprCpDutcycPct5 "Indicator that the EVSE Pilot signal has dutycycle of 5% which is for digital communication over PLC" UBYTE CU_CCSIPRCPDUTCYCPCT5 1 100 0.0 1.0 ECU_ADDRESS 0x70017c8e BYTE_ORDER MSB_LAST /end MEASUREMENT
/begin COMPU_METHOD CU_CCSIPRCPDUTCYCPCT5 "Conversion method for CcsIprCpDutcycPct5" RAT_FUNC "%10.0" "b" COEFFS 0.000000 1.000000 -0.000000 0.000000 0.000000 1.000000 /end COMPU_METHOD
/* Scalar measurable for DDE 'CcsIprCpDutcycRangeAc'. */
/begin MEASUREMENT CcsIprCpDutcycRangeAc "Indicator that the EVSE Pilot signal has dutycycle of the range for AC charging" UBYTE CU_CCSIPRCPDUTCYCRANGEAC 1 100 0.0 1.0 ECU_ADDRESS 0x700180e3 BYTE_ORDER MSB_LAST /end MEASUREMENT
/begin COMPU_METHOD CU_CCSIPRCPDUTCYCRANGEAC "Conversion method for CcsIprCpDutcycRangeAc" RAT_FUNC "%10.0" "b" COEFFS 0.000000 1.000000 -0.000000 0.000000 0.000000 1.000000 /end COMPU_METHOD
/* Scalar measurable for DDE 'CcsIprCpDutyPct5InRange'. */
/begin MEASUREMENT CcsIprCpDutyPct5InRange "Indicator that the EVSE Pilot signal has dutycycle of 5% which is for digital communication over PLC" UBYTE CU_CCSIPRCPDUTYPCT5INRANGE 1 100 0.0 1.0 ECU_ADDRESS 0x700184be BYTE_ORDER MSB_LAST /end MEASUREMENT
/begin COMPU_METHOD CU_CCSIPRCPDUTYPCT5INRANGE "Conversion method for CcsIprCpDutyPct5InRange" RAT_FUNC "%10.0" "b" COEFFS 0.000000 1.000000 -0.000000 0.000000 0.000000 1.000000 /end COMPU_METHOD
/* Scalar measurable for DDE 'CcsIprCpOscillatorOff'. */
/begin MEASUREMENT CcsIprCpOscillatorOff "Indicator that the Oscillator is off on the pilot signal" UBYTE CU_CCSIPRCPOSCILLATOROFF 1 100 0.0 1.0 ECU_ADDRESS 0x70017faa BYTE_ORDER MSB_LAST /end MEASUREMENT
/begin COMPU_METHOD CU_CCSIPRCPOSCILLATOROFF "Conversion method for CcsIprCpOscillatorOff" RAT_FUNC "%10.0" "b" COEFFS 0.000000 1.000000 -0.000000 0.000000 0.000000 1.000000 /end COMPU_METHOD
/* Scalar measurable for DDE 'CcsIprCpSt'. */
/begin MEASUREMENT CcsIprCpSt "Enumerated state of Control Piliot signal from charging interface" SLONG CU_CCSIPRCPST 1 100 -2147483648.0 2147483647.0 ECU_ADDRESS 0x7001842c BYTE_ORDER MSB_LAST /end MEASUREMENT
/begin COMPU_METHOD CU_CCSIPRCPST "Conversion method for CcsIprCpSt" TAB_VERB "%12.0" "enum" COMPU_TAB_REF CT_CCSIPRCPST /end COMPU_METHOD
/begin COMPU_VTAB CT_CCSIPRCPST "Conversion method for CcsIprCpSt" TAB_VERB 10 0 "PILOT_ST_UNKNOWN" 1 "PILOT_ST_A_0V_DISCONNECTED" 2 "PILOT_ST_B1_9V_OSCILTR_OFF" 3 "PILOT_ST_B2_9V_OSCILTR_ON" 4 "PILOT_ST_C2_6V_OSCILTR_ON" 5 "PILOT_ST_D2_3V_OSCILTR_ON" 6 "PILOT_ST_C1_6V_OSCILTR_OFF" 7 "PILOT_ST_D1_3V_OSCILTR_OFF" 8 "PILOT_ST_E_0V" 9 "PILOT_ST_F_m12V_OSCILTR_OFF" /end COMPU_VTAB
/* Scalar measurable for DDE 'CcsIprDcChgCrntNearZero'. */
/begin MEASUREMENT CcsIprDcChgCrntNearZero "True indicates that the charge current is close to zero (used for Relay weld checking after Charging)" UBYTE CU_CCSIPRDCCHGCRNTNEARZERO 1 100 0.0 1.0 ECU_ADDRESS 0x70017ef6 BYTE_ORDER MSB_LAST /end MEASUREMENT
/begin COMPU_METHOD CU_CCSIPRDCCHGCRNTNEARZERO "Conversion method for CcsIprDcChgCrntNearZero" RAT_FUNC "%10.0" "b" COEFFS 0.000000 1.000000 -0.000000 0.000000 0.000000 1.000000 /end COMPU_METHOD
/* Scalar measurable for DDE 'CcsIprDcChgInletCrntSafe'. */
/begin MEASUREMENT CcsIprDcChgInletCrntSafe "Indicator that the current at charge inlet is low and is in a safe level" UBYTE CU_CCSIPRDCCHGINLETCRNTSAFE 1 100 0.0 1.0 ECU_ADDRESS 0x7001836e BYTE_ORDER MSB_LAST /end MEASUREMENT
/begin COMPU_METHOD CU_CCSIPRDCCHGINLETCRNTSAFE "Conversion method for CcsIprDcChgInletCrntSafe" RAT_FUNC "%10.0" "b" COEFFS 0.000000 1.000000 -0.000000 0.000000 0.000000 1.000000 /end COMPU_METHOD
/* Scalar measurable for DDE 'CcsIprDcChgInletVoltSafe'. */
/begin MEASUREMENT CcsIprDcChgInletVoltSafe "Indicator that the volt at charge inlet is low and is in a safe level" UBYTE CU_CCSIPRDCCHGINLETVOLTSAFE 1 100 0.0 1.0 ECU_ADDRESS 0x70017e6b BYTE_ORDER MSB_LAST /end MEASUREMENT
/begin COMPU_METHOD CU_CCSIPRDCCHGINLETVOLTSAFE "Conversion method for CcsIprDcChgInletVoltSafe" RAT_FUNC "%10.0" "b" COEFFS 0.000000 1.000000 -0.000000 0.000000 0.000000 1.000000 /end COMPU_METHOD
/* Scalar measurable for DDE 'CcsIprDcPrechgComplete'. */
/begin MEASUREMENT CcsIprDcPrechgComplete "True indicates the precharge is done and RESS voltage is almost equal to Charge Inlet volt" UBYTE CU_CCSIPRDCPRECHGCOMPLETE 1 100 0.0 1.0 ECU_ADDRESS 0x700182b5 BYTE_ORDER MSB_LAST /end MEASUREMENT
/begin COMPU_METHOD CU_CCSIPRDCPRECHGCOMPLETE "Conversion method for CcsIprDcPrechgComplete" RAT_FUNC "%10.0" "b" COEFFS 0.000000 1.000000 -0.000000 0.000000 0.000000 1.000000 /end COMPU_METHOD
/* Scalar measurable for DDE 'CcsIprDisSchIdx'. */
/begin MEASUREMENT CcsIprDisSchIdx "Index value of the curently active discharging schedule segment" SBYTE CU_CCSIPRDISSCHIDX 1 100 -1.0 127.0 ECU_ADDRESS 0x70017dbc BYTE_ORDER MSB_LAST /end MEASUREMENT
/begin COMPU_METHOD CU_CCSIPRDISSCHIDX "Conversion method for CcsIprDisSchIdx" RAT_FUNC "%10.0" "NA" COEFFS 0.000000 1.000000 -0.000000 0.000000 0.000000 1.000000 /end COMPU_METHOD
/* Scalar measurable for DDE 'CcsIprDisSchMaxIdx'. */
/begin MEASUREMENT CcsIprDisSchMaxIdx "Maximum valid index of the current discharging schedule. -1 indicates the charging schedule is not valid." SBYTE CU_CCSIPRDISSCHMAXIDX 1 100 -1.0 127.0 ECU_ADDRESS 0x70018201 BYTE_ORDER MSB_LAST /end MEASUREMENT
/begin COMPU_METHOD CU_CCSIPRDISSCHMAXIDX "Conversion method for CcsIprDisSchMaxIdx" RAT_FUNC "%10.0" "NA" COEFFS 0.000000 1.000000 -0.000000 0.000000 0.000000 1.000000 /end COMPU_METHOD
/* Scalar measurable for DDE 'CcsIprDisSchPmaxClipped'. */
/begin MEASUREMENT CcsIprDisSchPmaxClipped "Indicates that the discharge schedule is presently imposing a Pmax clip on the system" UBYTE CU_CCSIPRDISSCHPMAXCLIPPED 1 100 0.0 1.0 ECU_ADDRESS 0x70017d1d BYTE_ORDER MSB_LAST /end MEASUREMENT
/begin COMPU_METHOD CU_CCSIPRDISSCHPMAXCLIPPED "Conversion method for CcsIprDisSchPmaxClipped" RAT_FUNC "%10.0" "b" COEFFS 0.000000 1.000000 -0.000000 0.000000 0.000000 1.000000 /end COMPU_METHOD
/* Scalar measurable for DDE 'CcsIprDisSchTimer'. */
/begin MEASUREMENT CcsIprDisSchTimer "Discharge schedule timer value" ULONG CU_CCSIPRDISSCHTIMER 1 100 0.0 4294967295.0 ECU_ADDRESS 0x70018174 BYTE_ORDER MSB_LAST /end MEASUREMENT
/begin COMPU_METHOD CU_CCSIPRDISSCHTIMER "Conversion method for CcsIprDisSchTimer" RAT_FUNC "%10.0" "NA" COEFFS 0.000000 1.000000 -0.000000 0.000000 0.000000 1.000000 /end COMPU_METHOD
/* Scalar measurable for DDE 'CcsIprPpPos'. */
/begin MEASUREMENT CcsIprPpPos "Displayable for monitoring  processed EVSE PP signal position" UBYTE CU_CCSIPRPPPOS 1 100 0.0 2.0 ECU_ADDRESS 0x70017c48 BYTE_ORDER MSB_LAST /end MEASUREMENT
/begin COMPU_METHOD CU_CCSIPRPPPOS "Conversion method for CcsIprPpPos" RAT_FUNC "%10.0" "1" COEFFS 0.000000 1.000000 -0.000000 0.000000 0.000000 1.000000 /end COMPU_METHOD
/* Scalar measurable for DDE 'CcsIprPpSt'. */
/begin MEASUREMENT CcsIprPpSt "Enumerated State of Proximity Signal according to SAE J1772" SLONG CU_CCSIPRPPST 1 100 -2147483648.0 2147483647.0 ECU_ADDRESS 0x7001800c BYTE_ORDER MSB_LAST /end MEASUREMENT
/begin COMPU_METHOD CU_CCSIPRPPST "Conversion method for CcsIprPpSt" TAB_VERB "%12.0" "enum" COMPU_TAB_REF CT_CCSIPRPPST /end COMPU_METHOD
/begin COMPU_VTAB CT_CCSIPRPPST "Conversion method for CcsIprPpSt" TAB_VERB 4 0 "PROX_DISCONNECTED" 1 "PROX_CONNECTED_S3_OPEN" 2 "PROX_CONNECTED_S3_CLOSE" 3 "PROX_INVALID" /end COMPU_VTAB
/* Scalar measurable for DDE 'CcsIprPrtEvseCouplerPluggedIn'. */
/begin MEASUREMENT CcsIprPrtEvseCouplerPluggedIn "True indicates the EVSE charge coupler is plugged in to the vehcile charge inlet" UBYTE CU_CCSIPRPRTEVSECOUPLERPLUGGED0 1 100 0.0 1.0 ECU_ADDRESS 0x70018473 BYTE_ORDER MSB_LAST /end MEASUREMENT
/begin COMPU_METHOD CU_CCSIPRPRTEVSECOUPLERPLUGGED0 "Conversion method for CcsIprPrtEvseCouplerPluggedIn" RAT_FUNC "%10.0" "b" COEFFS 0.000000 1.000000 -0.000000 0.000000 0.000000 1.000000 /end COMPU_METHOD
/* Scalar measurable for DDE 'CcsIprPrtHvPresent'. */
/begin MEASUREMENT CcsIprPrtHvPresent "True indicates a voltage is present at the charge inlet either on the core pins (AC or DC) or on extended pins (DC only)" UBYTE CU_CCSIPRPRTHVPRESENT 1 100 0.0 1.0 ECU_ADDRESS 0x70017f6c BYTE_ORDER MSB_LAST /end MEASUREMENT
/begin COMPU_METHOD CU_CCSIPRPRTHVPRESENT "Conversion method for CcsIprPrtHvPresent" RAT_FUNC "%10.0" "b" COEFFS 0.000000 1.000000 -0.000000 0.000000 0.000000 1.000000 /end COMPU_METHOD
/* Scalar measurable for DDE 'CcsIprPrtVehChargingPortSt'. */
/begin MEASUREMENT CcsIprPrtVehChargingPortSt "Enumerated state of Charging Inlet to be transmitted as a CAN signal to the vehicle controllers" SLONG CU_CCSIPRPRTVEHCHARGINGPORTST 1 100 -2147483648.0 2147483647.0 ECU_ADDRESS 0x700183b0 BYTE_ORDER MSB_LAST /end MEASUREMENT
/begin COMPU_METHOD CU_CCSIPRPRTVEHCHARGINGPORTST "Conversion method for CcsIprPrtVehChargingPortSt" TAB_VERB "%12.0" "enum" COMPU_TAB_REF CT_CCSIPRPRTVEHCHARGINGPORTST /end COMPU_METHOD
/begin COMPU_VTAB CT_CCSIPRPRTVEHCHARGINGPORTST "Conversion method for CcsIprPrtVehChargingPortSt" TAB_VERB 4 0 "CHARGER_UNPLUGGED" 1 "CHARGER_PLUGGED_HV_ABSENT" 2 "CHARGER_PLUGGED_HV_PRESENT" 3 "CHARGER_PORT_UNKNOWN" /end COMPU_VTAB
/* Scalar measurable for DDE 'CcsIprPrxDischargePmax'. */
/begin MEASUREMENT CcsIprPrxDischargePmax "Pmax value from the currently active discharge schedule" FLOAT32_IEEE CU_CCSIPRPRXDISCHARGEPMAX 1 100 0.0 10000000.0 ECU_ADDRESS 0x70017ebc BYTE_ORDER MSB_LAST /end MEASUREMENT
/begin COMPU_METHOD CU_CCSIPRPRXDISCHARGEPMAX "Conversion method for CcsIprPrxDischargePmax" RAT_FUNC "%10.0" "W" COEFFS 0.000000 1.000000 -0.000000 0.000000 0.000000 1.000000 /end COMPU_METHOD
/* Scalar measurable for DDE 'CcsIprPrxEvseCrntMax'. */
/begin MEASUREMENT CcsIprPrxEvseCrntMax "Maximum current the EVSE can deliver" FLOAT32_IEEE CU_CCSIPRPRXEVSECRNTMAX 1 100 0.0 196605.0 ECU_ADDRESS 0x7001831c BYTE_ORDER MSB_LAST /end MEASUREMENT
/begin COMPU_METHOD CU_CCSIPRPRXEVSECRNTMAX "Conversion method for CcsIprPrxEvseCrntMax" RAT_FUNC "%10.0" "A" COEFFS 0.000000 1.000000 -0.000000 0.000000 0.000000 1.000000 /end COMPU_METHOD
/* Scalar measurable for DDE 'CcsIprPrxEvseCrntMin'. */
/begin MEASUREMENT CcsIprPrxEvseCrntMin "Minimum current the EVSE can deliver" FLOAT32_IEEE CU_CCSIPRPRXEVSECRNTMIN 1 100 0.0 196605.0 ECU_ADDRESS 0x70017e20 BYTE_ORDER MSB_LAST /end MEASUREMENT
/begin COMPU_METHOD CU_CCSIPRPRXEVSECRNTMIN "Conversion method for CcsIprPrxEvseCrntMin" RAT_FUNC "%10.0" "A" COEFFS 0.000000 1.000000 -0.000000 0.000000 0.000000 1.000000 /end COMPU_METHOD
/* Scalar measurable for DDE 'CcsIprPrxEvseCrntValid'. */
/begin MEASUREMENT CcsIprPrxEvseCrntValid "TRUE indicates the most recent DC current measurement by EVSE at the charge inlet is considered valid. This value is recevied by the last V2G message" UBYTE CU_CCSIPRPRXEVSECRNTVALID 1 100 0.0 1.0 ECU_ADDRESS 0x70018274 BYTE_ORDER MSB_LAST /end MEASUREMENT
/begin COMPU_METHOD CU_CCSIPRPRXEVSECRNTVALID "Conversion method for CcsIprPrxEvseCrntValid" RAT_FUNC "%10.0" "NA" COEFFS 0.000000 1.000000 -0.000000 0.000000 0.000000 1.000000 /end COMPU_METHOD
/* Scalar measurable for DDE 'CcsIprPrxEvseDchgCrntMax'. */
/begin MEASUREMENT CcsIprPrxEvseDchgCrntMax "Maximum discharge current the EVSE can deliver" FLOAT32_IEEE CU_CCSIPRPRXEVSEDCHGCRNTMAX 1 100 0.0 196605.0 ECU_ADDRESS 0x70017d84 BYTE_ORDER MSB_LAST /end MEASUREMENT
/begin COMPU_METHOD CU_CCSIPRPRXEVSEDCHGCRNTMAX "Conversion method for CcsIprPrxEvseDchgCrntMax" RAT_FUNC "%10.0" "A" COEFFS 0.000000 1.000000 -0.000000 0.000000 0.000000 1.000000 /end COMPU_METHOD
/* Scalar measurable for DDE 'CcsIprPrxEvseDchgCrntMin'. */
/begin MEASUREMENT CcsIprPrxEvseDchgCrntMin "Maximum discharge current the EVSE can deliver" FLOAT32_IEEE CU_CCSIPRPRXEVSEDCHGCRNTMIN 1 100 0.0 196605.0 ECU_ADDRESS 0x700181b0 BYTE_ORDER MSB_LAST /end MEASUREMENT
/begin COMPU_METHOD CU_CCSIPRPRXEVSEDCHGCRNTMIN "Conversion method for CcsIprPrxEvseDchgCrntMin" RAT_FUNC "%10.0" "A" COEFFS 0.000000 1.000000 -0.000000 0.000000 0.000000 1.000000 /end COMPU_METHOD
/* Scalar measurable for DDE 'CcsIprPrxEvseDchgPwrMax'. */
/begin MEASUREMENT CcsIprPrxEvseDchgPwrMax "Maximum discharge power the EVSE can deliver" FLOAT32_IEEE CU_CCSIPRPRXEVSEDCHGPWRMAX 1 100 0.0 196605.0 ECU_ADDRESS 0x70017c90 BYTE_ORDER MSB_LAST /end MEASUREMENT
/begin COMPU_METHOD CU_CCSIPRPRXEVSEDCHGPWRMAX "Conversion method for CcsIprPrxEvseDchgPwrMax" RAT_FUNC "%10.0" "A" COEFFS 0.000000 1.000000 -0.000000 0.000000 0.000000 1.000000 /end COMPU_METHOD
/* Scalar measurable for DDE 'CcsIprPrxEvsePwrMax'. */
/begin MEASUREMENT CcsIprPrxEvsePwrMax "Maximum power that EVSE can deliver" FLOAT32_IEEE CU_CCSIPRPRXEVSEPWRMAX 1 100 0.0 196605.0 ECU_ADDRESS 0x700180e4 BYTE_ORDER MSB_LAST /end MEASUREMENT
/begin COMPU_METHOD CU_CCSIPRPRXEVSEPWRMAX "Conversion method for CcsIprPrxEvsePwrMax" RAT_FUNC "%10.0" "W" COEFFS 0.000000 1.000000 -0.000000 0.000000 0.000000 1.000000 /end COMPU_METHOD
/* Scalar measurable for DDE 'CcsIprPrxEvseVoltMax'. */
/begin MEASUREMENT CcsIprPrxEvseVoltMax "Maximum voltage the EVSE can deliver" FLOAT32_IEEE CU_CCSIPRPRXEVSEVOLTMAX 1 100 0.0 196605.0 ECU_ADDRESS 0x70017c08 BYTE_ORDER MSB_LAST /end MEASUREMENT
/begin COMPU_METHOD CU_CCSIPRPRXEVSEVOLTMAX "Conversion method for CcsIprPrxEvseVoltMax" RAT_FUNC "%10.0" "V" COEFFS 0.000000 1.000000 -0.000000 0.000000 0.000000 1.000000 /end COMPU_METHOD
/* Scalar measurable for DDE 'CcsIprPrxEvseVoltMin'. */
/begin MEASUREMENT CcsIprPrxEvseVoltMin "Minimum voltage the EVSE can deliver" FLOAT32_IEEE CU_CCSIPRPRXEVSEVOLTMIN 1 100 0.0 196605.0 ECU_ADDRESS 0x70017fac BYTE_ORDER MSB_LAST /end MEASUREMENT
/begin COMPU_METHOD CU_CCSIPRPRXEVSEVOLTMIN "Conversion method for CcsIprPrxEvseVoltMin" RAT_FUNC "%10.0" "V" COEFFS 0.000000 1.000000 -0.000000 0.000000 0.000000 1.000000 /end COMPU_METHOD
/* Scalar measurable for DDE 'CcsIprPrxEvseVoltValid'. */
/begin MEASUREMENT CcsIprPrxEvseVoltValid "TRUE indicates the most recent DC voltage measurement by EVSE at the charge inlet is considered valid. This value is recevied by the last V2G message" UBYTE CU_CCSIPRPRXEVSEVOLTVALID 1 100 0.0 1.0 ECU_ADDRESS 0x70018430 BYTE_ORDER MSB_LAST /end MEASUREMENT
/begin COMPU_METHOD CU_CCSIPRPRXEVSEVOLTVALID "Conversion method for CcsIprPrxEvseVoltValid" RAT_FUNC "%10.0" "NA" COEFFS 0.000000 1.000000 -0.000000 0.000000 0.000000 1.000000 /end COMPU_METHOD
/* Scalar measurable for DDE 'CcsIprPrxSchedulePmax'. */
/begin MEASUREMENT CcsIprPrxSchedulePmax "Pmax value from the currently active charge schedule" FLOAT32_IEEE CU_CCSIPRPRXSCHEDULEPMAX 1 100 0.0 10000000.0 ECU_ADDRESS 0x70017ef8 BYTE_ORDER MSB_LAST /end MEASUREMENT
/begin COMPU_METHOD CU_CCSIPRPRXSCHEDULEPMAX "Conversion method for CcsIprPrxSchedulePmax" RAT_FUNC "%10.0" "W" COEFFS 0.000000 1.000000 -0.000000 0.000000 0.000000 1.000000 /end COMPU_METHOD
/* Scalar measurable for DDE 'CcsIprSchIdx'. */
/begin MEASUREMENT CcsIprSchIdx "Index value of the curently active charging schedule segment" SBYTE CU_CCSIPRSCHIDX 1 100 -1.0 127.0 ECU_ADDRESS 0x7001836f BYTE_ORDER MSB_LAST /end MEASUREMENT
/begin COMPU_METHOD CU_CCSIPRSCHIDX "Conversion method for CcsIprSchIdx" RAT_FUNC "%10.0" "NA" COEFFS 0.000000 1.000000 -0.000000 0.000000 0.000000 1.000000 /end COMPU_METHOD
/* Scalar measurable for DDE 'CcsIprSchMaxIdx'. */
/begin MEASUREMENT CcsIprSchMaxIdx "Maximum valid index of the current charging schedule. -1 indicates the charging schedule is not valid." SBYTE CU_CCSIPRSCHMAXIDX 1 100 -1.0 127.0 ECU_ADDRESS 0x70017e6c BYTE_ORDER MSB_LAST /end MEASUREMENT
/begin COMPU_METHOD CU_CCSIPRSCHMAXIDX "Conversion method for CcsIprSchMaxIdx" RAT_FUNC "%10.0" "NA" COEFFS 0.000000 1.000000 -0.000000 0.000000 0.000000 1.000000 /end COMPU_METHOD
/* Scalar measurable for DDE 'CcsIprSchPmaxClipped'. */
/begin MEASUREMENT CcsIprSchPmaxClipped "Indicates that the charge schedule is presently imposing a Pmax clip on the system" UBYTE CU_CCSIPRSCHPMAXCLIPPED 1 100 0.0 1.0 ECU_ADDRESS 0x700182b6 BYTE_ORDER MSB_LAST /end MEASUREMENT
/begin COMPU_METHOD CU_CCSIPRSCHPMAXCLIPPED "Conversion method for CcsIprSchPmaxClipped" RAT_FUNC "%10.0" "b" COEFFS 0.000000 1.000000 -0.000000 0.000000 0.000000 1.000000 /end COMPU_METHOD
/* Scalar measurable for DDE 'CcsIprSchTimer'. */
/begin MEASUREMENT CcsIprSchTimer "Charge schedule timer value" ULONG CU_CCSIPRSCHTIMER 1 100 0.0 4294967295.0 ECU_ADDRESS 0x70017dc0 BYTE_ORDER MSB_LAST /end MEASUREMENT
/begin COMPU_METHOD CU_CCSIPRSCHTIMER "Conversion method for CcsIprSchTimer" RAT_FUNC "%10.0" "NA" COEFFS 0.000000 1.000000 -0.000000 0.000000 0.000000 1.000000 /end COMPU_METHOD
/* Scalar measurable for DDE 'CcsOutPtxDinAuthTxFlg'. */
/begin MEASUREMENT CcsOutPtxDinAuthTxFlg "a rising edge on this signal triggers the transmission of the V2G AuthorizationReq message to the EVSE" UBYTE CU_CCSOUTPTXDINAUTHTXFLG 1 100 0.0 1.0 ECU_ADDRESS 0x70017f6d BYTE_ORDER MSB_LAST /end MEASUREMENT
/begin COMPU_METHOD CU_CCSOUTPTXDINAUTHTXFLG "Conversion method for CcsOutPtxDinAuthTxFlg" RAT_FUNC "%10.0" "b" COEFFS 0.000000 1.000000 -0.000000 0.000000 0.000000 1.000000 /end COMPU_METHOD
/* Scalar measurable for DDE 'CcsOutPtxDinCblChkTxFlg'. */
/begin MEASUREMENT CcsOutPtxDinCblChkTxFlg "a rising edge on this signal triggers the transmission of the V2G CableCheckReq message to the EVSE" UBYTE CU_CCSOUTPTXDINCBLCHKTXFLG 1 100 0.0 1.0 ECU_ADDRESS 0x700183b4 BYTE_ORDER MSB_LAST /end MEASUREMENT
/begin COMPU_METHOD CU_CCSOUTPTXDINCBLCHKTXFLG "Conversion method for CcsOutPtxDinCblChkTxFlg" RAT_FUNC "%10.0" "b" COEFFS 0.000000 1.000000 -0.000000 0.000000 0.000000 1.000000 /end COMPU_METHOD
/* Scalar measurable for DDE 'CcsOutPtxDinChgParDiscTxFlg'. */
/begin MEASUREMENT CcsOutPtxDinChgParDiscTxFlg "a rising edge on this signal triggers the transmission of the second V2G ChargeParameterDiscoveryReq message to the EVSE" UBYTE CU_CCSOUTPTXDINCHGPARDISCTXFLG 1 100 0.0 1.0 ECU_ADDRESS 0x70017ec0 BYTE_ORDER MSB_LAST /end MEASUREMENT
/begin COMPU_METHOD CU_CCSOUTPTXDINCHGPARDISCTXFLG "Conversion method for CcsOutPtxDinChgParDiscTxFlg" RAT_FUNC "%10.0" "b" COEFFS 0.000000 1.000000 -0.000000 0.000000 0.000000 1.000000 /end COMPU_METHOD
/* Scalar measurable for DDE 'CcsOutPtxDinCrntDmdTxFlg'. */
/begin MEASUREMENT CcsOutPtxDinCrntDmdTxFlg "a rising edge on this signal triggers the transmission of the V2G CurrentDemandReq message to the EVSE" UBYTE CU_CCSOUTPTXDINCRNTDMDTXFLG 1 100 0.0 1.0 ECU_ADDRESS 0x70018320 BYTE_ORDER MSB_LAST /end MEASUREMENT
/begin COMPU_METHOD CU_CCSOUTPTXDINCRNTDMDTXFLG "Conversion method for CcsOutPtxDinCrntDmdTxFlg" RAT_FUNC "%10.0" "b" COEFFS 0.000000 1.000000 -0.000000 0.000000 0.000000 1.000000 /end COMPU_METHOD
/* Scalar measurable for DDE 'CcsOutPtxDinPmtSelTxFlg'. */
/begin MEASUREMENT CcsOutPtxDinPmtSelTxFlg "a rising edge on this signal triggers the transmission of the V2G ServicePaymentSelectionReq message to the EVSE" UBYTE CU_CCSOUTPTXDINPMTSELTXFLG 1 100 0.0 1.0 ECU_ADDRESS 0x70017e24 BYTE_ORDER MSB_LAST /end MEASUREMENT
/begin COMPU_METHOD CU_CCSOUTPTXDINPMTSELTXFLG "Conversion method for CcsOutPtxDinPmtSelTxFlg" RAT_FUNC "%10.0" "b" COEFFS 0.000000 1.000000 -0.000000 0.000000 0.000000 1.000000 /end COMPU_METHOD
/* Scalar measurable for DDE 'CcsOutPtxDinPreChgTxFlg'. */
/begin MEASUREMENT CcsOutPtxDinPreChgTxFlg "a rising edge on this signal triggers the transmission of the V2G PrechargeReq message to the EVSE" UBYTE CU_CCSOUTPTXDINPRECHGTXFLG 1 100 0.0 1.0 ECU_ADDRESS 0x70018275 BYTE_ORDER MSB_LAST /end MEASUREMENT
/begin COMPU_METHOD CU_CCSOUTPTXDINPRECHGTXFLG "Conversion method for CcsOutPtxDinPreChgTxFlg" RAT_FUNC "%10.0" "b" COEFFS 0.000000 1.000000 -0.000000 0.000000 0.000000 1.000000 /end COMPU_METHOD
/* Scalar measurable for DDE 'CcsOutPtxDinPwrDelShtDnTxFlg'. */
/begin MEASUREMENT CcsOutPtxDinPwrDelShtDnTxFlg "a rising edge on this signal triggers the transmission of the V2G PowerDeliveryReq shutdown message to the EVSE" UBYTE CU_CCSOUTPTXDINPWRDELSHTDNTXFLG 1 100 0.0 1.0 ECU_ADDRESS 0x70017d88 BYTE_ORDER MSB_LAST /end MEASUREMENT
/begin COMPU_METHOD CU_CCSOUTPTXDINPWRDELSHTDNTXFLG "Conversion method for CcsOutPtxDinPwrDelShtDnTxFlg" RAT_FUNC "%10.0" "b" COEFFS 0.000000 1.000000 -0.000000 0.000000 0.000000 1.000000 /end COMPU_METHOD
/* Scalar measurable for DDE 'CcsOutPtxDinPwrDelivTxFlg'. */
/begin MEASUREMENT CcsOutPtxDinPwrDelivTxFlg "a rising edge on this signal triggers the transmission of the V2G PowerDeliveryReq message to the EVSE" UBYTE CU_CCSOUTPTXDINPWRDELIVTXFLG 1 100 0.0 1.0 ECU_ADDRESS 0x700181b4 BYTE_ORDER MSB_LAST /end MEASUREMENT
/begin COMPU_METHOD CU_CCSOUTPTXDINPWRDELIVTXFLG "Conversion method for CcsOutPtxDinPwrDelivTxFlg" RAT_FUNC "%10.0" "b" COEFFS 0.000000 1.000000 -0.000000 0.000000 0.000000 1.000000 /end COMPU_METHOD
/* Scalar measurable for DDE 'CcsOutPtxDinSesSetupTxFlg'. */
/begin MEASUREMENT CcsOutPtxDinSesSetupTxFlg "a rising edge on this signal triggers the transmission of the V2G SessionSetupReq message to the EVSE" UBYTE CU_CCSOUTPTXDINSESSETUPTXFLG 1 100 0.0 1.0 ECU_ADDRESS 0x70017c94 BYTE_ORDER MSB_LAST /end MEASUREMENT
/begin COMPU_METHOD CU_CCSOUTPTXDINSESSETUPTXFLG "Conversion method for CcsOutPtxDinSesSetupTxFlg" RAT_FUNC "%10.0" "b" COEFFS 0.000000 1.000000 -0.000000 0.000000 0.000000 1.000000 /end COMPU_METHOD
/* Scalar measurable for DDE 'CcsOutPtxDinSesStopTxFlg'. */
/begin MEASUREMENT CcsOutPtxDinSesStopTxFlg "a rising edge on this signal triggers the transmission of the V2G SessionStopReq message to the EVSE" UBYTE CU_CCSOUTPTXDINSESSTOPTXFLG 1 100 0.0 1.0 ECU_ADDRESS 0x700180e8 BYTE_ORDER MSB_LAST /end MEASUREMENT
/begin COMPU_METHOD CU_CCSOUTPTXDINSESSTOPTXFLG "Conversion method for CcsOutPtxDinSesStopTxFlg" RAT_FUNC "%10.0" "b" COEFFS 0.000000 1.000000 -0.000000 0.000000 0.000000 1.000000 /end COMPU_METHOD
/* Scalar measurable for DDE 'CcsOutPtxDinSvcDiscTxFlg'. */
/begin MEASUREMENT CcsOutPtxDinSvcDiscTxFlg "a rising edge on this signal triggers the transmission of the V2G ServiceDiscoveryReq message to the EVSE" UBYTE CU_CCSOUTPTXDINSVCDISCTXFLG 1 100 0.0 1.0 ECU_ADDRESS 0x70017c0c BYTE_ORDER MSB_LAST /end MEASUREMENT
/begin COMPU_METHOD CU_CCSOUTPTXDINSVCDISCTXFLG "Conversion method for CcsOutPtxDinSvcDiscTxFlg" RAT_FUNC "%10.0" "b" COEFFS 0.000000 1.000000 -0.000000 0.000000 0.000000 1.000000 /end COMPU_METHOD
/* Scalar measurable for DDE 'CcsOutPtxDinWeldDetTxFlg'. */
/begin MEASUREMENT CcsOutPtxDinWeldDetTxFlg "a rising edge on this signal triggers the transmission of the V2G WeldingDetectionReq message to the EVSE" UBYTE CU_CCSOUTPTXDINWELDDETTXFLG 1 100 0.0 1.0 ECU_ADDRESS 0x70017fb0 BYTE_ORDER MSB_LAST /end MEASUREMENT
/begin COMPU_METHOD CU_CCSOUTPTXDINWELDDETTXFLG "Conversion method for CcsOutPtxDinWeldDetTxFlg" RAT_FUNC "%10.0" "b" COEFFS 0.000000 1.000000 -0.000000 0.000000 0.000000 1.000000 /end COMPU_METHOD
/* Scalar measurable for DDE 'CcsOutPtxIso1AuthTxFlg'. */
/begin MEASUREMENT CcsOutPtxIso1AuthTxFlg "a rising edge on this signal triggers the transmission of the V2G AuthorizationReq message to the EVSE" UBYTE CU_CCSOUTPTXISO1AUTHTXFLG 1 100 0.0 1.0 ECU_ADDRESS 0x70018431 BYTE_ORDER MSB_LAST /end MEASUREMENT
/begin COMPU_METHOD CU_CCSOUTPTXISO1AUTHTXFLG "Conversion method for CcsOutPtxIso1AuthTxFlg" RAT_FUNC "%10.0" "b" COEFFS 0.000000 1.000000 -0.000000 0.000000 0.000000 1.000000 /end COMPU_METHOD
/* Scalar measurable for DDE 'CcsOutPtxIso1CblChkTxFlg'. */
/begin MEASUREMENT CcsOutPtxIso1CblChkTxFlg "a rising edge on this signal triggers the transmission of the V2G CableCheckReq message to the EVSE" UBYTE CU_CCSOUTPTXISO1CBLCHKTXFLG 1 100 0.0 1.0 ECU_ADDRESS 0x70017efc BYTE_ORDER MSB_LAST /end MEASUREMENT
/begin COMPU_METHOD CU_CCSOUTPTXISO1CBLCHKTXFLG "Conversion method for CcsOutPtxIso1CblChkTxFlg" RAT_FUNC "%10.0" "b" COEFFS 0.000000 1.000000 -0.000000 0.000000 0.000000 1.000000 /end COMPU_METHOD
/* Scalar measurable for DDE 'CcsOutPtxIso1ChgParDiscTxFlg'. */
/begin MEASUREMENT CcsOutPtxIso1ChgParDiscTxFlg "a rising edge on this signal triggers the transmission of the second V2G ChargeParameterDiscoveryReq message to the EVSE" UBYTE CU_CCSOUTPTXISO1CHGPARDISCTXFLG 1 100 0.0 1.0 ECU_ADDRESS 0x70018370 BYTE_ORDER MSB_LAST /end MEASUREMENT
/begin COMPU_METHOD CU_CCSOUTPTXISO1CHGPARDISCTXFLG "Conversion method for CcsOutPtxIso1ChgParDiscTxFlg" RAT_FUNC "%10.0" "b" COEFFS 0.000000 1.000000 -0.000000 0.000000 0.000000 1.000000 /end COMPU_METHOD
/* Scalar measurable for DDE 'CcsOutPtxIso1CrntDmdTxFlg'. */
/begin MEASUREMENT CcsOutPtxIso1CrntDmdTxFlg "a rising edge on this signal triggers the transmission of the V2G CurrentDemandReq message to the EVSE" UBYTE CU_CCSOUTPTXISO1CRNTDMDTXFLG 1 100 0.0 1.0 ECU_ADDRESS 0x70017e6d BYTE_ORDER MSB_LAST /end MEASUREMENT
/begin COMPU_METHOD CU_CCSOUTPTXISO1CRNTDMDTXFLG "Conversion method for CcsOutPtxIso1CrntDmdTxFlg" RAT_FUNC "%10.0" "b" COEFFS 0.000000 1.000000 -0.000000 0.000000 0.000000 1.000000 /end COMPU_METHOD
/* Scalar measurable for DDE 'CcsOutPtxIso1PmtSelTxFlg'. */
/begin MEASUREMENT CcsOutPtxIso1PmtSelTxFlg "a rising edge on this signal triggers the transmission of the V2G ServicePaymentSelectionReq message to the EVSE" UBYTE CU_CCSOUTPTXISO1PMTSELTXFLG 1 100 0.0 1.0 ECU_ADDRESS 0x700182b7 BYTE_ORDER MSB_LAST /end MEASUREMENT
/begin COMPU_METHOD CU_CCSOUTPTXISO1PMTSELTXFLG "Conversion method for CcsOutPtxIso1PmtSelTxFlg" RAT_FUNC "%10.0" "b" COEFFS 0.000000 1.000000 -0.000000 0.000000 0.000000 1.000000 /end COMPU_METHOD
/* Scalar measurable for DDE 'CcsOutPtxIso1PreChgTxFlg'. */
/begin MEASUREMENT CcsOutPtxIso1PreChgTxFlg "a rising edge on this signal triggers the transmission of the V2G PrechargeReq message to the EVSE" UBYTE CU_CCSOUTPTXISO1PRECHGTXFLG 1 100 0.0 1.0 ECU_ADDRESS 0x70017dc4 BYTE_ORDER MSB_LAST /end MEASUREMENT
/begin COMPU_METHOD CU_CCSOUTPTXISO1PRECHGTXFLG "Conversion method for CcsOutPtxIso1PreChgTxFlg" RAT_FUNC "%10.0" "b" COEFFS 0.000000 1.000000 -0.000000 0.000000 0.000000 1.000000 /end COMPU_METHOD
/* Scalar measurable for DDE 'CcsOutPtxIso1PwrDelShtDnTxFlg'. */
/begin MEASUREMENT CcsOutPtxIso1PwrDelShtDnTxFlg "a rising edge on this signal triggers the transmission of the V2G PowerDeliveryReq shutdown message to the EVSE" UBYTE CU_CCSOUTPTXISO1PWRDELSHTDNTXF0 1 100 0.0 1.0 ECU_ADDRESS 0x70018208 BYTE_ORDER MSB_LAST /end MEASUREMENT
/begin COMPU_METHOD CU_CCSOUTPTXISO1PWRDELSHTDNTXF0 "Conversion method for CcsOutPtxIso1PwrDelShtDnTxFlg" RAT_FUNC "%10.0" "b" COEFFS 0.000000 1.000000 -0.000000 0.000000 0.000000 1.000000 /end COMPU_METHOD
/* Scalar measurable for DDE 'CcsOutPtxIso1PwrDelivTxFlg'. */
/begin MEASUREMENT CcsOutPtxIso1PwrDelivTxFlg "a rising edge on this signal triggers the transmission of the V2G PowerDeliveryReq message to the EVSE" UBYTE CU_CCSOUTPTXISO1PWRDELIVTXFLG 1 100 0.0 1.0 ECU_ADDRESS 0x70017d24 BYTE_ORDER MSB_LAST /end MEASUREMENT
/begin COMPU_METHOD CU_CCSOUTPTXISO1PWRDELIVTXFLG "Conversion method for CcsOutPtxIso1PwrDelivTxFlg" RAT_FUNC "%10.0" "b" COEFFS 0.000000 1.000000 -0.000000 0.000000 0.000000 1.000000 /end COMPU_METHOD
/* Scalar measurable for DDE 'CcsOutPtxIso1SesSetupTxFlg'. */
/begin MEASUREMENT CcsOutPtxIso1SesSetupTxFlg "a rising edge on this signal triggers the transmission of the V2G SessionSetupReq message to the EVSE" UBYTE CU_CCSOUTPTXISO1SESSETUPTXFLG 1 100 0.0 1.0 ECU_ADDRESS 0x7001817c BYTE_ORDER MSB_LAST /end MEASUREMENT
/begin COMPU_METHOD CU_CCSOUTPTXISO1SESSETUPTXFLG "Conversion method for CcsOutPtxIso1SesSetupTxFlg" RAT_FUNC "%10.0" "b" COEFFS 0.000000 1.000000 -0.000000 0.000000 0.000000 1.000000 /end COMPU_METHOD
/* Scalar measurable for DDE 'CcsOutPtxIso1SesStopTxFlg'. */
/begin MEASUREMENT CcsOutPtxIso1SesStopTxFlg "a rising edge on this signal triggers the transmission of the V2G SessionStopReq message to the EVSE" UBYTE CU_CCSOUTPTXISO1SESSTOPTXFLG 1 100 0.0 1.0 ECU_ADDRESS 0x70017c50 BYTE_ORDER MSB_LAST /end MEASUREMENT
/begin COMPU_METHOD CU_CCSOUTPTXISO1SESSTOPTXFLG "Conversion method for CcsOutPtxIso1SesStopTxFlg" RAT_FUNC "%10.0" "b" COEFFS 0.000000 1.000000 -0.000000 0.000000 0.000000 1.000000 /end COMPU_METHOD
/* Scalar measurable for DDE 'CcsOutPtxIso1SvcDetailTxFlg'. */
/begin MEASUREMENT CcsOutPtxIso1SvcDetailTxFlg "a rising edge on this signal triggers the transmission of the V2G ServiceDetailReq message to the EVSE" UBYTE CU_CCSOUTPTXISO1SVCDETAILTXFLG 1 100 0.0 1.0 ECU_ADDRESS 0x70018011 BYTE_ORDER MSB_LAST /end MEASUREMENT
/begin COMPU_METHOD CU_CCSOUTPTXISO1SVCDETAILTXFLG "Conversion method for CcsOutPtxIso1SvcDetailTxFlg" RAT_FUNC "%10.0" "b" COEFFS 0.000000 1.000000 -0.000000 0.000000 0.000000 1.000000 /end COMPU_METHOD
/* Scalar measurable for DDE 'CcsOutPtxIso1SvcDiscTxFlg'. */
/begin MEASUREMENT CcsOutPtxIso1SvcDiscTxFlg "a rising edge on this signal triggers the transmission of the V2G ServiceDiscoveryReq message to the EVSE" UBYTE CU_CCSOUTPTXISO1SVCDISCTXFLG 1 100 0.0 1.0 ECU_ADDRESS 0x70018475 BYTE_ORDER MSB_LAST /end MEASUREMENT
/begin COMPU_METHOD CU_CCSOUTPTXISO1SVCDISCTXFLG "Conversion method for CcsOutPtxIso1SvcDiscTxFlg" RAT_FUNC "%10.0" "b" COEFFS 0.000000 1.000000 -0.000000 0.000000 0.000000 1.000000 /end COMPU_METHOD
/* Scalar measurable for DDE 'CcsOutPtxIso1WeldDetTxFlg'. */
/begin MEASUREMENT CcsOutPtxIso1WeldDetTxFlg "a rising edge on this signal triggers the transmission of the V2G WeldingDetectionReq message to the EVSE" UBYTE CU_CCSOUTPTXISO1WELDDETTXFLG 1 100 0.0 1.0 ECU_ADDRESS 0x70017f6e BYTE_ORDER MSB_LAST /end MEASUREMENT
/begin COMPU_METHOD CU_CCSOUTPTXISO1WELDDETTXFLG "Conversion method for CcsOutPtxIso1WeldDetTxFlg" RAT_FUNC "%10.0" "b" COEFFS 0.000000 1.000000 -0.000000 0.000000 0.000000 1.000000 /end COMPU_METHOD
/* Scalar measurable for DDE 'CcsOutPtxIso2AuthTxFlg'. */
/begin MEASUREMENT CcsOutPtxIso2AuthTxFlg "a rising edge on this signal triggers the transmission of the V2G  AuthorizationReq message to the EVSE" UBYTE CU_CCSOUTPTXISO2AUTHTXFLG 1 100 0.0 1.0 ECU_ADDRESS 0x700183b5 BYTE_ORDER MSB_LAST /end MEASUREMENT
/begin COMPU_METHOD CU_CCSOUTPTXISO2AUTHTXFLG "Conversion method for CcsOutPtxIso2AuthTxFlg" RAT_FUNC "%10.0" "b" COEFFS 0.000000 1.000000 -0.000000 0.000000 0.000000 1.000000 /end COMPU_METHOD
/* Scalar measurable for DDE 'CcsOutPtxIso2BptCtrlTxFlg'. */
/begin MEASUREMENT CcsOutPtxIso2BptCtrlTxFlg "a rising edge on this signal triggers the transmission of the V2G DC_BidirectionalControlReq message to the EVSE" UBYTE CU_CCSOUTPTXISO2BPTCTRLTXFLG 1 100 0.0 1.0 ECU_ADDRESS 0x70017ec1 BYTE_ORDER MSB_LAST /end MEASUREMENT
/begin COMPU_METHOD CU_CCSOUTPTXISO2BPTCTRLTXFLG "Conversion method for CcsOutPtxIso2BptCtrlTxFlg" RAT_FUNC "%10.0" "b" COEFFS 0.000000 1.000000 -0.000000 0.000000 0.000000 1.000000 /end COMPU_METHOD
/* Scalar measurable for DDE 'CcsOutPtxIso2CblChkTxFlg'. */
/begin MEASUREMENT CcsOutPtxIso2CblChkTxFlg "a rising edge on this signal triggers the transmission of the V2G CableCheckReq message to the EVSE" UBYTE CU_CCSOUTPTXISO2CBLCHKTXFLG 1 100 0.0 1.0 ECU_ADDRESS 0x70018321 BYTE_ORDER MSB_LAST /end MEASUREMENT
/begin COMPU_METHOD CU_CCSOUTPTXISO2CBLCHKTXFLG "Conversion method for CcsOutPtxIso2CblChkTxFlg" RAT_FUNC "%10.0" "b" COEFFS 0.000000 1.000000 -0.000000 0.000000 0.000000 1.000000 /end COMPU_METHOD
/* Scalar measurable for DDE 'CcsOutPtxIso2ChgParDiscTxFlg'. */
/begin MEASUREMENT CcsOutPtxIso2ChgParDiscTxFlg "a rising edge on this signal triggers the transmission of the V2G ChargeParameterDiscoveryReq message to the EVSE" UBYTE CU_CCSOUTPTXISO2CHGPARDISCTXFLG 1 100 0.0 1.0 ECU_ADDRESS 0x70017e25 BYTE_ORDER MSB_LAST /end MEASUREMENT
/begin COMPU_METHOD CU_CCSOUTPTXISO2CHGPARDISCTXFLG "Conversion method for CcsOutPtxIso2ChgParDiscTxFlg" RAT_FUNC "%10.0" "b" COEFFS 0.000000 1.000000 -0.000000 0.000000 0.000000 1.000000 /end COMPU_METHOD
/* Scalar measurable for DDE 'CcsOutPtxIso2CrntDmdTxFlg'. */
/begin MEASUREMENT CcsOutPtxIso2CrntDmdTxFlg "a rising edge on this signal triggers the transmission of the V2G CurrentDemandReq message to the EVSE" UBYTE CU_CCSOUTPTXISO2CRNTDMDTXFLG 1 100 0.0 1.0 ECU_ADDRESS 0x70018276 BYTE_ORDER MSB_LAST /end MEASUREMENT
/begin COMPU_METHOD CU_CCSOUTPTXISO2CRNTDMDTXFLG "Conversion method for CcsOutPtxIso2CrntDmdTxFlg" RAT_FUNC "%10.0" "b" COEFFS 0.000000 1.000000 -0.000000 0.000000 0.000000 1.000000 /end COMPU_METHOD
/* Scalar measurable for DDE 'CcsOutPtxIso2PmtSelTxFlg'. */
/begin MEASUREMENT CcsOutPtxIso2PmtSelTxFlg "a rising edge on this signal triggers the transmission of the V2G PaymentServiceSelectionReq message to the EVSE" UBYTE CU_CCSOUTPTXISO2PMTSELTXFLG 1 100 0.0 1.0 ECU_ADDRESS 0x70017d89 BYTE_ORDER MSB_LAST /end MEASUREMENT
/begin COMPU_METHOD CU_CCSOUTPTXISO2PMTSELTXFLG "Conversion method for CcsOutPtxIso2PmtSelTxFlg" RAT_FUNC "%10.0" "b" COEFFS 0.000000 1.000000 -0.000000 0.000000 0.000000 1.000000 /end COMPU_METHOD
/* Scalar measurable for DDE 'CcsOutPtxIso2PreChgTxFlg'. */
/begin MEASUREMENT CcsOutPtxIso2PreChgTxFlg "a rising edge on this signal triggers the transmission of the V2G PreChargeReq message to the EVSE" UBYTE CU_CCSOUTPTXISO2PRECHGTXFLG 1 100 0.0 1.0 ECU_ADDRESS 0x700181b5 BYTE_ORDER MSB_LAST /end MEASUREMENT
/begin COMPU_METHOD CU_CCSOUTPTXISO2PRECHGTXFLG "Conversion method for CcsOutPtxIso2PreChgTxFlg" RAT_FUNC "%10.0" "b" COEFFS 0.000000 1.000000 -0.000000 0.000000 0.000000 1.000000 /end COMPU_METHOD
/* Scalar measurable for DDE 'CcsOutPtxIso2PwrDelShtdnTxFlg'. */
/begin MEASUREMENT CcsOutPtxIso2PwrDelShtdnTxFlg "a rising edge on this signal triggers the transmission of the second V2G PowerDeliveryReq message to the EVSE" UBYTE CU_CCSOUTPTXISO2PWRDELSHTDNTXF0 1 100 0.0 1.0 ECU_ADDRESS 0x70017c95 BYTE_ORDER MSB_LAST /end MEASUREMENT
/begin COMPU_METHOD CU_CCSOUTPTXISO2PWRDELSHTDNTXF0 "Conversion method for CcsOutPtxIso2PwrDelShtdnTxFlg" RAT_FUNC "%10.0" "b" COEFFS 0.000000 1.000000 -0.000000 0.000000 0.000000 1.000000 /end COMPU_METHOD
/* Scalar measurable for DDE 'CcsOutPtxIso2PwrDelivTxFlg'. */
/begin MEASUREMENT CcsOutPtxIso2PwrDelivTxFlg "a rising edge on this signal triggers the transmission of the V2G PowerDeliveryReq message to the EVSE" UBYTE CU_CCSOUTPTXISO2PWRDELIVTXFLG 1 100 0.0 1.0 ECU_ADDRESS 0x700180e9 BYTE_ORDER MSB_LAST /end MEASUREMENT
/begin COMPU_METHOD CU_CCSOUTPTXISO2PWRDELIVTXFLG "Conversion method for CcsOutPtxIso2PwrDelivTxFlg" RAT_FUNC "%10.0" "b" COEFFS 0.000000 1.000000 -0.000000 0.000000 0.000000 1.000000 /end COMPU_METHOD
/* Scalar measurable for DDE 'CcsOutPtxIso2SesSetupTxFlg'. */
/begin MEASUREMENT CcsOutPtxIso2SesSetupTxFlg "a rising edge on this signal triggers the transmission of the V2G SessionSetupReq message to the EVSE" UBYTE CU_CCSOUTPTXISO2SESSETUPTXFLG 1 100 0.0 1.0 ECU_ADDRESS 0x70017c0d BYTE_ORDER MSB_LAST /end MEASUREMENT
/begin COMPU_METHOD CU_CCSOUTPTXISO2SESSETUPTXFLG "Conversion method for CcsOutPtxIso2SesSetupTxFlg" RAT_FUNC "%10.0" "b" COEFFS 0.000000 1.000000 -0.000000 0.000000 0.000000 1.000000 /end COMPU_METHOD
/* Scalar measurable for DDE 'CcsOutPtxIso2SesStopTxFlg'. */
/begin MEASUREMENT CcsOutPtxIso2SesStopTxFlg "a rising edge on this signal triggers the transmission of the V2G SessionStopReq message to the EVSE" UBYTE CU_CCSOUTPTXISO2SESSTOPTXFLG 1 100 0.0 1.0 ECU_ADDRESS 0x70017fb1 BYTE_ORDER MSB_LAST /end MEASUREMENT
/begin COMPU_METHOD CU_CCSOUTPTXISO2SESSTOPTXFLG "Conversion method for CcsOutPtxIso2SesStopTxFlg" RAT_FUNC "%10.0" "b" COEFFS 0.000000 1.000000 -0.000000 0.000000 0.000000 1.000000 /end COMPU_METHOD
/* Scalar measurable for DDE 'CcsOutPtxIso2SvcDetailTxFlg'. */
/begin MEASUREMENT CcsOutPtxIso2SvcDetailTxFlg "a rising edge on this signal triggers the transmission of the V2G ServiceDetailReq message to the EVSE" UBYTE CU_CCSOUTPTXISO2SVCDETAILTXFLG 1 100 0.0 1.0 ECU_ADDRESS 0x70018432 BYTE_ORDER MSB_LAST /end MEASUREMENT
/begin COMPU_METHOD CU_CCSOUTPTXISO2SVCDETAILTXFLG "Conversion method for CcsOutPtxIso2SvcDetailTxFlg" RAT_FUNC "%10.0" "b" COEFFS 0.000000 1.000000 -0.000000 0.000000 0.000000 1.000000 /end COMPU_METHOD
/* Scalar measurable for DDE 'CcsOutPtxIso2SvcDiscTxFlg'. */
/begin MEASUREMENT CcsOutPtxIso2SvcDiscTxFlg "a rising edge on this signal triggers the transmission of the V2G ServiceDiscoveryReq message to the EVSE" UBYTE CU_CCSOUTPTXISO2SVCDISCTXFLG 1 100 0.0 1.0 ECU_ADDRESS 0x70017efd BYTE_ORDER MSB_LAST /end MEASUREMENT
/begin COMPU_METHOD CU_CCSOUTPTXISO2SVCDISCTXFLG "Conversion method for CcsOutPtxIso2SvcDiscTxFlg" RAT_FUNC "%10.0" "b" COEFFS 0.000000 1.000000 -0.000000 0.000000 0.000000 1.000000 /end COMPU_METHOD
/* Scalar measurable for DDE 'CcsOutPtxIso2WeldDetTxFlg'. */
/begin MEASUREMENT CcsOutPtxIso2WeldDetTxFlg "a rising edge on this signal triggers the transmission of the V2G WeldingDetectionReq message to the EVSE" UBYTE CU_CCSOUTPTXISO2WELDDETTXFLG 1 100 0.0 1.0 ECU_ADDRESS 0x70018371 BYTE_ORDER MSB_LAST /end MEASUREMENT
/begin COMPU_METHOD CU_CCSOUTPTXISO2WELDDETTXFLG "Conversion method for CcsOutPtxIso2WeldDetTxFlg" RAT_FUNC "%10.0" "b" COEFFS 0.000000 1.000000 -0.000000 0.000000 0.000000 1.000000 /end COMPU_METHOD
/* Scalar measurable for DDE 'CcsOutPtxMsgTransmitError'. */
/begin MEASUREMENT CcsOutPtxMsgTransmitError "is set to 1 if an error occurs while transmitting any of the V2G messages from PiCCs. This error is set by OE when it fails to process the input signals of a V2G TX message." UBYTE CU_CCSOUTPTXMSGTRANSMITERROR 1 100 0.0 1.0 ECU_ADDRESS 0x70017e6e BYTE_ORDER MSB_LAST /end MEASUREMENT
/begin COMPU_METHOD CU_CCSOUTPTXMSGTRANSMITERROR "Conversion method for CcsOutPtxMsgTransmitError" RAT_FUNC "%10.0" "b" COEFFS 0.000000 1.000000 -0.000000 0.000000 0.000000 1.000000 /end COMPU_METHOD
/* Scalar measurable for DDE 'CcsOutPtxSuppAppProtoTxFlg'. */
/begin MEASUREMENT CcsOutPtxSuppAppProtoTxFlg "a rising edge on this signal triggers the transmission of the V2G SupportedAppProtocolReq message to the EVSE" UBYTE CU_CCSOUTPTXSUPPAPPPROTOTXFLG 1 100 0.0 1.0 ECU_ADDRESS 0x700182b8 BYTE_ORDER MSB_LAST /end MEASUREMENT
/begin COMPU_METHOD CU_CCSOUTPTXSUPPAPPPROTOTXFLG "Conversion method for CcsOutPtxSuppAppProtoTxFlg" RAT_FUNC "%10.0" "b" COEFFS 0.000000 1.000000 -0.000000 0.000000 0.000000 1.000000 /end COMPU_METHOD
/* Scalar measurable for DDE 'DinAuthEvseProcessingSt'. */
/begin MEASUREMENT DinAuthEvseProcessingSt "Message YB: Parameter indicating that the EVSE has finished the processing that was initiated after the ContractAuthenticationReq or that the EVSE is still processing at the time the response message was sent." UBYTE CU_DINAUTHEVSEPROCESSINGST 1 100 0.0 255.0 ECU_ADDRESS 0x70018322 BYTE_ORDER MSB_LAST /end MEASUREMENT
/begin COMPU_METHOD CU_DINAUTHEVSEPROCESSINGST "Conversion method for DinAuthEvseProcessingSt" RAT_FUNC "%10.0" "enum" COEFFS 0.000000 1.000000 -0.000000 0.000000 0.000000 1.000000 /end COMPU_METHOD
/* Scalar measurable for DDE 'DinCblChkEvseIsolStatusFlg'. */
/begin MEASUREMENT DinCblChkEvseIsolStatusFlg "Identifies the presence of the EVSEIsolationStatus parameter." UBYTE CU_DINCBLCHKEVSEISOLSTATUSFLG 1 100 0.0 1.0 ECU_ADDRESS 0x70017e26 BYTE_ORDER MSB_LAST /end MEASUREMENT
/begin COMPU_METHOD CU_DINCBLCHKEVSEISOLSTATUSFLG "Conversion method for DinCblChkEvseIsolStatusFlg" RAT_FUNC "%10.0" "b" COEFFS 0.000000 1.000000 -0.000000 0.000000 0.000000 1.000000 /end COMPU_METHOD
/* Scalar measurable for DDE 'DinChgParDiscRxTrg'. */
/begin MEASUREMENT DinChgParDiscRxTrg "Trigger falg that on a rising edge indicates the event for receiving the PLC (V2G) message response 3b from EVSE" UBYTE CU_DINCHGPARDISCRXTRG 1 100 0.0 1.0 ECU_ADDRESS 0x70018277 BYTE_ORDER MSB_LAST /end MEASUREMENT
/begin COMPU_METHOD CU_DINCHGPARDISCRXTRG "Conversion method for DinChgParDiscRxTrg" RAT_FUNC "%10.0" "b" COEFFS 0.000000 1.000000 -0.000000 0.000000 0.000000 1.000000 /end COMPU_METHOD
/* Scalar measurable for DDE 'DinCrntDmdEvseCrntMaxLimFlg'. */
/begin MEASUREMENT DinCrntDmdEvseCrntMaxLimFlg "Indicates that the EVSEMaximumCurrentLimit parameter is available." UBYTE CU_DINCRNTDMDEVSECRNTMAXLIMFLG 1 100 0.0 1.0 ECU_ADDRESS 0x70017d8a BYTE_ORDER MSB_LAST /end MEASUREMENT
/begin COMPU_METHOD CU_DINCRNTDMDEVSECRNTMAXLIMFLG "Conversion method for DinCrntDmdEvseCrntMaxLimFlg" RAT_FUNC "%10.0" "b" COEFFS 0.000000 1.000000 -0.000000 0.000000 0.000000 1.000000 /end COMPU_METHOD
/* Scalar measurable for DDE 'DinCrntDmdEvseIsolStatusFlg'. */
/begin MEASUREMENT DinCrntDmdEvseIsolStatusFlg "Identifies the presence of the EVSEIsolationStatus parameter." UBYTE CU_DINCRNTDMDEVSEISOLSTATUSFLG 1 100 0.0 1.0 ECU_ADDRESS 0x700181b6 BYTE_ORDER MSB_LAST /end MEASUREMENT
/begin COMPU_METHOD CU_DINCRNTDMDEVSEISOLSTATUSFLG "Conversion method for DinCrntDmdEvseIsolStatusFlg" RAT_FUNC "%10.0" "b" COEFFS 0.000000 1.000000 -0.000000 0.000000 0.000000 1.000000 /end COMPU_METHOD
/* Scalar measurable for DDE 'DinCrntDmdEvsePwrLimReached'. */
/begin MEASUREMENT DinCrntDmdEvsePwrLimReached "If set to TRUE, the EVSE has reached its power limit." UBYTE CU_DINCRNTDMDEVSEPWRLIMREACHED 1 100 0.0 1.0 ECU_ADDRESS 0x70017c96 BYTE_ORDER MSB_LAST /end MEASUREMENT
/begin COMPU_METHOD CU_DINCRNTDMDEVSEPWRLIMREACHED "Conversion method for DinCrntDmdEvsePwrLimReached" RAT_FUNC "%10.0" "b" COEFFS 0.000000 1.000000 -0.000000 0.000000 0.000000 1.000000 /end COMPU_METHOD
/* Scalar measurable for DDE 'DinCrntDmdEvseStatusCode'. */
/begin MEASUREMENT DinCrntDmdEvseStatusCode "Indicates the internal state of the EVSE." UBYTE CU_DINCRNTDMDEVSESTATUSCODE 1 100 0.0 255.0 ECU_ADDRESS 0x700180ea BYTE_ORDER MSB_LAST /end MEASUREMENT
/begin COMPU_METHOD CU_DINCRNTDMDEVSESTATUSCODE "Conversion method for DinCrntDmdEvseStatusCode" RAT_FUNC "%10.0" "enum" COEFFS 0.000000 1.000000 -0.000000 0.000000 0.000000 1.000000 /end COMPU_METHOD
/* Scalar measurable for DDE 'DinCrntDmdEvseVolt'. */
/begin MEASUREMENT DinCrntDmdEvseVolt "Present voltage of EVSE" FLOAT32_IEEE CU_DINCRNTDMDEVSEVOLT 1 100 0.0 196605.0 ECU_ADDRESS 0x70017c10 BYTE_ORDER MSB_LAST /end MEASUREMENT
/begin COMPU_METHOD CU_DINCRNTDMDEVSEVOLT "Conversion method for DinCrntDmdEvseVolt" RAT_FUNC "%10.0" "V" COEFFS 0.000000 1.000000 -0.000000 0.000000 0.000000 1.000000 /end COMPU_METHOD
/* Scalar measurable for DDE 'DinCrntDmdEvseVoltMaxLim'. */
/begin MEASUREMENT DinCrntDmdEvseVoltMaxLim "Maximum voltage the EVSE can deliver" FLOAT32_IEEE CU_DINCRNTDMDEVSEVOLTMAXLIM 1 100 0.0 196605.0 ECU_ADDRESS 0x70017fb4 BYTE_ORDER MSB_LAST /end MEASUREMENT
/begin COMPU_METHOD CU_DINCRNTDMDEVSEVOLTMAXLIM "Conversion method for DinCrntDmdEvseVoltMaxLim" RAT_FUNC "%10.0" "V" COEFFS 0.000000 1.000000 -0.000000 0.000000 0.000000 1.000000 /end COMPU_METHOD
/* Scalar measurable for DDE 'DinCrntDmdEvseVoltMaxLimFlg'. */
/begin MEASUREMENT DinCrntDmdEvseVoltMaxLimFlg "Indicates that the EVSEMaximumVoltageLimit parameter is available." UBYTE CU_DINCRNTDMDEVSEVOLTMAXLIMFLG 1 100 0.0 1.0 ECU_ADDRESS 0x70018433 BYTE_ORDER MSB_LAST /end MEASUREMENT
/begin COMPU_METHOD CU_DINCRNTDMDEVSEVOLTMAXLIMFLG "Conversion method for DinCrntDmdEvseVoltMaxLimFlg" RAT_FUNC "%10.0" "b" COEFFS 0.000000 1.000000 -0.000000 0.000000 0.000000 1.000000 /end COMPU_METHOD
/* Scalar measurable for DDE 'DinDcChgParDiscEvseEgyDeliverableFlg'. */
/begin MEASUREMENT DinDcChgParDiscEvseEgyDelivera0 "Indicated the presente of the amount of energy signal to be delivered by the EVSE." UBYTE CU_DINDCCHGPARDISCEVSEEGYDELIV0 1 100 0.0 1.0 ECU_ADDRESS 0x70017efe BYTE_ORDER MSB_LAST /end MEASUREMENT
/begin COMPU_METHOD CU_DINDCCHGPARDISCEVSEEGYDELIV0 "Conversion method for DinDcChgParDiscEvseEgyDeliverableFlg" RAT_FUNC "%10.0" "b" COEFFS 0.000000 1.000000 -0.000000 0.000000 0.000000 1.000000 /end COMPU_METHOD
/* Scalar measurable for DDE 'DinDcChgParDiscEvsePwrMaxLimFlg'. */
/begin MEASUREMENT DinDcChgParDiscEvsePwrMaxLimFlg "Identifies the presence of the EVSEMaximumPower parameter." UBYTE CU_DINDCCHGPARDISCEVSEPWRMAXLI0 1 100 0.0 1.0 ECU_ADDRESS 0x70018372 BYTE_ORDER MSB_LAST /end MEASUREMENT
/begin COMPU_METHOD CU_DINDCCHGPARDISCEVSEPWRMAXLI0 "Conversion method for DinDcChgParDiscEvsePwrMaxLimFlg" RAT_FUNC "%10.0" "b" COEFFS 0.000000 1.000000 -0.000000 0.000000 0.000000 1.000000 /end COMPU_METHOD
/* Scalar measurable for DDE 'DinDcChgParDiscEvseVoltMaxLim'. */
/begin MEASUREMENT DinDcChgParDiscEvseVoltMaxLim "Maximum voltage the EVSE can deliver" FLOAT32_IEEE CU_DINDCCHGPARDISCEVSEVOLTMAXL0 1 100 0.0 196605.0 ECU_ADDRESS 0x70017e70 BYTE_ORDER MSB_LAST /end MEASUREMENT
/begin COMPU_METHOD CU_DINDCCHGPARDISCEVSEVOLTMAXL0 "Conversion method for DinDcChgParDiscEvseVoltMaxLim" RAT_FUNC "%10.0" "V" COEFFS 0.000000 1.000000 -0.000000 0.000000 0.000000 1.000000 /end COMPU_METHOD
/* Scalar measurable for DDE 'DinPmtSelRxTrg'. */
/begin MEASUREMENT DinPmtSelRxTrg "Trigger falg that on a rising edge indicates the event for receiving the PLC (V2G) message response Xb from EVSE" UBYTE CU_DINPMTSELRXTRG 1 100 0.0 1.0 ECU_ADDRESS 0x700182b9 BYTE_ORDER MSB_LAST /end MEASUREMENT
/begin COMPU_METHOD CU_DINPMTSELRXTRG "Conversion method for DinPmtSelRxTrg" RAT_FUNC "%10.0" "b" COEFFS 0.000000 1.000000 -0.000000 0.000000 0.000000 1.000000 /end COMPU_METHOD
/* Scalar measurable for DDE 'DinPreChgResponseCode'. */
/begin MEASUREMENT DinPreChgResponseCode "for message 5b: indicates the acknowledgment status of  this V2G messages received by the SECC." UBYTE CU_DINPRECHGRESPONSECODE 1 100 0.0 255.0 ECU_ADDRESS 0x70017dcc BYTE_ORDER MSB_LAST /end MEASUREMENT
/begin COMPU_METHOD CU_DINPRECHGRESPONSECODE "Conversion method for DinPreChgResponseCode" RAT_FUNC "%10.0" "1" COEFFS 0.000000 1.000000 -0.000000 0.000000 0.000000 1.000000 /end COMPU_METHOD
/* Scalar measurable for DDE 'DinPwrDelivDcEvseStatusFlg'. */
/begin MEASUREMENT DinPwrDelivDcEvseStatusFlg "Identifies the presence of the EVSEStatusCode parameter." UBYTE CU_DINPWRDELIVDCEVSESTATUSFLG 1 100 0.0 1.0 ECU_ADDRESS 0x7001820a BYTE_ORDER MSB_LAST /end MEASUREMENT
/begin COMPU_METHOD CU_DINPWRDELIVDCEVSESTATUSFLG "Conversion method for DinPwrDelivDcEvseStatusFlg" RAT_FUNC "%10.0" "b" COEFFS 0.000000 1.000000 -0.000000 0.000000 0.000000 1.000000 /end COMPU_METHOD
/* Scalar measurable for DDE 'DinPwrDelivEvseIsolSt'. */
/begin MEASUREMENT DinPwrDelivEvseIsolSt "Indicates the isolation condition" UBYTE CU_DINPWRDELIVEVSEISOLST 1 100 0.0 255.0 ECU_ADDRESS 0x70017d26 BYTE_ORDER MSB_LAST /end MEASUREMENT
/begin COMPU_METHOD CU_DINPWRDELIVEVSEISOLST "Conversion method for DinPwrDelivEvseIsolSt" RAT_FUNC "%10.0" "enum" COEFFS 0.000000 1.000000 -0.000000 0.000000 0.000000 1.000000 /end COMPU_METHOD
/* Scalar measurable for DDE 'DinPwrDelivEvseStatusCode'. */
/begin MEASUREMENT DinPwrDelivEvseStatusCode "Indicates the internal state of the EVSE." UBYTE CU_DINPWRDELIVEVSESTATUSCODE 1 100 0.0 255.0 ECU_ADDRESS 0x7001817e BYTE_ORDER MSB_LAST /end MEASUREMENT
/begin COMPU_METHOD CU_DINPWRDELIVEVSESTATUSCODE "Conversion method for DinPwrDelivEvseStatusCode" RAT_FUNC "%10.0" "enum" COEFFS 0.000000 1.000000 -0.000000 0.000000 0.000000 1.000000 /end COMPU_METHOD
/* Scalar measurable for DDE 'DinPwrDelivResponseCode'. */
/begin MEASUREMENT DinPwrDelivResponseCode "for message 6b: indicates the acknowledgment status of  this V2G messages received by the SECC." UBYTE CU_DINPWRDELIVRESPONSECODE 1 100 0.0 255.0 ECU_ADDRESS 0x70017c52 BYTE_ORDER MSB_LAST /end MEASUREMENT
/begin COMPU_METHOD CU_DINPWRDELIVRESPONSECODE "Conversion method for DinPwrDelivResponseCode" RAT_FUNC "%10.0" "1" COEFFS 0.000000 1.000000 -0.000000 0.000000 0.000000 1.000000 /end COMPU_METHOD
/* Scalar measurable for DDE 'DinPwrDelivRxTrg'. */
/begin MEASUREMENT DinPwrDelivRxTrg "Trigger falg that on a rising edge indicates the event for receiving the PLC (V2G) message response 6b from EVSE" UBYTE CU_DINPWRDELIVRXTRG 1 100 0.0 1.0 ECU_ADDRESS 0x70018018 BYTE_ORDER MSB_LAST /end MEASUREMENT
/begin COMPU_METHOD CU_DINPWRDELIVRXTRG "Conversion method for DinPwrDelivRxTrg" RAT_FUNC "%10.0" "b" COEFFS 0.000000 1.000000 -0.000000 0.000000 0.000000 1.000000 /end COMPU_METHOD
/* Scalar measurable for DDE 'DinSesSetupEvseIdLen'. */
/begin MEASUREMENT DinSesSetupEvseIdLen "Number of bytes in EVSE ID" UBYTE CU_DINSESSETUPEVSEIDLEN 1 100 0.0 37.0 ECU_ADDRESS 0x70018477 BYTE_ORDER MSB_LAST /end MEASUREMENT
/begin COMPU_METHOD CU_DINSESSETUPEVSEIDLEN "Conversion method for DinSesSetupEvseIdLen" RAT_FUNC "%10.0" "1" COEFFS 0.000000 1.000000 -0.000000 0.000000 0.000000 1.000000 /end COMPU_METHOD
/* Scalar measurable for DDE 'DinSesStopResponseCode'. */
/begin MEASUREMENT DinSesStopResponseCode "for message 10b: indicates the acknowledgment status of  this V2G messages received by the SECC." UBYTE CU_DINSESSTOPRESPONSECODE 1 100 0.0 255.0 ECU_ADDRESS 0x70017f70 BYTE_ORDER MSB_LAST /end MEASUREMENT
/begin COMPU_METHOD CU_DINSESSTOPRESPONSECODE "Conversion method for DinSesStopResponseCode" RAT_FUNC "%10.0" "1" COEFFS 0.000000 1.000000 -0.000000 0.000000 0.000000 1.000000 /end COMPU_METHOD
/* Scalar measurable for DDE 'DinSesStopRxTrg'. */
/begin MEASUREMENT DinSesStopRxTrg "Trigger falg that on a rising edge indicates the event for receiving the PLC (V2G) message response 10b from EVSE" UBYTE CU_DINSESSTOPRXTRG 1 100 0.0 1.0 ECU_ADDRESS 0x700183b7 BYTE_ORDER MSB_LAST /end MEASUREMENT
/begin COMPU_METHOD CU_DINSESSTOPRXTRG "Conversion method for DinSesStopRxTrg" RAT_FUNC "%10.0" "b" COEFFS 0.000000 1.000000 -0.000000 0.000000 0.000000 1.000000 /end COMPU_METHOD
/* Scalar measurable for DDE 'DinSvcDiscFreeSvc'. */
/begin MEASUREMENT DinSvcDiscFreeSvc "Indicates a list of booleans that denote if a service at a index is free of charge or not." UBYTE CU_DINSVCDISCFREESVC 1 100 0.0 1.0 ECU_ADDRESS 0x70017ec3 BYTE_ORDER MSB_LAST /end MEASUREMENT
/begin COMPU_METHOD CU_DINSVCDISCFREESVC "Conversion method for DinSvcDiscFreeSvc" RAT_FUNC "%10.0" "1" COEFFS 0.000000 1.000000 -0.000000 0.000000 0.000000 1.000000 /end COMPU_METHOD
/* Scalar measurable for DDE 'DinSvcDiscResponseCode'. */
/begin MEASUREMENT DinSvcDiscResponseCode "for message 2b: indicates the acknowledgment status of  this V2G messages received by the SECC." UBYTE CU_DINSVCDISCRESPONSECODE 1 100 0.0 255.0 ECU_ADDRESS 0x70018323 BYTE_ORDER MSB_LAST /end MEASUREMENT
/begin COMPU_METHOD CU_DINSVCDISCRESPONSECODE "Conversion method for DinSvcDiscResponseCode" RAT_FUNC "%10.0" "1" COEFFS 0.000000 1.000000 -0.000000 0.000000 0.000000 1.000000 /end COMPU_METHOD
/* Scalar measurable for DDE 'DinSvcDiscRxTrg'. */
/begin MEASUREMENT DinSvcDiscRxTrg "Trigger falg that on a rising edge indicates the event for receiving the PLC (V2G) message response 2b from EVSE" UBYTE CU_DINSVCDISCRXTRG 1 100 0.0 1.0 ECU_ADDRESS 0x70017e27 BYTE_ORDER MSB_LAST /end MEASUREMENT
/begin COMPU_METHOD CU_DINSVCDISCRXTRG "Conversion method for DinSvcDiscRxTrg" RAT_FUNC "%10.0" "b" COEFFS 0.000000 1.000000 -0.000000 0.000000 0.000000 1.000000 /end COMPU_METHOD
/* Scalar measurable for DDE 'DinSvcDiscSvcCategory'. */
/begin MEASUREMENT DinSvcDiscSvcCategory "The Service Category parameter in the received message from EVSE" UBYTE CU_DINSVCDISCSVCCATEGORY 1 100 0.0 4.0 ECU_ADDRESS 0x70018278 BYTE_ORDER MSB_LAST /end MEASUREMENT
/begin COMPU_METHOD CU_DINSVCDISCSVCCATEGORY "Conversion method for DinSvcDiscSvcCategory" RAT_FUNC "%10.0" "1" COEFFS 0.000000 1.000000 -0.000000 0.000000 0.000000 1.000000 /end COMPU_METHOD
/* Scalar measurable for DDE 'DinSvcDiscSvcId'. */
/begin MEASUREMENT DinSvcDiscSvcId "Identifies a service which has been offered by the SECC in the ServiceDiscoveryRes message" UWORD CU_DINSVCDISCSVCID 1 100 0.0 65535.0 ECU_ADDRESS 0x70017d8c BYTE_ORDER MSB_LAST /end MEASUREMENT
/begin COMPU_METHOD CU_DINSVCDISCSVCID "Conversion method for DinSvcDiscSvcId" RAT_FUNC "%10.0" "1" COEFFS 0.000000 1.000000 -0.000000 0.000000 0.000000 1.000000 /end COMPU_METHOD
/* Scalar measurable for DDE 'DinWeldDetResponseCode'. */
/begin MEASUREMENT DinWeldDetResponseCode "for message 9b: indicates the acknowledgment status of  this V2G messages received by the SECC." UBYTE CU_DINWELDDETRESPONSECODE 1 100 0.0 255.0 ECU_ADDRESS 0x700181b7 BYTE_ORDER MSB_LAST /end MEASUREMENT
/begin COMPU_METHOD CU_DINWELDDETRESPONSECODE "Conversion method for DinWeldDetResponseCode" RAT_FUNC "%10.0" "1" COEFFS 0.000000 1.000000 -0.000000 0.000000 0.000000 1.000000 /end COMPU_METHOD
/* Scalar measurable for DDE 'HostAcCrntPresAtPortEn'. */
/begin MEASUREMENT HostAcCrntPresAtPortEn "Exported global for inlet AC Current (post-override)." UBYTE CU_HOSTACCRNTPRESATPORTEN 1 100 0.0 1.0 ECU_ADDRESS 0x700180eb BYTE_ORDER MSB_LAST /end MEASUREMENT
/begin COMPU_METHOD CU_HOSTACCRNTPRESATPORTEN "Conversion method for HostAcCrntPresAtPortEn" RAT_FUNC "%10.0" "b" COEFFS 0.000000 1.000000 -0.000000 0.000000 0.000000 1.000000 /end COMPU_METHOD
/* Scalar measurable for DDE 'HostAcCrntPresentAtPort'. */
/begin MEASUREMENT HostAcCrntPresentAtPort "Instantaneous current at port" UBYTE CU_HOSTACCRNTPRESENTATPORT 1 100 0.0 1.0 ECU_ADDRESS 0x70017c14 BYTE_ORDER MSB_LAST /end MEASUREMENT
/begin COMPU_METHOD CU_HOSTACCRNTPRESENTATPORT "Conversion method for HostAcCrntPresentAtPort" RAT_FUNC "%10.0" "b" COEFFS 0.000000 1.000000 -0.000000 0.000000 0.000000 1.000000 /end COMPU_METHOD
/* Scalar measurable for DDE 'HostAcVltPresAtPortEn'. */
/begin MEASUREMENT HostAcVltPresAtPortEn "Exported global for inlet AC Voltage (post-override)." UBYTE CU_HOSTACVLTPRESATPORTEN 1 100 0.0 1.0 ECU_ADDRESS 0x70017fb8 BYTE_ORDER MSB_LAST /end MEASUREMENT
/begin COMPU_METHOD CU_HOSTACVLTPRESATPORTEN "Conversion method for HostAcVltPresAtPortEn" RAT_FUNC "%10.0" "b" COEFFS 0.000000 1.000000 -0.000000 0.000000 0.000000 1.000000 /end COMPU_METHOD
/* Scalar measurable for DDE 'HostAcVoltPresentAtPort'. */
/begin MEASUREMENT HostAcVoltPresentAtPort "Port AC voltage is present" UBYTE CU_HOSTACVOLTPRESENTATPORT 1 100 0.0 1.0 ECU_ADDRESS 0x70018434 BYTE_ORDER MSB_LAST /end MEASUREMENT
/begin COMPU_METHOD CU_HOSTACVOLTPRESENTATPORT "Conversion method for HostAcVoltPresentAtPort" RAT_FUNC "%10.0" "b" COEFFS 0.000000 1.000000 -0.000000 0.000000 0.000000 1.000000 /end COMPU_METHOD
/* Scalar measurable for DDE 'HostAinEvsePilotVoltPeakRaw'. */
/begin MEASUREMENT HostAinEvsePilotVoltPeakRaw "Raw Peak voltage value of charging interface Pilot signal" FLOAT32_IEEE CU_HOSTAINEVSEPILOTVOLTPEAKRAW 1 100 -50.0 100.0 ECU_ADDRESS 0x70017f00 BYTE_ORDER MSB_LAST /end MEASUREMENT
/begin COMPU_METHOD CU_HOSTAINEVSEPILOTVOLTPEAKRAW "Conversion method for HostAinEvsePilotVoltPeakRaw" RAT_FUNC "%10.0" "V" COEFFS 0.000000 1.000000 -0.000000 0.000000 0.000000 1.000000 /end COMPU_METHOD
/* Scalar measurable for DDE 'HostAinEvsePilotVoltRaw'. */
/begin MEASUREMENT HostAinEvsePilotVoltRaw "Raw voltage value of charging interface Pilot signal" FLOAT32_IEEE CU_HOSTAINEVSEPILOTVOLTRAW 1 100 -50.0 100.0 ECU_ADDRESS 0x70018374 BYTE_ORDER MSB_LAST /end MEASUREMENT
/begin COMPU_METHOD CU_HOSTAINEVSEPILOTVOLTRAW "Conversion method for HostAinEvsePilotVoltRaw" RAT_FUNC "%10.0" "V" COEFFS 0.000000 1.000000 -0.000000 0.000000 0.000000 1.000000 /end COMPU_METHOD
/* Scalar measurable for DDE 'HostAinEvseProximityVoltRaw'. */
/begin MEASUREMENT HostAinEvseProximityVoltRaw "Raw voltage value of charging interface Proximity signal" FLOAT32_IEEE CU_HOSTAINEVSEPROXIMITYVOLTRAW1 1 100 -50.0 100.0 ECU_ADDRESS 0x70017e74 BYTE_ORDER MSB_LAST /end MEASUREMENT
/begin COMPU_METHOD CU_HOSTAINEVSEPROXIMITYVOLTRAW1 "Conversion method for HostAinEvseProximityVoltRaw" RAT_FUNC "%10.0" "V" COEFFS 0.000000 1.000000 -0.000000 0.000000 0.000000 1.000000 /end COMPU_METHOD
/* Scalar measurable for DDE 'HostAinProximitySupplyFdbk'. */
/begin MEASUREMENT HostAinProximitySupplyFdbk "raw internal feedback form the 5V supply voltage output used for powring up the proximity  signal circuit in an EV-EVSE interface" FLOAT32_IEEE CU_HOSTAINPROXIMITYSUPPLYFDBK 1 100 -50.0 100.0 ECU_ADDRESS 0x700182bc BYTE_ORDER MSB_LAST /end MEASUREMENT
/begin COMPU_METHOD CU_HOSTAINPROXIMITYSUPPLYFDBK "Conversion method for HostAinProximitySupplyFdbk" RAT_FUNC "%10.0" "V" COEFFS 0.000000 1.000000 -0.000000 0.000000 0.000000 1.000000 /end COMPU_METHOD
/* Scalar measurable for DDE 'HostAllChgRelaysClosed'. */
/begin MEASUREMENT HostAllChgRelaysClosed "(not defined)" UBYTE CU_HOSTALLCHGRELAYSCLOSED 1 100 0.0 1.0 ECU_ADDRESS 0x7001820b BYTE_ORDER MSB_LAST /end MEASUREMENT
/begin COMPU_METHOD CU_HOSTALLCHGRELAYSCLOSED "Conversion method for HostAllChgRelaysClosed" RAT_FUNC "%10.0" "b" COEFFS 0.000000 1.000000 -0.000000 0.000000 0.000000 1.000000 /end COMPU_METHOD
/* Scalar measurable for DDE 'HostBptModePriority'. */
/begin MEASUREMENT HostBptModePriority "Exported global for BPT mode priority from Host (post-override)." UBYTE CU_HOSTBPTMODEPRIORITY 1 100 0.0 255.0 ECU_ADDRESS 0x70017d27 BYTE_ORDER MSB_LAST /end MEASUREMENT
/begin COMPU_METHOD CU_HOSTBPTMODEPRIORITY "Conversion method for HostBptModePriority" RAT_FUNC "%10.0" "e" COEFFS 0.000000 1.000000 -0.000000 0.000000 0.000000 1.000000 /end COMPU_METHOD
/* Scalar measurable for DDE 'HostChargeEmergencyStop'. */
/begin MEASUREMENT HostChargeEmergencyStop "(not defined)" UBYTE CU_HOSTCHARGEEMERGENCYSTOP 1 100 0.0 1.0 ECU_ADDRESS 0x7001817f BYTE_ORDER MSB_LAST /end MEASUREMENT
/begin COMPU_METHOD CU_HOSTCHARGEEMERGENCYSTOP "Conversion method for HostChargeEmergencyStop" RAT_FUNC "%10.0" "b" COEFFS 0.000000 1.000000 -0.000000 0.000000 0.000000 1.000000 /end COMPU_METHOD
/* Scalar measurable for DDE 'HostChargeNormalStop'. */
/begin MEASUREMENT HostChargeNormalStop "(not defined)" UBYTE CU_HOSTCHARGENORMALSTOP 1 100 0.0 1.0 ECU_ADDRESS 0x70018019 BYTE_ORDER MSB_LAST /end MEASUREMENT
/begin COMPU_METHOD CU_HOSTCHARGENORMALSTOP "Conversion method for HostChargeNormalStop" RAT_FUNC "%10.0" "b" COEFFS 0.000000 1.000000 -0.000000 0.000000 0.000000 1.000000 /end COMPU_METHOD
/* Scalar measurable for DDE 'HostChgInletLockStatus'. */
/begin MEASUREMENT HostChgInletLockStatus "(not defined)" UBYTE CU_HOSTCHGINLETLOCKSTATUS 1 100 0.0 1.0 ECU_ADDRESS 0x70018478 BYTE_ORDER MSB_LAST /end MEASUREMENT
/begin COMPU_METHOD CU_HOSTCHGINLETLOCKSTATUS "Conversion method for HostChgInletLockStatus" RAT_FUNC "%10.0" "b" COEFFS 0.000000 1.000000 -0.000000 0.000000 0.000000 1.000000 /end COMPU_METHOD
/* Scalar measurable for DDE 'HostChgPortCrntDc'. */
/begin MEASUREMENT HostChgPortCrntDc "Instantaneous current at port" FLOAT32_IEEE CU_HOSTCHGPORTCRNTDC 1 100 0.0 196605.0 ECU_ADDRESS 0x70017f74 BYTE_ORDER MSB_LAST /end MEASUREMENT
/begin COMPU_METHOD CU_HOSTCHGPORTCRNTDC "Conversion method for HostChgPortCrntDc" RAT_FUNC "%10.0" "A" COEFFS 0.000000 1.000000 -0.000000 0.000000 0.000000 1.000000 /end COMPU_METHOD
/* Scalar measurable for DDE 'HostChgPortCrntDcValid'. */
/begin MEASUREMENT HostChgPortCrntDcValid "(not defined)" UBYTE CU_HOSTCHGPORTCRNTDCVALID 1 100 0.0 1.0 ECU_ADDRESS 0x700183b8 BYTE_ORDER MSB_LAST /end MEASUREMENT
/begin COMPU_METHOD CU_HOSTCHGPORTCRNTDCVALID "Conversion method for HostChgPortCrntDcValid" RAT_FUNC "%10.0" "b" COEFFS 0.000000 1.000000 -0.000000 0.000000 0.000000 1.000000 /end COMPU_METHOD
/* Scalar measurable for DDE 'HostChgPortVoltDc'. */
/begin MEASUREMENT HostChgPortVoltDc "Port voltage" FLOAT32_IEEE CU_HOSTCHGPORTVOLTDC 1 100 0.0 196605.0 ECU_ADDRESS 0x70017ec4 BYTE_ORDER MSB_LAST /end MEASUREMENT
/begin COMPU_METHOD CU_HOSTCHGPORTVOLTDC "Conversion method for HostChgPortVoltDc" RAT_FUNC "%10.0" "V" COEFFS 0.000000 1.000000 -0.000000 0.000000 0.000000 1.000000 /end COMPU_METHOD
/* Scalar measurable for DDE 'HostChgPortVoltDcValid'. */
/begin MEASUREMENT HostChgPortVoltDcValid "(not defined)" UBYTE CU_HOSTCHGPORTVOLTDCVALID 1 100 0.0 1.0 ECU_ADDRESS 0x70018324 BYTE_ORDER MSB_LAST /end MEASUREMENT
/begin COMPU_METHOD CU_HOSTCHGPORTVOLTDCVALID "Conversion method for HostChgPortVoltDcValid" RAT_FUNC "%10.0" "b" COEFFS 0.000000 1.000000 -0.000000 0.000000 0.000000 1.000000 /end COMPU_METHOD
/* Scalar measurable for DDE 'HostChgRlyWeldCheckDone'. */
/begin MEASUREMENT HostChgRlyWeldCheckDone "(not defined)" UBYTE CU_HOSTCHGRLYWELDCHECKDONE 1 100 0.0 1.0 ECU_ADDRESS 0x70017e28 BYTE_ORDER MSB_LAST /end MEASUREMENT
/begin COMPU_METHOD CU_HOSTCHGRLYWELDCHECKDONE "Conversion method for HostChgRlyWeldCheckDone" RAT_FUNC "%10.0" "b" COEFFS 0.000000 1.000000 -0.000000 0.000000 0.000000 1.000000 /end COMPU_METHOD
/* Scalar measurable for DDE 'HostDepartureTime'. */
/begin MEASUREMENT HostDepartureTime "Departure time provided by the host" FLOAT32_IEEE CU_HOSTDEPARTURETIME 1 100 -3.40282346639e+38 3.40282346639e+38 ECU_ADDRESS 0x7001827c BYTE_ORDER MSB_LAST /end MEASUREMENT
/begin COMPU_METHOD CU_HOSTDEPARTURETIME "Conversion method for HostDepartureTime" RAT_FUNC "%10.0" "s" COEFFS 0.000000 1.000000 -0.000000 0.000000 0.000000 1.000000 /end COMPU_METHOD
/* Scalar measurable for DDE 'HostDesiredEgyTrnsfrMde'. */
/begin MEASUREMENT HostDesiredEgyTrnsfrMde "Exported global for desired energy transfer mode priority from Host (post-override)." UBYTE CU_HOSTDESIREDEGYTRNSFRMDE 1 100 0.0 255.0 ECU_ADDRESS 0x70017d8e BYTE_ORDER MSB_LAST /end MEASUREMENT
/begin COMPU_METHOD CU_HOSTDESIREDEGYTRNSFRMDE "Conversion method for HostDesiredEgyTrnsfrMde" RAT_FUNC "%10.0" "e" COEFFS 0.000000 1.000000 -0.000000 0.000000 0.000000 1.000000 /end COMPU_METHOD
/* Scalar measurable for DDE 'HostDynamicModePriority'. */
/begin MEASUREMENT HostDynamicModePriority "Exported global for dynamic mode priority from Host (post-override)." UBYTE CU_HOSTDYNAMICMODEPRIORITY 1 100 0.0 255.0 ECU_ADDRESS 0x700181b8 BYTE_ORDER MSB_LAST /end MEASUREMENT
/begin COMPU_METHOD CU_HOSTDYNAMICMODEPRIORITY "Conversion method for HostDynamicModePriority" RAT_FUNC "%10.0" "e" COEFFS 0.000000 1.000000 -0.000000 0.000000 0.000000 1.000000 /end COMPU_METHOD
/* Scalar measurable for DDE 'HostEvCurrMaxLim'. */
/begin MEASUREMENT HostEvCurrMaxLim "Maximum current supported by the vehicle." FLOAT32_IEEE CU_HOSTEVCURRMAXLIM 1 100 0.0 196605.0 ECU_ADDRESS 0x70017c98 BYTE_ORDER MSB_LAST /end MEASUREMENT
/begin COMPU_METHOD CU_HOSTEVCURRMAXLIM "Conversion method for HostEvCurrMaxLim" RAT_FUNC "%10.0" "A" COEFFS 0.000000 1.000000 -0.000000 0.000000 0.000000 1.000000 /end COMPU_METHOD
/* Scalar measurable for DDE 'HostEvCurrMinLim'. */
/begin MEASUREMENT HostEvCurrMinLim "Minimum current supported by the vehicle." FLOAT32_IEEE CU_HOSTEVCURRMINLIM 1 100 0.0 196605.0 ECU_ADDRESS 0x700180ec BYTE_ORDER MSB_LAST /end MEASUREMENT
/begin COMPU_METHOD CU_HOSTEVCURRMINLIM "Conversion method for HostEvCurrMinLim" RAT_FUNC "%10.0" "A" COEFFS 0.000000 1.000000 -0.000000 0.000000 0.000000 1.000000 /end COMPU_METHOD
/* Scalar measurable for DDE 'HostEvDisChgCurrMaxLim'. */
/begin MEASUREMENT HostEvDisChgCurrMaxLim "Maximum discharge current supported by the vehicle." FLOAT32_IEEE CU_HOSTEVDISCHGCURRMAXLIM 1 100 0.0 196605.0 ECU_ADDRESS 0x70017c18 BYTE_ORDER MSB_LAST /end MEASUREMENT
/begin COMPU_METHOD CU_HOSTEVDISCHGCURRMAXLIM "Conversion method for HostEvDisChgCurrMaxLim" RAT_FUNC "%10.0" "Wh" COEFFS 0.000000 1.000000 -0.000000 0.000000 0.000000 1.000000 /end COMPU_METHOD
/* Scalar measurable for DDE 'HostEvDisChgCurrMinLim'. */
/begin MEASUREMENT HostEvDisChgCurrMinLim "Minimum discharge current supported by the vehicle." FLOAT32_IEEE CU_HOSTEVDISCHGCURRMINLIM 1 100 0.0 196605.0 ECU_ADDRESS 0x70017fbc BYTE_ORDER MSB_LAST /end MEASUREMENT
/begin COMPU_METHOD CU_HOSTEVDISCHGCURRMINLIM "Conversion method for HostEvDisChgCurrMinLim" RAT_FUNC "%10.0" "Wh" COEFFS 0.000000 1.000000 -0.000000 0.000000 0.000000 1.000000 /end COMPU_METHOD
/* Scalar measurable for DDE 'HostEvDisChgPwrMaxLim'. */
/begin MEASUREMENT HostEvDisChgPwrMaxLim "Maximum discharge power supported by the vehicle." FLOAT32_IEEE CU_HOSTEVDISCHGPWRMAXLIM 1 100 0.0 196605.0 ECU_ADDRESS 0x70018438 BYTE_ORDER MSB_LAST /end MEASUREMENT
/begin COMPU_METHOD CU_HOSTEVDISCHGPWRMAXLIM "Conversion method for HostEvDisChgPwrMaxLim" RAT_FUNC "%10.0" "Wh" COEFFS 0.000000 1.000000 -0.000000 0.000000 0.000000 1.000000 /end COMPU_METHOD
/* Scalar measurable for DDE 'HostEvDisChgPwrMinLim'. */
/begin MEASUREMENT HostEvDisChgPwrMinLim "Minimum discharge power supported by the vehicle." FLOAT32_IEEE CU_HOSTEVDISCHGPWRMINLIM 1 100 0.0 196605.0 ECU_ADDRESS 0x70017f04 BYTE_ORDER MSB_LAST /end MEASUREMENT
/begin COMPU_METHOD CU_HOSTEVDISCHGPWRMINLIM "Conversion method for HostEvDisChgPwrMinLim" RAT_FUNC "%10.0" "Wh" COEFFS 0.000000 1.000000 -0.000000 0.000000 0.000000 1.000000 /end COMPU_METHOD
/* Scalar measurable for DDE 'HostEvEgyCapacity'. */
/begin MEASUREMENT HostEvEgyCapacity "Maximum energy capacity supported by the vehicle" FLOAT32_IEEE CU_HOSTEVEGYCAPACITY 1 100 0.0 196605.0 ECU_ADDRESS 0x70018378 BYTE_ORDER MSB_LAST /end MEASUREMENT
/begin COMPU_METHOD CU_HOSTEVEGYCAPACITY "Conversion method for HostEvEgyCapacity" RAT_FUNC "%10.0" "Wh" COEFFS 0.000000 1.000000 -0.000000 0.000000 0.000000 1.000000 /end COMPU_METHOD
/* Scalar measurable for DDE 'HostEvEgyReqAmount'. */
/begin MEASUREMENT HostEvEgyReqAmount "Amount of energy requested by the vehicle" FLOAT32_IEEE CU_HOSTEVEGYREQAMOUNT 1 100 0.0 196605.0 ECU_ADDRESS 0x70017e78 BYTE_ORDER MSB_LAST /end MEASUREMENT
/begin COMPU_METHOD CU_HOSTEVEGYREQAMOUNT "Conversion method for HostEvEgyReqAmount" RAT_FUNC "%10.0" "Wh" COEFFS 0.000000 1.000000 -0.000000 0.000000 0.000000 1.000000 /end COMPU_METHOD
/* Scalar measurable for DDE 'HostEvIsolCheckDisabled'. */
/begin MEASUREMENT HostEvIsolCheckDisabled "(not defined)" UBYTE CU_HOSTEVISOLCHECKDISABLED 1 100 0.0 1.0 ECU_ADDRESS 0x700182c0 BYTE_ORDER MSB_LAST /end MEASUREMENT
/begin COMPU_METHOD CU_HOSTEVISOLCHECKDISABLED "Conversion method for HostEvIsolCheckDisabled" RAT_FUNC "%10.0" "b" COEFFS 0.000000 1.000000 -0.000000 0.000000 0.000000 1.000000 /end COMPU_METHOD
/* Scalar measurable for DDE 'HostEvMaxEgy'. */
/begin MEASUREMENT HostEvMaxEgy "Maximum level of energy accepted by the EV" FLOAT32_IEEE CU_HOSTEVMAXEGY 1 100 0.0 196605.0 ECU_ADDRESS 0x70017dd0 BYTE_ORDER MSB_LAST /end MEASUREMENT
/begin COMPU_METHOD CU_HOSTEVMAXEGY "Conversion method for HostEvMaxEgy" RAT_FUNC "%10.0" "Wh" COEFFS 0.000000 1.000000 -0.000000 0.000000 0.000000 1.000000 /end COMPU_METHOD
/* Scalar measurable for DDE 'HostEvMinEgy'. */
/begin MEASUREMENT HostEvMinEgy "Minimum level of energy requested by the EV as soon as possible" FLOAT32_IEEE CU_HOSTEVMINEGY 1 100 0.0 196605.0 ECU_ADDRESS 0x7001820c BYTE_ORDER MSB_LAST /end MEASUREMENT
/begin COMPU_METHOD CU_HOSTEVMINEGY "Conversion method for HostEvMinEgy" RAT_FUNC "%10.0" "Wh" COEFFS 0.000000 1.000000 -0.000000 0.000000 0.000000 1.000000 /end COMPU_METHOD
/* Scalar measurable for DDE 'HostEvPwrMaxLim'. */
/begin MEASUREMENT HostEvPwrMaxLim "Maximum power supported by the vehicle." FLOAT32_IEEE CU_HOSTEVPWRMAXLIM 1 100 0.0 196605.0 ECU_ADDRESS 0x70017d28 BYTE_ORDER MSB_LAST /end MEASUREMENT
/begin COMPU_METHOD CU_HOSTEVPWRMAXLIM "Conversion method for HostEvPwrMaxLim" RAT_FUNC "%10.0" "W" COEFFS 0.000000 1.000000 -0.000000 0.000000 0.000000 1.000000 /end COMPU_METHOD
/* Scalar measurable for DDE 'HostEvPwrMinLim'. */
/begin MEASUREMENT HostEvPwrMinLim "Minimum power supported by the vehicle." FLOAT32_IEEE CU_HOSTEVPWRMINLIM 1 100 0.0 196605.0 ECU_ADDRESS 0x70018180 BYTE_ORDER MSB_LAST /end MEASUREMENT
/begin COMPU_METHOD CU_HOSTEVPWRMINLIM "Conversion method for HostEvPwrMinLim" RAT_FUNC "%10.0" "W" COEFFS 0.000000 1.000000 -0.000000 0.000000 0.000000 1.000000 /end COMPU_METHOD
/* Scalar measurable for DDE 'HostEvTargetCrnt'. */
/begin MEASUREMENT HostEvTargetCrnt "Instantaneous current requested by the vehicle" FLOAT32_IEEE CU_HOSTEVTARGETCRNT 1 100 0.0 196605.0 ECU_ADDRESS 0x70017c54 BYTE_ORDER MSB_LAST /end MEASUREMENT
/begin COMPU_METHOD CU_HOSTEVTARGETCRNT "Conversion method for HostEvTargetCrnt" RAT_FUNC "%10.0" "A" COEFFS 0.000000 1.000000 -0.000000 0.000000 0.000000 1.000000 /end COMPU_METHOD
/* Scalar measurable for DDE 'HostEvTargetVolt'. */
/begin MEASUREMENT HostEvTargetVolt "Target Voltage requested by EV" FLOAT32_IEEE CU_HOSTEVTARGETVOLT 1 100 0.0 196605.0 ECU_ADDRESS 0x7001801c BYTE_ORDER MSB_LAST /end MEASUREMENT
/begin COMPU_METHOD CU_HOSTEVTARGETVOLT "Conversion method for HostEvTargetVolt" RAT_FUNC "%10.0" "V" COEFFS 0.000000 1.000000 -0.000000 0.000000 0.000000 1.000000 /end COMPU_METHOD
/* Scalar measurable for DDE 'HostEvVoltMaxLim'. */
/begin MEASUREMENT HostEvVoltMaxLim "Maximum voltage supported by the vehicle." FLOAT32_IEEE CU_HOSTEVVOLTMAXLIM 1 100 0.0 196605.0 ECU_ADDRESS 0x7001847c BYTE_ORDER MSB_LAST /end MEASUREMENT
/begin COMPU_METHOD CU_HOSTEVVOLTMAXLIM "Conversion method for HostEvVoltMaxLim" RAT_FUNC "%10.0" "V" COEFFS 0.000000 1.000000 -0.000000 0.000000 0.000000 1.000000 /end COMPU_METHOD
/* Scalar measurable for DDE 'HostEvVoltMinLim'. */
/begin MEASUREMENT HostEvVoltMinLim "Minimum voltage supported by the vehicle." FLOAT32_IEEE CU_HOSTEVVOLTMINLIM 1 100 0.0 196605.0 ECU_ADDRESS 0x70017f78 BYTE_ORDER MSB_LAST /end MEASUREMENT
/begin COMPU_METHOD CU_HOSTEVVOLTMINLIM "Conversion method for HostEvVoltMinLim" RAT_FUNC "%10.0" "V" COEFFS 0.000000 1.000000 -0.000000 0.000000 0.000000 1.000000 /end COMPU_METHOD
/* Scalar measurable for DDE 'HostIgnoreIsolWarning'. */
/begin MEASUREMENT HostIgnoreIsolWarning "(not defined)" UBYTE CU_HOSTIGNOREISOLWARNING 1 100 0.0 1.0 ECU_ADDRESS 0x700183b9 BYTE_ORDER MSB_LAST /end MEASUREMENT
/begin COMPU_METHOD CU_HOSTIGNOREISOLWARNING "Conversion method for HostIgnoreIsolWarning" RAT_FUNC "%10.0" "b" COEFFS 0.000000 1.000000 -0.000000 0.000000 0.000000 1.000000 /end COMPU_METHOD
/* Scalar measurable for DDE 'HostPriorityDin'. */
/begin MEASUREMENT HostPriorityDin "Exported global for DIN70121 priority from Host (post-override)." UBYTE CU_HOSTPRIORITYDIN 1 100 0.0 255.0 ECU_ADDRESS 0x70017ec8 BYTE_ORDER MSB_LAST /end MEASUREMENT
/begin COMPU_METHOD CU_HOSTPRIORITYDIN "Conversion method for HostPriorityDin" RAT_FUNC "%10.0" "e" COEFFS 0.000000 1.000000 -0.000000 0.000000 0.000000 1.000000 /end COMPU_METHOD
/* Scalar measurable for DDE 'HostPriorityIsoV1'. */
/begin MEASUREMENT HostPriorityIsoV1 "Exported global for ISO15118-2 priority from Host (post-override)." UBYTE CU_HOSTPRIORITYISOV1 1 100 0.0 255.0 ECU_ADDRESS 0x70018325 BYTE_ORDER MSB_LAST /end MEASUREMENT
/begin COMPU_METHOD CU_HOSTPRIORITYISOV1 "Conversion method for HostPriorityIsoV1" RAT_FUNC "%10.0" "e" COEFFS 0.000000 1.000000 -0.000000 0.000000 0.000000 1.000000 /end COMPU_METHOD
/* Scalar measurable for DDE 'HostPriorityIsoV2'. */
/begin MEASUREMENT HostPriorityIsoV2 "Exported global for ISO15118-20 priority from Host (post-override)." UBYTE CU_HOSTPRIORITYISOV2 1 100 0.0 255.0 ECU_ADDRESS 0x70017e29 BYTE_ORDER MSB_LAST /end MEASUREMENT
/begin COMPU_METHOD CU_HOSTPRIORITYISOV2 "Conversion method for HostPriorityIsoV2" RAT_FUNC "%10.0" "e" COEFFS 0.000000 1.000000 -0.000000 0.000000 0.000000 1.000000 /end COMPU_METHOD
/* Scalar measurable for DDE 'HostProtocolDinEnbl'. */
/begin MEASUREMENT HostProtocolDinEnbl "Exported global for DIN70121 enable (post-override)." UBYTE CU_HOSTPROTOCOLDINENBL 1 100 0.0 1.0 ECU_ADDRESS 0x70018280 BYTE_ORDER MSB_LAST /end MEASUREMENT
/begin COMPU_METHOD CU_HOSTPROTOCOLDINENBL "Conversion method for HostProtocolDinEnbl" RAT_FUNC "%10.0" "b" COEFFS 0.000000 1.000000 -0.000000 0.000000 0.000000 1.000000 /end COMPU_METHOD
/* Scalar measurable for DDE 'HostProtocolIsoV1Enbl'. */
/begin MEASUREMENT HostProtocolIsoV1Enbl "Exported global for ISO15118-2 enable (post-override)." UBYTE CU_HOSTPROTOCOLISOV1ENBL 1 100 0.0 1.0 ECU_ADDRESS 0x70017d8f BYTE_ORDER MSB_LAST /end MEASUREMENT
/begin COMPU_METHOD CU_HOSTPROTOCOLISOV1ENBL "Conversion method for HostProtocolIsoV1Enbl" RAT_FUNC "%10.0" "b" COEFFS 0.000000 1.000000 -0.000000 0.000000 0.000000 1.000000 /end COMPU_METHOD
/* Scalar measurable for DDE 'HostProtocolIsoV2Enbl'. */
/begin MEASUREMENT HostProtocolIsoV2Enbl "Exported global for ISO15118-20 enable (post-override)." UBYTE CU_HOSTPROTOCOLISOV2ENBL 1 100 0.0 1.0 ECU_ADDRESS 0x700181b9 BYTE_ORDER MSB_LAST /end MEASUREMENT
/begin COMPU_METHOD CU_HOSTPROTOCOLISOV2ENBL "Conversion method for HostProtocolIsoV2Enbl" RAT_FUNC "%10.0" "b" COEFFS 0.000000 1.000000 -0.000000 0.000000 0.000000 1.000000 /end COMPU_METHOD
/* Scalar measurable for DDE 'HostPwminEvsePilotDutcyc'. */
/begin MEASUREMENT HostPwminEvsePilotDutcyc "duty_cycle percent feature for PWM Input of EVSE Pilot." FLOAT32_IEEE CU_HOSTPWMINEVSEPILOTDUTCYC 1 100 0.0 100.0 ECU_ADDRESS 0x70017c9c BYTE_ORDER MSB_LAST /end MEASUREMENT
/begin COMPU_METHOD CU_HOSTPWMINEVSEPILOTDUTCYC "Conversion method for HostPwminEvsePilotDutcyc" RAT_FUNC "%10.0" "%" COEFFS 0.000000 1.000000 -0.000000 0.000000 0.000000 1.000000 /end COMPU_METHOD
/* Scalar measurable for DDE 'HostPwminEvsePilotFreq'. */
/begin MEASUREMENT HostPwminEvsePilotFreq "Frequency of the last measured period for the PWM Input of EVSE Pilot" FLOAT32_IEEE CU_HOSTPWMINEVSEPILOTFREQ 1 100 0.0 10000000.0 ECU_ADDRESS 0x700180f0 BYTE_ORDER MSB_LAST /end MEASUREMENT
/begin COMPU_METHOD CU_HOSTPWMINEVSEPILOTFREQ "Conversion method for HostPwminEvsePilotFreq" RAT_FUNC "%10.0" "Hz" COEFFS 0.000000 1.000000 -0.000000 0.000000 0.000000 1.000000 /end COMPU_METHOD
/* Scalar measurable for DDE 'HostPwminEvsePilotTimeout'. */
/begin MEASUREMENT HostPwminEvsePilotTimeout "Timeout feature for PWM Input of EVSE Pilot (True if a complete period has not been measured for the timeout given by the mask parameter Time out, zero otherwise)." UBYTE CU_HOSTPWMINEVSEPILOTTIMEOUT 1 100 0.0 1.0 ECU_ADDRESS 0x70017c1c BYTE_ORDER MSB_LAST /end MEASUREMENT
/begin COMPU_METHOD CU_HOSTPWMINEVSEPILOTTIMEOUT "Conversion method for HostPwminEvsePilotTimeout" RAT_FUNC "%10.0" "b" COEFFS 0.000000 1.000000 -0.000000 0.000000 0.000000 1.000000 /end COMPU_METHOD
/* Scalar measurable for DDE 'HostRelayWeldCheckEnable'. */
/begin MEASUREMENT HostRelayWeldCheckEnable "(not defined)" UBYTE CU_HOSTRELAYWELDCHECKENABLE 1 100 0.0 1.0 ECU_ADDRESS 0x70017fc0 BYTE_ORDER MSB_LAST /end MEASUREMENT
/begin COMPU_METHOD CU_HOSTRELAYWELDCHECKENABLE "Conversion method for HostRelayWeldCheckEnable" RAT_FUNC "%10.0" "b" COEFFS 0.000000 1.000000 -0.000000 0.000000 0.000000 1.000000 /end COMPU_METHOD
/* Scalar measurable for DDE 'HostRemainTimeToFullSoc'. */
/begin MEASUREMENT HostRemainTimeToFullSoc "Estimated or calculated time until full charge is complete. For displaying on EVSE for user only." FLOAT32_IEEE CU_HOSTREMAINTIMETOFULLSOC 1 100 0.0 196605.0 ECU_ADDRESS 0x7001843c BYTE_ORDER MSB_LAST /end MEASUREMENT
/begin COMPU_METHOD CU_HOSTREMAINTIMETOFULLSOC "Conversion method for HostRemainTimeToFullSoc" RAT_FUNC "%10.0" "s" COEFFS 0.000000 1.000000 -0.000000 0.000000 0.000000 1.000000 /end COMPU_METHOD
/* Scalar measurable for DDE 'HostRemainTimetoBulkSoc'. */
/begin MEASUREMENT HostRemainTimetoBulkSoc "Estimated or calculated time until bulk charge is complete. For displaying on EVSE for user only." FLOAT32_IEEE CU_HOSTREMAINTIMETOBULKSOC 1 100 0.0 196605.0 ECU_ADDRESS 0x70017f08 BYTE_ORDER MSB_LAST /end MEASUREMENT
/begin COMPU_METHOD CU_HOSTREMAINTIMETOBULKSOC "Conversion method for HostRemainTimetoBulkSoc" RAT_FUNC "%10.0" "s" COEFFS 0.000000 1.000000 -0.000000 0.000000 0.000000 1.000000 /end COMPU_METHOD
/* Scalar measurable for DDE 'HostRessBulkSoc'. */
/begin MEASUREMENT HostRessBulkSoc "(not defined)" FLOAT32_IEEE CU_HOSTRESSBULKSOC 1 100 0.0 100.0 ECU_ADDRESS 0x7001837c BYTE_ORDER MSB_LAST /end MEASUREMENT
/begin COMPU_METHOD CU_HOSTRESSBULKSOC "Conversion method for HostRessBulkSoc" RAT_FUNC "%10.0" "%" COEFFS 0.000000 1.000000 -0.000000 0.000000 0.000000 1.000000 /end COMPU_METHOD
/* Scalar measurable for DDE 'HostRessSoc'. */
/begin MEASUREMENT HostRessSoc "(not defined)" FLOAT32_IEEE CU_HOSTRESSSOC 1 100 0.0 100.0 ECU_ADDRESS 0x70017e7c BYTE_ORDER MSB_LAST /end MEASUREMENT
/begin COMPU_METHOD CU_HOSTRESSSOC "Conversion method for HostRessSoc" RAT_FUNC "%10.0" "%" COEFFS 0.000000 1.000000 -0.000000 0.000000 0.000000 1.000000 /end COMPU_METHOD
/* Scalar measurable for DDE 'HostRessTargetSoc'. */
/begin MEASUREMENT HostRessTargetSoc "The state of charge desired by the EV" FLOAT32_IEEE CU_HOSTRESSTARGETSOC 1 100 0.0 196605.0 ECU_ADDRESS 0x700182c4 BYTE_ORDER MSB_LAST /end MEASUREMENT
/begin COMPU_METHOD CU_HOSTRESSTARGETSOC "Conversion method for HostRessTargetSoc" RAT_FUNC "%10.0" "Wh" COEFFS 0.000000 1.000000 -0.000000 0.000000 0.000000 1.000000 /end COMPU_METHOD
/* Scalar measurable for DDE 'HostRessVolt'. */
/begin MEASUREMENT HostRessVolt "Battery voltage" FLOAT32_IEEE CU_HOSTRESSVOLT 1 100 0.0 196605.0 ECU_ADDRESS 0x70017dd4 BYTE_ORDER MSB_LAST /end MEASUREMENT
/begin COMPU_METHOD CU_HOSTRESSVOLT "Conversion method for HostRessVolt" RAT_FUNC "%10.0" "V" COEFFS 0.000000 1.000000 -0.000000 0.000000 0.000000 1.000000 /end COMPU_METHOD
/* Scalar measurable for DDE 'V2gRxMsgSupPrtclRescode'. */
/begin MEASUREMENT V2gRxMsgSupPrtclRescode "for message SupportedAppProtocolRes: indicates the acknowledgment status of  this V2G messages received by the SECC." UBYTE CU_V2GRXMSGSUPPRTCLRESCODE 1 100 0.0 255.0 ECU_ADDRESS 0x70018365 BYTE_ORDER MSB_LAST /end MEASUREMENT
/begin COMPU_METHOD CU_V2GRXMSGSUPPRTCLRESCODE "Conversion method for V2gRxMsgSupPrtclRescode" RAT_FUNC "%10.0" "1" COEFFS 0.000000 1.000000 -0.000000 0.000000 0.000000 1.000000 /end COMPU_METHOD
/* Scalar measurable for DDE 'V2gRxMsgSupPrtclRxTrg'. */
/begin MEASUREMENT V2gRxMsgSupPrtclRxTrg "Trigger falg that on a rising edge indicates the event for receiving the PLC (V2G) message response SupportedAppProtocolRes from EVSE" UBYTE CU_V2GRXMSGSUPPRTCLRXTRG 1 100 0.0 1.0 ECU_ADDRESS 0x70018249 BYTE_ORDER MSB_LAST /end MEASUREMENT
/begin COMPU_METHOD CU_V2GRXMSGSUPPRTCLRXTRG "Conversion method for V2gRxMsgSupPrtclRxTrg" RAT_FUNC "%10.0" "b" COEFFS 0.000000 1.000000 -0.000000 0.000000 0.000000 1.000000 /end COMPU_METHOD
/* Scalar measurable for DDE 'V2gSlacLinkSt'. */
/begin MEASUREMENT V2gSlacLinkSt "Communication link status. Do not attempt to initiate communication unless the link status indicates connection." SLONG CU_V2GSLACLINKST 1 100 -2147483648.0 2147483647.0 ECU_ADDRESS 0x7001815c BYTE_ORDER MSB_LAST /end MEASUREMENT
/begin COMPU_METHOD CU_V2GSLACLINKST "Conversion method for V2gSlacLinkSt" TAB_VERB "%12.0" "enum" COMPU_TAB_REF CT_V2GSLACLINKST /end COMPU_METHOD
/begin COMPU_VTAB CT_V2GSLACLINKST "Conversion method for V2gSlacLinkSt" TAB_VERB 2 0 "PLC_LINK_DISCONNECTED" 1 "PLC_LINK_CONNECTED" /end COMPU_VTAB
/* Scalar measurable for DDE 'V2gSlacTcpSt'. */
/begin MEASUREMENT V2gSlacTcpSt "PLC Communication TCP connection status." SLONG CU_V2GSLACTCPST 1 100 -2147483648.0 2147483647.0 ECU_ADDRESS 0x700183c0 BYTE_ORDER MSB_LAST /end MEASUREMENT
/begin COMPU_METHOD CU_V2GSLACTCPST "Conversion method for V2gSlacTcpSt" TAB_VERB "%12.0" "enum" COMPU_TAB_REF CT_V2GSLACTCPST /end COMPU_METHOD
/begin COMPU_VTAB CT_V2GSLACTCPST "Conversion method for V2gSlacTcpSt" TAB_VERB 6 0 "PLC_TCP_DISCONNECTED" 1 "PLC_TCP_WAITING_SDP_RESPONSE" 2 "PLC_TCP_WAITING_SDP_READY" 3 "PLC_TCP_READY_TO_CONNECT" 4 "PLC_TCP_CONNECTING" 5 "PLC_TCP_CONNECTED" /end COMPU_VTAB
/* Scalar measurable for DDE 'V2gSupPrtclSelected'. */
/begin MEASUREMENT V2gSupPrtclSelected "Indicates the V2G protcol that the SECC has determined to use for this charging session" UBYTE CU_V2GSUPPRTCLSELECTED 1 100 0.0 1.0 ECU_ADDRESS 0x70017f8e BYTE_ORDER MSB_LAST /end MEASUREMENT
/begin COMPU_METHOD CU_V2GSUPPRTCLSELECTED "Conversion method for V2gSupPrtclSelected" RAT_FUNC "%10.0" "b" COEFFS 0.000000 1.000000 -0.000000 0.000000 0.000000 1.000000 /end COMPU_METHOD
/begin FUNCTION FaultBusDef "Group /ByModelHeirarchy/LaforgeTestApp_CCU/Core0-TestApp/V2G/OE_CCS/FLT/FaultBusDef"
 /begin LOC_MEASUREMENT CcsFltCpWrd CcsFltEvseSupPrtclWrd CcsFltInternalFaultsWrd CcsFltLinkWrd CcsFltPpWrd CcsFltRxEgyTrnsTypeWrd CcsFltRxEvVoltWrd CcsFltRxEvseCrntWrd CcsFltRxEvseIsolStWrd CcsFltRxEvseProcStWrd CcsFltRxEvsePwrWrd CcsFltRxEvseStCodeWrd CcsFltRxEvseVoltWrd CcsFltSeqWrd CcsFltStopFltResponse CcsFltV2gMsgWrd /end LOC_MEASUREMENT
/end FUNCTION
/begin FUNCTION FaultBitHandler3 "Group /ByModelHeirarchy/LaforgeTestApp_CCU/Core0-TestApp/V2G/OE_CCS/FLT/FltDiag/FaultBitHandler3" /begin REF_CHARACTERISTIC CcsFltCpEn_C /end REF_CHARACTERISTIC /end FUNCTION
/begin FUNCTION FaultBitHandler "Group /ByModelHeirarchy/LaforgeTestApp_CCU/Core0-TestApp/V2G/OE_CCS/FLT/FltDiag/leaky_bucket_FaultBitHandler/FaultBitHandler" /begin REF_CHARACTERISTIC CcsFltCpEn_C /end REF_CHARACTERISTIC /end FUNCTION
/begin FUNCTION leaky_bucket_FaultBitHandler "Group /ByModelHeirarchy/LaforgeTestApp_CCU/Core0-TestApp/V2G/OE_CCS/FLT/FltDiag/leaky_bucket_FaultBitHandler" /begin SUB_FUNCTION FaultBitHandler /end SUB_FUNCTION /begin REF_CHARACTERISTIC CcsFltCpEn_C /end REF_CHARACTERISTIC /end FUNCTION
/begin FUNCTION FaultBitHandler1 "Group /ByModelHeirarchy/LaforgeTestApp_CCU/Core0-TestApp/V2G/OE_CCS/FLT/FltDiag/leaky_bucket_FaultBitHandler1/FaultBitHandler" /begin REF_CHARACTERISTIC CcsFltCpEn_C /end REF_CHARACTERISTIC /end FUNCTION
/begin FUNCTION leaky_bucket_FaultBitHandler1 "Group /ByModelHeirarchy/LaforgeTestApp_CCU/Core0-TestApp/V2G/OE_CCS/FLT/FltDiag/leaky_bucket_FaultBitHandler1" /begin SUB_FUNCTION FaultBitHandler1 /end SUB_FUNCTION /begin REF_CHARACTERISTIC CcsFltCpEn_C /end REF_CHARACTERISTIC /end FUNCTION
/begin FUNCTION FaultBitHandler2 "Group /ByModelHeirarchy/LaforgeTestApp_CCU/Core0-TestApp/V2G/OE_CCS/FLT/FltDiag/leaky_bucket_FaultBitHandler2/FaultBitHandler" /begin REF_CHARACTERISTIC CcsFltCpEn_C /end REF_CHARACTERISTIC /end FUNCTION
/begin FUNCTION leaky_bucket_FaultBitHandler2 "Group /ByModelHeirarchy/LaforgeTestApp_CCU/Core0-TestApp/V2G/OE_CCS/FLT/FltDiag/leaky_bucket_FaultBitHandler2" /begin SUB_FUNCTION FaultBitHandler2 /end SUB_FUNCTION /begin REF_CHARACTERISTIC CcsFltCpEn_C /end REF_CHARACTERISTIC /end FUNCTION
/begin FUNCTION FaultBitHandler3 "Group /ByModelHeirarchy/LaforgeTestApp_CCU/Core0-TestApp/V2G/OE_CCS/FLT/FltDiag/leaky_bucket_FaultBitHandler3/FaultBitHandler" /begin REF_CHARACTERISTIC CcsFltCpEn_C /end REF_CHARACTERISTIC /end FUNCTION
/begin FUNCTION leaky_bucket_FaultBitHandler3 "Group /ByModelHeirarchy/LaforgeTestApp_CCU/Core0-TestApp/V2G/OE_CCS/FLT/FltDiag/leaky_bucket_FaultBitHandler3" /begin SUB_FUNCTION FaultBitHandler3 /end SUB_FUNCTION /begin REF_CHARACTERISTIC CcsFltCpEn_C /end REF_CHARACTERISTIC /end FUNCTION
/begin FUNCTION FaultBitHandler4 "Group /ByModelHeirarchy/LaforgeTestApp_CCU/Core0-TestApp/V2G/OE_CCS/FLT/FltDiag/leaky_bucket_FaultBitHandler5/FaultBitHandler" /begin REF_CHARACTERISTIC CcsFltCpEn_C /end REF_CHARACTERISTIC /end FUNCTION
/begin FUNCTION leaky_bucket_FaultBitHandler5 "Group /ByModelHeirarchy/LaforgeTestApp_CCU/Core0-TestApp/V2G/OE_CCS/FLT/FltDiag/leaky_bucket_FaultBitHandler5" /begin SUB_FUNCTION FaultBitHandler4 /end SUB_FUNCTION /begin REF_CHARACTERISTIC CcsFltCpEn_C /end REF_CHARACTERISTIC /end FUNCTION
/begin FUNCTION FltDiag "Group /ByModelHeirarchy/LaforgeTestApp_CCU/Core0-TestApp/V2G/OE_CCS/FLT/FltDiag"
 /begin SUB_FUNCTION FaultBitHandler3 leaky_bucket_FaultBitHandler leaky_bucket_FaultBitHandler1 leaky_bucket_FaultBitHandler2 leaky_bucket_FaultBitHandler3 leaky_bucket_FaultBitHandler5 /end SUB_FUNCTION
 /begin LOC_MEASUREMENT CcsFltCpWrd /end LOC_MEASUREMENT
 /begin REF_CHARACTERISTIC CcsFltCpDutcycOorhCmax_C CcsFltCpDutcycOorhLim_C CcsFltCpDutcycOorlCmax_C CcsFltCpDutcycOorlLim_C CcsFltCpEn_C CcsFltCpErrStOorCmax_C CcsFltCpErrStOorhLim_C CcsFltCpErrStOorlLim_C CcsFltCpFrqOorCmax_C CcsFltCpFrqOorhLim_C CcsFltCpFrqOorlLim_C CcsFltCpPwmtoCmax_C /end REF_CHARACTERISTIC
/end FUNCTION
/begin FUNCTION FaultBitHandler5 "Group /ByModelHeirarchy/LaforgeTestApp_CCU/Core0-TestApp/V2G/OE_CCS/FLT/FltDiag1/leaky_bucket_FaultBitHandler6/FaultBitHandler" /begin REF_CHARACTERISTIC CcsFltPpEn_C /end REF_CHARACTERISTIC /end FUNCTION
/begin FUNCTION leaky_bucket_FaultBitHandler6 "Group /ByModelHeirarchy/LaforgeTestApp_CCU/Core0-TestApp/V2G/OE_CCS/FLT/FltDiag1/leaky_bucket_FaultBitHandler6" /begin SUB_FUNCTION FaultBitHandler5 /end SUB_FUNCTION /begin REF_CHARACTERISTIC CcsFltPpEn_C /end REF_CHARACTERISTIC /end FUNCTION
/begin FUNCTION FaultBitHandler6 "Group /ByModelHeirarchy/LaforgeTestApp_CCU/Core0-TestApp/V2G/OE_CCS/FLT/FltDiag1/leaky_bucket_FaultBitHandler7/FaultBitHandler" /begin REF_CHARACTERISTIC CcsFltPpEn_C /end REF_CHARACTERISTIC /end FUNCTION
/begin FUNCTION leaky_bucket_FaultBitHandler7 "Group /ByModelHeirarchy/LaforgeTestApp_CCU/Core0-TestApp/V2G/OE_CCS/FLT/FltDiag1/leaky_bucket_FaultBitHandler7" /begin SUB_FUNCTION FaultBitHandler6 /end SUB_FUNCTION /begin REF_CHARACTERISTIC CcsFltPpEn_C /end REF_CHARACTERISTIC /end FUNCTION
/begin FUNCTION FaultBitHandler7 "Group /ByModelHeirarchy/LaforgeTestApp_CCU/Core0-TestApp/V2G/OE_CCS/FLT/FltDiag1/leaky_bucket_FaultBitHandler8/FaultBitHandler" /begin REF_CHARACTERISTIC CcsFltPpEn_C /end REF_CHARACTERISTIC /end FUNCTION
/begin FUNCTION leaky_bucket_FaultBitHandler8 "Group /ByModelHeirarchy/LaforgeTestApp_CCU/Core0-TestApp/V2G/OE_CCS/FLT/FltDiag1/leaky_bucket_FaultBitHandler8" /begin SUB_FUNCTION FaultBitHandler7 /end SUB_FUNCTION /begin REF_CHARACTERISTIC CcsFltPpEn_C /end REF_CHARACTERISTIC /end FUNCTION
/begin FUNCTION FaultBitHandler8 "Group /ByModelHeirarchy/LaforgeTestApp_CCU/Core0-TestApp/V2G/OE_CCS/FLT/FltDiag1/leaky_bucket_FaultBitHandler9/FaultBitHandler" /begin REF_CHARACTERISTIC CcsFltPpEn_C /end REF_CHARACTERISTIC /end FUNCTION
/begin FUNCTION leaky_bucket_FaultBitHandler9 "Group /ByModelHeirarchy/LaforgeTestApp_CCU/Core0-TestApp/V2G/OE_CCS/FLT/FltDiag1/leaky_bucket_FaultBitHandler9" /begin SUB_FUNCTION FaultBitHandler8 /end SUB_FUNCTION /begin REF_CHARACTERISTIC CcsFltPpEn_C /end REF_CHARACTERISTIC /end FUNCTION
/begin FUNCTION FltDiag1 "Group /ByModelHeirarchy/LaforgeTestApp_CCU/Core0-TestApp/V2G/OE_CCS/FLT/FltDiag1"
 /begin SUB_FUNCTION leaky_bucket_FaultBitHandler6 leaky_bucket_FaultBitHandler7 leaky_bucket_FaultBitHandler8 leaky_bucket_FaultBitHandler9 /end SUB_FUNCTION
 /begin LOC_MEASUREMENT CcsFltPpWrd /end LOC_MEASUREMENT
 /begin REF_CHARACTERISTIC CcsFltPpCpRatCmax_C CcsFltPpEn_C CcsFltPpVoltOorhCmax_C CcsFltPpVoltOorhLim_C CcsFltPpVoltOorlCmax_C CcsFltPpVoltOorlLim_C CcsFltPpVrefOorCmax_C CcsFltPpVrefOorhLim_C CcsFltPpVrefOorlLim_C /end REF_CHARACTERISTIC
/end FUNCTION
/begin FUNCTION FaultBitHandler1 "Group /ByModelHeirarchy/LaforgeTestApp_CCU/Core0-TestApp/V2G/OE_CCS/FLT/FltDiag10/Subsystem/FaultBitHandler1" /begin REF_CHARACTERISTIC CcsFltInternalFaultsEn_C /end REF_CHARACTERISTIC /end FUNCTION
/begin FUNCTION Subsystem "Group /ByModelHeirarchy/LaforgeTestApp_CCU/Core0-TestApp/V2G/OE_CCS/FLT/FltDiag10/Subsystem" /begin SUB_FUNCTION FaultBitHandler1 /end SUB_FUNCTION /begin REF_CHARACTERISTIC CcsFltInternalFaultsEn_C /end REF_CHARACTERISTIC /end FUNCTION
/begin FUNCTION FltDiag10 "Group /ByModelHeirarchy/LaforgeTestApp_CCU/Core0-TestApp/V2G/OE_CCS/FLT/FltDiag10" /begin SUB_FUNCTION Subsystem /end SUB_FUNCTION /begin LOC_MEASUREMENT CcsFltInternalFaultsWrd /end LOC_MEASUREMENT /end FUNCTION
/begin FUNCTION FaultBitHandler11 "Group /ByModelHeirarchy/LaforgeTestApp_CCU/Core0-TestApp/V2G/OE_CCS/FLT/FltDiag11/FaultBitHandler1" /begin REF_CHARACTERISTIC CcsFltLinkEn_C /end REF_CHARACTERISTIC /end FUNCTION
/begin FUNCTION FaultBitHandler2 "Group /ByModelHeirarchy/LaforgeTestApp_CCU/Core0-TestApp/V2G/OE_CCS/FLT/FltDiag11/FaultBitHandler2" /begin REF_CHARACTERISTIC CcsFltLinkEn_C /end REF_CHARACTERISTIC /end FUNCTION
/begin FUNCTION FaultBitHandler31 "Group /ByModelHeirarchy/LaforgeTestApp_CCU/Core0-TestApp/V2G/OE_CCS/FLT/FltDiag11/FaultBitHandler3" /begin REF_CHARACTERISTIC CcsFltLinkEn_C /end REF_CHARACTERISTIC /end FUNCTION
/begin FUNCTION FaultBitHandler4 "Group /ByModelHeirarchy/LaforgeTestApp_CCU/Core0-TestApp/V2G/OE_CCS/FLT/FltDiag11/FaultBitHandler4" /begin REF_CHARACTERISTIC CcsFltLinkEn_C /end REF_CHARACTERISTIC /end FUNCTION
/begin FUNCTION FltDiag11 "Group /ByModelHeirarchy/LaforgeTestApp_CCU/Core0-TestApp/V2G/OE_CCS/FLT/FltDiag11"
 /begin SUB_FUNCTION FaultBitHandler11 FaultBitHandler2 FaultBitHandler31 FaultBitHandler4 /end SUB_FUNCTION
 /begin LOC_MEASUREMENT CcsFltLinkWrd /end LOC_MEASUREMENT
 /begin REF_CHARACTERISTIC CcsFltLinkEn_C /end REF_CHARACTERISTIC
/end FUNCTION
/begin FUNCTION FaultBitHandler12 "Group /ByModelHeirarchy/LaforgeTestApp_CCU/Core0-TestApp/V2G/OE_CCS/FLT/FltDiag12/FaultBitHandler1" /begin REF_CHARACTERISTIC CcsFltRxSvcDiscEn_C /end REF_CHARACTERISTIC /end FUNCTION
/begin FUNCTION FaultBitHandler21 "Group /ByModelHeirarchy/LaforgeTestApp_CCU/Core0-TestApp/V2G/OE_CCS/FLT/FltDiag12/FaultBitHandler2" /begin REF_CHARACTERISTIC CcsFltRxSvcDiscEn_C /end REF_CHARACTERISTIC /end FUNCTION
/begin FUNCTION FaultBitHandler22 "Group /ByModelHeirarchy/LaforgeTestApp_CCU/Core0-TestApp/V2G/OE_CCS/FLT/FltDiag12/Subsystem/FaultBitHandler2" /begin REF_CHARACTERISTIC CcsFltRxSvcDiscEn_C /end REF_CHARACTERISTIC /end FUNCTION
/begin FUNCTION Subsystem1 "Group /ByModelHeirarchy/LaforgeTestApp_CCU/Core0-TestApp/V2G/OE_CCS/FLT/FltDiag12/Subsystem" /begin SUB_FUNCTION FaultBitHandler22 /end SUB_FUNCTION /begin REF_CHARACTERISTIC CcsFltRxSvcDiscEn_C /end REF_CHARACTERISTIC /end FUNCTION
/begin FUNCTION FltDiag12 "Group /ByModelHeirarchy/LaforgeTestApp_CCU/Core0-TestApp/V2G/OE_CCS/FLT/FltDiag12" /begin SUB_FUNCTION FaultBitHandler12 FaultBitHandler21 Subsystem1 /end SUB_FUNCTION /begin LOC_MEASUREMENT CcsFltEvseSupPrtclWrd /end LOC_MEASUREMENT /begin REF_CHARACTERISTIC CcsFltRxSvcDiscEn_C /end REF_CHARACTERISTIC /end FUNCTION
/begin FUNCTION FaultBitHandler13 "Group /ByModelHeirarchy/LaforgeTestApp_CCU/Core0-TestApp/V2G/OE_CCS/FLT/FltDiag13/Subsystem/FaultBitHandler1" /begin REF_CHARACTERISTIC CcsFltRxEvsePwrEn_C /end REF_CHARACTERISTIC /end FUNCTION
/begin FUNCTION FaultBitHandler32 "Group /ByModelHeirarchy/LaforgeTestApp_CCU/Core0-TestApp/V2G/OE_CCS/FLT/FltDiag13/Subsystem/FaultBitHandler3" /begin REF_CHARACTERISTIC CcsFltRxEvsePwrEn_C /end REF_CHARACTERISTIC /end FUNCTION
/begin FUNCTION Subsystem2 "Group /ByModelHeirarchy/LaforgeTestApp_CCU/Core0-TestApp/V2G/OE_CCS/FLT/FltDiag13/Subsystem" /begin SUB_FUNCTION FaultBitHandler13 FaultBitHandler32 /end SUB_FUNCTION /begin REF_CHARACTERISTIC CcsFltRxEvsePwrEn_C /end REF_CHARACTERISTIC /end FUNCTION
/begin FUNCTION FltDiag13 "Group /ByModelHeirarchy/LaforgeTestApp_CCU/Core0-TestApp/V2G/OE_CCS/FLT/FltDiag13" /begin SUB_FUNCTION Subsystem2 /end SUB_FUNCTION /begin LOC_MEASUREMENT CcsFltRxEvsePwrWrd /end LOC_MEASUREMENT /end FUNCTION
/begin FUNCTION FaultBitHandler9 "Group /ByModelHeirarchy/LaforgeTestApp_CCU/Core0-TestApp/V2G/OE_CCS/FLT/FltDiag2/FaultBitHandler" /begin REF_CHARACTERISTIC CcsFltV2gMsgEn_C /end REF_CHARACTERISTIC /end FUNCTION
/begin FUNCTION FaultBitHandler14 "Group /ByModelHeirarchy/LaforgeTestApp_CCU/Core0-TestApp/V2G/OE_CCS/FLT/FltDiag2/FaultBitHandler1" /begin REF_CHARACTERISTIC CcsFltV2gMsgEn_C /end REF_CHARACTERISTIC /end FUNCTION
/begin FUNCTION FaultBitHandler23 "Group /ByModelHeirarchy/LaforgeTestApp_CCU/Core0-TestApp/V2G/OE_CCS/FLT/FltDiag2/FaultBitHandler2" /begin REF_CHARACTERISTIC CcsFltV2gMsgEn_C /end REF_CHARACTERISTIC /end FUNCTION
/begin FUNCTION FaultBitHandler33 "Group /ByModelHeirarchy/LaforgeTestApp_CCU/Core0-TestApp/V2G/OE_CCS/FLT/FltDiag2/FaultBitHandler3" /begin REF_CHARACTERISTIC CcsFltV2gMsgEn_C /end REF_CHARACTERISTIC /end FUNCTION
/begin FUNCTION FaultBitHandler41 "Group /ByModelHeirarchy/LaforgeTestApp_CCU/Core0-TestApp/V2G/OE_CCS/FLT/FltDiag2/FaultBitHandler4" /begin REF_CHARACTERISTIC CcsFltV2gMsgEn_C /end REF_CHARACTERISTIC /end FUNCTION
/begin FUNCTION FaultBitHandler5 "Group /ByModelHeirarchy/LaforgeTestApp_CCU/Core0-TestApp/V2G/OE_CCS/FLT/FltDiag2/FaultBitHandler5" /begin REF_CHARACTERISTIC CcsFltV2gMsgEn_C /end REF_CHARACTERISTIC /end FUNCTION
/begin FUNCTION FaultBitHandler6 "Group /ByModelHeirarchy/LaforgeTestApp_CCU/Core0-TestApp/V2G/OE_CCS/FLT/FltDiag2/FaultBitHandler6" /begin REF_CHARACTERISTIC CcsFltV2gMsgEn_C /end REF_CHARACTERISTIC /end FUNCTION
/begin FUNCTION FaultBitHandler7 "Group /ByModelHeirarchy/LaforgeTestApp_CCU/Core0-TestApp/V2G/OE_CCS/FLT/FltDiag2/FaultBitHandler7" /begin REF_CHARACTERISTIC CcsFltV2gMsgEn_C /end REF_CHARACTERISTIC /end FUNCTION
/begin FUNCTION V2gResponseMessageTimeoutDIN "Group /ByModelHeirarchy/LaforgeTestApp_CCU/Core0-TestApp/V2G/OE_CCS/FLT/FltDiag2/V2gResponseMessageTimeoutDIN"
 /begin REF_CHARACTERISTIC CcsFltV2gMsgAuthVmto_C CcsFltV2gMsgCblChkVmto_C CcsFltV2gMsgCrntDmdVmto_C CcsFltV2gMsgParamDiscVmto_C CcsFltV2gMsgPrechglVmto_C CcsFltV2gMsgPwrDelivVmto_C CcsFltV2gMsgPymtSelVmto_C CcsFltV2gMsgSesSetupVmto_C CcsFltV2gMsgSesStopVmto_C CcsFltV2gMsgSupPrtclVmto_C CcsFltV2gMsgSvcDiscVmto_C CcsFltV2gMsgWeldDetVmto_C /end REF_CHARACTERISTIC
/end FUNCTION
/begin FUNCTION V2gResponseMessageTimeoutISO "Group /ByModelHeirarchy/LaforgeTestApp_CCU/Core0-TestApp/V2G/OE_CCS/FLT/FltDiag2/V2gResponseMessageTimeoutISO"
 /begin REF_CHARACTERISTIC CcsFltV2gMsgAuthVmto_C CcsFltV2gMsgBptCtrlVmto_C CcsFltV2gMsgCblChkVmto_C CcsFltV2gMsgCrntDmdIsoVmto_C CcsFltV2gMsgParamDiscVmto_C CcsFltV2gMsgPrechglVmto_C CcsFltV2gMsgPwrDelivIsoVmto_C CcsFltV2gMsgPymtSelVmto_C CcsFltV2gMsgSesSetupVmto_C CcsFltV2gMsgSesStopVmto_C CcsFltV2gMsgSupPrtclVmto_C CcsFltV2gMsgSvcDetailVmto_C CcsFltV2gMsgSvcDiscVmto_C CcsFltV2gMsgWeldDetVmto_C /end REF_CHARACTERISTIC
/end FUNCTION
/begin FUNCTION FltDiag2 "Group /ByModelHeirarchy/LaforgeTestApp_CCU/Core0-TestApp/V2G/OE_CCS/FLT/FltDiag2"
 /begin SUB_FUNCTION FaultBitHandler9 FaultBitHandler14 FaultBitHandler23 FaultBitHandler33 FaultBitHandler41 FaultBitHandler5 FaultBitHandler6 FaultBitHandler7 V2gResponseMessageTimeoutDIN V2gResponseMessageTimeoutISO /end SUB_FUNCTION
 /begin LOC_MEASUREMENT CcsFltV2gMsgWrd /end LOC_MEASUREMENT
 /begin REF_CHARACTERISTIC CcsFltV2gMsgEn_C /end REF_CHARACTERISTIC
/end FUNCTION
/begin FUNCTION FaultBitHandle00 "Group /ByModelHeirarchy/LaforgeTestApp_CCU/Core0-TestApp/V2G/OE_CCS/FLT/FltDiag3/leaky_bucket_FaultBitHandler1/FaultBitHandler" /begin REF_CHARACTERISTIC CcsFltSeqEn_C /end REF_CHARACTERISTIC /end FUNCTION
/begin FUNCTION leaky_bucket_FaultBitHandler11 "Group /ByModelHeirarchy/LaforgeTestApp_CCU/Core0-TestApp/V2G/OE_CCS/FLT/FltDiag3/leaky_bucket_FaultBitHandler1" /begin SUB_FUNCTION FaultBitHandle00 /end SUB_FUNCTION /begin REF_CHARACTERISTIC CcsFltSeqEn_C /end REF_CHARACTERISTIC /end FUNCTION
/begin FUNCTION FaultBitHandle01 "Group /ByModelHeirarchy/LaforgeTestApp_CCU/Core0-TestApp/V2G/OE_CCS/FLT/FltDiag3/leaky_bucket_FaultBitHandler2/FaultBitHandler" /begin REF_CHARACTERISTIC CcsFltSeqEn_C /end REF_CHARACTERISTIC /end FUNCTION
/begin FUNCTION leaky_bucket_FaultBitHandler21 "Group /ByModelHeirarchy/LaforgeTestApp_CCU/Core0-TestApp/V2G/OE_CCS/FLT/FltDiag3/leaky_bucket_FaultBitHandler2" /begin SUB_FUNCTION FaultBitHandle01 /end SUB_FUNCTION /begin REF_CHARACTERISTIC CcsFltSeqEn_C /end REF_CHARACTERISTIC /end FUNCTION
/begin FUNCTION FaultBitHandle02 "Group /ByModelHeirarchy/LaforgeTestApp_CCU/Core0-TestApp/V2G/OE_CCS/FLT/FltDiag3/leaky_bucket_FaultBitHandler3/FaultBitHandler" /begin REF_CHARACTERISTIC CcsFltSeqEn_C /end REF_CHARACTERISTIC /end FUNCTION
/begin FUNCTION leaky_bucket_FaultBitHandler31 "Group /ByModelHeirarchy/LaforgeTestApp_CCU/Core0-TestApp/V2G/OE_CCS/FLT/FltDiag3/leaky_bucket_FaultBitHandler3" /begin SUB_FUNCTION FaultBitHandle02 /end SUB_FUNCTION /begin REF_CHARACTERISTIC CcsFltSeqEn_C /end REF_CHARACTERISTIC /end FUNCTION
/begin FUNCTION FaultBitHandle03 "Group /ByModelHeirarchy/LaforgeTestApp_CCU/Core0-TestApp/V2G/OE_CCS/FLT/FltDiag3/leaky_bucket_FaultBitHandler4/FaultBitHandler" /begin REF_CHARACTERISTIC CcsFltSeqEn_C /end REF_CHARACTERISTIC /end FUNCTION
/begin FUNCTION leaky_bucket_FaultBitHandler4 "Group /ByModelHeirarchy/LaforgeTestApp_CCU/Core0-TestApp/V2G/OE_CCS/FLT/FltDiag3/leaky_bucket_FaultBitHandler4" /begin SUB_FUNCTION FaultBitHandle03 /end SUB_FUNCTION /begin REF_CHARACTERISTIC CcsFltSeqEn_C /end REF_CHARACTERISTIC /end FUNCTION
/begin FUNCTION FaultBitHandle04 "Group /ByModelHeirarchy/LaforgeTestApp_CCU/Core0-TestApp/V2G/OE_CCS/FLT/FltDiag3/leaky_bucket_FaultBitHandler5/FaultBitHandler" /begin REF_CHARACTERISTIC CcsFltSeqEn_C /end REF_CHARACTERISTIC /end FUNCTION
/begin FUNCTION leaky_bucket_FaultBitHandler51 "Group /ByModelHeirarchy/LaforgeTestApp_CCU/Core0-TestApp/V2G/OE_CCS/FLT/FltDiag3/leaky_bucket_FaultBitHandler5" /begin SUB_FUNCTION FaultBitHandle04 /end SUB_FUNCTION /begin REF_CHARACTERISTIC CcsFltSeqEn_C /end REF_CHARACTERISTIC /end FUNCTION
/begin FUNCTION FaultBitHandle05 "Group /ByModelHeirarchy/LaforgeTestApp_CCU/Core0-TestApp/V2G/OE_CCS/FLT/FltDiag3/leaky_bucket_FaultBitHandler6/FaultBitHandler" /begin REF_CHARACTERISTIC CcsFltSeqEn_C /end REF_CHARACTERISTIC /end FUNCTION
/begin FUNCTION leaky_bucket_FaultBitHandler61 "Group /ByModelHeirarchy/LaforgeTestApp_CCU/Core0-TestApp/V2G/OE_CCS/FLT/FltDiag3/leaky_bucket_FaultBitHandler6" /begin SUB_FUNCTION FaultBitHandle05 /end SUB_FUNCTION /begin REF_CHARACTERISTIC CcsFltSeqEn_C /end REF_CHARACTERISTIC /end FUNCTION
/begin FUNCTION FaultBitHandle06 "Group /ByModelHeirarchy/LaforgeTestApp_CCU/Core0-TestApp/V2G/OE_CCS/FLT/FltDiag3/leaky_bucket_FaultBitHandler7/FaultBitHandler" /begin REF_CHARACTERISTIC CcsFltSeqEn_C /end REF_CHARACTERISTIC /end FUNCTION
/begin FUNCTION leaky_bucket_FaultBitHandler71 "Group /ByModelHeirarchy/LaforgeTestApp_CCU/Core0-TestApp/V2G/OE_CCS/FLT/FltDiag3/leaky_bucket_FaultBitHandler7" /begin SUB_FUNCTION FaultBitHandle06 /end SUB_FUNCTION /begin REF_CHARACTERISTIC CcsFltSeqEn_C /end REF_CHARACTERISTIC /end FUNCTION
/begin FUNCTION FltDiag3 "Group /ByModelHeirarchy/LaforgeTestApp_CCU/Core0-TestApp/V2G/OE_CCS/FLT/FltDiag3"
 /begin SUB_FUNCTION leaky_bucket_FaultBitHandler11 leaky_bucket_FaultBitHandler21 leaky_bucket_FaultBitHandler31 leaky_bucket_FaultBitHandler4 leaky_bucket_FaultBitHandler51 leaky_bucket_FaultBitHandler61 leaky_bucket_FaultBitHandler71 /end SUB_FUNCTION
 /begin LOC_MEASUREMENT CcsFltSeqWrd /end LOC_MEASUREMENT
 /begin REF_CHARACTERISTIC CcsFltSeqChgReadyVstoCmax_C CcsFltSeqChgReadyVstoLim_C CcsFltSeqCommSetupVstoCmax_C CcsFltSeqCommSetupVstoLim_C CcsFltSeqEn_C CcsFltSeqIsolCheckVstoCmax_C CcsFltSeqIsolCheckVstoLim_C CcsFltSeqIsolStopVstoCmax_C CcsFltSeqIsolStopVstoLim_C CcsFltSeqLockEnVstoCmax_C CcsFltSeqLockEnVstoLim_C CcsFltSeqPrechgVstoCmax_C CcsFltSeqPrechgVstoLim_C CcsFltSeqRlyCloseVstoCmax_C CcsFltSeqRlyCloseVstoLim_C CcsStmDelayQcaStartup_C /end REF_CHARACTERISTIC
/end FUNCTION
/begin FUNCTION FaultBitHandler15 "Group /ByModelHeirarchy/LaforgeTestApp_CCU/Core0-TestApp/V2G/OE_CCS/FLT/FltDiag4/Subsystem/FaultBitHandler1" /begin REF_CHARACTERISTIC CcsFltRxEvseProcStEn_C /end REF_CHARACTERISTIC /end FUNCTION
/begin FUNCTION Subsystem3 "Group /ByModelHeirarchy/LaforgeTestApp_CCU/Core0-TestApp/V2G/OE_CCS/FLT/FltDiag4/Subsystem" /begin SUB_FUNCTION FaultBitHandler15 /end SUB_FUNCTION /begin REF_CHARACTERISTIC CcsFltEvseProcV2GtoLim_C CcsFltRxEvseProcStEn_C /end REF_CHARACTERISTIC /end FUNCTION
/begin FUNCTION FltDiag4 "Group /ByModelHeirarchy/LaforgeTestApp_CCU/Core0-TestApp/V2G/OE_CCS/FLT/FltDiag4" /begin SUB_FUNCTION Subsystem3 /end SUB_FUNCTION /begin LOC_MEASUREMENT CcsFltRxEvseProcStWrd /end LOC_MEASUREMENT /end FUNCTION
/begin FUNCTION FaultBitHandler16 "Group /ByModelHeirarchy/LaforgeTestApp_CCU/Core0-TestApp/V2G/OE_CCS/FLT/FltDiag5/Subsystem/FaultBitHandler1" /begin REF_CHARACTERISTIC CcsFltRxEvseIsolStEn_C /end REF_CHARACTERISTIC /end FUNCTION
/begin FUNCTION FaultBitHandler24 "Group /ByModelHeirarchy/LaforgeTestApp_CCU/Core0-TestApp/V2G/OE_CCS/FLT/FltDiag5/Subsystem/FaultBitHandler2" /begin REF_CHARACTERISTIC CcsFltRxEvseIsolStEn_C /end REF_CHARACTERISTIC /end FUNCTION
/begin FUNCTION FaultBitHandler34 "Group /ByModelHeirarchy/LaforgeTestApp_CCU/Core0-TestApp/V2G/OE_CCS/FLT/FltDiag5/Subsystem/FaultBitHandler3" /begin REF_CHARACTERISTIC CcsFltRxEvseIsolStEn_C /end REF_CHARACTERISTIC /end FUNCTION
/begin FUNCTION Subsystem4 "Group /ByModelHeirarchy/LaforgeTestApp_CCU/Core0-TestApp/V2G/OE_CCS/FLT/FltDiag5/Subsystem" /begin SUB_FUNCTION FaultBitHandler16 FaultBitHandler24 FaultBitHandler34 /end SUB_FUNCTION /begin REF_CHARACTERISTIC CcsFltRxEvseIsolStEn_C /end REF_CHARACTERISTIC /end FUNCTION
/begin FUNCTION FltDiag5 "Group /ByModelHeirarchy/LaforgeTestApp_CCU/Core0-TestApp/V2G/OE_CCS/FLT/FltDiag5" /begin SUB_FUNCTION Subsystem4 /end SUB_FUNCTION /begin LOC_MEASUREMENT CcsFltRxEvseIsolStWrd /end LOC_MEASUREMENT /end FUNCTION
/begin FUNCTION FaultBitHandler17 "Group /ByModelHeirarchy/LaforgeTestApp_CCU/Core0-TestApp/V2G/OE_CCS/FLT/FltDiag6/Subsystem/FaultBitHandler1" /begin REF_CHARACTERISTIC CcsFltRxEvseStCodeEn_C /end REF_CHARACTERISTIC /end FUNCTION
/begin FUNCTION FaultBitHandler25 "Group /ByModelHeirarchy/LaforgeTestApp_CCU/Core0-TestApp/V2G/OE_CCS/FLT/FltDiag6/Subsystem/FaultBitHandler2" /begin REF_CHARACTERISTIC CcsFltRxEvseStCodeEn_C /end REF_CHARACTERISTIC /end FUNCTION
/begin FUNCTION FaultBitHandler35 "Group /ByModelHeirarchy/LaforgeTestApp_CCU/Core0-TestApp/V2G/OE_CCS/FLT/FltDiag6/Subsystem/FaultBitHandler3" /begin REF_CHARACTERISTIC CcsFltRxEvseStCodeEn_C /end REF_CHARACTERISTIC /end FUNCTION
/begin FUNCTION FaultBitHandler42 "Group /ByModelHeirarchy/LaforgeTestApp_CCU/Core0-TestApp/V2G/OE_CCS/FLT/FltDiag6/Subsystem/FaultBitHandler4" /begin REF_CHARACTERISTIC CcsFltRxEvseStCodeEn_C /end REF_CHARACTERISTIC /end FUNCTION
/begin FUNCTION Subsystem5 "Group /ByModelHeirarchy/LaforgeTestApp_CCU/Core0-TestApp/V2G/OE_CCS/FLT/FltDiag6/Subsystem"
 /begin SUB_FUNCTION FaultBitHandler17 FaultBitHandler25 FaultBitHandler35 FaultBitHandler42 /end SUB_FUNCTION
 /begin REF_CHARACTERISTIC CcsFltRxEvseStCodeEn_C /end REF_CHARACTERISTIC
/end FUNCTION
/begin FUNCTION FltDiag6 "Group /ByModelHeirarchy/LaforgeTestApp_CCU/Core0-TestApp/V2G/OE_CCS/FLT/FltDiag6" /begin SUB_FUNCTION Subsystem5 /end SUB_FUNCTION /begin LOC_MEASUREMENT CcsFltRxEvseStCodeWrd /end LOC_MEASUREMENT /end FUNCTION
/begin FUNCTION FaultBitHandler18 "Group /ByModelHeirarchy/LaforgeTestApp_CCU/Core0-TestApp/V2G/OE_CCS/FLT/FltDiag7/Subsystem/FaultBitHandler1" /begin REF_CHARACTERISTIC CcsFltRxEgyTrnsTypeEn_C /end REF_CHARACTERISTIC /end FUNCTION
/begin FUNCTION FaultBitHandler26 "Group /ByModelHeirarchy/LaforgeTestApp_CCU/Core0-TestApp/V2G/OE_CCS/FLT/FltDiag7/Subsystem/FaultBitHandler2" /begin REF_CHARACTERISTIC CcsFltRxEgyTrnsTypeEn_C /end REF_CHARACTERISTIC /end FUNCTION
/begin FUNCTION Subsystem6 "Group /ByModelHeirarchy/LaforgeTestApp_CCU/Core0-TestApp/V2G/OE_CCS/FLT/FltDiag7/Subsystem" /begin SUB_FUNCTION FaultBitHandler18 FaultBitHandler26 /end SUB_FUNCTION /begin REF_CHARACTERISTIC CcsFltRxEgyTrnsTypeEn_C /end REF_CHARACTERISTIC /end FUNCTION
/begin FUNCTION FltDiag7 "Group /ByModelHeirarchy/LaforgeTestApp_CCU/Core0-TestApp/V2G/OE_CCS/FLT/FltDiag7" /begin SUB_FUNCTION Subsystem6 /end SUB_FUNCTION /begin LOC_MEASUREMENT CcsFltRxEgyTrnsTypeWrd /end LOC_MEASUREMENT /end FUNCTION
/begin FUNCTION FaultBitHandler19 "Group /ByModelHeirarchy/LaforgeTestApp_CCU/Core0-TestApp/V2G/OE_CCS/FLT/FltDiag8/Subsystem/FaultBitHandler1" /begin REF_CHARACTERISTIC CcsFltRxEvseVoltEn_C /end REF_CHARACTERISTIC /end FUNCTION
/begin FUNCTION FaultBitHandler27 "Group /ByModelHeirarchy/LaforgeTestApp_CCU/Core0-TestApp/V2G/OE_CCS/FLT/FltDiag8/Subsystem/FaultBitHandler2" /begin REF_CHARACTERISTIC CcsFltRxEvseVoltEn_C /end REF_CHARACTERISTIC /end FUNCTION
/begin FUNCTION FaultBitHandler36 "Group /ByModelHeirarchy/LaforgeTestApp_CCU/Core0-TestApp/V2G/OE_CCS/FLT/FltDiag8/Subsystem/FaultBitHandler3" /begin REF_CHARACTERISTIC CcsFltRxEvseVoltEn_C /end REF_CHARACTERISTIC /end FUNCTION
/begin FUNCTION FaultBitHandler51 "Group /ByModelHeirarchy/LaforgeTestApp_CCU/Core0-TestApp/V2G/OE_CCS/FLT/FltDiag8/Subsystem/FaultBitHandler5" /begin REF_CHARACTERISTIC CcsFltRxEvVoltEn_C /end REF_CHARACTERISTIC /end FUNCTION
/begin FUNCTION FaultBitHandler61 "Group /ByModelHeirarchy/LaforgeTestApp_CCU/Core0-TestApp/V2G/OE_CCS/FLT/FltDiag8/Subsystem/FaultBitHandler6" /begin REF_CHARACTERISTIC CcsFltRxEvVoltEn_C /end REF_CHARACTERISTIC /end FUNCTION
/begin FUNCTION FaultBitHandler71 "Group /ByModelHeirarchy/LaforgeTestApp_CCU/Core0-TestApp/V2G/OE_CCS/FLT/FltDiag8/Subsystem/FaultBitHandler7" /begin REF_CHARACTERISTIC CcsFltRxEvseVoltEn_C /end REF_CHARACTERISTIC /end FUNCTION
/begin FUNCTION FaultBitHandle07 "Group /ByModelHeirarchy/LaforgeTestApp_CCU/Core0-TestApp/V2G/OE_CCS/FLT/FltDiag8/Subsystem/leaky_bucket_FaultBitHandler8/FaultBitHandler" /begin REF_CHARACTERISTIC CcsFltRxEvseVoltEn_C /end REF_CHARACTERISTIC /end FUNCTION
/begin FUNCTION leaky_bucket_FaultBitHandler81 "Group /ByModelHeirarchy/LaforgeTestApp_CCU/Core0-TestApp/V2G/OE_CCS/FLT/FltDiag8/Subsystem/leaky_bucket_FaultBitHandler8" /begin SUB_FUNCTION FaultBitHandle07 /end SUB_FUNCTION /begin REF_CHARACTERISTIC CcsFltRxEvseVoltEn_C /end REF_CHARACTERISTIC /end FUNCTION
/begin FUNCTION FaultBitHandle08 "Group /ByModelHeirarchy/LaforgeTestApp_CCU/Core0-TestApp/V2G/OE_CCS/FLT/FltDiag8/Subsystem/leaky_bucket_FaultBitHandler9/FaultBitHandler" /begin REF_CHARACTERISTIC CcsFltRxEvseVoltEn_C /end REF_CHARACTERISTIC /end FUNCTION
/begin FUNCTION leaky_bucket_FaultBitHandler91 "Group /ByModelHeirarchy/LaforgeTestApp_CCU/Core0-TestApp/V2G/OE_CCS/FLT/FltDiag8/Subsystem/leaky_bucket_FaultBitHandler9" /begin SUB_FUNCTION FaultBitHandle08 /end SUB_FUNCTION /begin REF_CHARACTERISTIC CcsFltRxEvseVoltEn_C /end REF_CHARACTERISTIC /end FUNCTION
/begin FUNCTION Subsystem7 "Group /ByModelHeirarchy/LaforgeTestApp_CCU/Core0-TestApp/V2G/OE_CCS/FLT/FltDiag8/Subsystem"
 /begin SUB_FUNCTION FaultBitHandler19 FaultBitHandler27 FaultBitHandler36 FaultBitHandler51 FaultBitHandler61 FaultBitHandler71 leaky_bucket_FaultBitHandler81 leaky_bucket_FaultBitHandler91 /end SUB_FUNCTION
 /begin REF_CHARACTERISTIC CcsFltRxEvVoltEn_C CcsFltRxEvseVoltEn_C CcsFltRxEvseVoltPortOocCmax_C CcsFltRxEvseVoltPortOocLim_C CcsFltRxEvseVoltRessOocCmax_C CcsFltRxEvseVoltRessOocLim_C /end REF_CHARACTERISTIC
/end FUNCTION
/begin FUNCTION FltDiag8 "Group /ByModelHeirarchy/LaforgeTestApp_CCU/Core0-TestApp/V2G/OE_CCS/FLT/FltDiag8" /begin SUB_FUNCTION Subsystem7 /end SUB_FUNCTION /begin LOC_MEASUREMENT CcsFltRxEvVoltWrd CcsFltRxEvseVoltWrd /end LOC_MEASUREMENT /end FUNCTION
/begin FUNCTION FaultBitHandler10 "Group /ByModelHeirarchy/LaforgeTestApp_CCU/Core0-TestApp/V2G/OE_CCS/FLT/FltDiag9/Subsystem/FaultBitHandler1" /begin REF_CHARACTERISTIC CcsFltRxEvseCrntEn_C /end REF_CHARACTERISTIC /end FUNCTION
/begin FUNCTION FaultBitHandler37 "Group /ByModelHeirarchy/LaforgeTestApp_CCU/Core0-TestApp/V2G/OE_CCS/FLT/FltDiag9/Subsystem/FaultBitHandler3" /begin REF_CHARACTERISTIC CcsFltRxEvseCrntEn_C /end REF_CHARACTERISTIC /end FUNCTION
/begin FUNCTION FaultBitHandler52 "Group /ByModelHeirarchy/LaforgeTestApp_CCU/Core0-TestApp/V2G/OE_CCS/FLT/FltDiag9/Subsystem/FaultBitHandler5" /begin REF_CHARACTERISTIC CcsFltRxEvseCrntEn_C /end REF_CHARACTERISTIC /end FUNCTION
/begin FUNCTION FaultBitHandler62 "Group /ByModelHeirarchy/LaforgeTestApp_CCU/Core0-TestApp/V2G/OE_CCS/FLT/FltDiag9/Subsystem/FaultBitHandler6" /begin REF_CHARACTERISTIC CcsFltRxEvseCrntEn_C /end REF_CHARACTERISTIC /end FUNCTION
/begin FUNCTION FaultBitHandler72 "Group /ByModelHeirarchy/LaforgeTestApp_CCU/Core0-TestApp/V2G/OE_CCS/FLT/FltDiag9/Subsystem/FaultBitHandler7" /begin REF_CHARACTERISTIC CcsFltRxEvseCrntEn_C /end REF_CHARACTERISTIC /end FUNCTION
/begin FUNCTION FaultBitHandle09 "Group /ByModelHeirarchy/LaforgeTestApp_CCU/Core0-TestApp/V2G/OE_CCS/FLT/FltDiag9/Subsystem/leaky_bucket_FaultBitHandler9/FaultBitHandler" /begin REF_CHARACTERISTIC CcsFltRxEvseCrntEn_C /end REF_CHARACTERISTIC /end FUNCTION
/begin FUNCTION leaky_bucket_FaultBitHandler92 "Group /ByModelHeirarchy/LaforgeTestApp_CCU/Core0-TestApp/V2G/OE_CCS/FLT/FltDiag9/Subsystem/leaky_bucket_FaultBitHandler9" /begin SUB_FUNCTION FaultBitHandle09 /end SUB_FUNCTION /begin REF_CHARACTERISTIC CcsFltRxEvseCrntEn_C /end REF_CHARACTERISTIC /end FUNCTION
/begin FUNCTION Subsystem8 "Group /ByModelHeirarchy/LaforgeTestApp_CCU/Core0-TestApp/V2G/OE_CCS/FLT/FltDiag9/Subsystem"
 /begin SUB_FUNCTION FaultBitHandler10 FaultBitHandler37 FaultBitHandler52 FaultBitHandler62 FaultBitHandler72 leaky_bucket_FaultBitHandler92 /end SUB_FUNCTION
 /begin REF_CHARACTERISTIC CcsFltRxEvseCrntEn_C CcsFltRxEvseCrntPortOocCmax_C CcsFltRxEvseCrntPortOocLim_C /end REF_CHARACTERISTIC
/end FUNCTION
/begin FUNCTION FltDiag9 "Group /ByModelHeirarchy/LaforgeTestApp_CCU/Core0-TestApp/V2G/OE_CCS/FLT/FltDiag9" /begin SUB_FUNCTION Subsystem8 /end SUB_FUNCTION /begin LOC_MEASUREMENT CcsFltRxEvseCrntWrd /end LOC_MEASUREMENT /end FUNCTION
/begin FUNCTION FLT "Group /ByModelHeirarchy/LaforgeTestApp_CCU/Core0-TestApp/V2G/OE_CCS/FLT"
 /begin SUB_FUNCTION CcsFltStopFaultResponse FaultBusDef FltDiag FltDiag1 FltDiag10 FltDiag11 FltDiag12 FltDiag13 FltDiag2 FltDiag3 FltDiag4 FltDiag5 FltDiag6 FltDiag7 FltDiag8 FltDiag9 /end SUB_FUNCTION
/end FUNCTION
/begin FUNCTION CcsIprAc "Group /ByModelHeirarchy/LaforgeTestApp_CCU/Core0-TestApp/V2G/OE_CCS/IPR/CcsIprAc" /begin LOC_MEASUREMENT CcsIprAcdAvlbMaxAcChgCrnt CcsIprAcdAvlbMaxAcChgCrntPwm /end LOC_MEASUREMENT
 /begin REF_CHARACTERISTIC CcsIprAcdMaxAcCrntRange4Ofst1_C CcsIprAcdMaxAcCrntRange5Gain1_C CcsIprAcdMaxAcCrntRange5Ofst1_C CcsIprAcdMaxAcCrntRange6Gain1_C CcsIprAcdMaxAcCrntRange6Gain2_C CcsIprAcdMaxAcCrntRange7Gain1_C CcsIprAcdMaxAcCrntRange7Gain2_C CcsIprAcdMaxAcCrntRange7Ofst1_C CcsIprAcdMaxAcCrntRange8Gain1_C CcsIprAcdMaxAcCrntRange8Ofst1_C /end REF_CHARACTERISTIC
/end FUNCTION
/begin FUNCTION DigitalDebounce "Group /ByModelHeirarchy/LaforgeTestApp_CCU/Core0-TestApp/V2G/OE_CCS/IPR/CcsIprCp/CpChargingMode/DigitalDebounce" /begin REF_CHARACTERISTIC CcsIprCpDutcycPct5DbncTime_C /end REF_CHARACTERISTIC /end FUNCTION
/begin FUNCTION DigitalDebounce11 "Group /ByModelHeirarchy/LaforgeTestApp_CCU/Core0-TestApp/V2G/OE_CCS/IPR/CcsIprCp/CpChargingMode/DigitalDebounce1" /begin REF_CHARACTERISTIC CcsIprCpDutcycAcDbncTime_C /end REF_CHARACTERISTIC /end FUNCTION
/begin FUNCTION OVR_AndExport112 "Group /ByModelHeirarchy/LaforgeTestApp_CCU/Core0-TestApp/V2G/OE_CCS/IPR/CcsIprCp/CpChargingMode/OVR_AndExport11" /begin LOC_MEASUREMENT CcsIprCpChargingMode /end LOC_MEASUREMENT /begin REF_CHARACTERISTIC CcsIprCpChargingModeOf_C CcsIprCpChargingModeOv_C /end REF_CHARACTERISTIC /end FUNCTION
/begin FUNCTION CpChargingMode "Group /ByModelHeirarchy/LaforgeTestApp_CCU/Core0-TestApp/V2G/OE_CCS/IPR/CcsIprCp/CpChargingMode" /begin SUB_FUNCTION DigitalDebounce DigitalDebounce11 OVR_AndExport112 /end SUB_FUNCTION
 /begin LOC_MEASUREMENT CcsIprCpDutcycAc CcsIprCpDutcycPct5 CcsIprCpDutcycRangeAc CcsIprCpDutyPct5InRange CcsIprCpOscillatorOff /end LOC_MEASUREMENT
 /begin REF_CHARACTERISTIC CcsIprCpDutcycAcDbncTime_C CcsIprCpDutcycPct5DbncTime_C CcsIprCpDutyRangeAcLimHi_C CcsIprCpDutyRangeAcLimLo_C CcsIprCpDutyRangeDcLimHi_C CcsIprCpDutyRangeDcLimLo_C /end REF_CHARACTERISTIC
/end FUNCTION
/begin FUNCTION CpState "Group /ByModelHeirarchy/LaforgeTestApp_CCU/Core0-TestApp/V2G/OE_CCS/IPR/CcsIprCp/CpState" /begin LOC_MEASUREMENT CcsIprCpSt /end LOC_MEASUREMENT /end FUNCTION
/begin FUNCTION CcsIprCp "Group /ByModelHeirarchy/LaforgeTestApp_CCU/Core0-TestApp/V2G/OE_CCS/IPR/CcsIprCp" /begin SUB_FUNCTION CpChargingMode CpState /end SUB_FUNCTION /end FUNCTION
/begin FUNCTION DigitalDebounce1 "Group /ByModelHeirarchy/LaforgeTestApp_CCU/Core0-TestApp/V2G/OE_CCS/IPR/CcsIprDc/DigitalDebounce" /begin REF_CHARACTERISTIC CcsIprDcPrechgDoneDbncTime_C /end REF_CHARACTERISTIC /end FUNCTION
/begin FUNCTION OVR_AndExport15 "Group /ByModelHeirarchy/LaforgeTestApp_CCU/Core0-TestApp/V2G/OE_CCS/IPR/CcsIprDc/OVR_AndExport1" /begin LOC_MEASUREMENT CcsIprDcChgInletCrntSafe /end LOC_MEASUREMENT /begin REF_CHARACTERISTIC CcsIprDcChgInletCrntSafeOf_C CcsIprDcChgInletCrntSafeOv_C /end REF_CHARACTERISTIC /end FUNCTION
/begin FUNCTION OVR_AndExport113 "Group /ByModelHeirarchy/LaforgeTestApp_CCU/Core0-TestApp/V2G/OE_CCS/IPR/CcsIprDc/OVR_AndExport11" /begin LOC_MEASUREMENT CcsIprDcPrechgComplete /end LOC_MEASUREMENT /begin REF_CHARACTERISTIC CcsIprDcPrechgCompleteOf_C CcsIprDcPrechgCompleteOv_C /end REF_CHARACTERISTIC /end FUNCTION
/begin FUNCTION OVR_AndExport34 "Group /ByModelHeirarchy/LaforgeTestApp_CCU/Core0-TestApp/V2G/OE_CCS/IPR/CcsIprDc/OVR_AndExport3" /begin LOC_MEASUREMENT CcsIprDcChgInletVoltSafe /end LOC_MEASUREMENT /begin REF_CHARACTERISTIC CcsIprDcChgInletVoltSafeOf_C CcsIprDcChgInletVoltSafeOv_C /end REF_CHARACTERISTIC /end FUNCTION
/begin FUNCTION CcsIprDc "Group /ByModelHeirarchy/LaforgeTestApp_CCU/Core0-TestApp/V2G/OE_CCS/IPR/CcsIprDc"
 /begin SUB_FUNCTION DigitalDebounce1 OVR_AndExport15 OVR_AndExport113 OVR_AndExport34 /end SUB_FUNCTION
 /begin LOC_MEASUREMENT CcsIprDcChgCrntNearZero /end LOC_MEASUREMENT
 /begin REF_CHARACTERISTIC CcsIprDcChgCrntNearZeroThrsh_C CcsIprDcChgInletCrntSafeThrsh_C CcsIprDcChgInletVoltSafeThrsh_C CcsIprDcPrechgDoneDbncTime_C CcsIprDcPrechgVoltThrsh_C /end REF_CHARACTERISTIC
/end FUNCTION
/begin FUNCTION OVR_AndExport222 "Group /ByModelHeirarchy/LaforgeTestApp_CCU/Core0-TestApp/V2G/OE_CCS/IPR/CcsIprPp/OVR_AndExport22" /begin LOC_MEASUREMENT CcsIprPpSt /end LOC_MEASUREMENT /begin REF_CHARACTERISTIC CcsIprPpStOf_C CcsIprPpStOv_C /end REF_CHARACTERISTIC /end FUNCTION
/begin FUNCTION OVR_AndExport223 "Group /ByModelHeirarchy/LaforgeTestApp_CCU/Core0-TestApp/V2G/OE_CCS/IPR/CcsIprPp/ThreeStateAnalogSwitch/OVR_AndExport22" /begin LOC_MEASUREMENT CcsIprPpPos /end LOC_MEASUREMENT /begin REF_CHARACTERISTIC CcsIprPpPosOf_C CcsIprPpPosOv_C /end REF_CHARACTERISTIC /end FUNCTION
/begin FUNCTION ThreeStateAnalogSwitch "Group /ByModelHeirarchy/LaforgeTestApp_CCU/Core0-TestApp/V2G/OE_CCS/IPR/CcsIprPp/ThreeStateAnalogSwitch" /begin SUB_FUNCTION OVR_AndExport223 /end SUB_FUNCTION /begin REF_CHARACTERISTIC CcsIprPpDbncTime_C /end REF_CHARACTERISTIC /end FUNCTION
/begin FUNCTION CcsIprPp "Group /ByModelHeirarchy/LaforgeTestApp_CCU/Core0-TestApp/V2G/OE_CCS/IPR/CcsIprPp" /begin SUB_FUNCTION OVR_AndExport222 ThreeStateAnalogSwitch /end SUB_FUNCTION /begin REF_CHARACTERISTIC CcsIprPpSupplyInvalidInitTime_C /end REF_CHARACTERISTIC /end FUNCTION
/begin FUNCTION OVR_AndExport43 "Group /ByModelHeirarchy/LaforgeTestApp_CCU/Core0-TestApp/V2G/OE_CCS/IPR/CcsIprPrt/OVR_AndExport4" /begin LOC_MEASUREMENT CcsIprPrtVehChargingPortSt /end LOC_MEASUREMENT
 /begin REF_CHARACTERISTIC CcsIprPrtVehChargingPortStOf_C CcsIprPrtVehChargingPortStOv_C /end REF_CHARACTERISTIC
/end FUNCTION
/begin FUNCTION CcsIprPrt "Group /ByModelHeirarchy/LaforgeTestApp_CCU/Core0-TestApp/V2G/OE_CCS/IPR/CcsIprPrt" /begin SUB_FUNCTION OVR_AndExport43 /end SUB_FUNCTION /begin LOC_MEASUREMENT CcsIprPrtEvseCouplerPluggedIn CcsIprPrtHvPresent /end LOC_MEASUREMENT /end FUNCTION
/begin FUNCTION OVR_AndExport16 "Group /ByModelHeirarchy/LaforgeTestApp_CCU/Core0-TestApp/V2G/OE_CCS/IPR/CcsIprPrx/OVR_AndExport1" /begin LOC_MEASUREMENT CcsIprPrxEvseCrntMax /end LOC_MEASUREMENT /begin REF_CHARACTERISTIC CcsIprPrxEvseCrntMaxOf_C CcsIprPrxEvseCrntMaxOv_C /end REF_CHARACTERISTIC /end FUNCTION
/begin FUNCTION OVR_AndExport24 "Group /ByModelHeirarchy/LaforgeTestApp_CCU/Core0-TestApp/V2G/OE_CCS/IPR/CcsIprPrx/OVR_AndExport2" /begin LOC_MEASUREMENT CcsIprPrxEvseVoltMax /end LOC_MEASUREMENT /begin REF_CHARACTERISTIC CcsIprPrxEvseVoltMaxOf_C CcsIprPrxEvseVoltMaxOv_C /end REF_CHARACTERISTIC /end FUNCTION
/begin FUNCTION OVR_AndExport35 "Group /ByModelHeirarchy/LaforgeTestApp_CCU/Core0-TestApp/V2G/OE_CCS/IPR/CcsIprPrx/OVR_AndExport3" /begin LOC_MEASUREMENT CcsIprPrxEvsePwrMax /end LOC_MEASUREMENT /begin REF_CHARACTERISTIC CcsIprPrxEvsePwrMaxOf_C CcsIprPrxEvsePwrMaxOv_C /end REF_CHARACTERISTIC /end FUNCTION
/begin FUNCTION OVR_AndExport44 "Group /ByModelHeirarchy/LaforgeTestApp_CCU/Core0-TestApp/V2G/OE_CCS/IPR/CcsIprPrx/OVR_AndExport4" /begin LOC_MEASUREMENT CcsIprPrxEvseVoltMin /end LOC_MEASUREMENT /begin REF_CHARACTERISTIC CcsIprPrxEvseVoltMinOf_C CcsIprPrxEvseVoltMinOv_C /end REF_CHARACTERISTIC /end FUNCTION
/begin FUNCTION OVR_AndExport53 "Group /ByModelHeirarchy/LaforgeTestApp_CCU/Core0-TestApp/V2G/OE_CCS/IPR/CcsIprPrx/OVR_AndExport5" /begin LOC_MEASUREMENT CcsIprPrxEvseCrntMin /end LOC_MEASUREMENT /begin REF_CHARACTERISTIC CcsIprPrxEvseCrntMinOf_C CcsIprPrxEvseCrntMinOv_C /end REF_CHARACTERISTIC /end FUNCTION
/begin FUNCTION OVR_AndExport73 "Group /ByModelHeirarchy/LaforgeTestApp_CCU/Core0-TestApp/V2G/OE_CCS/IPR/CcsIprPrx/OVR_AndExport7" /begin LOC_MEASUREMENT CcsIprPrxEvseDchgCrntMin /end LOC_MEASUREMENT /begin REF_CHARACTERISTIC CcsIprPrxEvseDchgCrntMinOf_C CcsIprPrxEvseDchgCrntMinOv_C /end REF_CHARACTERISTIC /end FUNCTION
/begin FUNCTION OVR_AndExport83 "Group /ByModelHeirarchy/LaforgeTestApp_CCU/Core0-TestApp/V2G/OE_CCS/IPR/CcsIprPrx/OVR_AndExport8" /begin LOC_MEASUREMENT CcsIprPrxEvseDchgCrntMax /end LOC_MEASUREMENT /begin REF_CHARACTERISTIC CcsIprPrxEvseDchgCrntMaxOf_C CcsIprPrxEvseDchgCrntMaxOv_C /end REF_CHARACTERISTIC /end FUNCTION
/begin FUNCTION OVR_AndExport94 "Group /ByModelHeirarchy/LaforgeTestApp_CCU/Core0-TestApp/V2G/OE_CCS/IPR/CcsIprPrx/OVR_AndExport9" /begin LOC_MEASUREMENT CcsIprPrxEvseDchgPwrMax /end LOC_MEASUREMENT /begin REF_CHARACTERISTIC CcsIprPrxEvseDchgPwrMaxOf_C CcsIprPrxEvseDchgPwrMaxOv_C /end REF_CHARACTERISTIC /end FUNCTION
/begin FUNCTION CcsIprPrx "Group /ByModelHeirarchy/LaforgeTestApp_CCU/Core0-TestApp/V2G/OE_CCS/IPR/CcsIprPrx"
 /begin SUB_FUNCTION OVR_AndExport16 OVR_AndExport24 OVR_AndExport35 OVR_AndExport44 OVR_AndExport53 OVR_AndExport73 OVR_AndExport83 OVR_AndExport94 /end SUB_FUNCTION
 /begin LOC_MEASUREMENT CcsIprChgPortCrntDc CcsIprChgPortVoltDc CcsIprPrxEvseCrntValid CcsIprPrxEvseVoltValid /end LOC_MEASUREMENT
 /begin REF_CHARACTERISTIC CcsIprPrxEvseCrntValidTimeout_C CcsIprPrxEvseVoltValidTimeout_C /end REF_CHARACTERISTIC
/end FUNCTION
/begin FUNCTION CcsIprPmaxEn "Group /ByModelHeirarchy/LaforgeTestApp_CCU/Core0-TestApp/V2G/OE_CCS/IPR/CcsIprSchedule/CcsIprPmaxEn" /begin REF_CHARACTERISTIC CcsIprPmaxEnable_C /end REF_CHARACTERISTIC /end FUNCTION
/begin FUNCTION CcsIprSchedule "Group /ByModelHeirarchy/LaforgeTestApp_CCU/Core0-TestApp/V2G/OE_CCS/IPR/CcsIprSchedule" /begin SUB_FUNCTION CcsIprPmaxEn /end SUB_FUNCTION /end FUNCTION
/begin FUNCTION CcsIprPmaxEn1 "Group /ByModelHeirarchy/LaforgeTestApp_CCU/Core0-TestApp/V2G/OE_CCS/IPR/CcsIprScheduleDischarge/CcsIprPmaxEn" /begin REF_CHARACTERISTIC CcsIprPmaxEnable_C /end REF_CHARACTERISTIC /end FUNCTION
/begin FUNCTION CcsIprScheduleDischarge "Group /ByModelHeirarchy/LaforgeTestApp_CCU/Core0-TestApp/V2G/OE_CCS/IPR/CcsIprScheduleDischarge" /begin SUB_FUNCTION CcsIprPmaxEn1 /end SUB_FUNCTION /end FUNCTION
/begin FUNCTION IPR "Group /ByModelHeirarchy/LaforgeTestApp_CCU/Core0-TestApp/V2G/OE_CCS/IPR"
 /begin SUB_FUNCTION CcsIprAc CcsIprCp CcsIprDc CcsIprPp CcsIprPrt CcsIprPrx CcsIprSchedule CcsIprScheduleDischarge /end SUB_FUNCTION
 /begin LOC_MEASUREMENT CcsIprDisSchIdx CcsIprDisSchMaxIdx CcsIprDisSchPmaxClipped CcsIprDisSchTimer CcsIprPrxDischargePmax CcsIprPrxSchedulePmax CcsIprSchIdx CcsIprSchMaxIdx CcsIprSchPmaxClipped CcsIprSchTimer /end LOC_MEASUREMENT
 /begin REF_CHARACTERISTIC CcsIprDisPmaxDefault_C CcsIprPmaxDefault_C /end REF_CHARACTERISTIC
/end FUNCTION
/begin FUNCTION _6a_PowerDeliveryReq "Group /ByModelHeirarchy/LaforgeTestApp_CCU/Core0-TestApp/V2G/OE_CCS/OUT/V2G_TX_DINSPEC70121/6a-PowerDeliveryReq"
 /begin REF_CHARACTERISTIC CcsOprChgProfileEntryMaxPwr_CA CcsOprChgProfileEntryStrt_CA /end REF_CHARACTERISTIC
/end FUNCTION
/begin FUNCTION V2G_TX_DINSPEC70121 "Group /ByModelHeirarchy/LaforgeTestApp_CCU/Core0-TestApp/V2G/OE_CCS/OUT/V2G_TX_DINSPEC70121" /begin SUB_FUNCTION _6a_PowerDeliveryReq /end SUB_FUNCTION
 /begin LOC_MEASUREMENT CcsOutPtxDinAuthTxFlg CcsOutPtxDinCblChkTxFlg CcsOutPtxDinChgParDiscTxFlg CcsOutPtxDinCrntDmdTxFlg CcsOutPtxDinPmtSelTxFlg CcsOutPtxDinPreChgTxFlg CcsOutPtxDinPwrDelShtDnTxFlg CcsOutPtxDinPwrDelivTxFlg CcsOutPtxDinSesSetupTxFlg CcsOutPtxDinSesStopTxFlg CcsOutPtxDinSvcDiscTxFlg CcsOutPtxDinWeldDetTxFlg /end LOC_MEASUREMENT
/end FUNCTION
/begin FUNCTION V2G_TX_ISO15118ED1 "Group /ByModelHeirarchy/LaforgeTestApp_CCU/Core0-TestApp/V2G/OE_CCS/OUT/V2G_TX_ISO15118ED1"
 /begin LOC_MEASUREMENT CcsOutPtxIso1AuthTxFlg CcsOutPtxIso1CblChkTxFlg CcsOutPtxIso1ChgParDiscTxFlg CcsOutPtxIso1CrntDmdTxFlg CcsOutPtxIso1PmtSelTxFlg CcsOutPtxIso1PreChgTxFlg CcsOutPtxIso1PwrDelShtDnTxFlg CcsOutPtxIso1PwrDelivTxFlg CcsOutPtxIso1SesSetupTxFlg CcsOutPtxIso1SesStopTxFlg CcsOutPtxIso1SvcDetailTxFlg CcsOutPtxIso1SvcDiscTxFlg CcsOutPtxIso1WeldDetTxFlg /end LOC_MEASUREMENT
/end FUNCTION
/begin FUNCTION V2G_TX_ISO15118ED2 "Group /ByModelHeirarchy/LaforgeTestApp_CCU/Core0-TestApp/V2G/OE_CCS/OUT/V2G_TX_ISO15118ED2"
 /begin LOC_MEASUREMENT CcsOutPtxIso2AuthTxFlg CcsOutPtxIso2BptCtrlTxFlg CcsOutPtxIso2CblChkTxFlg CcsOutPtxIso2ChgParDiscTxFlg CcsOutPtxIso2CrntDmdTxFlg CcsOutPtxIso2PmtSelTxFlg CcsOutPtxIso2PreChgTxFlg CcsOutPtxIso2PwrDelShtdnTxFlg CcsOutPtxIso2PwrDelivTxFlg CcsOutPtxIso2SesSetupTxFlg CcsOutPtxIso2SesStopTxFlg CcsOutPtxIso2SvcDetailTxFlg CcsOutPtxIso2SvcDiscTxFlg CcsOutPtxIso2WeldDetTxFlg /end LOC_MEASUREMENT
/end FUNCTION
/begin FUNCTION OUT "Group /ByModelHeirarchy/LaforgeTestApp_CCU/Core0-TestApp/V2G/OE_CCS/OUT" /begin SUB_FUNCTION V2G_TX_DINSPEC70121 V2G_TX_ISO15118ED1 V2G_TX_ISO15118ED2 /end SUB_FUNCTION /begin LOC_MEASUREMENT CcsOutPtxMsgTransmitError CcsOutPtxSuppAppProtoTxFlg /end LOC_MEASUREMENT /end FUNCTION
/begin FUNCTION OVR_AndExport17 "Group /ByModelHeirarchy/LaforgeTestApp_CCU/Core0-TestApp/V2G/OE_CCS/OVR_AndExport1" /begin LOC_MEASUREMENT HostAinEvseProximityVoltRaw /end LOC_MEASUREMENT
 /begin REF_CHARACTERISTIC HostAinEvseProximityVoltRawOf_C HostAinEvseProximityVoltRawOv_C /end REF_CHARACTERISTIC
/end FUNCTION
/begin FUNCTION OVR_AndExport103 "Group /ByModelHeirarchy/LaforgeTestApp_CCU/Core0-TestApp/V2G/OE_CCS/OVR_AndExport10" /begin LOC_MEASUREMENT HostChgRlyWeldCheckDone /end LOC_MEASUREMENT /begin REF_CHARACTERISTIC HostChgRlyWeldCheckDoneOf_C HostChgRlyWeldCheckDoneOv_C /end REF_CHARACTERISTIC /end FUNCTION
/begin FUNCTION OVR_AndExport114 "Group /ByModelHeirarchy/LaforgeTestApp_CCU/Core0-TestApp/V2G/OE_CCS/OVR_AndExport11" /begin LOC_MEASUREMENT HostRessSoc /end LOC_MEASUREMENT /begin REF_CHARACTERISTIC HostRessSocOf_C HostRessSocOv_C /end REF_CHARACTERISTIC /end FUNCTION
/begin FUNCTION OVR_AndExport123 "Group /ByModelHeirarchy/LaforgeTestApp_CCU/Core0-TestApp/V2G/OE_CCS/OVR_AndExport12" /begin LOC_MEASUREMENT HostRessBulkSoc /end LOC_MEASUREMENT /begin REF_CHARACTERISTIC HostRessBulkSocOf_C HostRessBulkSocOv_C /end REF_CHARACTERISTIC /end FUNCTION
/begin FUNCTION OVR_AndExport134 "Group /ByModelHeirarchy/LaforgeTestApp_CCU/Core0-TestApp/V2G/OE_CCS/OVR_AndExport13" /begin LOC_MEASUREMENT HostAcVltPresAtPortEn /end LOC_MEASUREMENT /begin REF_CHARACTERISTIC HostAcVltPresAtPortEnOf_C HostAcVltPresAtPortEnOv_C /end REF_CHARACTERISTIC /end FUNCTION
/begin FUNCTION OVR_AndExport142 "Group /ByModelHeirarchy/LaforgeTestApp_CCU/Core0-TestApp/V2G/OE_CCS/OVR_AndExport14" /begin LOC_MEASUREMENT HostAllChgRelaysClosed /end LOC_MEASUREMENT /begin REF_CHARACTERISTIC HostAllChgRelaysClosedOf_C HostAllChgRelaysClosedOv_C /end REF_CHARACTERISTIC /end FUNCTION
/begin FUNCTION OVR_AndExport152 "Group /ByModelHeirarchy/LaforgeTestApp_CCU/Core0-TestApp/V2G/OE_CCS/OVR_AndExport15" /begin LOC_MEASUREMENT HostChgInletLockStatus /end LOC_MEASUREMENT /begin REF_CHARACTERISTIC HostChgInletLockStatusOf_C HostChgInletLockStatusOv_C /end REF_CHARACTERISTIC /end FUNCTION
/begin FUNCTION OVR_AndExport162 "Group /ByModelHeirarchy/LaforgeTestApp_CCU/Core0-TestApp/V2G/OE_CCS/OVR_AndExport16" /begin LOC_MEASUREMENT HostEvTargetCrnt /end LOC_MEASUREMENT /begin REF_CHARACTERISTIC HostEvTargetCrntOf_C HostEvTargetCrntOv_C /end REF_CHARACTERISTIC /end FUNCTION
/begin FUNCTION OVR_AndExport172 "Group /ByModelHeirarchy/LaforgeTestApp_CCU/Core0-TestApp/V2G/OE_CCS/OVR_AndExport17" /begin LOC_MEASUREMENT HostEvCurrMaxLim /end LOC_MEASUREMENT /begin REF_CHARACTERISTIC HostEvCurrMaxLimOf_C HostEvCurrMaxLimOv_C /end REF_CHARACTERISTIC /end FUNCTION
/begin FUNCTION OVR_AndExport182 "Group /ByModelHeirarchy/LaforgeTestApp_CCU/Core0-TestApp/V2G/OE_CCS/OVR_AndExport18" /begin LOC_MEASUREMENT HostEvTargetVolt /end LOC_MEASUREMENT /begin REF_CHARACTERISTIC HostEvTargetVoltOf_C HostEvTargetVoltOv_C /end REF_CHARACTERISTIC /end FUNCTION
/begin FUNCTION OVR_AndExport192 "Group /ByModelHeirarchy/LaforgeTestApp_CCU/Core0-TestApp/V2G/OE_CCS/OVR_AndExport19" /begin LOC_MEASUREMENT HostEvVoltMaxLim /end LOC_MEASUREMENT /begin REF_CHARACTERISTIC HostEvVoltMaxLimOf_C HostEvVoltMaxLimOv_C /end REF_CHARACTERISTIC /end FUNCTION
/begin FUNCTION OVR_AndExport25 "Group /ByModelHeirarchy/LaforgeTestApp_CCU/Core0-TestApp/V2G/OE_CCS/OVR_AndExport2" /begin LOC_MEASUREMENT HostPwminEvsePilotTimeout /end LOC_MEASUREMENT
 /begin REF_CHARACTERISTIC HostPwminEvsePilotTimeoutOf_C HostPwminEvsePilotTimeoutOv_C /end REF_CHARACTERISTIC
/end FUNCTION
/begin FUNCTION OVR_AndExport202 "Group /ByModelHeirarchy/LaforgeTestApp_CCU/Core0-TestApp/V2G/OE_CCS/OVR_AndExport20" /begin LOC_MEASUREMENT HostRessVolt /end LOC_MEASUREMENT /begin REF_CHARACTERISTIC HostRessVoltOf_C HostRessVoltOv_C /end REF_CHARACTERISTIC /end FUNCTION
/begin FUNCTION OVR_AndExport212 "Group /ByModelHeirarchy/LaforgeTestApp_CCU/Core0-TestApp/V2G/OE_CCS/OVR_AndExport21" /begin LOC_MEASUREMENT HostEvIsolCheckDisabled /end LOC_MEASUREMENT /begin REF_CHARACTERISTIC HostEvIsolCheckDisabledOf_C HostEvIsolCheckDisabledOv_C /end REF_CHARACTERISTIC /end FUNCTION
/begin FUNCTION OVR_AndExport224 "Group /ByModelHeirarchy/LaforgeTestApp_CCU/Core0-TestApp/V2G/OE_CCS/OVR_AndExport22" /begin LOC_MEASUREMENT HostChgPortVoltDc /end LOC_MEASUREMENT /begin REF_CHARACTERISTIC HostChgPortVoltDcOf_C HostChgPortVoltDcOv_C /end REF_CHARACTERISTIC /end FUNCTION
/begin FUNCTION OVR_AndExport232 "Group /ByModelHeirarchy/LaforgeTestApp_CCU/Core0-TestApp/V2G/OE_CCS/OVR_AndExport23" /begin LOC_MEASUREMENT HostChgPortCrntDc /end LOC_MEASUREMENT /begin REF_CHARACTERISTIC HostChgPortCrntDcOf_C HostChgPortCrntDcOv_C /end REF_CHARACTERISTIC /end FUNCTION
/begin FUNCTION OVR_AndExport242 "Group /ByModelHeirarchy/LaforgeTestApp_CCU/Core0-TestApp/V2G/OE_CCS/OVR_AndExport24" /begin LOC_MEASUREMENT HostEvPwrMaxLim /end LOC_MEASUREMENT /begin REF_CHARACTERISTIC HostEvPwrMaxLimOf_C HostEvPwrMaxLimOv_C /end REF_CHARACTERISTIC /end FUNCTION
/begin FUNCTION OVR_AndExport252 "Group /ByModelHeirarchy/LaforgeTestApp_CCU/Core0-TestApp/V2G/OE_CCS/OVR_AndExport25" /begin LOC_MEASUREMENT HostAcVoltPresentAtPort /end LOC_MEASUREMENT /begin REF_CHARACTERISTIC HostAcVoltPresentAtPortOf_C HostAcVoltPresentAtPortOv_C /end REF_CHARACTERISTIC /end FUNCTION
/begin FUNCTION OVR_AndExport262 "Group /ByModelHeirarchy/LaforgeTestApp_CCU/Core0-TestApp/V2G/OE_CCS/OVR_AndExport26" /begin LOC_MEASUREMENT HostAcCrntPresentAtPort /end LOC_MEASUREMENT /begin REF_CHARACTERISTIC HostAcCrntPresentAtPortOf_C HostAcCrntPresentAtPortOv_C /end REF_CHARACTERISTIC /end FUNCTION
/begin FUNCTION OVR_AndExport272 "Group /ByModelHeirarchy/LaforgeTestApp_CCU/Core0-TestApp/V2G/OE_CCS/OVR_AndExport27" /begin LOC_MEASUREMENT HostEvEgyReqAmount /end LOC_MEASUREMENT /begin REF_CHARACTERISTIC HostEvEgyReqAmountOf_C HostEvEgyReqAmountOv_C /end REF_CHARACTERISTIC /end FUNCTION
/begin FUNCTION OVR_AndExport282 "Group /ByModelHeirarchy/LaforgeTestApp_CCU/Core0-TestApp/V2G/OE_CCS/OVR_AndExport28" /begin LOC_MEASUREMENT HostEvEgyCapacity /end LOC_MEASUREMENT /begin REF_CHARACTERISTIC HostEvEgyCapacityOf_C HostEvEgyCapacityOv_C /end REF_CHARACTERISTIC /end FUNCTION
/begin FUNCTION OVR_AndExport292 "Group /ByModelHeirarchy/LaforgeTestApp_CCU/Core0-TestApp/V2G/OE_CCS/OVR_AndExport29" /begin LOC_MEASUREMENT HostEvCurrMinLim /end LOC_MEASUREMENT /begin REF_CHARACTERISTIC HostEvCurrMinLimOf_C HostEvCurrMinLimOv_C /end REF_CHARACTERISTIC /end FUNCTION
/begin FUNCTION OVR_AndExport36 "Group /ByModelHeirarchy/LaforgeTestApp_CCU/Core0-TestApp/V2G/OE_CCS/OVR_AndExport3" /begin LOC_MEASUREMENT HostAinEvsePilotVoltRaw /end LOC_MEASUREMENT /begin REF_CHARACTERISTIC HostAinEvsePilotVoltRawOf_C HostAinEvsePilotVoltRawOv_C /end REF_CHARACTERISTIC /end FUNCTION
/begin FUNCTION OVR_AndExport302 "Group /ByModelHeirarchy/LaforgeTestApp_CCU/Core0-TestApp/V2G/OE_CCS/OVR_AndExport30" /begin LOC_MEASUREMENT HostChgPortVoltDcValid /end LOC_MEASUREMENT /begin REF_CHARACTERISTIC HostChgPortVoltDcValidOf_C HostChgPortVoltDcValidOv_C /end REF_CHARACTERISTIC /end FUNCTION
/begin FUNCTION OVR_AndExport312 "Group /ByModelHeirarchy/LaforgeTestApp_CCU/Core0-TestApp/V2G/OE_CCS/OVR_AndExport31" /begin LOC_MEASUREMENT HostChgPortCrntDcValid /end LOC_MEASUREMENT /begin REF_CHARACTERISTIC HostChgPortCrntDcValidOf_C HostChgPortCrntDcValidOv_C /end REF_CHARACTERISTIC /end FUNCTION
/begin FUNCTION OVR_AndExport322 "Group /ByModelHeirarchy/LaforgeTestApp_CCU/Core0-TestApp/V2G/OE_CCS/OVR_AndExport32" /begin LOC_MEASUREMENT HostRelayWeldCheckEnable /end LOC_MEASUREMENT /begin REF_CHARACTERISTIC HostRelayWeldCheckEnableOf_C HostRelayWeldCheckEnableOv_C /end REF_CHARACTERISTIC /end FUNCTION
/begin FUNCTION OVR_AndExport331 "Group /ByModelHeirarchy/LaforgeTestApp_CCU/Core0-TestApp/V2G/OE_CCS/OVR_AndExport33" /begin LOC_MEASUREMENT HostAcCrntPresAtPortEn /end LOC_MEASUREMENT /begin REF_CHARACTERISTIC HostAcCrntPresAtPortEnOf_C HostAcCrntPresAtPortEnOv_C /end REF_CHARACTERISTIC /end FUNCTION
/begin FUNCTION OVR_AndExport341 "Group /ByModelHeirarchy/LaforgeTestApp_CCU/Core0-TestApp/V2G/OE_CCS/OVR_AndExport34" /begin LOC_MEASUREMENT HostIgnoreIsolWarning /end LOC_MEASUREMENT /begin REF_CHARACTERISTIC HostIgnoreIsolWarningOf_C HostIgnoreIsolWarningOv_C /end REF_CHARACTERISTIC /end FUNCTION
/begin FUNCTION OVR_AndExport351 "Group /ByModelHeirarchy/LaforgeTestApp_CCU/Core0-TestApp/V2G/OE_CCS/OVR_AndExport35" /begin LOC_MEASUREMENT HostRemainTimetoBulkSoc /end LOC_MEASUREMENT /begin REF_CHARACTERISTIC HostRemainTimetoBulkSocOf_C HostRemainTimetoBulkSocOv_C /end REF_CHARACTERISTIC /end FUNCTION
/begin FUNCTION OVR_AndExport36 "Group /ByModelHeirarchy/LaforgeTestApp_CCU/Core0-TestApp/V2G/OE_CCS/OVR_AndExport36" /begin LOC_MEASUREMENT HostRemainTimeToFullSoc /end LOC_MEASUREMENT /begin REF_CHARACTERISTIC HostRemainTimeToFullSocOf_C HostRemainTimeToFullSocOv_C /end REF_CHARACTERISTIC /end FUNCTION
/begin FUNCTION OVR_AndExport37 "Group /ByModelHeirarchy/LaforgeTestApp_CCU/Core0-TestApp/V2G/OE_CCS/OVR_AndExport37" /begin LOC_MEASUREMENT HostDepartureTime /end LOC_MEASUREMENT /begin REF_CHARACTERISTIC HostDepartureTimeOf_C HostDepartureTimeOv_C /end REF_CHARACTERISTIC /end FUNCTION
/begin FUNCTION OVR_AndExport45 "Group /ByModelHeirarchy/LaforgeTestApp_CCU/Core0-TestApp/V2G/OE_CCS/OVR_AndExport4" /begin LOC_MEASUREMENT HostPwminEvsePilotDutcyc /end LOC_MEASUREMENT /begin REF_CHARACTERISTIC HostPwminEvsePilotDutcycOf_C HostPwminEvsePilotDutcycOv_C /end REF_CHARACTERISTIC /end FUNCTION
/begin FUNCTION OVR_AndExport43 "Group /ByModelHeirarchy/LaforgeTestApp_CCU/Core0-TestApp/V2G/OE_CCS/OVR_AndExport43" /begin LOC_MEASUREMENT HostEvPwrMinLim /end LOC_MEASUREMENT /begin REF_CHARACTERISTIC HostEvPwrMinLimOf_C HostEvPwrMinLimOv_C /end REF_CHARACTERISTIC /end FUNCTION
/begin FUNCTION OVR_AndExport44 "Group /ByModelHeirarchy/LaforgeTestApp_CCU/Core0-TestApp/V2G/OE_CCS/OVR_AndExport44" /begin LOC_MEASUREMENT HostEvVoltMinLim /end LOC_MEASUREMENT /begin REF_CHARACTERISTIC HostEvVoltMinLimOf_C HostEvVoltMinLimOv_C /end REF_CHARACTERISTIC /end FUNCTION
/begin FUNCTION OVR_AndExport45 "Group /ByModelHeirarchy/LaforgeTestApp_CCU/Core0-TestApp/V2G/OE_CCS/OVR_AndExport45" /begin LOC_MEASUREMENT HostEvMaxEgy /end LOC_MEASUREMENT /begin REF_CHARACTERISTIC HostEvMaxEgyOf_C HostEvMaxEgyOv_C /end REF_CHARACTERISTIC /end FUNCTION
/begin FUNCTION OVR_AndExport46 "Group /ByModelHeirarchy/LaforgeTestApp_CCU/Core0-TestApp/V2G/OE_CCS/OVR_AndExport46" /begin LOC_MEASUREMENT HostEvMinEgy /end LOC_MEASUREMENT /begin REF_CHARACTERISTIC HostEvMinEgyOf_C HostEvMinEgyOv_C /end REF_CHARACTERISTIC /end FUNCTION
/begin FUNCTION OVR_AndExport47 "Group /ByModelHeirarchy/LaforgeTestApp_CCU/Core0-TestApp/V2G/OE_CCS/OVR_AndExport47" /begin LOC_MEASUREMENT HostRessTargetSoc /end LOC_MEASUREMENT /begin REF_CHARACTERISTIC HostRessTargetSocOf_C HostRessTargetSocOv_C /end REF_CHARACTERISTIC /end FUNCTION
/begin FUNCTION OVR_AndExport48 "Group /ByModelHeirarchy/LaforgeTestApp_CCU/Core0-TestApp/V2G/OE_CCS/OVR_AndExport48" /begin LOC_MEASUREMENT HostEvDisChgCurrMaxLim /end LOC_MEASUREMENT /begin REF_CHARACTERISTIC HostEvDisChgCurrMaxLimOf_C HostEvDisChgCurrMaxLimOv_C /end REF_CHARACTERISTIC /end FUNCTION
/begin FUNCTION OVR_AndExport49 "Group /ByModelHeirarchy/LaforgeTestApp_CCU/Core0-TestApp/V2G/OE_CCS/OVR_AndExport49" /begin LOC_MEASUREMENT HostEvDisChgCurrMinLim /end LOC_MEASUREMENT /begin REF_CHARACTERISTIC HostEvDisChgCurrMinLimOf_C HostEvDisChgCurrMinLimOv_C /end REF_CHARACTERISTIC /end FUNCTION
/begin FUNCTION OVR_AndExport54 "Group /ByModelHeirarchy/LaforgeTestApp_CCU/Core0-TestApp/V2G/OE_CCS/OVR_AndExport5" /begin LOC_MEASUREMENT HostPwminEvsePilotFreq /end LOC_MEASUREMENT /begin REF_CHARACTERISTIC HostPwminEvsePilotFreqOf_C HostPwminEvsePilotFreqOv_C /end REF_CHARACTERISTIC /end FUNCTION
/begin FUNCTION OVR_AndExport50 "Group /ByModelHeirarchy/LaforgeTestApp_CCU/Core0-TestApp/V2G/OE_CCS/OVR_AndExport50" /begin LOC_MEASUREMENT HostEvDisChgPwrMaxLim /end LOC_MEASUREMENT /begin REF_CHARACTERISTIC HostEvDisChgPwrMaxLimOf_C HostEvDisChgPwrMaxLimOv_C /end REF_CHARACTERISTIC /end FUNCTION
/begin FUNCTION OVR_AndExport51 "Group /ByModelHeirarchy/LaforgeTestApp_CCU/Core0-TestApp/V2G/OE_CCS/OVR_AndExport51" /begin LOC_MEASUREMENT HostEvDisChgPwrMinLim /end LOC_MEASUREMENT /begin REF_CHARACTERISTIC HostEvDisChgPwrMinLimOf_C HostEvDisChgPwrMinLimOv_C /end REF_CHARACTERISTIC /end FUNCTION
/begin FUNCTION OVR_AndExport52 "Group /ByModelHeirarchy/LaforgeTestApp_CCU/Core0-TestApp/V2G/OE_CCS/OVR_AndExport52" /begin LOC_MEASUREMENT HostProtocolDinEnbl /end LOC_MEASUREMENT /begin REF_CHARACTERISTIC HostProtocolDinEnblOf_C HostProtocolDinEnblOv_C /end REF_CHARACTERISTIC /end FUNCTION
/begin FUNCTION OVR_AndExport53 "Group /ByModelHeirarchy/LaforgeTestApp_CCU/Core0-TestApp/V2G/OE_CCS/OVR_AndExport53" /begin LOC_MEASUREMENT HostProtocolIsoV1Enbl /end LOC_MEASUREMENT /begin REF_CHARACTERISTIC HostProtocolIsoV1EnblOf_C HostProtocolIsoV1EnblOv_C /end REF_CHARACTERISTIC /end FUNCTION
/begin FUNCTION OVR_AndExport54 "Group /ByModelHeirarchy/LaforgeTestApp_CCU/Core0-TestApp/V2G/OE_CCS/OVR_AndExport54" /begin LOC_MEASUREMENT HostProtocolIsoV2Enbl /end LOC_MEASUREMENT /begin REF_CHARACTERISTIC HostProtocolIsoV2EnblOf_C HostProtocolIsoV2EnblOv_C /end REF_CHARACTERISTIC /end FUNCTION
/begin FUNCTION OVR_AndExport55 "Group /ByModelHeirarchy/LaforgeTestApp_CCU/Core0-TestApp/V2G/OE_CCS/OVR_AndExport55" /begin LOC_MEASUREMENT HostPriorityDin /end LOC_MEASUREMENT /begin REF_CHARACTERISTIC HostPriorityDinOf_C HostPriorityDinOv_C /end REF_CHARACTERISTIC /end FUNCTION
/begin FUNCTION OVR_AndExport56 "Group /ByModelHeirarchy/LaforgeTestApp_CCU/Core0-TestApp/V2G/OE_CCS/OVR_AndExport56" /begin LOC_MEASUREMENT HostPriorityIsoV1 /end LOC_MEASUREMENT /begin REF_CHARACTERISTIC HostPriorityIsoV1Of_C HostPriorityIsoV1Ov_C /end REF_CHARACTERISTIC /end FUNCTION
/begin FUNCTION OVR_AndExport57 "Group /ByModelHeirarchy/LaforgeTestApp_CCU/Core0-TestApp/V2G/OE_CCS/OVR_AndExport57" /begin LOC_MEASUREMENT HostPriorityIsoV2 /end LOC_MEASUREMENT /begin REF_CHARACTERISTIC HostPriorityIsoV2Of_C HostPriorityIsoV2Ov_C /end REF_CHARACTERISTIC /end FUNCTION
/begin FUNCTION OVR_AndExport58 "Group /ByModelHeirarchy/LaforgeTestApp_CCU/Core0-TestApp/V2G/OE_CCS/OVR_AndExport58" /begin LOC_MEASUREMENT HostDynamicModePriority /end LOC_MEASUREMENT /begin REF_CHARACTERISTIC HostDynamicModePriorityOf_C HostDynamicModePriorityOv_C /end REF_CHARACTERISTIC /end FUNCTION
/begin FUNCTION OVR_AndExport59 "Group /ByModelHeirarchy/LaforgeTestApp_CCU/Core0-TestApp/V2G/OE_CCS/OVR_AndExport59" /begin LOC_MEASUREMENT HostBptModePriority /end LOC_MEASUREMENT /begin REF_CHARACTERISTIC HostBptModePriorityOf_C HostBptModePriorityOv_C /end REF_CHARACTERISTIC /end FUNCTION
/begin FUNCTION OVR_AndExport64 "Group /ByModelHeirarchy/LaforgeTestApp_CCU/Core0-TestApp/V2G/OE_CCS/OVR_AndExport6" /begin LOC_MEASUREMENT HostAinProximitySupplyFdbk /end LOC_MEASUREMENT
 /begin REF_CHARACTERISTIC HostAinProximitySupplyFdbkOf_C HostAinProximitySupplyFdbkOv_C /end REF_CHARACTERISTIC
/end FUNCTION
/begin FUNCTION OVR_AndExport60 "Group /ByModelHeirarchy/LaforgeTestApp_CCU/Core0-TestApp/V2G/OE_CCS/OVR_AndExport60" /begin LOC_MEASUREMENT HostDesiredEgyTrnsfrMde /end LOC_MEASUREMENT /begin REF_CHARACTERISTIC HostDesiredEgyTrnsfrMdeOf_C HostDesiredEgyTrnsfrMdeOv_C /end REF_CHARACTERISTIC /end FUNCTION
/begin FUNCTION OVR_AndExport74 "Group /ByModelHeirarchy/LaforgeTestApp_CCU/Core0-TestApp/V2G/OE_CCS/OVR_AndExport7" /begin LOC_MEASUREMENT HostChargeNormalStop /end LOC_MEASUREMENT /begin REF_CHARACTERISTIC HostChargeNormalStopOf_C HostChargeNormalStopOv_C /end REF_CHARACTERISTIC /end FUNCTION
/begin FUNCTION OVR_AndExport84 "Group /ByModelHeirarchy/LaforgeTestApp_CCU/Core0-TestApp/V2G/OE_CCS/OVR_AndExport8" /begin LOC_MEASUREMENT HostAinEvsePilotVoltPeakRaw /end LOC_MEASUREMENT
 /begin REF_CHARACTERISTIC HostAinEvsePilotVoltPeakRawOf_C HostAinEvsePilotVoltPeakRawOv_C /end REF_CHARACTERISTIC
/end FUNCTION
/begin FUNCTION OVR_AndExport95 "Group /ByModelHeirarchy/LaforgeTestApp_CCU/Core0-TestApp/V2G/OE_CCS/OVR_AndExport9" /begin LOC_MEASUREMENT HostChargeEmergencyStop /end LOC_MEASUREMENT /begin REF_CHARACTERISTIC HostChargeEmergencyStopOf_C HostChargeEmergencyStopOv_C /end REF_CHARACTERISTIC /end FUNCTION
/begin FUNCTION OVR_AndExport1 "Group /ByModelHeirarchy/LaforgeTestApp_CCU/Core0-TestApp/V2G/OE_CCS/V2gRx/OVR_AndExport" /begin LOC_MEASUREMENT V2gRxMsgSupPrtclRxTrg /end LOC_MEASUREMENT /begin REF_CHARACTERISTIC V2gRxMsgSupPrtclRxTrgOf_C V2gRxMsgSupPrtclRxTrgOv_C /end REF_CHARACTERISTIC /end FUNCTION
/begin FUNCTION OVR_AndExport18 "Group /ByModelHeirarchy/LaforgeTestApp_CCU/Core0-TestApp/V2G/OE_CCS/V2gRx/OVR_AndExport1" /begin LOC_MEASUREMENT V2gRxMsgSupPrtclRescode /end LOC_MEASUREMENT /begin REF_CHARACTERISTIC V2gRxMsgSupPrtclRescodeOf_C V2gRxMsgSupPrtclRescodeOv_C /end REF_CHARACTERISTIC /end FUNCTION
/begin FUNCTION OVR_AndExport26 "Group /ByModelHeirarchy/LaforgeTestApp_CCU/Core0-TestApp/V2G/OE_CCS/V2gRx/OVR_AndExport2" /begin LOC_MEASUREMENT V2gSupPrtclSelected /end LOC_MEASUREMENT /begin REF_CHARACTERISTIC V2gSupPrtclSelectedOf_C V2gSupPrtclSelectedOv_C /end REF_CHARACTERISTIC /end FUNCTION
/begin FUNCTION OVR_AndExport38 "Group /ByModelHeirarchy/LaforgeTestApp_CCU/Core0-TestApp/V2G/OE_CCS/V2gRx/OVR_AndExport38" /begin LOC_MEASUREMENT V2gSlacLinkSt /end LOC_MEASUREMENT /begin REF_CHARACTERISTIC V2gSlacLinkStOf_C V2gSlacLinkStOv_C /end REF_CHARACTERISTIC /end FUNCTION
/begin FUNCTION OVR_AndExport391 "Group /ByModelHeirarchy/LaforgeTestApp_CCU/Core0-TestApp/V2G/OE_CCS/V2gRx/OVR_AndExport39" /begin LOC_MEASUREMENT V2gSlacTcpSt /end LOC_MEASUREMENT /begin REF_CHARACTERISTIC V2gSlacTcpStOf_C V2gSlacTcpStOv_C /end REF_CHARACTERISTIC /end FUNCTION
/begin FUNCTION V2G_RX_DINSPEC70121 "Group /ByModelHeirarchy/LaforgeTestApp_CCU/Core0-TestApp/V2G/OE_CCS/V2gRx/V2G_RX_DINSPEC70121"
 /begin LOC_MEASUREMENT DinAuthEvseProcessingSt DinCblChkEvseIsolStatusFlg DinChgParDiscRxTrg DinCrntDmdEvseCrntMaxLimFlg DinCrntDmdEvseIsolStatusFlg DinCrntDmdEvsePwrLimReached DinCrntDmdEvseStatusCode DinCrntDmdEvseVolt DinCrntDmdEvseVoltMaxLim DinCrntDmdEvseVoltMaxLimFlg DinDcChgParDiscEvseEgyDelivera0 DinDcChgParDiscEvsePwrMaxLimFlg DinDcChgParDiscEvseVoltMaxLim DinPmtSelRxTrg DinPreChgResponseCode DinPwrDelivDcEvseStatusFlg DinPwrDelivEvseIsolSt DinPwrDelivEvseStatusCode DinPwrDelivResponseCode DinPwrDelivRxTrg DinSesSetupEvseIdLen DinSesStopResponseCode DinSesStopRxTrg DinSvcDiscFreeSvc DinSvcDiscResponseCode DinSvcDiscRxTrg DinSvcDiscSvcCategory DinSvcDiscSvcId DinWeldDetResponseCode /end LOC_MEASUREMENT
/end FUNCTION
/end MODULE
/end PROJECT
