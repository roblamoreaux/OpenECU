ASAP2_VERSION 1 31
/begin PROJECT LaForge_CCU_TestApp "Test Application for LaForge TC367"
/begin HEADER "Dana" VERSION "0_3_1" /end HEADER
/begin MODULE OpenECU_TC367_001 ""
/* Scalar measurable for DDE 'Iso2EvseId[5]'. */
/begin MEASUREMENT Iso2EvseId[5] "The ID that uniquely identifies the EVSE. Format is defined in the ISO 15118 ED2 Spec Annex H" UBYTE CU_ISO2EVSEID[5] 1 100 0.0 255.0 ECU_ADDRESS 0x70017cf9 BYTE_ORDER MSB_LAST /end MEASUREMENT
/begin COMPU_METHOD CU_ISO2EVSEID[5] "Conversion method for Iso2EvseId[5]" RAT_FUNC "%10.0" "1" COEFFS 0.000000 1.000000 -0.000000 0.000000 0.000000 1.000000 /end COMPU_METHOD
/* Scalar measurable for DDE 'Iso2EvseId[6]'. */
/begin MEASUREMENT Iso2EvseId[6] "The ID that uniquely identifies the EVSE. Format is defined in the ISO 15118 ED2 Spec Annex H" UBYTE CU_ISO2EVSEID[6] 1 100 0.0 255.0 ECU_ADDRESS 0x70017cfa BYTE_ORDER MSB_LAST /end MEASUREMENT
/begin COMPU_METHOD CU_ISO2EVSEID[6] "Conversion method for Iso2EvseId[6]" RAT_FUNC "%10.0" "1" COEFFS 0.000000 1.000000 -0.000000 0.000000 0.000000 1.000000 /end COMPU_METHOD
/* Scalar measurable for DDE 'Iso2EvseId[7]'. */
/begin MEASUREMENT Iso2EvseId[7] "The ID that uniquely identifies the EVSE. Format is defined in the ISO 15118 ED2 Spec Annex H" UBYTE CU_ISO2EVSEID[7] 1 100 0.0 255.0 ECU_ADDRESS 0x70017cfb BYTE_ORDER MSB_LAST /end MEASUREMENT
/begin COMPU_METHOD CU_ISO2EVSEID[7] "Conversion method for Iso2EvseId[7]" RAT_FUNC "%10.0" "1" COEFFS 0.000000 1.000000 -0.000000 0.000000 0.000000 1.000000 /end COMPU_METHOD
/* Scalar measurable for DDE 'Iso2EvseId[8]'. */
/begin MEASUREMENT Iso2EvseId[8] "The ID that uniquely identifies the EVSE. Format is defined in the ISO 15118 ED2 Spec Annex H" UBYTE CU_ISO2EVSEID[8] 1 100 0.0 255.0 ECU_ADDRESS 0x70017cfc BYTE_ORDER MSB_LAST /end MEASUREMENT
/begin COMPU_METHOD CU_ISO2EVSEID[8] "Conversion method for Iso2EvseId[8]" RAT_FUNC "%10.0" "1" COEFFS 0.000000 1.000000 -0.000000 0.000000 0.000000 1.000000 /end COMPU_METHOD
/* Scalar measurable for DDE 'Iso2EvseId[9]'. */
/begin MEASUREMENT Iso2EvseId[9] "The ID that uniquely identifies the EVSE. Format is defined in the ISO 15118 ED2 Spec Annex H" UBYTE CU_ISO2EVSEID[9] 1 100 0.0 255.0 ECU_ADDRESS 0x70017cfd BYTE_ORDER MSB_LAST /end MEASUREMENT
/begin COMPU_METHOD CU_ISO2EVSEID[9] "Conversion method for Iso2EvseId[9]" RAT_FUNC "%10.0" "1" COEFFS 0.000000 1.000000 -0.000000 0.000000 0.000000 1.000000 /end COMPU_METHOD
/* Scalar measurable for DDE 'Iso2PmtSelEvseStatPres'. */
/begin MEASUREMENT Iso2PmtSelEvseStatPres "Indicates the presence of the EVSENotificationMaxDelay and EVSENotification parameters in the PaymentServiceSelectionRes message" UBYTE CU_ISO2PMTSELEVSESTATPRES 1 100 0.0 1.0 ECU_ADDRESS 0x70018248 BYTE_ORDER MSB_LAST /end MEASUREMENT
/begin COMPU_METHOD CU_ISO2PMTSELEVSESTATPRES "Conversion method for Iso2PmtSelEvseStatPres" RAT_FUNC "%10.0" "b" COEFFS 0.000000 1.000000 -0.000000 0.000000 0.000000 1.000000 /end COMPU_METHOD
/* Scalar measurable for DDE 'Iso2PmtSelNotif'. */
/begin MEASUREMENT Iso2PmtSelNotif "Indicates action SECC wants the EVSE to perform in the PaymentServiceSelectionRes message" UBYTE CU_ISO2PMTSELNOTIF 1 100 0.0 255.0 ECU_ADDRESS 0x70017c2d BYTE_ORDER MSB_LAST /end MEASUREMENT
/begin COMPU_METHOD CU_ISO2PMTSELNOTIF "Conversion method for Iso2PmtSelNotif" RAT_FUNC "%10.0" "1" COEFFS 0.000000 1.000000 -0.000000 0.000000 0.000000 1.000000 /end COMPU_METHOD
/* Scalar measurable for DDE 'Iso2PmtSelNotifMaxDelay'. */
/begin MEASUREMENT Iso2PmtSelNotifMaxDelay "Indicates the time until the SECC expects the EVCC to react on the EVSENotification action set in the PaymentServiceSelectionRes message" UWORD CU_ISO2PMTSELNOTIFMAXDELAY 1 100 0.0 65535.0 ECU_ADDRESS 0x70018358 BYTE_ORDER MSB_LAST /end MEASUREMENT
/begin COMPU_METHOD CU_ISO2PMTSELNOTIFMAXDELAY "Conversion method for Iso2PmtSelNotifMaxDelay" RAT_FUNC "%10.0" "1" COEFFS 0.000000 1.000000 -0.000000 0.000000 0.000000 1.000000 /end COMPU_METHOD
/* Scalar measurable for DDE 'Iso2PmtSelRescode'. */
/begin MEASUREMENT Iso2PmtSelRescode "for ISOv2 PaymentServiceSelectionRes message: indicates the acknowledgment status of this V2G messages received by the SECC." UBYTE CU_ISO2PMTSELRESCODE 1 100 0.0 255.0 ECU_ADDRESS 0x700181a9 BYTE_ORDER MSB_LAST /end MEASUREMENT
/begin COMPU_METHOD CU_ISO2PMTSELRESCODE "Conversion method for Iso2PmtSelRescode" RAT_FUNC "%10.0" "1" COEFFS 0.000000 1.000000 -0.000000 0.000000 0.000000 1.000000 /end COMPU_METHOD
/* Scalar measurable for DDE 'Iso2PmtSelRxTrg'. */
/begin MEASUREMENT Iso2PmtSelRxTrg "Trigger flag that on a rising edge indicates the event for receiving the PLC (V2G) PaymentServiceSelectionRes message from the EVSE" UBYTE CU_ISO2PMTSELRXTRG 1 100 0.0 1.0 ECU_ADDRESS 0x70017f64 BYTE_ORDER MSB_LAST /end MEASUREMENT
/begin COMPU_METHOD CU_ISO2PMTSELRXTRG "Conversion method for Iso2PmtSelRxTrg" RAT_FUNC "%10.0" "b" COEFFS 0.000000 1.000000 -0.000000 0.000000 0.000000 1.000000 /end COMPU_METHOD
/* Scalar measurable for DDE 'Iso2PreChgEvsePresVolt'. */
/begin MEASUREMENT Iso2PreChgEvsePresVolt "Indicates the measured High Voltage DC (HVDC) voltage at the output of the DC Supply." FLOAT32_IEEE CU_ISO2PRECHGEVSEPRESVOLT 1 100 -3.40282346639e+38 3.40282346639e+38 ECU_ADDRESS 0x700181cc BYTE_ORDER MSB_LAST /end MEASUREMENT
/begin COMPU_METHOD CU_ISO2PRECHGEVSEPRESVOLT "Conversion method for Iso2PreChgEvsePresVolt" RAT_FUNC "%10.0" "%" COEFFS 0.000000 1.000000 -0.000000 0.000000 0.000000 1.000000 /end COMPU_METHOD
/* Scalar measurable for DDE 'Iso2PreChgEvseStatPres'. */
/begin MEASUREMENT Iso2PreChgEvseStatPres "Indicates the presence of the EVSENotificationMaxDelay and EVSENotification parameters in the PreChargeRes message" UBYTE CU_ISO2PRECHGEVSESTATPRES 1 100 0.0 1.0 ECU_ADDRESS 0x70018492 BYTE_ORDER MSB_LAST /end MEASUREMENT
/begin COMPU_METHOD CU_ISO2PRECHGEVSESTATPRES "Conversion method for Iso2PreChgEvseStatPres" RAT_FUNC "%10.0" "b" COEFFS 0.000000 1.000000 -0.000000 0.000000 0.000000 1.000000 /end COMPU_METHOD
/* Scalar measurable for DDE 'Iso2PreChgNotif'. */
/begin MEASUREMENT Iso2PreChgNotif "Indicates action SECC wants the EVSE to perform in the PreChargeRes message" UBYTE CU_ISO2PRECHGNOTIF 1 100 0.0 255.0 ECU_ADDRESS 0x70017e9d BYTE_ORDER MSB_LAST /end MEASUREMENT
/begin COMPU_METHOD CU_ISO2PRECHGNOTIF "Conversion method for Iso2PreChgNotif" RAT_FUNC "%10.0" "1" COEFFS 0.000000 1.000000 -0.000000 0.000000 0.000000 1.000000 /end COMPU_METHOD
/* Scalar measurable for DDE 'Iso2PreChgNotifMaxDelay'. */
/begin MEASUREMENT Iso2PreChgNotifMaxDelay "Indicates the time until the SECC expects the EVCC to react on the EVSENotification action set in the PreChargeRes message" UWORD CU_ISO2PRECHGNOTIFMAXDELAY 1 100 0.0 65535.0 ECU_ADDRESS 0x70017ce4 BYTE_ORDER MSB_LAST /end MEASUREMENT
/begin COMPU_METHOD CU_ISO2PRECHGNOTIFMAXDELAY "Conversion method for Iso2PreChgNotifMaxDelay" RAT_FUNC "%10.0" "1" COEFFS 0.000000 1.000000 -0.000000 0.000000 0.000000 1.000000 /end COMPU_METHOD
/* Scalar measurable for DDE 'Iso2PreChgRescode'. */
/begin MEASUREMENT Iso2PreChgRescode "for ISOv2 PreChargeRes message: indicates the acknowledgment status of this V2G messages received by the SECC." UBYTE CU_ISO2PRECHGRESCODE 1 100 0.0 255.0 ECU_ADDRESS 0x700183ff BYTE_ORDER MSB_LAST /end MEASUREMENT
/begin COMPU_METHOD CU_ISO2PRECHGRESCODE "Conversion method for Iso2PreChgRescode" RAT_FUNC "%10.0" "1" COEFFS 0.000000 1.000000 -0.000000 0.000000 0.000000 1.000000 /end COMPU_METHOD
/* Scalar measurable for DDE 'Iso2PreChgRxTrg'. */
/begin MEASUREMENT Iso2PreChgRxTrg "Trigger flag that on a rising edge indicates the event for receiving the PLC (V2G) PreChargeRes message from the EVSE" UBYTE CU_ISO2PRECHGRXTRG 1 100 0.0 1.0 ECU_ADDRESS 0x7001826d BYTE_ORDER MSB_LAST /end MEASUREMENT
/begin COMPU_METHOD CU_ISO2PRECHGRXTRG "Conversion method for Iso2PreChgRxTrg" RAT_FUNC "%10.0" "b" COEFFS 0.000000 1.000000 -0.000000 0.000000 0.000000 1.000000 /end COMPU_METHOD
/* Scalar measurable for DDE 'Iso2PwrDelivEvseProcessing'. */
/begin MEASUREMENT Iso2PwrDelivEvseProcessing "Indicates that the EVSE has either finished or still in process of finishing the processing that was started after the AuthorizationReq message" UBYTE CU_ISO2PWRDELIVEVSEPROCESSING 1 100 0.0 255.0 ECU_ADDRESS 0x70018450 BYTE_ORDER MSB_LAST /end MEASUREMENT
/begin COMPU_METHOD CU_ISO2PWRDELIVEVSEPROCESSING "Conversion method for Iso2PwrDelivEvseProcessing" RAT_FUNC "%10.0" "1" COEFFS 0.000000 1.000000 -0.000000 0.000000 0.000000 1.000000 /end COMPU_METHOD
/* Scalar measurable for DDE 'Iso2PwrDelivEvseStatPres'. */
/begin MEASUREMENT Iso2PwrDelivEvseStatPres "Indicates the presence of the EVSENotificationMaxDelay and EVSENotification parameters in the PowerDeliveryRes message" UBYTE CU_ISO2PWRDELIVEVSESTATPRES 1 100 0.0 1.0 ECU_ADDRESS 0x70017e39 BYTE_ORDER MSB_LAST /end MEASUREMENT
/begin COMPU_METHOD CU_ISO2PWRDELIVEVSESTATPRES "Conversion method for Iso2PwrDelivEvseStatPres" RAT_FUNC "%10.0" "b" COEFFS 0.000000 1.000000 -0.000000 0.000000 0.000000 1.000000 /end COMPU_METHOD
/* Scalar measurable for DDE 'Iso2PwrDelivNotif'. */
/begin MEASUREMENT Iso2PwrDelivNotif "Indicates action SECC wants the EVSE to perform in the PowerDeliveryRes message" UBYTE CU_ISO2PWRDELIVNOTIF 1 100 0.0 255.0 ECU_ADDRESS 0x700181a0 BYTE_ORDER MSB_LAST /end MEASUREMENT
/begin COMPU_METHOD CU_ISO2PWRDELIVNOTIF "Conversion method for Iso2PwrDelivNotif" RAT_FUNC "%10.0" "1" COEFFS 0.000000 1.000000 -0.000000 0.000000 0.000000 1.000000 /end COMPU_METHOD
/* Scalar measurable for DDE 'Iso2PwrDelivNotifMaxDelay'. */
/begin MEASUREMENT Iso2PwrDelivNotifMaxDelay "Indicates the time until the SECC expects the EVCC to react on the EVSENotification action set in the PowerDeliveryRes message" UWORD CU_ISO2PWRDELIVNOTIFMAXDELAY 1 100 0.0 65535.0 ECU_ADDRESS 0x70017f56 BYTE_ORDER MSB_LAST /end MEASUREMENT
/begin COMPU_METHOD CU_ISO2PWRDELIVNOTIFMAXDELAY "Conversion method for Iso2PwrDelivNotifMaxDelay" RAT_FUNC "%10.0" "1" COEFFS 0.000000 1.000000 -0.000000 0.000000 0.000000 1.000000 /end COMPU_METHOD
/* Scalar measurable for DDE 'Iso2PwrDelivRescode'. */
/begin MEASUREMENT Iso2PwrDelivRescode "for ISOv2 PowerDeliveryRes message: indicates the acknowledgment status of this V2G messages received by the SECC." UBYTE CU_ISO2PWRDELIVRESCODE 1 100 0.0 255.0 ECU_ADDRESS 0x70017db4 BYTE_ORDER MSB_LAST /end MEASUREMENT
/begin COMPU_METHOD CU_ISO2PWRDELIVRESCODE "Conversion method for Iso2PwrDelivRescode" RAT_FUNC "%10.0" "1" COEFFS 0.000000 1.000000 -0.000000 0.000000 0.000000 1.000000 /end COMPU_METHOD
/* Scalar measurable for DDE 'Iso2PwrDelivRxTrg'. */
/begin MEASUREMENT Iso2PwrDelivRxTrg "Trigger flag that on a rising edge indicates the event for receiving the PLC (V2G) PowerDeliveryRes message from the EVSE" UBYTE CU_ISO2PWRDELIVRXTRG 1 100 0.0 1.0 ECU_ADDRESS 0x700183bd BYTE_ORDER MSB_LAST /end MEASUREMENT
/begin COMPU_METHOD CU_ISO2PWRDELIVRXTRG "Conversion method for Iso2PwrDelivRxTrg" RAT_FUNC "%10.0" "b" COEFFS 0.000000 1.000000 -0.000000 0.000000 0.000000 1.000000 /end COMPU_METHOD
/* Scalar measurable for DDE 'Iso2SesSetupNotif'. */
/begin MEASUREMENT Iso2SesSetupNotif "Indicates action SECC wants the EVSE to perform in the SessionSetupRes message" UBYTE CU_ISO2SESSETUPNOTIF 1 100 0.0 255.0 ECU_ADDRESS 0x70017de8 BYTE_ORDER MSB_LAST /end MEASUREMENT
/begin COMPU_METHOD CU_ISO2SESSETUPNOTIF "Conversion method for Iso2SesSetupNotif" RAT_FUNC "%10.0" "1" COEFFS 0.000000 1.000000 -0.000000 0.000000 0.000000 1.000000 /end COMPU_METHOD
/* Scalar measurable for DDE 'Iso2SesSetupNotifMaxDelay'. */
/begin MEASUREMENT Iso2SesSetupNotifMaxDelay "Indicates the time until the SECC expects the EVCC to react on the EVSENotification action set in the SessionSetupRes message" UWORD CU_ISO2SESSETUPNOTIFMAXDELAY 1 100 0.0 65535.0 ECU_ADDRESS 0x7001814e BYTE_ORDER MSB_LAST /end MEASUREMENT
/begin COMPU_METHOD CU_ISO2SESSETUPNOTIFMAXDELAY "Conversion method for Iso2SesSetupNotifMaxDelay" RAT_FUNC "%10.0" "1" COEFFS 0.000000 1.000000 -0.000000 0.000000 0.000000 1.000000 /end COMPU_METHOD
/* Scalar measurable for DDE 'Iso2SesSetupRescode'. */
/begin MEASUREMENT Iso2SesSetupRescode "for ISOv2 SessionSetupRes message: indicates the acknowledgment status of this V2G messages received by the SECC." UBYTE CU_ISO2SESSETUPRESCODE 1 100 0.0 255.0 ECU_ADDRESS 0x700183f4 BYTE_ORDER MSB_LAST /end MEASUREMENT
/begin COMPU_METHOD CU_ISO2SESSETUPRESCODE "Conversion method for Iso2SesSetupRescode" RAT_FUNC "%10.0" "1" COEFFS 0.000000 1.000000 -0.000000 0.000000 0.000000 1.000000 /end COMPU_METHOD
/* Scalar measurable for DDE 'Iso2SesSetupRxTrg'. */
/begin MEASUREMENT Iso2SesSetupRxTrg "Trigger flag that on a rising edge indicates the event for receiving the PLC (V2G) SessionSetupRes message from the EVSE" UBYTE CU_ISO2SESSETUPRXTRG 1 100 0.0 1.0 ECU_ADDRESS 0x7001825d BYTE_ORDER MSB_LAST /end MEASUREMENT
/begin COMPU_METHOD CU_ISO2SESSETUPRXTRG "Conversion method for Iso2SesSetupRxTrg" RAT_FUNC "%10.0" "b" COEFFS 0.000000 1.000000 -0.000000 0.000000 0.000000 1.000000 /end COMPU_METHOD
/* Scalar measurable for DDE 'Iso2SesSetupTimestmp'. */
/begin MEASUREMENT Iso2SesSetupTimestmp "Timestamp of the current SECC time using the Unix Time Stamp format." SLONG CU_ISO2SESSETUPTIMESTMP 1 100 0.0 2147483647.0 ECU_ADDRESS 0x70018000 BYTE_ORDER MSB_LAST /end MEASUREMENT
/begin COMPU_METHOD CU_ISO2SESSETUPTIMESTMP "Conversion method for Iso2SesSetupTimestmp" RAT_FUNC "%10.0" "1" COEFFS 0.000000 1.000000 -0.000000 0.000000 0.000000 1.000000 /end COMPU_METHOD
/* Scalar measurable for DDE 'Iso2SesSetupTimestmpPres'. */
/begin MEASUREMENT Iso2SesSetupTimestmpPres "Indicates the presence of the EVSETimeStamp parameter" UBYTE CU_ISO2SESSETUPTIMESTMPPRES 1 100 0.0 1.0 ECU_ADDRESS 0x70017d96 BYTE_ORDER MSB_LAST /end MEASUREMENT
/begin COMPU_METHOD CU_ISO2SESSETUPTIMESTMPPRES "Conversion method for Iso2SesSetupTimestmpPres" RAT_FUNC "%10.0" "b" COEFFS 0.000000 1.000000 -0.000000 0.000000 0.000000 1.000000 /end COMPU_METHOD
/* Scalar measurable for DDE 'Iso2SesStopEvseStatPres'. */
/begin MEASUREMENT Iso2SesStopEvseStatPres "Indicates the presence of the EVSENotificationMaxDelay and EVSENotification parameters in the SessionStopRes message" UBYTE CU_ISO2SESSTOPEVSESTATPRES 1 100 0.0 1.0 ECU_ADDRESS 0x70018055 BYTE_ORDER MSB_LAST /end MEASUREMENT
/begin COMPU_METHOD CU_ISO2SESSTOPEVSESTATPRES "Conversion method for Iso2SesStopEvseStatPres" RAT_FUNC "%10.0" "b" COEFFS 0.000000 1.000000 -0.000000 0.000000 0.000000 1.000000 /end COMPU_METHOD
/* Scalar measurable for DDE 'Iso2SesStopNotif'. */
/begin MEASUREMENT Iso2SesStopNotif "Indicates action SECC wants the EVSE to perform in the SessionStopRes message" UBYTE CU_ISO2SESSTOPNOTIF 1 100 0.0 255.0 ECU_ADDRESS 0x70018390 BYTE_ORDER MSB_LAST /end MEASUREMENT
/begin COMPU_METHOD CU_ISO2SESSTOPNOTIF "Conversion method for Iso2SesStopNotif" RAT_FUNC "%10.0" "1" COEFFS 0.000000 1.000000 -0.000000 0.000000 0.000000 1.000000 /end COMPU_METHOD
/* Scalar measurable for DDE 'Iso2SesStopNotifMaxDelay'. */
/begin MEASUREMENT Iso2SesStopNotifMaxDelay "Indicates the time until the SECC expects the EVCC to react on the EVSENotification action set in the SessionStopRes message" UWORD CU_ISO2SESSTOPNOTIFMAXDELAY 1 100 0.0 65535.0 ECU_ADDRESS 0x70017dac BYTE_ORDER MSB_LAST /end MEASUREMENT
/begin COMPU_METHOD CU_ISO2SESSTOPNOTIFMAXDELAY "Conversion method for Iso2SesStopNotifMaxDelay" RAT_FUNC "%10.0" "1" COEFFS 0.000000 1.000000 -0.000000 0.000000 0.000000 1.000000 /end COMPU_METHOD
/* Scalar measurable for DDE 'Iso2SesStopRescode'. */
/begin MEASUREMENT Iso2SesStopRescode "for ISOv2 SessionStopRes message: indicates the acknowledgment status of this V2G messages received by the SECC." UBYTE CU_ISO2SESSTOPRESCODE 1 100 0.0 255.0 ECU_ADDRESS 0x7001849d BYTE_ORDER MSB_LAST /end MEASUREMENT
/begin COMPU_METHOD CU_ISO2SESSTOPRESCODE "Conversion method for Iso2SesStopRescode" RAT_FUNC "%10.0" "1" COEFFS 0.000000 1.000000 -0.000000 0.000000 0.000000 1.000000 /end COMPU_METHOD
/* Scalar measurable for DDE 'Iso2SesStopRxTrg'. */
/begin MEASUREMENT Iso2SesStopRxTrg "Trigger flag that on a rising edge indicates the event for receiving the PLC (V2G) SessionStopRes message from the EVSE" UBYTE CU_ISO2SESSTOPRXTRG 1 100 0.0 1.0 ECU_ADDRESS 0x70018309 BYTE_ORDER MSB_LAST /end MEASUREMENT
/begin COMPU_METHOD CU_ISO2SESSTOPRXTRG "Conversion method for Iso2SesStopRxTrg" RAT_FUNC "%10.0" "b" COEFFS 0.000000 1.000000 -0.000000 0.000000 0.000000 1.000000 /end COMPU_METHOD
/* Scalar measurable for DDE 'Iso2SvcDetailEvseMaxDelay'. */
/begin MEASUREMENT Iso2SvcDetailEvseMaxDelay "Indicates the time until the SECC expects the EVCC to react on the EVSENotification action set in the ServiceDetailRes message" UWORD CU_ISO2SVCDETAILEVSEMAXDELAY 1 100 0.0 65535.0 ECU_ADDRESS 0x70017fca BYTE_ORDER MSB_LAST /end MEASUREMENT
/begin COMPU_METHOD CU_ISO2SVCDETAILEVSEMAXDELAY "Conversion method for Iso2SvcDetailEvseMaxDelay" RAT_FUNC "%10.0" "1" COEFFS 0.000000 1.000000 -0.000000 0.000000 0.000000 1.000000 /end COMPU_METHOD
/* Scalar measurable for DDE 'Iso2SvcDetailEvseStatPres'. */
/begin MEASUREMENT Iso2SvcDetailEvseStatPres "Indicates the presence of the EVSENotificationMaxDelay and EVSENotification parameters in the ServiceDetailRes message" UBYTE CU_ISO2SVCDETAILEVSESTATPRES 1 100 0.0 1.0 ECU_ADDRESS 0x70018341 BYTE_ORDER MSB_LAST /end MEASUREMENT
/begin COMPU_METHOD CU_ISO2SVCDETAILEVSESTATPRES "Conversion method for Iso2SvcDetailEvseStatPres" RAT_FUNC "%10.0" "b" COEFFS 0.000000 1.000000 -0.000000 0.000000 0.000000 1.000000 /end COMPU_METHOD
/* Scalar measurable for DDE 'Iso2SvcDetailNotif'. */
/begin MEASUREMENT Iso2SvcDetailNotif "Indicates action SECC wants the EVSE to perform in the ServiceDetailRes message" UBYTE CU_ISO2SVCDETAILNOTIF 1 100 0.0 255.0 ECU_ADDRESS 0x70017d4a BYTE_ORDER MSB_LAST /end MEASUREMENT
/begin COMPU_METHOD CU_ISO2SVCDETAILNOTIF "Conversion method for Iso2SvcDetailNotif" RAT_FUNC "%10.0" "1" COEFFS 0.000000 1.000000 -0.000000 0.000000 0.000000 1.000000 /end COMPU_METHOD
/* Scalar measurable for DDE 'Iso2SvcDetailRescode'. */
/begin MEASUREMENT Iso2SvcDetailRescode "for ISOv2 ServiceDetailRes message: indicates the acknowledgment status of this V2G messages received by the SECC." UBYTE CU_ISO2SVCDETAILRESCODE 1 100 0.0 255.0 ECU_ADDRESS 0x7001845d BYTE_ORDER MSB_LAST /end MEASUREMENT
/begin COMPU_METHOD CU_ISO2SVCDETAILRESCODE "Conversion method for Iso2SvcDetailRescode" RAT_FUNC "%10.0" "1" COEFFS 0.000000 1.000000 -0.000000 0.000000 0.000000 1.000000 /end COMPU_METHOD
/* Scalar measurable for DDE 'Iso2SvcDetailRxTrg'. */
/begin MEASUREMENT Iso2SvcDetailRxTrg "Trigger flag that on a rising edge indicates the event for receiving the PLC (V2G) ServiceDetailRes message from the EVSE" UBYTE CU_ISO2SVCDETAILRXTRG 1 100 0.0 1.0 ECU_ADDRESS 0x700182a6 BYTE_ORDER MSB_LAST /end MEASUREMENT
/begin COMPU_METHOD CU_ISO2SVCDETAILRXTRG "Conversion method for Iso2SvcDetailRxTrg" RAT_FUNC "%10.0" "b" COEFFS 0.000000 1.000000 -0.000000 0.000000 0.000000 1.000000 /end COMPU_METHOD
/* Scalar measurable for DDE 'Iso2SvcDetailSvcId'. */
/begin MEASUREMENT Iso2SvcDetailSvcId "Identifies a service which has been offered by the SECC in the ServiceDiscoveryRes message" UWORD CU_ISO2SVCDETAILSVCID 1 100 0.0 65535.0 ECU_ADDRESS 0x70018098 BYTE_ORDER MSB_LAST /end MEASUREMENT
/begin COMPU_METHOD CU_ISO2SVCDETAILSVCID "Conversion method for Iso2SvcDetailSvcId" RAT_FUNC "%10.0" "1" COEFFS 0.000000 1.000000 -0.000000 0.000000 0.000000 1.000000 /end COMPU_METHOD
/* Scalar measurable for DDE 'Iso2SvcDetailSvcParamSetLen'. */
/begin MEASUREMENT Iso2SvcDetailSvcParamSetLen "Actual number of elements in the ServiceParameterList parameter of the ServiceDetailRes message" UBYTE CU_ISO2SVCDETAILSVCPARAMSETLEN 1 100 0.0 255.0 ECU_ADDRESS 0x70017de1 BYTE_ORDER MSB_LAST /end MEASUREMENT
/begin COMPU_METHOD CU_ISO2SVCDETAILSVCPARAMSETLEN "Conversion method for Iso2SvcDetailSvcParamSetLen" RAT_FUNC "%10.0" "1" COEFFS 0.000000 1.000000 -0.000000 0.000000 0.000000 1.000000 /end COMPU_METHOD
/* Scalar measurable for DDE 'Iso2SvcDetailSvcParamSetSizes[0]'. */
/begin MEASUREMENT Iso2SvcDetailSvcParamSetSizes[1 "Indicates the array that holds the array length of each parameter in each parameter set. \n(i.e holds the array length of ServiceDetailRes -> ServiceParameterList -> ParameterSet -> Parameter)" UBYTE CU_ISO2SVCDETAILSVCPARAMSETSIZ1 1 100 0.0 255.0 ECU_ADDRESS 0x70018148 BYTE_ORDER MSB_LAST /end MEASUREMENT
/begin COMPU_METHOD CU_ISO2SVCDETAILSVCPARAMSETSIZ1 "Conversion method for Iso2SvcDetailSvcParamSetSizes[0]" RAT_FUNC "%10.0" "1" COEFFS 0.000000 1.000000 -0.000000 0.000000 0.000000 1.000000 /end COMPU_METHOD
/* Scalar measurable for DDE 'Iso2SvcDetailSvcParamSetSizes[1]'. */
/begin MEASUREMENT Iso2SvcDetailSvcParamSetSizes[2 "Indicates the array that holds the array length of each parameter in each parameter set. \n(i.e holds the array length of ServiceDetailRes -> ServiceParameterList -> ParameterSet -> Parameter)" UBYTE CU_ISO2SVCDETAILSVCPARAMSETSIZ2 1 100 0.0 255.0 ECU_ADDRESS 0x70018149 BYTE_ORDER MSB_LAST /end MEASUREMENT
/begin COMPU_METHOD CU_ISO2SVCDETAILSVCPARAMSETSIZ2 "Conversion method for Iso2SvcDetailSvcParamSetSizes[1]" RAT_FUNC "%10.0" "1" COEFFS 0.000000 1.000000 -0.000000 0.000000 0.000000 1.000000 /end COMPU_METHOD
/* Scalar measurable for DDE 'Iso2SvcDetailSvcParamSetSizes[2]'. */
/begin MEASUREMENT Iso2SvcDetailSvcParamSetSizes[0 "Indicates the array that holds the array length of each parameter in each parameter set. \n(i.e holds the array length of ServiceDetailRes -> ServiceParameterList -> ParameterSet -> Parameter)" UBYTE CU_ISO2SVCDETAILSVCPARAMSETSIZ0 1 100 0.0 255.0 ECU_ADDRESS 0x7001814a BYTE_ORDER MSB_LAST /end MEASUREMENT
/begin COMPU_METHOD CU_ISO2SVCDETAILSVCPARAMSETSIZ0 "Conversion method for Iso2SvcDetailSvcParamSetSizes[2]" RAT_FUNC "%10.0" "1" COEFFS 0.000000 1.000000 -0.000000 0.000000 0.000000 1.000000 /end COMPU_METHOD
/* Scalar measurable for DDE 'Iso2SvcDetailSvcParamSetSizes[3]'. */
/begin MEASUREMENT Iso2SvcDetailSvcParamSetSizes[3 "Indicates the array that holds the array length of each parameter in each parameter set. \n(i.e holds the array length of ServiceDetailRes -> ServiceParameterList -> ParameterSet -> Parameter)" UBYTE CU_ISO2SVCDETAILSVCPARAMSETSIZ3 1 100 0.0 255.0 ECU_ADDRESS 0x7001814b BYTE_ORDER MSB_LAST /end MEASUREMENT
/begin COMPU_METHOD CU_ISO2SVCDETAILSVCPARAMSETSIZ3 "Conversion method for Iso2SvcDetailSvcParamSetSizes[3]" RAT_FUNC "%10.0" "1" COEFFS 0.000000 1.000000 -0.000000 0.000000 0.000000 1.000000 /end COMPU_METHOD
/* Scalar measurable for DDE 'Iso2SvcDetailSvcParamSetSizes[4]'. */
/begin MEASUREMENT Iso2SvcDetailSvcParamSetSizes[4 "Indicates the array that holds the array length of each parameter in each parameter set. \n(i.e holds the array length of ServiceDetailRes -> ServiceParameterList -> ParameterSet -> Parameter)" UBYTE CU_ISO2SVCDETAILSVCPARAMSETSIZ4 1 100 0.0 255.0 ECU_ADDRESS 0x7001814c BYTE_ORDER MSB_LAST /end MEASUREMENT
/begin COMPU_METHOD CU_ISO2SVCDETAILSVCPARAMSETSIZ4 "Conversion method for Iso2SvcDetailSvcParamSetSizes[4]" RAT_FUNC "%10.0" "1" COEFFS 0.000000 1.000000 -0.000000 0.000000 0.000000 1.000000 /end COMPU_METHOD
/* Scalar measurable for DDE 'Iso2SvcDiscEgyTrnsLen'. */
/begin MEASUREMENT Iso2SvcDiscEgyTrnsLen "Actual number of elements in the Iso2SvcDiscEnergyTransferSvcIds and Iso2SvcDiscEnergyTransferSvcFreeSvc lists" UBYTE CU_ISO2SVCDISCEGYTRNSLEN 1 100 0.0 255.0 ECU_ADDRESS 0x700183ed BYTE_ORDER MSB_LAST /end MEASUREMENT
/begin COMPU_METHOD CU_ISO2SVCDISCEGYTRNSLEN "Conversion method for Iso2SvcDiscEgyTrnsLen" RAT_FUNC "%10.0" "1" COEFFS 0.000000 1.000000 -0.000000 0.000000 0.000000 1.000000 /end COMPU_METHOD
/* Scalar measurable for DDE 'Iso2SvcDiscEgyTrnsSvcFreeSvc[0]'. */
/begin MEASUREMENT Iso2SvcDiscEgyTrnsSvcFreeSvc[0] "Indicates a list of booleans that denote if a service at a index is free of charge or not." UBYTE CU_ISO2SVCDISCEGYTRNSSVCFREESV2 1 100 0.0 1.0 ECU_ADDRESS 0x70018254 BYTE_ORDER MSB_LAST /end MEASUREMENT
/begin COMPU_METHOD CU_ISO2SVCDISCEGYTRNSSVCFREESV2 "Conversion method for Iso2SvcDiscEgyTrnsSvcFreeSvc[0]" RAT_FUNC "%10.0" "1" COEFFS 0.000000 1.000000 -0.000000 0.000000 0.000000 1.000000 /end COMPU_METHOD
/* Scalar measurable for DDE 'Iso2SvcDiscEgyTrnsSvcFreeSvc[1]'. */
/begin MEASUREMENT Iso2SvcDiscEgyTrnsSvcFreeSvc[1] "Indicates a list of booleans that denote if a service at a index is free of charge or not." UBYTE CU_ISO2SVCDISCEGYTRNSSVCFREESV7 1 100 0.0 1.0 ECU_ADDRESS 0x70018255 BYTE_ORDER MSB_LAST /end MEASUREMENT
/begin COMPU_METHOD CU_ISO2SVCDISCEGYTRNSSVCFREESV7 "Conversion method for Iso2SvcDiscEgyTrnsSvcFreeSvc[1]" RAT_FUNC "%10.0" "1" COEFFS 0.000000 1.000000 -0.000000 0.000000 0.000000 1.000000 /end COMPU_METHOD
/* Scalar measurable for DDE 'Iso2SvcDiscEgyTrnsSvcFreeSvc[2]'. */
/begin MEASUREMENT Iso2SvcDiscEgyTrnsSvcFreeSvc[2] "Indicates a list of booleans that denote if a service at a index is free of charge or not." UBYTE CU_ISO2SVCDISCEGYTRNSSVCFREESV1 1 100 0.0 1.0 ECU_ADDRESS 0x70018256 BYTE_ORDER MSB_LAST /end MEASUREMENT
/begin COMPU_METHOD CU_ISO2SVCDISCEGYTRNSSVCFREESV1 "Conversion method for Iso2SvcDiscEgyTrnsSvcFreeSvc[2]" RAT_FUNC "%10.0" "1" COEFFS 0.000000 1.000000 -0.000000 0.000000 0.000000 1.000000 /end COMPU_METHOD
/* Scalar measurable for DDE 'Iso2SvcDiscEgyTrnsSvcFreeSvc[3]'. */
/begin MEASUREMENT Iso2SvcDiscEgyTrnsSvcFreeSvc[3] "Indicates a list of booleans that denote if a service at a index is free of charge or not." UBYTE CU_ISO2SVCDISCEGYTRNSSVCFREESV0 1 100 0.0 1.0 ECU_ADDRESS 0x70018257 BYTE_ORDER MSB_LAST /end MEASUREMENT
/begin COMPU_METHOD CU_ISO2SVCDISCEGYTRNSSVCFREESV0 "Conversion method for Iso2SvcDiscEgyTrnsSvcFreeSvc[3]" RAT_FUNC "%10.0" "1" COEFFS 0.000000 1.000000 -0.000000 0.000000 0.000000 1.000000 /end COMPU_METHOD
/* Scalar measurable for DDE 'Iso2SvcDiscEgyTrnsSvcFreeSvc[4]'. */
/begin MEASUREMENT Iso2SvcDiscEgyTrnsSvcFreeSvc[4] "Indicates a list of booleans that denote if a service at a index is free of charge or not." UBYTE CU_ISO2SVCDISCEGYTRNSSVCFREESV4 1 100 0.0 1.0 ECU_ADDRESS 0x70018258 BYTE_ORDER MSB_LAST /end MEASUREMENT
/begin COMPU_METHOD CU_ISO2SVCDISCEGYTRNSSVCFREESV4 "Conversion method for Iso2SvcDiscEgyTrnsSvcFreeSvc[4]" RAT_FUNC "%10.0" "1" COEFFS 0.000000 1.000000 -0.000000 0.000000 0.000000 1.000000 /end COMPU_METHOD
/* Scalar measurable for DDE 'Iso2SvcDiscEgyTrnsSvcFreeSvc[5]'. */
/begin MEASUREMENT Iso2SvcDiscEgyTrnsSvcFreeSvc[5] "Indicates a list of booleans that denote if a service at a index is free of charge or not." UBYTE CU_ISO2SVCDISCEGYTRNSSVCFREESV3 1 100 0.0 1.0 ECU_ADDRESS 0x70018259 BYTE_ORDER MSB_LAST /end MEASUREMENT
/begin COMPU_METHOD CU_ISO2SVCDISCEGYTRNSSVCFREESV3 "Conversion method for Iso2SvcDiscEgyTrnsSvcFreeSvc[5]" RAT_FUNC "%10.0" "1" COEFFS 0.000000 1.000000 -0.000000 0.000000 0.000000 1.000000 /end COMPU_METHOD
/* Scalar measurable for DDE 'Iso2SvcDiscEgyTrnsSvcFreeSvc[6]'. */
/begin MEASUREMENT Iso2SvcDiscEgyTrnsSvcFreeSvc[6] "Indicates a list of booleans that denote if a service at a index is free of charge or not." UBYTE CU_ISO2SVCDISCEGYTRNSSVCFREESV6 1 100 0.0 1.0 ECU_ADDRESS 0x7001825a BYTE_ORDER MSB_LAST /end MEASUREMENT
/begin COMPU_METHOD CU_ISO2SVCDISCEGYTRNSSVCFREESV6 "Conversion method for Iso2SvcDiscEgyTrnsSvcFreeSvc[6]" RAT_FUNC "%10.0" "1" COEFFS 0.000000 1.000000 -0.000000 0.000000 0.000000 1.000000 /end COMPU_METHOD
/* Scalar measurable for DDE 'Iso2SvcDiscEgyTrnsSvcFreeSvc[7]'. */
/begin MEASUREMENT Iso2SvcDiscEgyTrnsSvcFreeSvc[7] "Indicates a list of booleans that denote if a service at a index is free of charge or not." UBYTE CU_ISO2SVCDISCEGYTRNSSVCFREESV5 1 100 0.0 1.0 ECU_ADDRESS 0x7001825b BYTE_ORDER MSB_LAST /end MEASUREMENT
/begin COMPU_METHOD CU_ISO2SVCDISCEGYTRNSSVCFREESV5 "Conversion method for Iso2SvcDiscEgyTrnsSvcFreeSvc[7]" RAT_FUNC "%10.0" "1" COEFFS 0.000000 1.000000 -0.000000 0.000000 0.000000 1.000000 /end COMPU_METHOD
/* Scalar measurable for DDE 'Iso2SvcDiscEgyTrnsSvcIds[0]'. */
/begin MEASUREMENT Iso2SvcDiscEgyTrnsSvcIds[0] "Indicates the list of service IDs of the available charging and BPT services supported by the EVSE" UWORD CU_ISO2SVCDISCEGYTRNSSVCIDS[0] 1 100 0.0 65535.0 ECU_ADDRESS 0x70017fee BYTE_ORDER MSB_LAST /end MEASUREMENT
/begin COMPU_METHOD CU_ISO2SVCDISCEGYTRNSSVCIDS[0] "Conversion method for Iso2SvcDiscEgyTrnsSvcIds[0]" RAT_FUNC "%10.0" "1" COEFFS 0.000000 1.000000 -0.000000 0.000000 0.000000 1.000000 /end COMPU_METHOD
/* Scalar measurable for DDE 'Iso2SvcDiscEgyTrnsSvcIds[1]'. */
/begin MEASUREMENT Iso2SvcDiscEgyTrnsSvcIds[1] "Indicates the list of service IDs of the available charging and BPT services supported by the EVSE" UWORD CU_ISO2SVCDISCEGYTRNSSVCIDS[1] 1 100 0.0 65535.0 ECU_ADDRESS 0x70017ff0 BYTE_ORDER MSB_LAST /end MEASUREMENT
/begin COMPU_METHOD CU_ISO2SVCDISCEGYTRNSSVCIDS[1] "Conversion method for Iso2SvcDiscEgyTrnsSvcIds[1]" RAT_FUNC "%10.0" "1" COEFFS 0.000000 1.000000 -0.000000 0.000000 0.000000 1.000000 /end COMPU_METHOD
/* Scalar measurable for DDE 'Iso2SvcDiscEgyTrnsSvcIds[2]'. */
/begin MEASUREMENT Iso2SvcDiscEgyTrnsSvcIds[2] "Indicates the list of service IDs of the available charging and BPT services supported by the EVSE" UWORD CU_ISO2SVCDISCEGYTRNSSVCIDS[2] 1 100 0.0 65535.0 ECU_ADDRESS 0x70017ff2 BYTE_ORDER MSB_LAST /end MEASUREMENT
/begin COMPU_METHOD CU_ISO2SVCDISCEGYTRNSSVCIDS[2] "Conversion method for Iso2SvcDiscEgyTrnsSvcIds[2]" RAT_FUNC "%10.0" "1" COEFFS 0.000000 1.000000 -0.000000 0.000000 0.000000 1.000000 /end COMPU_METHOD
/* Scalar measurable for DDE 'Iso2SvcDiscEgyTrnsSvcIds[3]'. */
/begin MEASUREMENT Iso2SvcDiscEgyTrnsSvcIds[3] "Indicates the list of service IDs of the available charging and BPT services supported by the EVSE" UWORD CU_ISO2SVCDISCEGYTRNSSVCIDS[3] 1 100 0.0 65535.0 ECU_ADDRESS 0x70017ff4 BYTE_ORDER MSB_LAST /end MEASUREMENT
/begin COMPU_METHOD CU_ISO2SVCDISCEGYTRNSSVCIDS[3] "Conversion method for Iso2SvcDiscEgyTrnsSvcIds[3]" RAT_FUNC "%10.0" "1" COEFFS 0.000000 1.000000 -0.000000 0.000000 0.000000 1.000000 /end COMPU_METHOD
/* Scalar measurable for DDE 'Iso2SvcDiscEgyTrnsSvcIds[4]'. */
/begin MEASUREMENT Iso2SvcDiscEgyTrnsSvcIds[4] "Indicates the list of service IDs of the available charging and BPT services supported by the EVSE" UWORD CU_ISO2SVCDISCEGYTRNSSVCIDS[4] 1 100 0.0 65535.0 ECU_ADDRESS 0x70017ff6 BYTE_ORDER MSB_LAST /end MEASUREMENT
/begin COMPU_METHOD CU_ISO2SVCDISCEGYTRNSSVCIDS[4] "Conversion method for Iso2SvcDiscEgyTrnsSvcIds[4]" RAT_FUNC "%10.0" "1" COEFFS 0.000000 1.000000 -0.000000 0.000000 0.000000 1.000000 /end COMPU_METHOD
/* Scalar measurable for DDE 'Iso2SvcDiscEgyTrnsSvcIds[5]'. */
/begin MEASUREMENT Iso2SvcDiscEgyTrnsSvcIds[5] "Indicates the list of service IDs of the available charging and BPT services supported by the EVSE" UWORD CU_ISO2SVCDISCEGYTRNSSVCIDS[5] 1 100 0.0 65535.0 ECU_ADDRESS 0x70017ff8 BYTE_ORDER MSB_LAST /end MEASUREMENT
/begin COMPU_METHOD CU_ISO2SVCDISCEGYTRNSSVCIDS[5] "Conversion method for Iso2SvcDiscEgyTrnsSvcIds[5]" RAT_FUNC "%10.0" "1" COEFFS 0.000000 1.000000 -0.000000 0.000000 0.000000 1.000000 /end COMPU_METHOD
/* Scalar measurable for DDE 'Iso2SvcDiscEgyTrnsSvcIds[6]'. */
/begin MEASUREMENT Iso2SvcDiscEgyTrnsSvcIds[6] "Indicates the list of service IDs of the available charging and BPT services supported by the EVSE" UWORD CU_ISO2SVCDISCEGYTRNSSVCIDS[6] 1 100 0.0 65535.0 ECU_ADDRESS 0x70017ffa BYTE_ORDER MSB_LAST /end MEASUREMENT
/begin COMPU_METHOD CU_ISO2SVCDISCEGYTRNSSVCIDS[6] "Conversion method for Iso2SvcDiscEgyTrnsSvcIds[6]" RAT_FUNC "%10.0" "1" COEFFS 0.000000 1.000000 -0.000000 0.000000 0.000000 1.000000 /end COMPU_METHOD
/* Scalar measurable for DDE 'Iso2SvcDiscEgyTrnsSvcIds[7]'. */
/begin MEASUREMENT Iso2SvcDiscEgyTrnsSvcIds[7] "Indicates the list of service IDs of the available charging and BPT services supported by the EVSE" UWORD CU_ISO2SVCDISCEGYTRNSSVCIDS[7] 1 100 0.0 65535.0 ECU_ADDRESS 0x70017ffc BYTE_ORDER MSB_LAST /end MEASUREMENT
/begin COMPU_METHOD CU_ISO2SVCDISCEGYTRNSSVCIDS[7] "Conversion method for Iso2SvcDiscEgyTrnsSvcIds[7]" RAT_FUNC "%10.0" "1" COEFFS 0.000000 1.000000 -0.000000 0.000000 0.000000 1.000000 /end COMPU_METHOD
/* Scalar measurable for DDE 'Iso2SvcDiscEvseStatPres'. */
/begin MEASUREMENT Iso2SvcDiscEvseStatPres "Indicates the presence of the EVSENotificationMaxDelay and EVSENotification parameters in the ServiceDiscoveryRes message" UBYTE CU_ISO2SVCDISCEVSESTATPRES 1 100 0.0 1.0 ECU_ADDRESS 0x70017e62 BYTE_ORDER MSB_LAST /end MEASUREMENT
/begin COMPU_METHOD CU_ISO2SVCDISCEVSESTATPRES "Conversion method for Iso2SvcDiscEvseStatPres" RAT_FUNC "%10.0" "b" COEFFS 0.000000 1.000000 -0.000000 0.000000 0.000000 1.000000 /end COMPU_METHOD
/* Scalar measurable for DDE 'Iso2SvcDiscNotif'. */
/begin MEASUREMENT Iso2SvcDiscNotif "Indicates action SECC wants the EVSE to perform in the ServiceDiscoveryRes message" UBYTE CU_ISO2SVCDISCNOTIF 1 100 0.0 255.0 ECU_ADDRESS 0x70018484 BYTE_ORDER MSB_LAST /end MEASUREMENT
/begin COMPU_METHOD CU_ISO2SVCDISCNOTIF "Conversion method for Iso2SvcDiscNotif" RAT_FUNC "%10.0" "1" COEFFS 0.000000 1.000000 -0.000000 0.000000 0.000000 1.000000 /end COMPU_METHOD
/* Scalar measurable for DDE 'Iso2SvcDiscNotifMaxDelay'. */
/begin MEASUREMENT Iso2SvcDiscNotifMaxDelay "Indicates the time until the SECC expects the EVCC to react on the EVSENotification action set in the ServiceDiscoveryRes message" UWORD CU_ISO2SVCDISCNOTIFMAXDELAY 1 100 0.0 65535.0 ECU_ADDRESS 0x70017e94 BYTE_ORDER MSB_LAST /end MEASUREMENT
/begin COMPU_METHOD CU_ISO2SVCDISCNOTIFMAXDELAY "Conversion method for Iso2SvcDiscNotifMaxDelay" RAT_FUNC "%10.0" "1" COEFFS 0.000000 1.000000 -0.000000 0.000000 0.000000 1.000000 /end COMPU_METHOD
/* Scalar measurable for DDE 'Iso2SvcDiscRescode'. */
/begin MEASUREMENT Iso2SvcDiscRescode "for ISOv2 ServiceDiscoveryRes message: indicates the acknowledgment status of this V2G messages received by the SECC." UBYTE CU_ISO2SVCDISCRESCODE 1 100 0.0 255.0 ECU_ADDRESS 0x700181dc BYTE_ORDER MSB_LAST /end MEASUREMENT
/begin COMPU_METHOD CU_ISO2SVCDISCRESCODE "Conversion method for Iso2SvcDiscRescode" RAT_FUNC "%10.0" "1" COEFFS 0.000000 1.000000 -0.000000 0.000000 0.000000 1.000000 /end COMPU_METHOD
/* Scalar measurable for DDE 'Iso2SvcDiscRxTrg'. */
/begin MEASUREMENT Iso2SvcDiscRxTrg "Trigger flag that on a rising edge indicates the event for receiving the PLC (V2G) ServiceDiscoveryRes message from the EVSE" UBYTE CU_ISO2SVCDISCRXTRG 1 100 0.0 1.0 ECU_ADDRESS 0x70017f91 BYTE_ORDER MSB_LAST /end MEASUREMENT
/begin COMPU_METHOD CU_ISO2SVCDISCRXTRG "Conversion method for Iso2SvcDiscRxTrg" RAT_FUNC "%10.0" "b" COEFFS 0.000000 1.000000 -0.000000 0.000000 0.000000 1.000000 /end COMPU_METHOD
/* Scalar measurable for DDE 'Iso2SvcDiscVasListLen'. */
/begin MEASUREMENT Iso2SvcDiscVasListLen "Actual number of elements in the Iso2SvcDiscVasListIds and Iso2SvcDiscVasListFreeSvc lists" UBYTE CU_ISO2SVCDISCVASLISTLEN 1 100 0.0 255.0 ECU_ADDRESS 0x70017e08 BYTE_ORDER MSB_LAST /end MEASUREMENT
/begin COMPU_METHOD CU_ISO2SVCDISCVASLISTLEN "Conversion method for Iso2SvcDiscVasListLen" RAT_FUNC "%10.0" "1" COEFFS 0.000000 1.000000 -0.000000 0.000000 0.000000 1.000000 /end COMPU_METHOD
/* Scalar measurable for DDE 'Iso2WeldDetEvsePresVolt'. */
/begin MEASUREMENT Iso2WeldDetEvsePresVolt "Indicates the measured High Voltage DC (HVDC) voltage at the output of the DC Supply." FLOAT32_IEEE CU_ISO2WELDDETEVSEPRESVOLT 1 100 -3.40282346639e+38 3.40282346639e+38 ECU_ADDRESS 0x70017c40 BYTE_ORDER MSB_LAST /end MEASUREMENT
/begin COMPU_METHOD CU_ISO2WELDDETEVSEPRESVOLT "Conversion method for Iso2WeldDetEvsePresVolt" RAT_FUNC "%10.0" "%" COEFFS 0.000000 1.000000 -0.000000 0.000000 0.000000 1.000000 /end COMPU_METHOD
/* Scalar measurable for DDE 'Iso2WeldDetEvseStatPres'. */
/begin MEASUREMENT Iso2WeldDetEvseStatPres "Indicates the presence of the EVSENotificationMaxDelay and EVSENotification parameters in the WeldingDetectionRes message" UBYTE CU_ISO2WELDDETEVSESTATPRES 1 100 0.0 1.0 ECU_ADDRESS 0x70017e35 BYTE_ORDER MSB_LAST /end MEASUREMENT
/begin COMPU_METHOD CU_ISO2WELDDETEVSESTATPRES "Conversion method for Iso2WeldDetEvseStatPres" RAT_FUNC "%10.0" "b" COEFFS 0.000000 1.000000 -0.000000 0.000000 0.000000 1.000000 /end COMPU_METHOD
/* Scalar measurable for DDE 'Iso2WeldDetNotif'. */
/begin MEASUREMENT Iso2WeldDetNotif "Indicates action SECC wants the EVSE to perform in the WeldingDetectionRes message" UBYTE CU_ISO2WELDDETNOTIF 1 100 0.0 255.0 ECU_ADDRESS 0x70018194 BYTE_ORDER MSB_LAST /end MEASUREMENT
/begin COMPU_METHOD CU_ISO2WELDDETNOTIF "Conversion method for Iso2WeldDetNotif" RAT_FUNC "%10.0" "1" COEFFS 0.000000 1.000000 -0.000000 0.000000 0.000000 1.000000 /end COMPU_METHOD
/* Scalar measurable for DDE 'Iso2WeldDetNotifMaxDelay'. */
/begin MEASUREMENT Iso2WeldDetNotifMaxDelay "Indicates the time until the SECC expects the EVCC to react on the EVSENotification action set in the WeldingDetectionRes message" UWORD CU_ISO2WELDDETNOTIFMAXDELAY 1 100 0.0 65535.0 ECU_ADDRESS 0x7001845a BYTE_ORDER MSB_LAST /end MEASUREMENT
/begin COMPU_METHOD CU_ISO2WELDDETNOTIFMAXDELAY "Conversion method for Iso2WeldDetNotifMaxDelay" RAT_FUNC "%10.0" "1" COEFFS 0.000000 1.000000 -0.000000 0.000000 0.000000 1.000000 /end COMPU_METHOD
/* Scalar measurable for DDE 'Iso2WeldDetRescode'. */
/begin MEASUREMENT Iso2WeldDetRescode "for ISOv2 WeldingDetectionRes message: indicates the acknowledgment status of this V2G messages received by the SECC." UBYTE CU_ISO2WELDDETRESCODE 1 100 0.0 255.0 ECU_ADDRESS 0x700182a4 BYTE_ORDER MSB_LAST /end MEASUREMENT
/begin COMPU_METHOD CU_ISO2WELDDETRESCODE "Conversion method for Iso2WeldDetRescode" RAT_FUNC "%10.0" "1" COEFFS 0.000000 1.000000 -0.000000 0.000000 0.000000 1.000000 /end COMPU_METHOD
/* Scalar measurable for DDE 'Iso2WeldDetRxTrg'. */
/begin MEASUREMENT Iso2WeldDetRxTrg "Trigger flag that on a rising edge indicates the event for receiving the PLC (V2G) WeldingDetectionRes message from the EVSE" UBYTE CU_ISO2WELDDETRXTRG 1 100 0.0 1.0 ECU_ADDRESS 0x70018095 BYTE_ORDER MSB_LAST /end MEASUREMENT
/begin COMPU_METHOD CU_ISO2WELDDETRXTRG "Conversion method for Iso2WeldDetRxTrg" RAT_FUNC "%10.0" "b" COEFFS 0.000000 1.000000 -0.000000 0.000000 0.000000 1.000000 /end COMPU_METHOD
/* Scalar measurable for DDE 'K3_ignition_MaxFlt'. */
/begin MEASUREMENT K3_ignition_MaxFlt "Ignition above max threshold latched after debounce (CCU pin K3)" UBYTE CU_K3_IGNITION_MAXFLT 1 100 0.0 1.0 ECU_ADDRESS 0x7001a14c BYTE_ORDER MSB_LAST /end MEASUREMENT
/begin COMPU_METHOD CU_K3_IGNITION_MAXFLT "Conversion method for K3_ignition_MaxFlt" RAT_FUNC "%10.0" "(not defined)" COEFFS 0.000000 1.000000 -0.000000 0.000000 0.000000 1.000000 /end COMPU_METHOD
/* Scalar measurable for DDE 'K3_ignition_MaxFltActv'. */
/begin MEASUREMENT K3_ignition_MaxFltActv "Active fault high K3 (Max fault no latch or debounce)" UBYTE CU_K3_IGNITION_MAXFLTACTV 1 100 0.0 1.0 ECU_ADDRESS 0x7001a0bc BYTE_ORDER MSB_LAST /end MEASUREMENT
/begin COMPU_METHOD CU_K3_IGNITION_MAXFLTACTV "Conversion method for K3_ignition_MaxFltActv" RAT_FUNC "%10.0" "(not defined)" COEFFS 0.000000 1.000000 -0.000000 0.000000 0.000000 1.000000 /end COMPU_METHOD
/* Scalar measurable for DDE 'K3_ignition_MinFlt'. */
/begin MEASUREMENT K3_ignition_MinFlt "Ignition below min threshold latched after debounce (CCU pin K3)" UBYTE CU_K3_IGNITION_MINFLT 1 100 0.0 1.0 ECU_ADDRESS 0x7001a03f BYTE_ORDER MSB_LAST /end MEASUREMENT
/begin COMPU_METHOD CU_K3_IGNITION_MINFLT "Conversion method for K3_ignition_MinFlt" RAT_FUNC "%10.0" "(not defined)" COEFFS 0.000000 1.000000 -0.000000 0.000000 0.000000 1.000000 /end COMPU_METHOD
/* Scalar measurable for DDE 'K3_ignition_MinFltActv'. */
/begin MEASUREMENT K3_ignition_MinFltActv "Active fault low K3 (Min fault no latch or debounce)" UBYTE CU_K3_IGNITION_MINFLTACTV 1 100 0.0 1.0 ECU_ADDRESS 0x70019faf BYTE_ORDER MSB_LAST /end MEASUREMENT
/begin COMPU_METHOD CU_K3_IGNITION_MINFLTACTV "Conversion method for K3_ignition_MinFltActv" RAT_FUNC "%10.0" "(not defined)" COEFFS 0.000000 1.000000 -0.000000 0.000000 0.000000 1.000000 /end COMPU_METHOD
/* Scalar measurable for DDE 'M2_HbrNVmon_MaxFlt'. */
/begin MEASUREMENT M2_HbrNVmon_MaxFlt "HbrN Vmon above max threshold latched after debounce (CCU pin M2)" UBYTE CU_M2_HBRNVMON_MAXFLT 1 100 0.0 1.0 ECU_ADDRESS 0x70019f31 BYTE_ORDER MSB_LAST /end MEASUREMENT
/begin COMPU_METHOD CU_M2_HBRNVMON_MAXFLT "Conversion method for M2_HbrNVmon_MaxFlt" RAT_FUNC "%10.0" "(not defined)" COEFFS 0.000000 1.000000 -0.000000 0.000000 0.000000 1.000000 /end COMPU_METHOD
/* Scalar measurable for DDE 'M2_HbrNVmon_MaxFltActv'. */
/begin MEASUREMENT M2_HbrNVmon_MaxFltActv "Active fault high M2 (Max fault no latch or debounce)" UBYTE CU_M2_HBRNVMON_MAXFLTACTV 1 100 0.0 1.0 ECU_ADDRESS 0x70019ebc BYTE_ORDER MSB_LAST /end MEASUREMENT
/begin COMPU_METHOD CU_M2_HBRNVMON_MAXFLTACTV "Conversion method for M2_HbrNVmon_MaxFltActv" RAT_FUNC "%10.0" "(not defined)" COEFFS 0.000000 1.000000 -0.000000 0.000000 0.000000 1.000000 /end COMPU_METHOD
/* Scalar measurable for DDE 'M2_HbrNVmon_MinFlt'. */
/begin MEASUREMENT M2_HbrNVmon_MinFlt "HbrN Vmon below min threshold latched after debounce (CCU pin M2)" UBYTE CU_M2_HBRNVMON_MINFLT 1 100 0.0 1.0 ECU_ADDRESS 0x7001a140 BYTE_ORDER MSB_LAST /end MEASUREMENT
/begin COMPU_METHOD CU_M2_HBRNVMON_MINFLT "Conversion method for M2_HbrNVmon_MinFlt" RAT_FUNC "%10.0" "(not defined)" COEFFS 0.000000 1.000000 -0.000000 0.000000 0.000000 1.000000 /end COMPU_METHOD
/* Scalar measurable for DDE 'M2_HbrNVmon_MinFltActv'. */
/begin MEASUREMENT M2_HbrNVmon_MinFltActv "Active fault low M2 (Min fault no latch or debounce)" UBYTE CU_M2_HBRNVMON_MINFLTACTV 1 100 0.0 1.0 ECU_ADDRESS 0x7001a0b0 BYTE_ORDER MSB_LAST /end MEASUREMENT
/begin COMPU_METHOD CU_M2_HBRNVMON_MINFLTACTV "Conversion method for M2_HbrNVmon_MinFltActv" RAT_FUNC "%10.0" "(not defined)" COEFFS 0.000000 1.000000 -0.000000 0.000000 0.000000 1.000000 /end COMPU_METHOD
/* Scalar measurable for DDE 'M3_HbrPVmon_MaxFlt'. */
/begin MEASUREMENT M3_HbrPVmon_MaxFlt "HbrP Vmon above max threshold latched after debounce (CCU pin M3)" UBYTE CU_M3_HBRPVMON_MAXFLT 1 100 0.0 1.0 ECU_ADDRESS 0x7001a03c BYTE_ORDER MSB_LAST /end MEASUREMENT
/begin COMPU_METHOD CU_M3_HBRPVMON_MAXFLT "Conversion method for M3_HbrPVmon_MaxFlt" RAT_FUNC "%10.0" "(not defined)" COEFFS 0.000000 1.000000 -0.000000 0.000000 0.000000 1.000000 /end COMPU_METHOD
/* Scalar measurable for DDE 'M3_HbrPVmon_MaxFltActv'. */
/begin MEASUREMENT M3_HbrPVmon_MaxFltActv "Active fault high M3 (Max fault no latch or debounce)" UBYTE CU_M3_HBRPVMON_MAXFLTACTV 1 100 0.0 1.0 ECU_ADDRESS 0x70019fac BYTE_ORDER MSB_LAST /end MEASUREMENT
/begin COMPU_METHOD CU_M3_HBRPVMON_MAXFLTACTV "Conversion method for M3_HbrPVmon_MaxFltActv" RAT_FUNC "%10.0" "(not defined)" COEFFS 0.000000 1.000000 -0.000000 0.000000 0.000000 1.000000 /end COMPU_METHOD
/* Scalar measurable for DDE 'M3_HbrPVmon_MinFlt'. */
/begin MEASUREMENT M3_HbrPVmon_MinFlt "HbrP Vmon below min threshold latched after debounce (CCU pin M3)" UBYTE CU_M3_HBRPVMON_MINFLT 1 100 0.0 1.0 ECU_ADDRESS 0x70019f29 BYTE_ORDER MSB_LAST /end MEASUREMENT
/begin COMPU_METHOD CU_M3_HBRPVMON_MINFLT "Conversion method for M3_HbrPVmon_MinFlt" RAT_FUNC "%10.0" "(not defined)" COEFFS 0.000000 1.000000 -0.000000 0.000000 0.000000 1.000000 /end COMPU_METHOD
/* Scalar measurable for DDE 'M3_HbrPVmon_MinFltActv'. */
/begin MEASUREMENT M3_HbrPVmon_MinFltActv "Active fault low M3 (Min fault no latch or debounce)" UBYTE CU_M3_HBRPVMON_MINFLTACTV 1 100 0.0 1.0 ECU_ADDRESS 0x70019eb3 BYTE_ORDER MSB_LAST /end MEASUREMENT
/begin COMPU_METHOD CU_M3_HBRPVMON_MINFLTACTV "Conversion method for M3_HbrPVmon_MinFltActv" RAT_FUNC "%10.0" "(not defined)" COEFFS 0.000000 1.000000 -0.000000 0.000000 0.000000 1.000000 /end COMPU_METHOD
/* Scalar measurable for DDE 'NotEcuRunning'. */
/begin MEASUREMENT NotEcuRunning "Not ECU running flag." UBYTE CU_NOTECURUNNING 1 100 0.0 1.0 ECU_ADDRESS 0x7001a14d BYTE_ORDER MSB_LAST /end MEASUREMENT
/begin COMPU_METHOD CU_NOTECURUNNING "Conversion method for NotEcuRunning" RAT_FUNC "%10.0" "(not defined)" COEFFS 0.000000 1.000000 -0.000000 0.000000 0.000000 1.000000 /end COMPU_METHOD
/* Scalar measurable for DDE 'NotShutdownFromLowBatt'. */
/begin MEASUREMENT NotShutdownFromLowBatt "(not defined)" UBYTE CU_NOTSHUTDOWNFROMLOWBATT 1 100 0.0 255.0 ECU_ADDRESS 0x70019fbe BYTE_ORDER MSB_LAST /end MEASUREMENT
/begin COMPU_METHOD CU_NOTSHUTDOWNFROMLOWBATT "Conversion method for NotShutdownFromLowBatt" RAT_FUNC "%10.0" "(not defined)" COEFFS 0.000000 1.000000 -0.000000 0.000000 0.000000 1.000000 /end COMPU_METHOD
/* Scalar measurable for DDE 'ParamSetIdSelected'. */
/begin MEASUREMENT ParamSetIdSelected "Selected Parameter Set Id from the Service Discovery and Detail Parser" UWORD CU_PARAMSETIDSELECTED 1 100 0.0 65535.0 ECU_ADDRESS 0x70017eb2 BYTE_ORDER MSB_LAST /end MEASUREMENT
/begin COMPU_METHOD CU_PARAMSETIDSELECTED "Conversion method for ParamSetIdSelected" RAT_FUNC "%10.0" "NU" COEFFS 0.000000 1.000000 -0.000000 0.000000 0.000000 1.000000 /end COMPU_METHOD
/* Scalar measurable for DDE 'PregEcuDateOfManufactureAvailable'. */
/begin MEASUREMENT PregEcuDateOfManufactureAvaila0 "(not defined)" UBYTE CU_PREGECUDATEOFMANUFACTUREAVA0 1 100 0.0 255.0 ECU_ADDRESS 0x7001a15d BYTE_ORDER MSB_LAST /end MEASUREMENT
/begin COMPU_METHOD CU_PREGECUDATEOFMANUFACTUREAVA0 "Conversion method for PregEcuDateOfManufactureAvailable" RAT_FUNC "%10.0" "(not defined)" COEFFS 0.000000 1.000000 -0.000000 0.000000 0.000000 1.000000 /end COMPU_METHOD
/* Scalar measurable for DDE 'PregEcuDateOfManufactureDay'. */
/begin MEASUREMENT PregEcuDateOfManufactureDay "(not defined)" UBYTE CU_PREGECUDATEOFMANUFACTUREDAY 1 100 0.0 255.0 ECU_ADDRESS 0x70019ff8 BYTE_ORDER MSB_LAST /end MEASUREMENT
/begin COMPU_METHOD CU_PREGECUDATEOFMANUFACTUREDAY "Conversion method for PregEcuDateOfManufactureDay" RAT_FUNC "%10.0" "(not defined)" COEFFS 0.000000 1.000000 -0.000000 0.000000 0.000000 1.000000 /end COMPU_METHOD
/* Scalar measurable for DDE 'PregEcuDateOfManufactureMonth'. */
/begin MEASUREMENT PregEcuDateOfManufactureMonth "(not defined)" UBYTE CU_PREGECUDATEOFMANUFACTUREMON0 1 100 0.0 255.0 ECU_ADDRESS 0x7001a186 BYTE_ORDER MSB_LAST /end MEASUREMENT
/begin COMPU_METHOD CU_PREGECUDATEOFMANUFACTUREMON0 "Conversion method for PregEcuDateOfManufactureMonth" RAT_FUNC "%10.0" "(not defined)" COEFFS 0.000000 1.000000 -0.000000 0.000000 0.000000 1.000000 /end COMPU_METHOD
/* Scalar measurable for DDE 'PregEcuDateOfManufactureShift'. */
/begin MEASUREMENT PregEcuDateOfManufactureShift "(not defined)" UBYTE CU_PREGECUDATEOFMANUFACTURESHI0 1 100 0.0 255.0 ECU_ADDRESS 0x7001a019 BYTE_ORDER MSB_LAST /end MEASUREMENT
/begin COMPU_METHOD CU_PREGECUDATEOFMANUFACTURESHI0 "Conversion method for PregEcuDateOfManufactureShift" RAT_FUNC "%10.0" "(not defined)" COEFFS 0.000000 1.000000 -0.000000 0.000000 0.000000 1.000000 /end COMPU_METHOD
/* Scalar measurable for DDE 'PregEcuDateOfManufactureYear'. */
/begin MEASUREMENT PregEcuDateOfManufactureYear "(not defined)" UWORD CU_PREGECUDATEOFMANUFACTUREYEAR 1 100 0.0 65535.0 ECU_ADDRESS 0x70019eae BYTE_ORDER MSB_LAST /end MEASUREMENT
/begin COMPU_METHOD CU_PREGECUDATEOFMANUFACTUREYEAR "Conversion method for PregEcuDateOfManufactureYear" RAT_FUNC "%10.0" "(not defined)" COEFFS 0.000000 1.000000 -0.000000 0.000000 0.000000 1.000000 /end COMPU_METHOD
/* Scalar measurable for DDE 'PregEcuEngineeringPartNumberAvailable'. */
/begin MEASUREMENT PregEcuEngineeringPartNumberAv0 "(not defined)" UBYTE CU_PREGECUENGINEERINGPARTNUMBE2 1 100 0.0 255.0 ECU_ADDRESS 0x70019fe4 BYTE_ORDER MSB_LAST /end MEASUREMENT
/begin COMPU_METHOD CU_PREGECUENGINEERINGPARTNUMBE2 "Conversion method for PregEcuEngineeringPartNumberAvailable" RAT_FUNC "%10.0" "(not defined)" COEFFS 0.000000 1.000000 -0.000000 0.000000 0.000000 1.000000 /end COMPU_METHOD
/* Scalar measurable for DDE 'PregEcuEngineeringPartNumberID'. */
/begin MEASUREMENT PregEcuEngineeringPartNumberID "(not defined)" UBYTE CU_PREGECUENGINEERINGPARTNUMBE1 1 100 0.0 255.0 ECU_ADDRESS 0x7001a170 BYTE_ORDER MSB_LAST /end MEASUREMENT
/begin COMPU_METHOD CU_PREGECUENGINEERINGPARTNUMBE1 "Conversion method for PregEcuEngineeringPartNumberID" RAT_FUNC "%10.0" "(not defined)" COEFFS 0.000000 1.000000 -0.000000 0.000000 0.000000 1.000000 /end COMPU_METHOD
/* Scalar measurable for DDE 'PregEcuEngineeringPartNumberPart'. */
/begin MEASUREMENT PregEcuEngineeringPartNumberPa0 "(not defined)" ULONG CU_PREGECUENGINEERINGPARTNUMBE3 1 100 0.0 4294967295.0 ECU_ADDRESS 0x7001a004 BYTE_ORDER MSB_LAST /end MEASUREMENT
/begin COMPU_METHOD CU_PREGECUENGINEERINGPARTNUMBE3 "Conversion method for PregEcuEngineeringPartNumberPart" RAT_FUNC "%10.0" "(not defined)" COEFFS 0.000000 1.000000 -0.000000 0.000000 0.000000 1.000000 /end COMPU_METHOD
/* Scalar measurable for DDE 'PregEcuEngineeringPartNumberPrefix'. */
/begin MEASUREMENT PregEcuEngineeringPartNumberPr0 "(not defined)" UBYTE CU_PREGECUENGINEERINGPARTNUMBE0 1 100 0.0 255.0 ECU_ADDRESS 0x70019f0d BYTE_ORDER MSB_LAST /end MEASUREMENT
/begin COMPU_METHOD CU_PREGECUENGINEERINGPARTNUMBE0 "Conversion method for PregEcuEngineeringPartNumberPrefix" RAT_FUNC "%10.0" "(not defined)" COEFFS 0.000000 1.000000 -0.000000 0.000000 0.000000 1.000000 /end COMPU_METHOD
/* Scalar measurable for DDE 'PregEcuFactoryBuildTypeA'. */
/begin MEASUREMENT PregEcuFactoryBuildTypeA "(not defined)" UBYTE CU_PREGECUFACTORYBUILDTYPEA 1 100 0.0 255.0 ECU_ADDRESS 0x7001a0a0 BYTE_ORDER MSB_LAST /end MEASUREMENT
/begin COMPU_METHOD CU_PREGECUFACTORYBUILDTYPEA "Conversion method for PregEcuFactoryBuildTypeA" RAT_FUNC "%10.0" "(not defined)" COEFFS 0.000000 1.000000 -0.000000 0.000000 0.000000 1.000000 /end COMPU_METHOD
/* Scalar measurable for DDE 'PregEcuFactoryBuildTypeAvailable'. */
/begin MEASUREMENT PregEcuFactoryBuildTypeAvailab0 "(not defined)" UBYTE CU_PREGECUFACTORYBUILDTYPEAVAI0 1 100 0.0 255.0 ECU_ADDRESS 0x70019f30 BYTE_ORDER MSB_LAST /end MEASUREMENT
/begin COMPU_METHOD CU_PREGECUFACTORYBUILDTYPEAVAI0 "Conversion method for PregEcuFactoryBuildTypeAvailable" RAT_FUNC "%10.0" "(not defined)" COEFFS 0.000000 1.000000 -0.000000 0.000000 0.000000 1.000000 /end COMPU_METHOD
/* Scalar measurable for DDE 'PregEcuFactoryBuildTypeB'. */
/begin MEASUREMENT PregEcuFactoryBuildTypeB "(not defined)" UBYTE CU_PREGECUFACTORYBUILDTYPEB 1 100 0.0 255.0 ECU_ADDRESS 0x7001a0c4 BYTE_ORDER MSB_LAST /end MEASUREMENT
/begin COMPU_METHOD CU_PREGECUFACTORYBUILDTYPEB "Conversion method for PregEcuFactoryBuildTypeB" RAT_FUNC "%10.0" "(not defined)" COEFFS 0.000000 1.000000 -0.000000 0.000000 0.000000 1.000000 /end COMPU_METHOD
/* Scalar measurable for DDE 'PregEcuFactoryIdA'. */
/begin MEASUREMENT PregEcuFactoryIdA "(not defined)" UBYTE CU_PREGECUFACTORYIDA 1 100 0.0 255.0 ECU_ADDRESS 0x70019f48 BYTE_ORDER MSB_LAST /end MEASUREMENT
/begin COMPU_METHOD CU_PREGECUFACTORYIDA "Conversion method for PregEcuFactoryIdA" RAT_FUNC "%10.0" "(not defined)" COEFFS 0.000000 1.000000 -0.000000 0.000000 0.000000 1.000000 /end COMPU_METHOD
/* Scalar measurable for DDE 'PregEcuFactoryIdB'. */
/begin MEASUREMENT PregEcuFactoryIdB "(not defined)" UBYTE CU_PREGECUFACTORYIDB 1 100 0.0 255.0 ECU_ADDRESS 0x7001a0da BYTE_ORDER MSB_LAST /end MEASUREMENT
/begin COMPU_METHOD CU_PREGECUFACTORYIDB "Conversion method for PregEcuFactoryIdB" RAT_FUNC "%10.0" "(not defined)" COEFFS 0.000000 1.000000 -0.000000 0.000000 0.000000 1.000000 /end COMPU_METHOD
/* Scalar measurable for DDE 'PregEcuFactoryPartA'. */
/begin MEASUREMENT PregEcuFactoryPartA "(not defined)" UWORD CU_PREGECUFACTORYPARTA 1 100 0.0 65535.0 ECU_ADDRESS 0x70019f66 BYTE_ORDER MSB_LAST /end MEASUREMENT
/begin COMPU_METHOD CU_PREGECUFACTORYPARTA "Conversion method for PregEcuFactoryPartA" RAT_FUNC "%10.0" "(not defined)" COEFFS 0.000000 1.000000 -0.000000 0.000000 0.000000 1.000000 /end COMPU_METHOD
/* Scalar measurable for DDE 'PregEcuFactoryPartB'. */
/begin MEASUREMENT PregEcuFactoryPartB "(not defined)" UWORD CU_PREGECUFACTORYPARTB 1 100 0.0 65535.0 ECU_ADDRESS 0x7001a0fc BYTE_ORDER MSB_LAST /end MEASUREMENT
/begin COMPU_METHOD CU_PREGECUFACTORYPARTB "Conversion method for PregEcuFactoryPartB" RAT_FUNC "%10.0" "(not defined)" COEFFS 0.000000 1.000000 -0.000000 0.000000 0.000000 1.000000 /end COMPU_METHOD
/* Scalar measurable for DDE 'PregEcuFactoryPartNumAvailable'. */
/begin MEASUREMENT PregEcuFactoryPartNumAvailable "(not defined)" UBYTE CU_PREGECUFACTORYPARTNUMAVAILA0 1 100 0.0 255.0 ECU_ADDRESS 0x70019f90 BYTE_ORDER MSB_LAST /end MEASUREMENT
/begin COMPU_METHOD CU_PREGECUFACTORYPARTNUMAVAILA0 "Conversion method for PregEcuFactoryPartNumAvailable" RAT_FUNC "%10.0" "(not defined)" COEFFS 0.000000 1.000000 -0.000000 0.000000 0.000000 1.000000 /end COMPU_METHOD
/* Scalar measurable for DDE 'PregEcuLowerWordSerialNumber'. */
/begin MEASUREMENT PregEcuLowerWordSerialNumber "(not defined)" ULONG CU_PREGECULOWERWORDSERIALNUMBER 1 100 0.0 4294967295.0 ECU_ADDRESS 0x7001a114 BYTE_ORDER MSB_LAST /end MEASUREMENT
/begin COMPU_METHOD CU_PREGECULOWERWORDSERIALNUMBER "Conversion method for PregEcuLowerWordSerialNumber" RAT_FUNC "%10.0" "(not defined)" COEFFS 0.000000 1.000000 -0.000000 0.000000 0.000000 1.000000 /end COMPU_METHOD
/* Scalar measurable for DDE 'PregEcuLowerWordSerialNumberAvailable'. */
/begin MEASUREMENT PregEcuLowerWordSerialNumberAv0 "(not defined)" UBYTE CU_PREGECULOWERWORDSERIALNUMBE0 1 100 0.0 255.0 ECU_ADDRESS 0x70019fad BYTE_ORDER MSB_LAST /end MEASUREMENT
/begin COMPU_METHOD CU_PREGECULOWERWORDSERIALNUMBE0 "Conversion method for PregEcuLowerWordSerialNumberAvailable" RAT_FUNC "%10.0" "(not defined)" COEFFS 0.000000 1.000000 -0.000000 0.000000 0.000000 1.000000 /end COMPU_METHOD
/* Scalar measurable for DDE 'PregEcuPcbIssue'. */
/begin MEASUREMENT PregEcuPcbIssue "(not defined)" UBYTE CU_PREGECUPCBISSUE 1 100 0.0 255.0 ECU_ADDRESS 0x70019ec5 BYTE_ORDER MSB_LAST /end MEASUREMENT
/begin COMPU_METHOD CU_PREGECUPCBISSUE "Conversion method for PregEcuPcbIssue" RAT_FUNC "%10.0" "(not defined)" COEFFS 0.000000 1.000000 -0.000000 0.000000 0.000000 1.000000 /end COMPU_METHOD
/* Scalar measurable for DDE 'PregEcuPcbIssueAvailable'. */
/begin MEASUREMENT PregEcuPcbIssueAvailable "(not defined)" UBYTE CU_PREGECUPCBISSUEAVAILABLE 1 100 0.0 255.0 ECU_ADDRESS 0x7001a04e BYTE_ORDER MSB_LAST /end MEASUREMENT
/begin COMPU_METHOD CU_PREGECUPCBISSUEAVAILABLE "Conversion method for PregEcuPcbIssueAvailable" RAT_FUNC "%10.0" "(not defined)" COEFFS 0.000000 1.000000 -0.000000 0.000000 0.000000 1.000000 /end COMPU_METHOD
/* Scalar measurable for DDE 'PregEcuPcbMod'. */
/begin MEASUREMENT PregEcuPcbMod "(not defined)" UBYTE CU_PREGECUPCBMOD 1 100 0.0 255.0 ECU_ADDRESS 0x70019edd BYTE_ORDER MSB_LAST /end MEASUREMENT
/begin COMPU_METHOD CU_PREGECUPCBMOD "Conversion method for PregEcuPcbMod" RAT_FUNC "%10.0" "(not defined)" COEFFS 0.000000 1.000000 -0.000000 0.000000 0.000000 1.000000 /end COMPU_METHOD
/* Scalar measurable for DDE 'PregEcuSerialNumberInfoAvailable'. */
/begin MEASUREMENT PregEcuSerialNumberInfoAvailab0 "(not defined)" UBYTE CU_PREGECUSERIALNUMBERINFOAVAI0 1 100 0.0 255.0 ECU_ADDRESS 0x7001a071 BYTE_ORDER MSB_LAST /end MEASUREMENT
/begin COMPU_METHOD CU_PREGECUSERIALNUMBERINFOAVAI0 "Conversion method for PregEcuSerialNumberInfoAvailable" RAT_FUNC "%10.0" "(not defined)" COEFFS 0.000000 1.000000 -0.000000 0.000000 0.000000 1.000000 /end COMPU_METHOD
/* Scalar measurable for DDE 'PregEcuSerialNumberInfoFirstKey'. */
/begin MEASUREMENT PregEcuSerialNumberInfoFirstKey "(not defined)" UBYTE CU_PREGECUSERIALNUMBERINFOFIRS0 1 100 0.0 255.0 ECU_ADDRESS 0x70019efe BYTE_ORDER MSB_LAST /end MEASUREMENT
/begin COMPU_METHOD CU_PREGECUSERIALNUMBERINFOFIRS0 "Conversion method for PregEcuSerialNumberInfoFirstKey" RAT_FUNC "%10.0" "(not defined)" COEFFS 0.000000 1.000000 -0.000000 0.000000 0.000000 1.000000 /end COMPU_METHOD
/* Scalar measurable for DDE 'PregEcuSerialNumberInfoLength'. */
/begin MEASUREMENT PregEcuSerialNumberInfoLength "(not defined)" UBYTE CU_PREGECUSERIALNUMBERINFOLENG0 1 100 0.0 255.0 ECU_ADDRESS 0x7001a08e BYTE_ORDER MSB_LAST /end MEASUREMENT
/begin COMPU_METHOD CU_PREGECUSERIALNUMBERINFOLENG0 "Conversion method for PregEcuSerialNumberInfoLength" RAT_FUNC "%10.0" "(not defined)" COEFFS 0.000000 1.000000 -0.000000 0.000000 0.000000 1.000000 /end COMPU_METHOD
/* Scalar measurable for DDE 'PregEcuUpperWordSerialAvailable'. */
/begin MEASUREMENT PregEcuUpperWordSerialAvailable "(not defined)" UBYTE CU_PREGECUUPPERWORDSERIALAVAIL0 1 100 0.0 255.0 ECU_ADDRESS 0x70019f1d BYTE_ORDER MSB_LAST /end MEASUREMENT
/begin COMPU_METHOD CU_PREGECUUPPERWORDSERIALAVAIL0 "Conversion method for PregEcuUpperWordSerialAvailable" RAT_FUNC "%10.0" "(not defined)" COEFFS 0.000000 1.000000 -0.000000 0.000000 0.000000 1.000000 /end COMPU_METHOD
/* Scalar measurable for DDE 'PregEcuUpperWordSerialNumber'. */
/begin MEASUREMENT PregEcuUpperWordSerialNumber "(not defined)" ULONG CU_PREGECUUPPERWORDSERIALNUMBER 1 100 0.0 4294967295.0 ECU_ADDRESS 0x7001a058 BYTE_ORDER MSB_LAST /end MEASUREMENT
/begin COMPU_METHOD CU_PREGECUUPPERWORDSERIALNUMBER "Conversion method for PregEcuUpperWordSerialNumber" RAT_FUNC "%10.0" "(not defined)" COEFFS 0.000000 1.000000 -0.000000 0.000000 0.000000 1.000000 /end COMPU_METHOD
/* Scalar measurable for DDE 'ServiceIdSelected'. */
/begin MEASUREMENT ServiceIdSelected "Selected Service Id from the Service Discovery and Detail Parser" UWORD CU_SERVICEIDSELECTED 1 100 0.0 65535.0 ECU_ADDRESS 0x70018142 BYTE_ORDER MSB_LAST /end MEASUREMENT
/begin COMPU_METHOD CU_SERVICEIDSELECTED "Conversion method for ServiceIdSelected" RAT_FUNC "%10.0" "NU" COEFFS 0.000000 1.000000 -0.000000 0.000000 0.000000 1.000000 /end COMPU_METHOD
/* Scalar measurable for DDE 'ShutdownCmd'. */
/begin MEASUREMENT ShutdownCmd "ShutdownFromLowBatt OR NotEcuRunning" UBYTE CU_SHUTDOWNCMD 1 100 0.0 255.0 ECU_ADDRESS 0x70019eec BYTE_ORDER MSB_LAST /end MEASUREMENT
/begin COMPU_METHOD CU_SHUTDOWNCMD "Conversion method for ShutdownCmd" RAT_FUNC "%10.0" "(not defined)" COEFFS 0.000000 1.000000 -0.000000 0.000000 0.000000 1.000000 /end COMPU_METHOD
/* Scalar measurable for DDE 'ShutdownDelayed'. */
/begin MEASUREMENT ShutdownDelayed "Shutdown signal after first delay (goes to TLT9255 sleep request then additional delay before disable power hold)" UBYTE CU_SHUTDOWNDELAYED 1 100 0.0 1.0 ECU_ADDRESS 0x7001a081 BYTE_ORDER MSB_LAST /end MEASUREMENT
/begin COMPU_METHOD CU_SHUTDOWNDELAYED "Conversion method for ShutdownDelayed" RAT_FUNC "%10.0" "(not defined)" COEFFS 0.000000 1.000000 -0.000000 0.000000 0.000000 1.000000 /end COMPU_METHOD
/* Scalar measurable for DDE 'ShutdownFromLowBatt'. */
/begin MEASUREMENT ShutdownFromLowBatt "VBatFilt < genc_VBatShutdownThreshold" UBYTE CU_SHUTDOWNFROMLOWBATT 1 100 0.0 255.0 ECU_ADDRESS 0x70019f91 BYTE_ORDER MSB_LAST /end MEASUREMENT
/begin COMPU_METHOD CU_SHUTDOWNFROMLOWBATT "Conversion method for ShutdownFromLowBatt" RAT_FUNC "%10.0" "(not defined)" COEFFS 0.000000 1.000000 -0.000000 0.000000 0.000000 1.000000 /end COMPU_METHOD
/* Scalar measurable for DDE 'SimRessSoc'. */
/begin MEASUREMENT SimRessSoc "Processed HV battery SOC value received from HV battery controller" FLOAT32_IEEE CU_SIMRESSSOC 1 100 0.0 100.0 ECU_ADDRESS 0x700183c8 BYTE_ORDER MSB_LAST /end MEASUREMENT
/begin COMPU_METHOD CU_SIMRESSSOC "Conversion method for SimRessSoc" RAT_FUNC "%10.0" "%" COEFFS 0.000000 1.000000 -0.000000 0.000000 0.000000 1.000000 /end COMPU_METHOD
/* Scalar measurable for DDE 'SimRessVolt'. */
/begin MEASUREMENT SimRessVolt "Processed value of HV battery voltage" FLOAT32_IEEE CU_SIMRESSVOLT 1 100 -10.0 1500.0 ECU_ADDRESS 0x70017df4 BYTE_ORDER MSB_LAST /end MEASUREMENT
/begin COMPU_METHOD CU_SIMRESSVOLT "Conversion method for SimRessVolt" RAT_FUNC "%10.0" "V" COEFFS 0.000000 1.000000 -0.000000 0.000000 0.000000 1.000000 /end COMPU_METHOD
/* Scalar measurable for DDE 'SvcSearchSt'. */
/begin MEASUREMENT SvcSearchSt "Service Discovery and Detail Parser Search Status" SLONG CU_SVCSEARCHST 1 100 -2147483648.0 2147483647.0 ECU_ADDRESS 0x70017c30 BYTE_ORDER MSB_LAST /end MEASUREMENT
/begin COMPU_METHOD CU_SVCSEARCHST "Conversion method for SvcSearchSt" TAB_VERB "%12.0" "enum" COMPU_TAB_REF CT_SVCSEARCHST /end COMPU_METHOD
/begin COMPU_VTAB CT_SVCSEARCHST "Conversion method for SvcSearchSt" TAB_VERB 5 0 "SEARCH_ONGOING" 1 "WAIT_FOR_SVCDETAIL" 2 "FINISHED_NO_RESULT" 3 "SEARCH_FINISHED" 4 "SEARCH_STARTUP" /end COMPU_VTAB
/* Scalar measurable for DDE 'SysCpuLoading'. */
/begin MEASUREMENT SysCpuLoading "CPU Loading in percentage of the HCU" FLOAT32_IEEE CU_SYSCPULOADING 1 100 0.0 1000.0 ECU_ADDRESS 0x70018360 BYTE_ORDER MSB_LAST /end MEASUREMENT
/begin COMPU_METHOD CU_SYSCPULOADING "Conversion method for SysCpuLoading" RAT_FUNC "%10.0" "%" COEFFS 0.000000 1.000000 -0.000000 0.000000 0.000000 1.000000 /end COMPU_METHOD
/* Scalar measurable for DDE 'SysResetType'. */
/begin MEASUREMENT SysResetType "System Reset Type" UBYTE CU_SYSRESETTYPE 1 100 0.0 250.0 ECU_ADDRESS 0x700181ab BYTE_ORDER MSB_LAST /end MEASUREMENT
/begin COMPU_METHOD CU_SYSRESETTYPE "Conversion method for SysResetType" RAT_FUNC "%10.0" "1" COEFFS 0.000000 1.000000 -0.000000 0.000000 0.000000 1.000000 /end COMPU_METHOD
/* Scalar measurable for DDE 'SysStackUsed'. */
/begin MEASUREMENT SysStackUsed "Stack used on the M560" ULONG CU_SYSSTACKUSED 1 100 0.0 100000.0 ECU_ADDRESS 0x0 BYTE_ORDER MSB_LAST /end MEASUREMENT
/begin COMPU_METHOD CU_SYSSTACKUSED "Conversion method for SysStackUsed" RAT_FUNC "%10.0" "1" COEFFS 0.000000 1.000000 -0.000000 0.000000 0.000000 1.000000 /end COMPU_METHOD
/* Scalar measurable for DDE 'SysTaskDurLoopA'. */
/begin MEASUREMENT SysTaskDurLoopA "Task Duration for the task with sampling time LoopA_SC" ULONG CU_SYSTASKDURLOOPA 1 100 0.0 10000.0 ECU_ADDRESS 0x70017da0 BYTE_ORDER MSB_LAST /end MEASUREMENT
/begin COMPU_METHOD CU_SYSTASKDURLOOPA "Conversion method for SysTaskDurLoopA" RAT_FUNC "%10.0" "s" COEFFS 0.000000 1.000000 -0.000000 0.000000 0.000000 1.000000 /end COMPU_METHOD
/* Scalar measurable for DDE 'SysTaskDurLoopB'. */
/begin MEASUREMENT SysTaskDurLoopB "Task Duration for the task with sampling time LoopB_SC" ULONG CU_SYSTASKDURLOOPB 1 100 0.0 10000.0 ECU_ADDRESS 0x70018084 BYTE_ORDER MSB_LAST /end MEASUREMENT
/begin COMPU_METHOD CU_SYSTASKDURLOOPB "Conversion method for SysTaskDurLoopB" RAT_FUNC "%10.0" "s" COEFFS 0.000000 1.000000 -0.000000 0.000000 0.000000 1.000000 /end COMPU_METHOD
/* Scalar measurable for DDE 'SysTaskDurLoopC'. */
/begin MEASUREMENT SysTaskDurLoopC "Task Duration for the task with sampling time LoopC_SC" ULONG CU_SYSTASKDURLOOPC 1 100 0.0 10000.0 ECU_ADDRESS 0x70017ea0 BYTE_ORDER MSB_LAST /end MEASUREMENT
/begin COMPU_METHOD CU_SYSTASKDURLOOPC "Conversion method for SysTaskDurLoopC" RAT_FUNC "%10.0" "s" COEFFS 0.000000 1.000000 -0.000000 0.000000 0.000000 1.000000 /end COMPU_METHOD
/* Scalar measurable for DDE 'SysTaskDurLoopCcs'. */
/begin MEASUREMENT SysTaskDurLoopCcs "Task Duration for the task with sampling time LoopCcs_SC" ULONG CU_SYSTASKDURLOOPCCS 1 100 0.0 10000.0 ECU_ADDRESS 0x70017ce8 BYTE_ORDER MSB_LAST /end MEASUREMENT
/begin COMPU_METHOD CU_SYSTASKDURLOOPCCS "Conversion method for SysTaskDurLoopCcs" RAT_FUNC "%10.0" "s" COEFFS 0.000000 1.000000 -0.000000 0.000000 0.000000 1.000000 /end COMPU_METHOD
/* Scalar measurable for DDE 'SysTaskPeriodOverrunLoopA'. */
/begin MEASUREMENT SysTaskPeriodOverrunLoopA "Overruns of the task with sampling time LoopA_SC" UBYTE CU_SYSTASKPERIODOVERRUNLOOPA 1 100 0.0 255.0 ECU_ADDRESS 0x70018426 BYTE_ORDER MSB_LAST /end MEASUREMENT
/begin COMPU_METHOD CU_SYSTASKPERIODOVERRUNLOOPA "Conversion method for SysTaskPeriodOverrunLoopA" RAT_FUNC "%10.0" "cnt" COEFFS 0.000000 1.000000 -0.000000 0.000000 0.000000 1.000000 /end COMPU_METHOD
/* Scalar measurable for DDE 'SysTaskPeriodOverrunLoopB'. */
/begin MEASUREMENT SysTaskPeriodOverrunLoopB "Overruns of the task with sampling time LoopB_SC" UBYTE CU_SYSTASKPERIODOVERRUNLOOPB 1 100 0.0 255.0 ECU_ADDRESS 0x70017d40 BYTE_ORDER MSB_LAST /end MEASUREMENT
/begin COMPU_METHOD CU_SYSTASKPERIODOVERRUNLOOPB "Conversion method for SysTaskPeriodOverrunLoopB" RAT_FUNC "%10.0" "cnt" COEFFS 0.000000 1.000000 -0.000000 0.000000 0.000000 1.000000 /end COMPU_METHOD
/* Scalar measurable for DDE 'SysTimeSinceWakeMillisecond'. */
/begin MEASUREMENT SysTimeSinceWakeMillisecond "The Time (millisecond) since the ECU is waked up and started to run the application software." ULONG CU_SYSTIMESINCEWAKEMILLISECOND 1 100 0.0 4294967295.0 ECU_ADDRESS 0x70017fd8 BYTE_ORDER MSB_LAST /end MEASUREMENT
/begin COMPU_METHOD CU_SYSTIMESINCEWAKEMILLISECOND "Conversion method for SysTimeSinceWakeMillisecond" RAT_FUNC "%10.0" "ms" COEFFS 0.000000 1.000000 -0.000000 0.000000 0.000000 1.000000 /end COMPU_METHOD
/* Scalar measurable for DDE 'SysTimeSinceWakeSecond'. */
/begin MEASUREMENT SysTimeSinceWakeSecond "The Time (seconds) since the ECU is waked up and started to run the application software." ULONG CU_SYSTIMESINCEWAKESECOND 1 100 0.0 4294967295.0 ECU_ADDRESS 0x7001834c BYTE_ORDER MSB_LAST /end MEASUREMENT
/begin COMPU_METHOD CU_SYSTIMESINCEWAKESECOND "Conversion method for SysTimeSinceWakeSecond" RAT_FUNC "%10.0" "s" COEFFS 0.000000 1.000000 -0.000000 0.000000 0.000000 1.000000 /end COMPU_METHOD
/* Scalar measurable for DDE 'TLF35584DataFrom[0]'. */
/begin MEASUREMENT TLF35584DataFrom[0] "(not defined)" UBYTE CU_TLF35584DATAFROM[0] 1 100 0.0 255.0 ECU_ADDRESS 0x7001a118 BYTE_ORDER MSB_LAST /end MEASUREMENT
/begin COMPU_METHOD CU_TLF35584DATAFROM[0] "Conversion method for TLF35584DataFrom[0]" RAT_FUNC "%10.0" "(not defined)" COEFFS 0.000000 1.000000 -0.000000 0.000000 0.000000 1.000000 /end COMPU_METHOD
/* Scalar measurable for DDE 'TLF35584DataFrom[10]'. */
/begin MEASUREMENT TLF35584DataFrom[10] "(not defined)" UBYTE CU_TLF35584DATAFROM[10] 1 100 0.0 255.0 ECU_ADDRESS 0x7001a122 BYTE_ORDER MSB_LAST /end MEASUREMENT
/begin COMPU_METHOD CU_TLF35584DATAFROM[10] "Conversion method for TLF35584DataFrom[10]" RAT_FUNC "%10.0" "(not defined)" COEFFS 0.000000 1.000000 -0.000000 0.000000 0.000000 1.000000 /end COMPU_METHOD
/* Scalar measurable for DDE 'TLF35584DataFrom[11]'. */
/begin MEASUREMENT TLF35584DataFrom[11] "(not defined)" UBYTE CU_TLF35584DATAFROM[11] 1 100 0.0 255.0 ECU_ADDRESS 0x7001a123 BYTE_ORDER MSB_LAST /end MEASUREMENT
/begin COMPU_METHOD CU_TLF35584DATAFROM[11] "Conversion method for TLF35584DataFrom[11]" RAT_FUNC "%10.0" "(not defined)" COEFFS 0.000000 1.000000 -0.000000 0.000000 0.000000 1.000000 /end COMPU_METHOD
/* Scalar measurable for DDE 'TLF35584DataFrom[12]'. */
/begin MEASUREMENT TLF35584DataFrom[12] "(not defined)" UBYTE CU_TLF35584DATAFROM[12] 1 100 0.0 255.0 ECU_ADDRESS 0x7001a124 BYTE_ORDER MSB_LAST /end MEASUREMENT
/begin COMPU_METHOD CU_TLF35584DATAFROM[12] "Conversion method for TLF35584DataFrom[12]" RAT_FUNC "%10.0" "(not defined)" COEFFS 0.000000 1.000000 -0.000000 0.000000 0.000000 1.000000 /end COMPU_METHOD
/* Scalar measurable for DDE 'TLF35584DataFrom[13]'. */
/begin MEASUREMENT TLF35584DataFrom[13] "(not defined)" UBYTE CU_TLF35584DATAFROM[13] 1 100 0.0 255.0 ECU_ADDRESS 0x7001a125 BYTE_ORDER MSB_LAST /end MEASUREMENT
/begin COMPU_METHOD CU_TLF35584DATAFROM[13] "Conversion method for TLF35584DataFrom[13]" RAT_FUNC "%10.0" "(not defined)" COEFFS 0.000000 1.000000 -0.000000 0.000000 0.000000 1.000000 /end COMPU_METHOD
/* Scalar measurable for DDE 'TLF35584DataFrom[14]'. */
/begin MEASUREMENT TLF35584DataFrom[14] "(not defined)" UBYTE CU_TLF35584DATAFROM[14] 1 100 0.0 255.0 ECU_ADDRESS 0x7001a126 BYTE_ORDER MSB_LAST /end MEASUREMENT
/begin COMPU_METHOD CU_TLF35584DATAFROM[14] "Conversion method for TLF35584DataFrom[14]" RAT_FUNC "%10.0" "(not defined)" COEFFS 0.000000 1.000000 -0.000000 0.000000 0.000000 1.000000 /end COMPU_METHOD
/* Scalar measurable for DDE 'TLF35584DataFrom[15]'. */
/begin MEASUREMENT TLF35584DataFrom[15] "(not defined)" UBYTE CU_TLF35584DATAFROM[15] 1 100 0.0 255.0 ECU_ADDRESS 0x7001a127 BYTE_ORDER MSB_LAST /end MEASUREMENT
/begin COMPU_METHOD CU_TLF35584DATAFROM[15] "Conversion method for TLF35584DataFrom[15]" RAT_FUNC "%10.0" "(not defined)" COEFFS 0.000000 1.000000 -0.000000 0.000000 0.000000 1.000000 /end COMPU_METHOD
/* Scalar measurable for DDE 'TLF35584DataFrom[16]'. */
/begin MEASUREMENT TLF35584DataFrom[16] "(not defined)" UBYTE CU_TLF35584DATAFROM[16] 1 100 0.0 255.0 ECU_ADDRESS 0x7001a128 BYTE_ORDER MSB_LAST /end MEASUREMENT
/begin COMPU_METHOD CU_TLF35584DATAFROM[16] "Conversion method for TLF35584DataFrom[16]" RAT_FUNC "%10.0" "(not defined)" COEFFS 0.000000 1.000000 -0.000000 0.000000 0.000000 1.000000 /end COMPU_METHOD
/* Scalar measurable for DDE 'TLF35584DataFrom[17]'. */
/begin MEASUREMENT TLF35584DataFrom[17] "(not defined)" UBYTE CU_TLF35584DATAFROM[17] 1 100 0.0 255.0 ECU_ADDRESS 0x7001a129 BYTE_ORDER MSB_LAST /end MEASUREMENT
/begin COMPU_METHOD CU_TLF35584DATAFROM[17] "Conversion method for TLF35584DataFrom[17]" RAT_FUNC "%10.0" "(not defined)" COEFFS 0.000000 1.000000 -0.000000 0.000000 0.000000 1.000000 /end COMPU_METHOD
/* Scalar measurable for DDE 'TLF35584DataFrom[18]'. */
/begin MEASUREMENT TLF35584DataFrom[18] "(not defined)" UBYTE CU_TLF35584DATAFROM[18] 1 100 0.0 255.0 ECU_ADDRESS 0x7001a12a BYTE_ORDER MSB_LAST /end MEASUREMENT
/begin COMPU_METHOD CU_TLF35584DATAFROM[18] "Conversion method for TLF35584DataFrom[18]" RAT_FUNC "%10.0" "(not defined)" COEFFS 0.000000 1.000000 -0.000000 0.000000 0.000000 1.000000 /end COMPU_METHOD
/* Scalar measurable for DDE 'TLF35584DataFrom[19]'. */
/begin MEASUREMENT TLF35584DataFrom[19] "(not defined)" UBYTE CU_TLF35584DATAFROM[19] 1 100 0.0 255.0 ECU_ADDRESS 0x7001a12b BYTE_ORDER MSB_LAST /end MEASUREMENT
/begin COMPU_METHOD CU_TLF35584DATAFROM[19] "Conversion method for TLF35584DataFrom[19]" RAT_FUNC "%10.0" "(not defined)" COEFFS 0.000000 1.000000 -0.000000 0.000000 0.000000 1.000000 /end COMPU_METHOD
/* Scalar measurable for DDE 'TLF35584DataFrom[1]'. */
/begin MEASUREMENT TLF35584DataFrom[1] "(not defined)" UBYTE CU_TLF35584DATAFROM[1] 1 100 0.0 255.0 ECU_ADDRESS 0x7001a119 BYTE_ORDER MSB_LAST /end MEASUREMENT
/begin COMPU_METHOD CU_TLF35584DATAFROM[1] "Conversion method for TLF35584DataFrom[1]" RAT_FUNC "%10.0" "(not defined)" COEFFS 0.000000 1.000000 -0.000000 0.000000 0.000000 1.000000 /end COMPU_METHOD
/* Scalar measurable for DDE 'TLF35584DataFrom[20]'. */
/begin MEASUREMENT TLF35584DataFrom[20] "(not defined)" UBYTE CU_TLF35584DATAFROM[20] 1 100 0.0 255.0 ECU_ADDRESS 0x7001a12c BYTE_ORDER MSB_LAST /end MEASUREMENT
/begin COMPU_METHOD CU_TLF35584DATAFROM[20] "Conversion method for TLF35584DataFrom[20]" RAT_FUNC "%10.0" "(not defined)" COEFFS 0.000000 1.000000 -0.000000 0.000000 0.000000 1.000000 /end COMPU_METHOD
/* Scalar measurable for DDE 'TLF35584DataFrom[21]'. */
/begin MEASUREMENT TLF35584DataFrom[21] "(not defined)" UBYTE CU_TLF35584DATAFROM[21] 1 100 0.0 255.0 ECU_ADDRESS 0x7001a12d BYTE_ORDER MSB_LAST /end MEASUREMENT
/begin COMPU_METHOD CU_TLF35584DATAFROM[21] "Conversion method for TLF35584DataFrom[21]" RAT_FUNC "%10.0" "(not defined)" COEFFS 0.000000 1.000000 -0.000000 0.000000 0.000000 1.000000 /end COMPU_METHOD
/* Scalar measurable for DDE 'TLF35584DataFrom[22]'. */
/begin MEASUREMENT TLF35584DataFrom[22] "(not defined)" UBYTE CU_TLF35584DATAFROM[22] 1 100 0.0 255.0 ECU_ADDRESS 0x7001a12e BYTE_ORDER MSB_LAST /end MEASUREMENT
/begin COMPU_METHOD CU_TLF35584DATAFROM[22] "Conversion method for TLF35584DataFrom[22]" RAT_FUNC "%10.0" "(not defined)" COEFFS 0.000000 1.000000 -0.000000 0.000000 0.000000 1.000000 /end COMPU_METHOD
/* Scalar measurable for DDE 'TLF35584DataFrom[23]'. */
/begin MEASUREMENT TLF35584DataFrom[23] "(not defined)" UBYTE CU_TLF35584DATAFROM[23] 1 100 0.0 255.0 ECU_ADDRESS 0x7001a12f BYTE_ORDER MSB_LAST /end MEASUREMENT
/begin COMPU_METHOD CU_TLF35584DATAFROM[23] "Conversion method for TLF35584DataFrom[23]" RAT_FUNC "%10.0" "(not defined)" COEFFS 0.000000 1.000000 -0.000000 0.000000 0.000000 1.000000 /end COMPU_METHOD
/* Scalar measurable for DDE 'TLF35584DataFrom[24]'. */
/begin MEASUREMENT TLF35584DataFrom[24] "(not defined)" UBYTE CU_TLF35584DATAFROM[24] 1 100 0.0 255.0 ECU_ADDRESS 0x7001a130 BYTE_ORDER MSB_LAST /end MEASUREMENT
/begin COMPU_METHOD CU_TLF35584DATAFROM[24] "Conversion method for TLF35584DataFrom[24]" RAT_FUNC "%10.0" "(not defined)" COEFFS 0.000000 1.000000 -0.000000 0.000000 0.000000 1.000000 /end COMPU_METHOD
/* Scalar measurable for DDE 'TLF35584DataFrom[2]'. */
/begin MEASUREMENT TLF35584DataFrom[2] "(not defined)" UBYTE CU_TLF35584DATAFROM[2] 1 100 0.0 255.0 ECU_ADDRESS 0x7001a11a BYTE_ORDER MSB_LAST /end MEASUREMENT
/begin COMPU_METHOD CU_TLF35584DATAFROM[2] "Conversion method for TLF35584DataFrom[2]" RAT_FUNC "%10.0" "(not defined)" COEFFS 0.000000 1.000000 -0.000000 0.000000 0.000000 1.000000 /end COMPU_METHOD
/* Scalar measurable for DDE 'TLF35584DataFrom[3]'. */
/begin MEASUREMENT TLF35584DataFrom[3] "(not defined)" UBYTE CU_TLF35584DATAFROM[3] 1 100 0.0 255.0 ECU_ADDRESS 0x7001a11b BYTE_ORDER MSB_LAST /end MEASUREMENT
/begin COMPU_METHOD CU_TLF35584DATAFROM[3] "Conversion method for TLF35584DataFrom[3]" RAT_FUNC "%10.0" "(not defined)" COEFFS 0.000000 1.000000 -0.000000 0.000000 0.000000 1.000000 /end COMPU_METHOD
/* Scalar measurable for DDE 'TLF35584DataFrom[4]'. */
/begin MEASUREMENT TLF35584DataFrom[4] "(not defined)" UBYTE CU_TLF35584DATAFROM[4] 1 100 0.0 255.0 ECU_ADDRESS 0x7001a11c BYTE_ORDER MSB_LAST /end MEASUREMENT
/begin COMPU_METHOD CU_TLF35584DATAFROM[4] "Conversion method for TLF35584DataFrom[4]" RAT_FUNC "%10.0" "(not defined)" COEFFS 0.000000 1.000000 -0.000000 0.000000 0.000000 1.000000 /end COMPU_METHOD
/* Scalar measurable for DDE 'TLF35584DataFrom[5]'. */
/begin MEASUREMENT TLF35584DataFrom[5] "(not defined)" UBYTE CU_TLF35584DATAFROM[5] 1 100 0.0 255.0 ECU_ADDRESS 0x7001a11d BYTE_ORDER MSB_LAST /end MEASUREMENT
/begin COMPU_METHOD CU_TLF35584DATAFROM[5] "Conversion method for TLF35584DataFrom[5]" RAT_FUNC "%10.0" "(not defined)" COEFFS 0.000000 1.000000 -0.000000 0.000000 0.000000 1.000000 /end COMPU_METHOD
/* Scalar measurable for DDE 'TLF35584DataFrom[6]'. */
/begin MEASUREMENT TLF35584DataFrom[6] "(not defined)" UBYTE CU_TLF35584DATAFROM[6] 1 100 0.0 255.0 ECU_ADDRESS 0x7001a11e BYTE_ORDER MSB_LAST /end MEASUREMENT
/begin COMPU_METHOD CU_TLF35584DATAFROM[6] "Conversion method for TLF35584DataFrom[6]" RAT_FUNC "%10.0" "(not defined)" COEFFS 0.000000 1.000000 -0.000000 0.000000 0.000000 1.000000 /end COMPU_METHOD
/* Scalar measurable for DDE 'TLF35584DataFrom[7]'. */
/begin MEASUREMENT TLF35584DataFrom[7] "(not defined)" UBYTE CU_TLF35584DATAFROM[7] 1 100 0.0 255.0 ECU_ADDRESS 0x7001a11f BYTE_ORDER MSB_LAST /end MEASUREMENT
/begin COMPU_METHOD CU_TLF35584DATAFROM[7] "Conversion method for TLF35584DataFrom[7]" RAT_FUNC "%10.0" "(not defined)" COEFFS 0.000000 1.000000 -0.000000 0.000000 0.000000 1.000000 /end COMPU_METHOD
/* Scalar measurable for DDE 'TLF35584DataFrom[8]'. */
/begin MEASUREMENT TLF35584DataFrom[8] "(not defined)" UBYTE CU_TLF35584DATAFROM[8] 1 100 0.0 255.0 ECU_ADDRESS 0x7001a120 BYTE_ORDER MSB_LAST /end MEASUREMENT
/begin COMPU_METHOD CU_TLF35584DATAFROM[8] "Conversion method for TLF35584DataFrom[8]" RAT_FUNC "%10.0" "(not defined)" COEFFS 0.000000 1.000000 -0.000000 0.000000 0.000000 1.000000 /end COMPU_METHOD
/* Scalar measurable for DDE 'TLF35584DataFrom[9]'. */
/begin MEASUREMENT TLF35584DataFrom[9] "(not defined)" UBYTE CU_TLF35584DATAFROM[9] 1 100 0.0 255.0 ECU_ADDRESS 0x7001a121 BYTE_ORDER MSB_LAST /end MEASUREMENT
/begin COMPU_METHOD CU_TLF35584DATAFROM[9] "Conversion method for TLF35584DataFrom[9]" RAT_FUNC "%10.0" "(not defined)" COEFFS 0.000000 1.000000 -0.000000 0.000000 0.000000 1.000000 /end COMPU_METHOD
/* Scalar measurable for DDE 'TLF35584GetJobResult'. */
/begin MEASUREMENT TLF35584GetJobResult "(not defined)" UBYTE CU_TLF35584GETJOBRESULT 1 100 0.0 255.0 ECU_ADDRESS 0x70019fae BYTE_ORDER MSB_LAST /end MEASUREMENT
/begin COMPU_METHOD CU_TLF35584GETJOBRESULT "Conversion method for TLF35584GetJobResult" RAT_FUNC "%10.0" "(not defined)" COEFFS 0.000000 1.000000 -0.000000 0.000000 0.000000 1.000000 /end COMPU_METHOD
/* Scalar measurable for DDE 'TLF35584JobResult'. */
/begin MEASUREMENT TLF35584JobResult "(not defined)" UBYTE CU_TLF35584JOBRESULT 1 100 0.0 255.0 ECU_ADDRESS 0x7001a14e BYTE_ORDER MSB_LAST /end MEASUREMENT
/begin COMPU_METHOD CU_TLF35584JOBRESULT "Conversion method for TLF35584JobResult" RAT_FUNC "%10.0" "(not defined)" COEFFS 0.000000 1.000000 -0.000000 0.000000 0.000000 1.000000 /end COMPU_METHOD
/* Scalar measurable for DDE 'TLF35584RqstdCmd[0]'. */
/begin MEASUREMENT TLF35584RqstdCmd[0] "(not defined)" UBYTE CU_TLF35584RQSTDCMD[0] 1 100 0.0 255.0 ECU_ADDRESS 0x70019fbf BYTE_ORDER MSB_LAST /end MEASUREMENT
/begin COMPU_METHOD CU_TLF35584RQSTDCMD[0] "Conversion method for TLF35584RqstdCmd[0]" RAT_FUNC "%10.0" "(not defined)" COEFFS 0.000000 1.000000 -0.000000 0.000000 0.000000 1.000000 /end COMPU_METHOD
/* Scalar measurable for DDE 'TLF35584RqstdCmd[10]'. */
/begin MEASUREMENT TLF35584RqstdCmd[10] "(not defined)" UBYTE CU_TLF35584RQSTDCMD[10] 1 100 0.0 255.0 ECU_ADDRESS 0x70019fc9 BYTE_ORDER MSB_LAST /end MEASUREMENT
/begin COMPU_METHOD CU_TLF35584RQSTDCMD[10] "Conversion method for TLF35584RqstdCmd[10]" RAT_FUNC "%10.0" "(not defined)" COEFFS 0.000000 1.000000 -0.000000 0.000000 0.000000 1.000000 /end COMPU_METHOD
/* Scalar measurable for DDE 'TLF35584RqstdCmd[11]'. */
/begin MEASUREMENT TLF35584RqstdCmd[11] "(not defined)" UBYTE CU_TLF35584RQSTDCMD[11] 1 100 0.0 255.0 ECU_ADDRESS 0x70019fca BYTE_ORDER MSB_LAST /end MEASUREMENT
/begin COMPU_METHOD CU_TLF35584RQSTDCMD[11] "Conversion method for TLF35584RqstdCmd[11]" RAT_FUNC "%10.0" "(not defined)" COEFFS 0.000000 1.000000 -0.000000 0.000000 0.000000 1.000000 /end COMPU_METHOD
/* Scalar measurable for DDE 'TLF35584RqstdCmd[12]'. */
/begin MEASUREMENT TLF35584RqstdCmd[12] "(not defined)" UBYTE CU_TLF35584RQSTDCMD[12] 1 100 0.0 255.0 ECU_ADDRESS 0x70019fcb BYTE_ORDER MSB_LAST /end MEASUREMENT
/begin COMPU_METHOD CU_TLF35584RQSTDCMD[12] "Conversion method for TLF35584RqstdCmd[12]" RAT_FUNC "%10.0" "(not defined)" COEFFS 0.000000 1.000000 -0.000000 0.000000 0.000000 1.000000 /end COMPU_METHOD
/* Scalar measurable for DDE 'TLF35584RqstdCmd[13]'. */
/begin MEASUREMENT TLF35584RqstdCmd[13] "(not defined)" UBYTE CU_TLF35584RQSTDCMD[13] 1 100 0.0 255.0 ECU_ADDRESS 0x70019fcc BYTE_ORDER MSB_LAST /end MEASUREMENT
/begin COMPU_METHOD CU_TLF35584RQSTDCMD[13] "Conversion method for TLF35584RqstdCmd[13]" RAT_FUNC "%10.0" "(not defined)" COEFFS 0.000000 1.000000 -0.000000 0.000000 0.000000 1.000000 /end COMPU_METHOD
/* Scalar measurable for DDE 'TLF35584RqstdCmd[14]'. */
/begin MEASUREMENT TLF35584RqstdCmd[14] "(not defined)" UBYTE CU_TLF35584RQSTDCMD[14] 1 100 0.0 255.0 ECU_ADDRESS 0x70019fcd BYTE_ORDER MSB_LAST /end MEASUREMENT
/begin COMPU_METHOD CU_TLF35584RQSTDCMD[14] "Conversion method for TLF35584RqstdCmd[14]" RAT_FUNC "%10.0" "(not defined)" COEFFS 0.000000 1.000000 -0.000000 0.000000 0.000000 1.000000 /end COMPU_METHOD
/* Scalar measurable for DDE 'TLF35584RqstdCmd[15]'. */
/begin MEASUREMENT TLF35584RqstdCmd[15] "(not defined)" UBYTE CU_TLF35584RQSTDCMD[15] 1 100 0.0 255.0 ECU_ADDRESS 0x70019fce BYTE_ORDER MSB_LAST /end MEASUREMENT
/begin COMPU_METHOD CU_TLF35584RQSTDCMD[15] "Conversion method for TLF35584RqstdCmd[15]" RAT_FUNC "%10.0" "(not defined)" COEFFS 0.000000 1.000000 -0.000000 0.000000 0.000000 1.000000 /end COMPU_METHOD
/* Scalar measurable for DDE 'TLF35584RqstdCmd[16]'. */
/begin MEASUREMENT TLF35584RqstdCmd[16] "(not defined)" UBYTE CU_TLF35584RQSTDCMD[16] 1 100 0.0 255.0 ECU_ADDRESS 0x70019fcf BYTE_ORDER MSB_LAST /end MEASUREMENT
/begin COMPU_METHOD CU_TLF35584RQSTDCMD[16] "Conversion method for TLF35584RqstdCmd[16]" RAT_FUNC "%10.0" "(not defined)" COEFFS 0.000000 1.000000 -0.000000 0.000000 0.000000 1.000000 /end COMPU_METHOD
/* Scalar measurable for DDE 'TLF35584RqstdCmd[17]'. */
/begin MEASUREMENT TLF35584RqstdCmd[17] "(not defined)" UBYTE CU_TLF35584RQSTDCMD[17] 1 100 0.0 255.0 ECU_ADDRESS 0x70019fd0 BYTE_ORDER MSB_LAST /end MEASUREMENT
/begin COMPU_METHOD CU_TLF35584RQSTDCMD[17] "Conversion method for TLF35584RqstdCmd[17]" RAT_FUNC "%10.0" "(not defined)" COEFFS 0.000000 1.000000 -0.000000 0.000000 0.000000 1.000000 /end COMPU_METHOD
/* Scalar measurable for DDE 'TLF35584RqstdCmd[18]'. */
/begin MEASUREMENT TLF35584RqstdCmd[18] "(not defined)" UBYTE CU_TLF35584RQSTDCMD[18] 1 100 0.0 255.0 ECU_ADDRESS 0x70019fd1 BYTE_ORDER MSB_LAST /end MEASUREMENT
/begin COMPU_METHOD CU_TLF35584RQSTDCMD[18] "Conversion method for TLF35584RqstdCmd[18]" RAT_FUNC "%10.0" "(not defined)" COEFFS 0.000000 1.000000 -0.000000 0.000000 0.000000 1.000000 /end COMPU_METHOD
/* Scalar measurable for DDE 'TLF35584RqstdCmd[19]'. */
/begin MEASUREMENT TLF35584RqstdCmd[19] "(not defined)" UBYTE CU_TLF35584RQSTDCMD[19] 1 100 0.0 255.0 ECU_ADDRESS 0x70019fd2 BYTE_ORDER MSB_LAST /end MEASUREMENT
/begin COMPU_METHOD CU_TLF35584RQSTDCMD[19] "Conversion method for TLF35584RqstdCmd[19]" RAT_FUNC "%10.0" "(not defined)" COEFFS 0.000000 1.000000 -0.000000 0.000000 0.000000 1.000000 /end COMPU_METHOD
/* Scalar measurable for DDE 'TLF35584RqstdCmd[1]'. */
/begin MEASUREMENT TLF35584RqstdCmd[1] "(not defined)" UBYTE CU_TLF35584RQSTDCMD[1] 1 100 0.0 255.0 ECU_ADDRESS 0x70019fc0 BYTE_ORDER MSB_LAST /end MEASUREMENT
/begin COMPU_METHOD CU_TLF35584RQSTDCMD[1] "Conversion method for TLF35584RqstdCmd[1]" RAT_FUNC "%10.0" "(not defined)" COEFFS 0.000000 1.000000 -0.000000 0.000000 0.000000 1.000000 /end COMPU_METHOD
/* Scalar measurable for DDE 'TLF35584RqstdCmd[20]'. */
/begin MEASUREMENT TLF35584RqstdCmd[20] "(not defined)" UBYTE CU_TLF35584RQSTDCMD[20] 1 100 0.0 255.0 ECU_ADDRESS 0x70019fd3 BYTE_ORDER MSB_LAST /end MEASUREMENT
/begin COMPU_METHOD CU_TLF35584RQSTDCMD[20] "Conversion method for TLF35584RqstdCmd[20]" RAT_FUNC "%10.0" "(not defined)" COEFFS 0.000000 1.000000 -0.000000 0.000000 0.000000 1.000000 /end COMPU_METHOD
/* Scalar measurable for DDE 'TLF35584RqstdCmd[21]'. */
/begin MEASUREMENT TLF35584RqstdCmd[21] "(not defined)" UBYTE CU_TLF35584RQSTDCMD[21] 1 100 0.0 255.0 ECU_ADDRESS 0x70019fd4 BYTE_ORDER MSB_LAST /end MEASUREMENT
/begin COMPU_METHOD CU_TLF35584RQSTDCMD[21] "Conversion method for TLF35584RqstdCmd[21]" RAT_FUNC "%10.0" "(not defined)" COEFFS 0.000000 1.000000 -0.000000 0.000000 0.000000 1.000000 /end COMPU_METHOD
/* Scalar measurable for DDE 'TLF35584RqstdCmd[22]'. */
/begin MEASUREMENT TLF35584RqstdCmd[22] "(not defined)" UBYTE CU_TLF35584RQSTDCMD[22] 1 100 0.0 255.0 ECU_ADDRESS 0x70019fd5 BYTE_ORDER MSB_LAST /end MEASUREMENT
/begin COMPU_METHOD CU_TLF35584RQSTDCMD[22] "Conversion method for TLF35584RqstdCmd[22]" RAT_FUNC "%10.0" "(not defined)" COEFFS 0.000000 1.000000 -0.000000 0.000000 0.000000 1.000000 /end COMPU_METHOD
/* Scalar measurable for DDE 'TLF35584RqstdCmd[23]'. */
/begin MEASUREMENT TLF35584RqstdCmd[23] "(not defined)" UBYTE CU_TLF35584RQSTDCMD[23] 1 100 0.0 255.0 ECU_ADDRESS 0x70019fd6 BYTE_ORDER MSB_LAST /end MEASUREMENT
/begin COMPU_METHOD CU_TLF35584RQSTDCMD[23] "Conversion method for TLF35584RqstdCmd[23]" RAT_FUNC "%10.0" "(not defined)" COEFFS 0.000000 1.000000 -0.000000 0.000000 0.000000 1.000000 /end COMPU_METHOD
/* Scalar measurable for DDE 'TLF35584RqstdCmd[24]'. */
/begin MEASUREMENT TLF35584RqstdCmd[24] "(not defined)" UBYTE CU_TLF35584RQSTDCMD[24] 1 100 0.0 255.0 ECU_ADDRESS 0x70019fd7 BYTE_ORDER MSB_LAST /end MEASUREMENT
/begin COMPU_METHOD CU_TLF35584RQSTDCMD[24] "Conversion method for TLF35584RqstdCmd[24]" RAT_FUNC "%10.0" "(not defined)" COEFFS 0.000000 1.000000 -0.000000 0.000000 0.000000 1.000000 /end COMPU_METHOD
/* Scalar measurable for DDE 'TLF35584RqstdCmd[2]'. */
/begin MEASUREMENT TLF35584RqstdCmd[2] "(not defined)" UBYTE CU_TLF35584RQSTDCMD[2] 1 100 0.0 255.0 ECU_ADDRESS 0x70019fc1 BYTE_ORDER MSB_LAST /end MEASUREMENT
/begin COMPU_METHOD CU_TLF35584RQSTDCMD[2] "Conversion method for TLF35584RqstdCmd[2]" RAT_FUNC "%10.0" "(not defined)" COEFFS 0.000000 1.000000 -0.000000 0.000000 0.000000 1.000000 /end COMPU_METHOD
/* Scalar measurable for DDE 'TLF35584RqstdCmd[3]'. */
/begin MEASUREMENT TLF35584RqstdCmd[3] "(not defined)" UBYTE CU_TLF35584RQSTDCMD[3] 1 100 0.0 255.0 ECU_ADDRESS 0x70019fc2 BYTE_ORDER MSB_LAST /end MEASUREMENT
/begin COMPU_METHOD CU_TLF35584RQSTDCMD[3] "Conversion method for TLF35584RqstdCmd[3]" RAT_FUNC "%10.0" "(not defined)" COEFFS 0.000000 1.000000 -0.000000 0.000000 0.000000 1.000000 /end COMPU_METHOD
/* Scalar measurable for DDE 'TLF35584RqstdCmd[4]'. */
/begin MEASUREMENT TLF35584RqstdCmd[4] "(not defined)" UBYTE CU_TLF35584RQSTDCMD[4] 1 100 0.0 255.0 ECU_ADDRESS 0x70019fc3 BYTE_ORDER MSB_LAST /end MEASUREMENT
/begin COMPU_METHOD CU_TLF35584RQSTDCMD[4] "Conversion method for TLF35584RqstdCmd[4]" RAT_FUNC "%10.0" "(not defined)" COEFFS 0.000000 1.000000 -0.000000 0.000000 0.000000 1.000000 /end COMPU_METHOD
/* Scalar measurable for DDE 'TLF35584RqstdCmd[5]'. */
/begin MEASUREMENT TLF35584RqstdCmd[5] "(not defined)" UBYTE CU_TLF35584RQSTDCMD[5] 1 100 0.0 255.0 ECU_ADDRESS 0x70019fc4 BYTE_ORDER MSB_LAST /end MEASUREMENT
/begin COMPU_METHOD CU_TLF35584RQSTDCMD[5] "Conversion method for TLF35584RqstdCmd[5]" RAT_FUNC "%10.0" "(not defined)" COEFFS 0.000000 1.000000 -0.000000 0.000000 0.000000 1.000000 /end COMPU_METHOD
/* Scalar measurable for DDE 'TLF35584RqstdCmd[6]'. */
/begin MEASUREMENT TLF35584RqstdCmd[6] "(not defined)" UBYTE CU_TLF35584RQSTDCMD[6] 1 100 0.0 255.0 ECU_ADDRESS 0x70019fc5 BYTE_ORDER MSB_LAST /end MEASUREMENT
/begin COMPU_METHOD CU_TLF35584RQSTDCMD[6] "Conversion method for TLF35584RqstdCmd[6]" RAT_FUNC "%10.0" "(not defined)" COEFFS 0.000000 1.000000 -0.000000 0.000000 0.000000 1.000000 /end COMPU_METHOD
/* Scalar measurable for DDE 'TLF35584RqstdCmd[7]'. */
/begin MEASUREMENT TLF35584RqstdCmd[7] "(not defined)" UBYTE CU_TLF35584RQSTDCMD[7] 1 100 0.0 255.0 ECU_ADDRESS 0x70019fc6 BYTE_ORDER MSB_LAST /end MEASUREMENT
/begin COMPU_METHOD CU_TLF35584RQSTDCMD[7] "Conversion method for TLF35584RqstdCmd[7]" RAT_FUNC "%10.0" "(not defined)" COEFFS 0.000000 1.000000 -0.000000 0.000000 0.000000 1.000000 /end COMPU_METHOD
/* Scalar measurable for DDE 'TLF35584RqstdCmd[8]'. */
/begin MEASUREMENT TLF35584RqstdCmd[8] "(not defined)" UBYTE CU_TLF35584RQSTDCMD[8] 1 100 0.0 255.0 ECU_ADDRESS 0x70019fc7 BYTE_ORDER MSB_LAST /end MEASUREMENT
/begin COMPU_METHOD CU_TLF35584RQSTDCMD[8] "Conversion method for TLF35584RqstdCmd[8]" RAT_FUNC "%10.0" "(not defined)" COEFFS 0.000000 1.000000 -0.000000 0.000000 0.000000 1.000000 /end COMPU_METHOD
/* Scalar measurable for DDE 'TLF35584RqstdCmd[9]'. */
/begin MEASUREMENT TLF35584RqstdCmd[9] "(not defined)" UBYTE CU_TLF35584RQSTDCMD[9] 1 100 0.0 255.0 ECU_ADDRESS 0x70019fc8 BYTE_ORDER MSB_LAST /end MEASUREMENT
/begin COMPU_METHOD CU_TLF35584RQSTDCMD[9] "Conversion method for TLF35584RqstdCmd[9]" RAT_FUNC "%10.0" "(not defined)" COEFFS 0.000000 1.000000 -0.000000 0.000000 0.000000 1.000000 /end COMPU_METHOD
/* Scalar measurable for DDE 'TLF35584Send'. */
/begin MEASUREMENT TLF35584Send "(not defined)" UBYTE CU_TLF35584SEND 1 100 0.0 255.0 ECU_ADDRESS 0x7001a15e BYTE_ORDER MSB_LAST /end MEASUREMENT
/begin COMPU_METHOD CU_TLF35584SEND "Conversion method for TLF35584Send" RAT_FUNC "%10.0" "(not defined)" COEFFS 0.000000 1.000000 -0.000000 0.000000 0.000000 1.000000 /end COMPU_METHOD
/* Scalar measurable for DDE 'TLF35584Size'. */
/begin MEASUREMENT TLF35584Size "(not defined)" UWORD CU_TLF35584SIZE 1 100 0.0 65535.0 ECU_ADDRESS 0x70019ffa BYTE_ORDER MSB_LAST /end MEASUREMENT
/begin COMPU_METHOD CU_TLF35584SIZE "Conversion method for TLF35584Size" RAT_FUNC "%10.0" "(not defined)" COEFFS 0.000000 1.000000 -0.000000 0.000000 0.000000 1.000000 /end COMPU_METHOD
/* Scalar measurable for DDE 'TLF35584UserData[0]'. */
/begin MEASUREMENT TLF35584UserData[0] "(not defined)" UBYTE CU_TLF35584USERDATA[0] 1 100 0.0 255.0 ECU_ADDRESS 0x7001a187 BYTE_ORDER MSB_LAST /end MEASUREMENT
/begin COMPU_METHOD CU_TLF35584USERDATA[0] "Conversion method for TLF35584UserData[0]" RAT_FUNC "%10.0" "(not defined)" COEFFS 0.000000 1.000000 -0.000000 0.000000 0.000000 1.000000 /end COMPU_METHOD
/* Scalar measurable for DDE 'TLF35584UserData[10]'. */
/begin MEASUREMENT TLF35584UserData[10] "(not defined)" UBYTE CU_TLF35584USERDATA[10] 1 100 0.0 255.0 ECU_ADDRESS 0x7001a191 BYTE_ORDER MSB_LAST /end MEASUREMENT
/begin COMPU_METHOD CU_TLF35584USERDATA[10] "Conversion method for TLF35584UserData[10]" RAT_FUNC "%10.0" "(not defined)" COEFFS 0.000000 1.000000 -0.000000 0.000000 0.000000 1.000000 /end COMPU_METHOD
/* Scalar measurable for DDE 'TLF35584UserData[11]'. */
/begin MEASUREMENT TLF35584UserData[11] "(not defined)" UBYTE CU_TLF35584USERDATA[11] 1 100 0.0 255.0 ECU_ADDRESS 0x7001a192 BYTE_ORDER MSB_LAST /end MEASUREMENT
/begin COMPU_METHOD CU_TLF35584USERDATA[11] "Conversion method for TLF35584UserData[11]" RAT_FUNC "%10.0" "(not defined)" COEFFS 0.000000 1.000000 -0.000000 0.000000 0.000000 1.000000 /end COMPU_METHOD
/* Scalar measurable for DDE 'TLF35584UserData[12]'. */
/begin MEASUREMENT TLF35584UserData[12] "(not defined)" UBYTE CU_TLF35584USERDATA[12] 1 100 0.0 255.0 ECU_ADDRESS 0x7001a193 BYTE_ORDER MSB_LAST /end MEASUREMENT
/begin COMPU_METHOD CU_TLF35584USERDATA[12] "Conversion method for TLF35584UserData[12]" RAT_FUNC "%10.0" "(not defined)" COEFFS 0.000000 1.000000 -0.000000 0.000000 0.000000 1.000000 /end COMPU_METHOD
/* Scalar measurable for DDE 'TLF35584UserData[13]'. */
/begin MEASUREMENT TLF35584UserData[13] "(not defined)" UBYTE CU_TLF35584USERDATA[13] 1 100 0.0 255.0 ECU_ADDRESS 0x7001a194 BYTE_ORDER MSB_LAST /end MEASUREMENT
/begin COMPU_METHOD CU_TLF35584USERDATA[13] "Conversion method for TLF35584UserData[13]" RAT_FUNC "%10.0" "(not defined)" COEFFS 0.000000 1.000000 -0.000000 0.000000 0.000000 1.000000 /end COMPU_METHOD
/* Scalar measurable for DDE 'TLF35584UserData[14]'. */
/begin MEASUREMENT TLF35584UserData[14] "(not defined)" UBYTE CU_TLF35584USERDATA[14] 1 100 0.0 255.0 ECU_ADDRESS 0x7001a195 BYTE_ORDER MSB_LAST /end MEASUREMENT
/begin COMPU_METHOD CU_TLF35584USERDATA[14] "Conversion method for TLF35584UserData[14]" RAT_FUNC "%10.0" "(not defined)" COEFFS 0.000000 1.000000 -0.000000 0.000000 0.000000 1.000000 /end COMPU_METHOD
/* Scalar measurable for DDE 'TLF35584UserData[15]'. */
/begin MEASUREMENT TLF35584UserData[15] "(not defined)" UBYTE CU_TLF35584USERDATA[15] 1 100 0.0 255.0 ECU_ADDRESS 0x7001a196 BYTE_ORDER MSB_LAST /end MEASUREMENT
/begin COMPU_METHOD CU_TLF35584USERDATA[15] "Conversion method for TLF35584UserData[15]" RAT_FUNC "%10.0" "(not defined)" COEFFS 0.000000 1.000000 -0.000000 0.000000 0.000000 1.000000 /end COMPU_METHOD
/* Scalar measurable for DDE 'TLF35584UserData[16]'. */
/begin MEASUREMENT TLF35584UserData[16] "(not defined)" UBYTE CU_TLF35584USERDATA[16] 1 100 0.0 255.0 ECU_ADDRESS 0x7001a197 BYTE_ORDER MSB_LAST /end MEASUREMENT
/begin COMPU_METHOD CU_TLF35584USERDATA[16] "Conversion method for TLF35584UserData[16]" RAT_FUNC "%10.0" "(not defined)" COEFFS 0.000000 1.000000 -0.000000 0.000000 0.000000 1.000000 /end COMPU_METHOD
/* Scalar measurable for DDE 'TLF35584UserData[17]'. */
/begin MEASUREMENT TLF35584UserData[17] "(not defined)" UBYTE CU_TLF35584USERDATA[17] 1 100 0.0 255.0 ECU_ADDRESS 0x7001a198 BYTE_ORDER MSB_LAST /end MEASUREMENT
/begin COMPU_METHOD CU_TLF35584USERDATA[17] "Conversion method for TLF35584UserData[17]" RAT_FUNC "%10.0" "(not defined)" COEFFS 0.000000 1.000000 -0.000000 0.000000 0.000000 1.000000 /end COMPU_METHOD
/* Scalar measurable for DDE 'TLF35584UserData[18]'. */
/begin MEASUREMENT TLF35584UserData[18] "(not defined)" UBYTE CU_TLF35584USERDATA[18] 1 100 0.0 255.0 ECU_ADDRESS 0x7001a199 BYTE_ORDER MSB_LAST /end MEASUREMENT
/begin COMPU_METHOD CU_TLF35584USERDATA[18] "Conversion method for TLF35584UserData[18]" RAT_FUNC "%10.0" "(not defined)" COEFFS 0.000000 1.000000 -0.000000 0.000000 0.000000 1.000000 /end COMPU_METHOD
/* Scalar measurable for DDE 'TLF35584UserData[19]'. */
/begin MEASUREMENT TLF35584UserData[19] "(not defined)" UBYTE CU_TLF35584USERDATA[19] 1 100 0.0 255.0 ECU_ADDRESS 0x7001a19a BYTE_ORDER MSB_LAST /end MEASUREMENT
/begin COMPU_METHOD CU_TLF35584USERDATA[19] "Conversion method for TLF35584UserData[19]" RAT_FUNC "%10.0" "(not defined)" COEFFS 0.000000 1.000000 -0.000000 0.000000 0.000000 1.000000 /end COMPU_METHOD
/* Scalar measurable for DDE 'TLF35584UserData[1]'. */
/begin MEASUREMENT TLF35584UserData[1] "(not defined)" UBYTE CU_TLF35584USERDATA[1] 1 100 0.0 255.0 ECU_ADDRESS 0x7001a188 BYTE_ORDER MSB_LAST /end MEASUREMENT
/begin COMPU_METHOD CU_TLF35584USERDATA[1] "Conversion method for TLF35584UserData[1]" RAT_FUNC "%10.0" "(not defined)" COEFFS 0.000000 1.000000 -0.000000 0.000000 0.000000 1.000000 /end COMPU_METHOD
/* Scalar measurable for DDE 'TLF35584UserData[20]'. */
/begin MEASUREMENT TLF35584UserData[20] "(not defined)" UBYTE CU_TLF35584USERDATA[20] 1 100 0.0 255.0 ECU_ADDRESS 0x7001a19b BYTE_ORDER MSB_LAST /end MEASUREMENT
/begin COMPU_METHOD CU_TLF35584USERDATA[20] "Conversion method for TLF35584UserData[20]" RAT_FUNC "%10.0" "(not defined)" COEFFS 0.000000 1.000000 -0.000000 0.000000 0.000000 1.000000 /end COMPU_METHOD
/* Scalar measurable for DDE 'TLF35584UserData[21]'. */
/begin MEASUREMENT TLF35584UserData[21] "(not defined)" UBYTE CU_TLF35584USERDATA[21] 1 100 0.0 255.0 ECU_ADDRESS 0x7001a19c BYTE_ORDER MSB_LAST /end MEASUREMENT
/begin COMPU_METHOD CU_TLF35584USERDATA[21] "Conversion method for TLF35584UserData[21]" RAT_FUNC "%10.0" "(not defined)" COEFFS 0.000000 1.000000 -0.000000 0.000000 0.000000 1.000000 /end COMPU_METHOD
/* Scalar measurable for DDE 'TLF35584UserData[22]'. */
/begin MEASUREMENT TLF35584UserData[22] "(not defined)" UBYTE CU_TLF35584USERDATA[22] 1 100 0.0 255.0 ECU_ADDRESS 0x7001a19d BYTE_ORDER MSB_LAST /end MEASUREMENT
/begin COMPU_METHOD CU_TLF35584USERDATA[22] "Conversion method for TLF35584UserData[22]" RAT_FUNC "%10.0" "(not defined)" COEFFS 0.000000 1.000000 -0.000000 0.000000 0.000000 1.000000 /end COMPU_METHOD
/* Scalar measurable for DDE 'TLF35584UserData[23]'. */
/begin MEASUREMENT TLF35584UserData[23] "(not defined)" UBYTE CU_TLF35584USERDATA[23] 1 100 0.0 255.0 ECU_ADDRESS 0x7001a19e BYTE_ORDER MSB_LAST /end MEASUREMENT
/begin COMPU_METHOD CU_TLF35584USERDATA[23] "Conversion method for TLF35584UserData[23]" RAT_FUNC "%10.0" "(not defined)" COEFFS 0.000000 1.000000 -0.000000 0.000000 0.000000 1.000000 /end COMPU_METHOD
/* Scalar measurable for DDE 'TLF35584UserData[24]'. */
/begin MEASUREMENT TLF35584UserData[24] "(not defined)" UBYTE CU_TLF35584USERDATA[24] 1 100 0.0 255.0 ECU_ADDRESS 0x7001a19f BYTE_ORDER MSB_LAST /end MEASUREMENT
/begin COMPU_METHOD CU_TLF35584USERDATA[24] "Conversion method for TLF35584UserData[24]" RAT_FUNC "%10.0" "(not defined)" COEFFS 0.000000 1.000000 -0.000000 0.000000 0.000000 1.000000 /end COMPU_METHOD
/* Scalar measurable for DDE 'TLF35584UserData[2]'. */
/begin MEASUREMENT TLF35584UserData[2] "(not defined)" UBYTE CU_TLF35584USERDATA[2] 1 100 0.0 255.0 ECU_ADDRESS 0x7001a189 BYTE_ORDER MSB_LAST /end MEASUREMENT
/begin COMPU_METHOD CU_TLF35584USERDATA[2] "Conversion method for TLF35584UserData[2]" RAT_FUNC "%10.0" "(not defined)" COEFFS 0.000000 1.000000 -0.000000 0.000000 0.000000 1.000000 /end COMPU_METHOD
/* Scalar measurable for DDE 'TLF35584UserData[3]'. */
/begin MEASUREMENT TLF35584UserData[3] "(not defined)" UBYTE CU_TLF35584USERDATA[3] 1 100 0.0 255.0 ECU_ADDRESS 0x7001a18a BYTE_ORDER MSB_LAST /end MEASUREMENT
/begin COMPU_METHOD CU_TLF35584USERDATA[3] "Conversion method for TLF35584UserData[3]" RAT_FUNC "%10.0" "(not defined)" COEFFS 0.000000 1.000000 -0.000000 0.000000 0.000000 1.000000 /end COMPU_METHOD
/* Scalar measurable for DDE 'TLF35584UserData[4]'. */
/begin MEASUREMENT TLF35584UserData[4] "(not defined)" UBYTE CU_TLF35584USERDATA[4] 1 100 0.0 255.0 ECU_ADDRESS 0x7001a18b BYTE_ORDER MSB_LAST /end MEASUREMENT
/begin COMPU_METHOD CU_TLF35584USERDATA[4] "Conversion method for TLF35584UserData[4]" RAT_FUNC "%10.0" "(not defined)" COEFFS 0.000000 1.000000 -0.000000 0.000000 0.000000 1.000000 /end COMPU_METHOD
/* Scalar measurable for DDE 'TLF35584UserData[5]'. */
/begin MEASUREMENT TLF35584UserData[5] "(not defined)" UBYTE CU_TLF35584USERDATA[5] 1 100 0.0 255.0 ECU_ADDRESS 0x7001a18c BYTE_ORDER MSB_LAST /end MEASUREMENT
/begin COMPU_METHOD CU_TLF35584USERDATA[5] "Conversion method for TLF35584UserData[5]" RAT_FUNC "%10.0" "(not defined)" COEFFS 0.000000 1.000000 -0.000000 0.000000 0.000000 1.000000 /end COMPU_METHOD
/* Scalar measurable for DDE 'TLF35584UserData[6]'. */
/begin MEASUREMENT TLF35584UserData[6] "(not defined)" UBYTE CU_TLF35584USERDATA[6] 1 100 0.0 255.0 ECU_ADDRESS 0x7001a18d BYTE_ORDER MSB_LAST /end MEASUREMENT
/begin COMPU_METHOD CU_TLF35584USERDATA[6] "Conversion method for TLF35584UserData[6]" RAT_FUNC "%10.0" "(not defined)" COEFFS 0.000000 1.000000 -0.000000 0.000000 0.000000 1.000000 /end COMPU_METHOD
/* Scalar measurable for DDE 'TLF35584UserData[7]'. */
/begin MEASUREMENT TLF35584UserData[7] "(not defined)" UBYTE CU_TLF35584USERDATA[7] 1 100 0.0 255.0 ECU_ADDRESS 0x7001a18e BYTE_ORDER MSB_LAST /end MEASUREMENT
/begin COMPU_METHOD CU_TLF35584USERDATA[7] "Conversion method for TLF35584UserData[7]" RAT_FUNC "%10.0" "(not defined)" COEFFS 0.000000 1.000000 -0.000000 0.000000 0.000000 1.000000 /end COMPU_METHOD
/* Scalar measurable for DDE 'TLF35584UserData[8]'. */
/begin MEASUREMENT TLF35584UserData[8] "(not defined)" UBYTE CU_TLF35584USERDATA[8] 1 100 0.0 255.0 ECU_ADDRESS 0x7001a18f BYTE_ORDER MSB_LAST /end MEASUREMENT
/begin COMPU_METHOD CU_TLF35584USERDATA[8] "Conversion method for TLF35584UserData[8]" RAT_FUNC "%10.0" "(not defined)" COEFFS 0.000000 1.000000 -0.000000 0.000000 0.000000 1.000000 /end COMPU_METHOD
/* Scalar measurable for DDE 'TLF35584UserData[9]'. */
/begin MEASUREMENT TLF35584UserData[9] "(not defined)" UBYTE CU_TLF35584USERDATA[9] 1 100 0.0 255.0 ECU_ADDRESS 0x7001a190 BYTE_ORDER MSB_LAST /end MEASUREMENT
/begin COMPU_METHOD CU_TLF35584USERDATA[9] "Conversion method for TLF35584UserData[9]" RAT_FUNC "%10.0" "(not defined)" COEFFS 0.000000 1.000000 -0.000000 0.000000 0.000000 1.000000 /end COMPU_METHOD
/* Scalar measurable for DDE 'TempIntDegC_MaxFlt'. */
/begin MEASUREMENT TempIntDegC_MaxFlt "Temp Internal DegC above max threshold latched after debounce" UBYTE CU_TEMPINTDEGC_MAXFLT 1 100 0.0 1.0 ECU_ADDRESS 0x7001a01a BYTE_ORDER MSB_LAST /end MEASUREMENT
/begin COMPU_METHOD CU_TEMPINTDEGC_MAXFLT "Conversion method for TempIntDegC_MaxFlt" RAT_FUNC "%10.0" "(not defined)" COEFFS 0.000000 1.000000 -0.000000 0.000000 0.000000 1.000000 /end COMPU_METHOD
/* Scalar measurable for DDE 'TempIntDegC_MaxFltActv'. */
/begin MEASUREMENT TempIntDegC_MaxFltActv "Active fault high TempInt DegC (Max fault no latch or debounce)" UBYTE CU_TEMPINTDEGC_MAXFLTACTV 1 100 0.0 1.0 ECU_ADDRESS 0x70019eb0 BYTE_ORDER MSB_LAST /end MEASUREMENT
/begin COMPU_METHOD CU_TEMPINTDEGC_MAXFLTACTV "Conversion method for TempIntDegC_MaxFltActv" RAT_FUNC "%10.0" "(not defined)" COEFFS 0.000000 1.000000 -0.000000 0.000000 0.000000 1.000000 /end COMPU_METHOD
/* Scalar measurable for DDE 'TempIntDegC_MinFlt'. */
/begin MEASUREMENT TempIntDegC_MinFlt "Temp Internal DegC below min threshold latched after debounce" UBYTE CU_TEMPINTDEGC_MINFLT 1 100 0.0 1.0 ECU_ADDRESS 0x7001a03d BYTE_ORDER MSB_LAST /end MEASUREMENT
/begin COMPU_METHOD CU_TEMPINTDEGC_MINFLT "Conversion method for TempIntDegC_MinFlt" RAT_FUNC "%10.0" "(not defined)" COEFFS 0.000000 1.000000 -0.000000 0.000000 0.000000 1.000000 /end COMPU_METHOD
/* Scalar measurable for DDE 'TempIntDegC_MinFltActv'. */
/begin MEASUREMENT TempIntDegC_MinFltActv "Active fault low TempInt DegC (Min fault no latch or debounce)" UBYTE CU_TEMPINTDEGC_MINFLTACTV 1 100 0.0 1.0 ECU_ADDRESS 0x70019f3a BYTE_ORDER MSB_LAST /end MEASUREMENT
/begin COMPU_METHOD CU_TEMPINTDEGC_MINFLTACTV "Conversion method for TempIntDegC_MinFltActv" RAT_FUNC "%10.0" "(not defined)" COEFFS 0.000000 1.000000 -0.000000 0.000000 0.000000 1.000000 /end COMPU_METHOD
/* Scalar measurable for DDE 'TempInt_MaxFlt'. */
/begin MEASUREMENT TempInt_MaxFlt "Internal Temp above max threshold latched after debounce" UBYTE CU_TEMPINT_MAXFLT 1 100 0.0 1.0 ECU_ADDRESS 0x7001a0d1 BYTE_ORDER MSB_LAST /end MEASUREMENT
/begin COMPU_METHOD CU_TEMPINT_MAXFLT "Conversion method for TempInt_MaxFlt" RAT_FUNC "%10.0" "(not defined)" COEFFS 0.000000 1.000000 -0.000000 0.000000 0.000000 1.000000 /end COMPU_METHOD
/* Scalar measurable for DDE 'TempInt_MaxFltActv'. */
/begin MEASUREMENT TempInt_MaxFltActv "Active fault high (Max fault no latch or debounce)" UBYTE CU_TEMPINT_MAXFLTACTV 1 100 0.0 1.0 ECU_ADDRESS 0x70019f55 BYTE_ORDER MSB_LAST /end MEASUREMENT
/begin COMPU_METHOD CU_TEMPINT_MAXFLTACTV "Conversion method for TempInt_MaxFltActv" RAT_FUNC "%10.0" "(not defined)" COEFFS 0.000000 1.000000 -0.000000 0.000000 0.000000 1.000000 /end COMPU_METHOD
/* Scalar measurable for DDE 'TempInt_MinFlt'. */
/begin MEASUREMENT TempInt_MinFlt "Internal Temp below min threshold latched after debounce" UBYTE CU_TEMPINT_MINFLT 1 100 0.0 1.0 ECU_ADDRESS 0x7001a0e9 BYTE_ORDER MSB_LAST /end MEASUREMENT
/begin COMPU_METHOD CU_TEMPINT_MINFLT "Conversion method for TempInt_MinFlt" RAT_FUNC "%10.0" "(not defined)" COEFFS 0.000000 1.000000 -0.000000 0.000000 0.000000 1.000000 /end COMPU_METHOD
/* Scalar measurable for DDE 'TempInt_MinFltActv'. */
/begin MEASUREMENT TempInt_MinFltActv "Active fault low (Min fault no latch or debounce)" UBYTE CU_TEMPINT_MINFLTACTV 1 100 0.0 1.0 ECU_ADDRESS 0x70019f7d BYTE_ORDER MSB_LAST /end MEASUREMENT
/begin COMPU_METHOD CU_TEMPINT_MINFLTACTV "Conversion method for TempInt_MinFltActv" RAT_FUNC "%10.0" "(not defined)" COEFFS 0.000000 1.000000 -0.000000 0.000000 0.000000 1.000000 /end COMPU_METHOD
/* Scalar measurable for DDE 'V2gEcuConnectionSt'. */
/begin MEASUREMENT V2gEcuConnectionSt "Internal Signal to read the V2G connection Status" UBYTE CU_V2GECUCONNECTIONST 1 100 0.0 255.0 ECU_ADDRESS 0x700181a2 BYTE_ORDER MSB_LAST /end MEASUREMENT
/begin COMPU_METHOD CU_V2GECUCONNECTIONST "Conversion method for V2gEcuConnectionSt" RAT_FUNC "%10.0" "1" COEFFS 0.000000 1.000000 -0.000000 0.000000 0.000000 1.000000 /end COMPU_METHOD
/* Scalar measurable for DDE 'V2gEcuPlcChipStatus'. */
/begin MEASUREMENT V2gEcuPlcChipStatus "Internal Signal to read the PLC Chip status" UBYTE CU_V2GECUPLCCHIPSTATUS 1 100 0.0 255.0 ECU_ADDRESS 0x70017f59 BYTE_ORDER MSB_LAST /end MEASUREMENT
/begin COMPU_METHOD CU_V2GECUPLCCHIPSTATUS "Conversion method for V2gEcuPlcChipStatus" RAT_FUNC "%10.0" "1" COEFFS 0.000000 1.000000 -0.000000 0.000000 0.000000 1.000000 /end COMPU_METHOD
/* Scalar measurable for DDE 'V2gEcuPlcLinkStatus'. */
/begin MEASUREMENT V2gEcuPlcLinkStatus "Internal Signal to read the Link Status when establishing the PLC link between EV and EVSE" UBYTE CU_V2GECUPLCLINKSTATUS 1 100 0.0 255.0 ECU_ADDRESS 0x70017db8 BYTE_ORDER MSB_LAST /end MEASUREMENT
/begin COMPU_METHOD CU_V2GECUPLCLINKSTATUS "Conversion method for V2gEcuPlcLinkStatus" RAT_FUNC "%10.0" "1" COEFFS 0.000000 1.000000 -0.000000 0.000000 0.000000 1.000000 /end COMPU_METHOD
/* Scalar measurable for DDE 'V2gEcuQcaErrCode'. */
/begin MEASUREMENT V2gEcuQcaErrCode "Internal Signal to read the QCA chip error code when establishing the PLC link between EV and EVSE" UBYTE CU_V2GECUQCAERRCODE 1 100 0.0 255.0 ECU_ADDRESS 0x70017f83 BYTE_ORDER MSB_LAST /end MEASUREMENT
/begin COMPU_METHOD CU_V2GECUQCAERRCODE "Conversion method for V2gEcuQcaErrCode" RAT_FUNC "%10.0" "1" COEFFS 0.000000 1.000000 -0.000000 0.000000 0.000000 1.000000 /end COMPU_METHOD
/* Scalar measurable for DDE 'V2gEcuSlacEvseAvgAttenuation'. */
/begin MEASUREMENT V2gEcuSlacEvseAvgAttenuation "Internal Signal to read the average attenuation value reported by EVSE when establishing the PLC link between EV and EVSE" FLOAT32_IEEE CU_V2GECUSLACEVSEAVGATTENUATION 1 100 -10000.0 10000.0 ECU_ADDRESS 0x700182e0 BYTE_ORDER MSB_LAST /end MEASUREMENT
/begin COMPU_METHOD CU_V2GECUSLACEVSEAVGATTENUATION "Conversion method for V2gEcuSlacEvseAvgAttenuation" RAT_FUNC "%10.0" "1" COEFFS 0.000000 1.000000 -0.000000 0.000000 0.000000 1.000000 /end COMPU_METHOD
/* Scalar measurable for DDE 'V2gEcuSlacSessionState'. */
/begin MEASUREMENT V2gEcuSlacSessionState "Internal Signal to read the SLAC Session State during establishing the PLC link between EV and EVSE" UBYTE CU_V2GECUSLACSESSIONSTATE 1 100 0.0 255.0 ECU_ADDRESS 0x70017cbc BYTE_ORDER MSB_LAST /end MEASUREMENT
/begin COMPU_METHOD CU_V2GECUSLACSESSIONSTATE "Conversion method for V2gEcuSlacSessionState" RAT_FUNC "%10.0" "1" COEFFS 0.000000 1.000000 -0.000000 0.000000 0.000000 1.000000 /end COMPU_METHOD
/* Scalar measurable for DDE 'V2gEcuSlacState'. */
/begin MEASUREMENT V2gEcuSlacState "Internal Signal to read the SLAC state during establishing the PLC link between EV and EVSE" UBYTE CU_V2GECUSLACSTATE 1 100 0.0 255.0 ECU_ADDRESS 0x700183fc BYTE_ORDER MSB_LAST /end MEASUREMENT
/begin COMPU_METHOD CU_V2GECUSLACSTATE "Conversion method for V2gEcuSlacState" RAT_FUNC "%10.0" "1" COEFFS 0.000000 1.000000 -0.000000 0.000000 0.000000 1.000000 /end COMPU_METHOD
/* Scalar measurable for DDE 'V2gEcuTcpStatus'. */
/begin MEASUREMENT V2gEcuTcpStatus "Internal Signal to read the TCP status when establishing the PLC link between EV and EVSE" UBYTE CU_V2GECUTCPSTATUS 1 100 0.0 255.0 ECU_ADDRESS 0x70018264 BYTE_ORDER MSB_LAST /end MEASUREMENT
/begin COMPU_METHOD CU_V2GECUTCPSTATUS "Conversion method for V2gEcuTcpStatus" RAT_FUNC "%10.0" "1" COEFFS 0.000000 1.000000 -0.000000 0.000000 0.000000 1.000000 /end COMPU_METHOD
/* Scalar measurable for DDE 'V2gEcuUnmatchedSlacPhase'. */
/begin MEASUREMENT V2gEcuUnmatchedSlacPhase "Internal Signal to read the SLAC phase during establishing the PLC link between EV and EVSE" UBYTE CU_V2GECUUNMATCHEDSLACPHASE 1 100 0.0 255.0 ECU_ADDRESS 0x70018008 BYTE_ORDER MSB_LAST /end MEASUREMENT
/begin COMPU_METHOD CU_V2GECUUNMATCHEDSLACPHASE "Conversion method for V2gEcuUnmatchedSlacPhase" RAT_FUNC "%10.0" "1" COEFFS 0.000000 1.000000 -0.000000 0.000000 0.000000 1.000000 /end COMPU_METHOD
/* Scalar measurable for DDE 'V2gEcuV2gConnectionErrCode'. */
/begin MEASUREMENT V2gEcuV2gConnectionErrCode "Internal Signal to read the connection error code when establishing the PLC link between EV and EVSE" UBYTE CU_V2GECUV2GCONNECTIONERRCODE 1 100 0.0 255.0 ECU_ADDRESS 0x7001828d BYTE_ORDER MSB_LAST /end MEASUREMENT
/begin COMPU_METHOD CU_V2GECUV2GCONNECTIONERRCODE "Conversion method for V2gEcuV2gConnectionErrCode" RAT_FUNC "%10.0" "1" COEFFS 0.000000 1.000000 -0.000000 0.000000 0.000000 1.000000 /end COMPU_METHOD
/* Scalar measurable for DDE 'V2gEvccIpAddress[0]'. */
/begin MEASUREMENT V2gEvccIpAddress[0] "V2G connection information" UWORD CU_V2GEVCCIPADDRESS[0] 1 100 0.0 65535.0 ECU_ADDRESS 0x70017c6a BYTE_ORDER MSB_LAST /end MEASUREMENT
/begin COMPU_METHOD CU_V2GEVCCIPADDRESS[0] "Conversion method for V2gEvccIpAddress[0]" RAT_FUNC "%10.0" "1" COEFFS 0.000000 1.000000 -0.000000 0.000000 0.000000 1.000000 /end COMPU_METHOD
/* Scalar measurable for DDE 'V2gEvccIpAddress[1]'. */
/begin MEASUREMENT V2gEvccIpAddress[1] "V2G connection information" UWORD CU_V2GEVCCIPADDRESS[1] 1 100 0.0 65535.0 ECU_ADDRESS 0x70017c6c BYTE_ORDER MSB_LAST /end MEASUREMENT
/begin COMPU_METHOD CU_V2GEVCCIPADDRESS[1] "Conversion method for V2gEvccIpAddress[1]" RAT_FUNC "%10.0" "1" COEFFS 0.000000 1.000000 -0.000000 0.000000 0.000000 1.000000 /end COMPU_METHOD
/* Scalar measurable for DDE 'V2gEvccIpAddress[2]'. */
/begin MEASUREMENT V2gEvccIpAddress[2] "V2G connection information" UWORD CU_V2GEVCCIPADDRESS[2] 1 100 0.0 65535.0 ECU_ADDRESS 0x70017c6e BYTE_ORDER MSB_LAST /end MEASUREMENT
/begin COMPU_METHOD CU_V2GEVCCIPADDRESS[2] "Conversion method for V2gEvccIpAddress[2]" RAT_FUNC "%10.0" "1" COEFFS 0.000000 1.000000 -0.000000 0.000000 0.000000 1.000000 /end COMPU_METHOD
/* Scalar measurable for DDE 'V2gEvccIpAddress[3]'. */
/begin MEASUREMENT V2gEvccIpAddress[3] "V2G connection information" UWORD CU_V2GEVCCIPADDRESS[3] 1 100 0.0 65535.0 ECU_ADDRESS 0x70017c70 BYTE_ORDER MSB_LAST /end MEASUREMENT
/begin COMPU_METHOD CU_V2GEVCCIPADDRESS[3] "Conversion method for V2gEvccIpAddress[3]" RAT_FUNC "%10.0" "1" COEFFS 0.000000 1.000000 -0.000000 0.000000 0.000000 1.000000 /end COMPU_METHOD
/* Scalar measurable for DDE 'V2gEvccIpAddress[4]'. */
/begin MEASUREMENT V2gEvccIpAddress[4] "V2G connection information" UWORD CU_V2GEVCCIPADDRESS[4] 1 100 0.0 65535.0 ECU_ADDRESS 0x70017c72 BYTE_ORDER MSB_LAST /end MEASUREMENT
/begin COMPU_METHOD CU_V2GEVCCIPADDRESS[4] "Conversion method for V2gEvccIpAddress[4]" RAT_FUNC "%10.0" "1" COEFFS 0.000000 1.000000 -0.000000 0.000000 0.000000 1.000000 /end COMPU_METHOD
/* Scalar measurable for DDE 'V2gEvccIpAddress[5]'. */
/begin MEASUREMENT V2gEvccIpAddress[5] "V2G connection information" UWORD CU_V2GEVCCIPADDRESS[5] 1 100 0.0 65535.0 ECU_ADDRESS 0x70017c74 BYTE_ORDER MSB_LAST /end MEASUREMENT
/begin COMPU_METHOD CU_V2GEVCCIPADDRESS[5] "Conversion method for V2gEvccIpAddress[5]" RAT_FUNC "%10.0" "1" COEFFS 0.000000 1.000000 -0.000000 0.000000 0.000000 1.000000 /end COMPU_METHOD
/* Scalar measurable for DDE 'V2gEvccIpAddress[6]'. */
/begin MEASUREMENT V2gEvccIpAddress[6] "V2G connection information" UWORD CU_V2GEVCCIPADDRESS[6] 1 100 0.0 65535.0 ECU_ADDRESS 0x70017c76 BYTE_ORDER MSB_LAST /end MEASUREMENT
/begin COMPU_METHOD CU_V2GEVCCIPADDRESS[6] "Conversion method for V2gEvccIpAddress[6]" RAT_FUNC "%10.0" "1" COEFFS 0.000000 1.000000 -0.000000 0.000000 0.000000 1.000000 /end COMPU_METHOD
/* Scalar measurable for DDE 'V2gEvccIpAddress[7]'. */
/begin MEASUREMENT V2gEvccIpAddress[7] "V2G connection information" UWORD CU_V2GEVCCIPADDRESS[7] 1 100 0.0 65535.0 ECU_ADDRESS 0x70017c78 BYTE_ORDER MSB_LAST /end MEASUREMENT
/begin COMPU_METHOD CU_V2GEVCCIPADDRESS[7] "Conversion method for V2gEvccIpAddress[7]" RAT_FUNC "%10.0" "1" COEFFS 0.000000 1.000000 -0.000000 0.000000 0.000000 1.000000 /end COMPU_METHOD
/* Scalar measurable for DDE 'V2gEvccMacAddress[0]'. */
/begin MEASUREMENT V2gEvccMacAddress[0] "V2G connection information" UBYTE CU_V2GEVCCMACADDRESS[0] 1 100 0.0 255.0 ECU_ADDRESS 0x70017f47 BYTE_ORDER MSB_LAST /end MEASUREMENT
/begin COMPU_METHOD CU_V2GEVCCMACADDRESS[0] "Conversion method for V2gEvccMacAddress[0]" RAT_FUNC "%10.0" "1" COEFFS 0.000000 1.000000 -0.000000 0.000000 0.000000 1.000000 /end COMPU_METHOD
/* Scalar measurable for DDE 'V2gEvccMacAddress[1]'. */
/begin MEASUREMENT V2gEvccMacAddress[1] "V2G connection information" UBYTE CU_V2GEVCCMACADDRESS[1] 1 100 0.0 255.0 ECU_ADDRESS 0x70017f48 BYTE_ORDER MSB_LAST /end MEASUREMENT
/begin COMPU_METHOD CU_V2GEVCCMACADDRESS[1] "Conversion method for V2gEvccMacAddress[1]" RAT_FUNC "%10.0" "1" COEFFS 0.000000 1.000000 -0.000000 0.000000 0.000000 1.000000 /end COMPU_METHOD
/* Scalar measurable for DDE 'V2gEvccMacAddress[2]'. */
/begin MEASUREMENT V2gEvccMacAddress[2] "V2G connection information" UBYTE CU_V2GEVCCMACADDRESS[2] 1 100 0.0 255.0 ECU_ADDRESS 0x70017f49 BYTE_ORDER MSB_LAST /end MEASUREMENT
/begin COMPU_METHOD CU_V2GEVCCMACADDRESS[2] "Conversion method for V2gEvccMacAddress[2]" RAT_FUNC "%10.0" "1" COEFFS 0.000000 1.000000 -0.000000 0.000000 0.000000 1.000000 /end COMPU_METHOD
/* Scalar measurable for DDE 'V2gEvccMacAddress[3]'. */
/begin MEASUREMENT V2gEvccMacAddress[3] "V2G connection information" UBYTE CU_V2GEVCCMACADDRESS[3] 1 100 0.0 255.0 ECU_ADDRESS 0x70017f4a BYTE_ORDER MSB_LAST /end MEASUREMENT
/begin COMPU_METHOD CU_V2GEVCCMACADDRESS[3] "Conversion method for V2gEvccMacAddress[3]" RAT_FUNC "%10.0" "1" COEFFS 0.000000 1.000000 -0.000000 0.000000 0.000000 1.000000 /end COMPU_METHOD
/* Scalar measurable for DDE 'V2gEvccMacAddress[4]'. */
/begin MEASUREMENT V2gEvccMacAddress[4] "V2G connection information" UBYTE CU_V2GEVCCMACADDRESS[4] 1 100 0.0 255.0 ECU_ADDRESS 0x70017f4b BYTE_ORDER MSB_LAST /end MEASUREMENT
/begin COMPU_METHOD CU_V2GEVCCMACADDRESS[4] "Conversion method for V2gEvccMacAddress[4]" RAT_FUNC "%10.0" "1" COEFFS 0.000000 1.000000 -0.000000 0.000000 0.000000 1.000000 /end COMPU_METHOD
/* Scalar measurable for DDE 'V2gEvccMacAddress[5]'. */
/begin MEASUREMENT V2gEvccMacAddress[5] "V2G connection information" UBYTE CU_V2GEVCCMACADDRESS[5] 1 100 0.0 255.0 ECU_ADDRESS 0x70017f4c BYTE_ORDER MSB_LAST /end MEASUREMENT
/begin COMPU_METHOD CU_V2GEVCCMACADDRESS[5] "Conversion method for V2gEvccMacAddress[5]" RAT_FUNC "%10.0" "1" COEFFS 0.000000 1.000000 -0.000000 0.000000 0.000000 1.000000 /end COMPU_METHOD
/* Scalar measurable for DDE 'V2gEvccTcpPortNumber'. */
/begin MEASUREMENT V2gEvccTcpPortNumber "V2G connection information" UWORD CU_V2GEVCCTCPPORTNUMBER 1 100 0.0 65535.0 ECU_ADDRESS 0x70017db0 BYTE_ORDER MSB_LAST /end MEASUREMENT
/begin COMPU_METHOD CU_V2GEVCCTCPPORTNUMBER "Conversion method for V2gEvccTcpPortNumber" RAT_FUNC "%10.0" "1" COEFFS 0.000000 1.000000 -0.000000 0.000000 0.000000 1.000000 /end COMPU_METHOD
/* Scalar measurable for DDE 'V2gEvseIpAddress[0]'. */
/begin MEASUREMENT V2gEvseIpAddress[0] "V2G connection information" UWORD CU_V2GEVSEIPADDRESS[0] 1 100 0.0 65535.0 ECU_ADDRESS 0x700184a4 BYTE_ORDER MSB_LAST /end MEASUREMENT
/begin COMPU_METHOD CU_V2GEVSEIPADDRESS[0] "Conversion method for V2gEvseIpAddress[0]" RAT_FUNC "%10.0" "1" COEFFS 0.000000 1.000000 -0.000000 0.000000 0.000000 1.000000 /end COMPU_METHOD
/* Scalar measurable for DDE 'V2gEvseIpAddress[1]'. */
/begin MEASUREMENT V2gEvseIpAddress[1] "V2G connection information" UWORD CU_V2GEVSEIPADDRESS[1] 1 100 0.0 65535.0 ECU_ADDRESS 0x700184a6 BYTE_ORDER MSB_LAST /end MEASUREMENT
/begin COMPU_METHOD CU_V2GEVSEIPADDRESS[1] "Conversion method for V2gEvseIpAddress[1]" RAT_FUNC "%10.0" "1" COEFFS 0.000000 1.000000 -0.000000 0.000000 0.000000 1.000000 /end COMPU_METHOD
/* Scalar measurable for DDE 'V2gEvseIpAddress[2]'. */
/begin MEASUREMENT V2gEvseIpAddress[2] "V2G connection information" UWORD CU_V2GEVSEIPADDRESS[2] 1 100 0.0 65535.0 ECU_ADDRESS 0x700184a8 BYTE_ORDER MSB_LAST /end MEASUREMENT
/begin COMPU_METHOD CU_V2GEVSEIPADDRESS[2] "Conversion method for V2gEvseIpAddress[2]" RAT_FUNC "%10.0" "1" COEFFS 0.000000 1.000000 -0.000000 0.000000 0.000000 1.000000 /end COMPU_METHOD
/* Scalar measurable for DDE 'V2gEvseIpAddress[3]'. */
/begin MEASUREMENT V2gEvseIpAddress[3] "V2G connection information" UWORD CU_V2GEVSEIPADDRESS[3] 1 100 0.0 65535.0 ECU_ADDRESS 0x700184aa BYTE_ORDER MSB_LAST /end MEASUREMENT
/begin COMPU_METHOD CU_V2GEVSEIPADDRESS[3] "Conversion method for V2gEvseIpAddress[3]" RAT_FUNC "%10.0" "1" COEFFS 0.000000 1.000000 -0.000000 0.000000 0.000000 1.000000 /end COMPU_METHOD
/* Scalar measurable for DDE 'V2gEvseIpAddress[4]'. */
/begin MEASUREMENT V2gEvseIpAddress[4] "V2G connection information" UWORD CU_V2GEVSEIPADDRESS[4] 1 100 0.0 65535.0 ECU_ADDRESS 0x700184ac BYTE_ORDER MSB_LAST /end MEASUREMENT
/begin COMPU_METHOD CU_V2GEVSEIPADDRESS[4] "Conversion method for V2gEvseIpAddress[4]" RAT_FUNC "%10.0" "1" COEFFS 0.000000 1.000000 -0.000000 0.000000 0.000000 1.000000 /end COMPU_METHOD
/* Scalar measurable for DDE 'V2gEvseIpAddress[5]'. */
/begin MEASUREMENT V2gEvseIpAddress[5] "V2G connection information" UWORD CU_V2GEVSEIPADDRESS[5] 1 100 0.0 65535.0 ECU_ADDRESS 0x700184ae BYTE_ORDER MSB_LAST /end MEASUREMENT
/begin COMPU_METHOD CU_V2GEVSEIPADDRESS[5] "Conversion method for V2gEvseIpAddress[5]" RAT_FUNC "%10.0" "1" COEFFS 0.000000 1.000000 -0.000000 0.000000 0.000000 1.000000 /end COMPU_METHOD
/* Scalar measurable for DDE 'V2gEvseIpAddress[6]'. */
/begin MEASUREMENT V2gEvseIpAddress[6] "V2G connection information" UWORD CU_V2GEVSEIPADDRESS[6] 1 100 0.0 65535.0 ECU_ADDRESS 0x700184b0 BYTE_ORDER MSB_LAST /end MEASUREMENT
/begin COMPU_METHOD CU_V2GEVSEIPADDRESS[6] "Conversion method for V2gEvseIpAddress[6]" RAT_FUNC "%10.0" "1" COEFFS 0.000000 1.000000 -0.000000 0.000000 0.000000 1.000000 /end COMPU_METHOD
/* Scalar measurable for DDE 'V2gEvseIpAddress[7]'. */
/begin MEASUREMENT V2gEvseIpAddress[7] "V2G connection information" UWORD CU_V2GEVSEIPADDRESS[7] 1 100 0.0 65535.0 ECU_ADDRESS 0x700184b2 BYTE_ORDER MSB_LAST /end MEASUREMENT
/begin COMPU_METHOD CU_V2GEVSEIPADDRESS[7] "Conversion method for V2gEvseIpAddress[7]" RAT_FUNC "%10.0" "1" COEFFS 0.000000 1.000000 -0.000000 0.000000 0.000000 1.000000 /end COMPU_METHOD
/* Scalar measurable for DDE 'V2gEvseMacAddress[0]'. */
/begin MEASUREMENT V2gEvseMacAddress[0] "V2G connection information" UBYTE CU_V2GEVSEMACADDRESS[0] 1 100 0.0 255.0 ECU_ADDRESS 0x70018310 BYTE_ORDER MSB_LAST /end MEASUREMENT
/begin COMPU_METHOD CU_V2GEVSEMACADDRESS[0] "Conversion method for V2gEvseMacAddress[0]" RAT_FUNC "%10.0" "1" COEFFS 0.000000 1.000000 -0.000000 0.000000 0.000000 1.000000 /end COMPU_METHOD
/* Scalar measurable for DDE 'V2gEvseMacAddress[1]'. */
/begin MEASUREMENT V2gEvseMacAddress[1] "V2G connection information" UBYTE CU_V2GEVSEMACADDRESS[1] 1 100 0.0 255.0 ECU_ADDRESS 0x70018311 BYTE_ORDER MSB_LAST /end MEASUREMENT
/begin COMPU_METHOD CU_V2GEVSEMACADDRESS[1] "Conversion method for V2gEvseMacAddress[1]" RAT_FUNC "%10.0" "1" COEFFS 0.000000 1.000000 -0.000000 0.000000 0.000000 1.000000 /end COMPU_METHOD
/* Scalar measurable for DDE 'V2gEvseMacAddress[2]'. */
/begin MEASUREMENT V2gEvseMacAddress[2] "V2G connection information" UBYTE CU_V2GEVSEMACADDRESS[2] 1 100 0.0 255.0 ECU_ADDRESS 0x70018312 BYTE_ORDER MSB_LAST /end MEASUREMENT
/begin COMPU_METHOD CU_V2GEVSEMACADDRESS[2] "Conversion method for V2gEvseMacAddress[2]" RAT_FUNC "%10.0" "1" COEFFS 0.000000 1.000000 -0.000000 0.000000 0.000000 1.000000 /end COMPU_METHOD
/* Scalar measurable for DDE 'V2gEvseMacAddress[3]'. */
/begin MEASUREMENT V2gEvseMacAddress[3] "V2G connection information" UBYTE CU_V2GEVSEMACADDRESS[3] 1 100 0.0 255.0 ECU_ADDRESS 0x70018313 BYTE_ORDER MSB_LAST /end MEASUREMENT
/begin COMPU_METHOD CU_V2GEVSEMACADDRESS[3] "Conversion method for V2gEvseMacAddress[3]" RAT_FUNC "%10.0" "1" COEFFS 0.000000 1.000000 -0.000000 0.000000 0.000000 1.000000 /end COMPU_METHOD
/* Scalar measurable for DDE 'V2gEvseMacAddress[4]'. */
/begin MEASUREMENT V2gEvseMacAddress[4] "V2G connection information" UBYTE CU_V2GEVSEMACADDRESS[4] 1 100 0.0 255.0 ECU_ADDRESS 0x70018314 BYTE_ORDER MSB_LAST /end MEASUREMENT
/begin COMPU_METHOD CU_V2GEVSEMACADDRESS[4] "Conversion method for V2gEvseMacAddress[4]" RAT_FUNC "%10.0" "1" COEFFS 0.000000 1.000000 -0.000000 0.000000 0.000000 1.000000 /end COMPU_METHOD
/* Scalar measurable for DDE 'V2gEvseMacAddress[5]'. */
/begin MEASUREMENT V2gEvseMacAddress[5] "V2G connection information" UBYTE CU_V2GEVSEMACADDRESS[5] 1 100 0.0 255.0 ECU_ADDRESS 0x70018315 BYTE_ORDER MSB_LAST /end MEASUREMENT
/begin COMPU_METHOD CU_V2GEVSEMACADDRESS[5] "Conversion method for V2gEvseMacAddress[5]" RAT_FUNC "%10.0" "1" COEFFS 0.000000 1.000000 -0.000000 0.000000 0.000000 1.000000 /end COMPU_METHOD
/* Scalar measurable for DDE 'V2gEvseTcpPortNumber'. */
/begin MEASUREMENT V2gEvseTcpPortNumber "V2G connection information" UWORD CU_V2GEVSETCPPORTNUMBER 1 100 0.0 65535.0 ECU_ADDRESS 0x70017c22 BYTE_ORDER MSB_LAST /end MEASUREMENT
/begin COMPU_METHOD CU_V2GEVSETCPPORTNUMBER "Conversion method for V2gEvseTcpPortNumber" RAT_FUNC "%10.0" "1" COEFFS 0.000000 1.000000 -0.000000 0.000000 0.000000 1.000000 /end COMPU_METHOD
/* Scalar measurable for DDE 'V2gRxMsgAuthEvseProcessing'. */
/begin MEASUREMENT V2gRxMsgAuthEvseProcessing "Message YB: Parameter indicating that the EVSE has finished the processing that was initiated after the ContractAuthenticationReq or that the EVSE is still processing at the time the response message was sent." SLONG CU_V2GRXMSGAUTHEVSEPROCESSING 1 100 -2147483648.0 2147483647.0 ECU_ADDRESS 0x70017edc BYTE_ORDER MSB_LAST /end MEASUREMENT
/begin COMPU_METHOD CU_V2GRXMSGAUTHEVSEPROCESSING "Conversion method for V2gRxMsgAuthEvseProcessing" TAB_VERB "%12.0" "enum" COMPU_TAB_REF CT_V2GRXMSGAUTHEVSEPROCESSING /end COMPU_METHOD
/begin COMPU_VTAB CT_V2GRXMSGAUTHEVSEPROCESSING "Conversion method for V2gRxMsgAuthEvseProcessing" TAB_VERB 3 0 "FINISHED" 1 "ONGOING" 2 "ONGOING_WAITINGFORCUSTOMERINTERACTION" /end COMPU_VTAB
/* Scalar measurable for DDE 'V2gRxMsgAuthNotif'. */
/begin MEASUREMENT V2gRxMsgAuthNotif "The arbitrated Notification Max Delay parameter in the received message from EVSE" SLONG CU_V2GRXMSGAUTHNOTIF 1 100 -2147483648.0 2147483647.0 ECU_ADDRESS 0x70018250 BYTE_ORDER MSB_LAST /end MEASUREMENT
/begin COMPU_METHOD CU_V2GRXMSGAUTHNOTIF "Conversion method for V2gRxMsgAuthNotif" TAB_VERB "%12.0" "1" COMPU_TAB_REF CT_V2GRXMSGAUTHNOTIF /end COMPU_METHOD
/begin COMPU_VTAB CT_V2GRXMSGAUTHNOTIF "Conversion method for V2gRxMsgAuthNotif" TAB_VERB 3 0 "NONE" 1 "STOPCHARGING" 2 "RENEGOTIATION" /end COMPU_VTAB
/* Scalar measurable for DDE 'V2gRxMsgAuthNotifFlg'. */
/begin MEASUREMENT V2gRxMsgAuthNotifFlg "The arbitrated Notification parameter in the received message from EVSE" UBYTE CU_V2GRXMSGAUTHNOTIFFLG 1 100 0.0 1.0 ECU_ADDRESS 0x70017fec BYTE_ORDER MSB_LAST /end MEASUREMENT
/begin COMPU_METHOD CU_V2GRXMSGAUTHNOTIFFLG "Conversion method for V2gRxMsgAuthNotifFlg" RAT_FUNC "%10.0" "b" COEFFS 0.000000 1.000000 -0.000000 0.000000 0.000000 1.000000 /end COMPU_METHOD
/* Scalar measurable for DDE 'V2gRxMsgAuthNotifMaxDelay'. */
/begin MEASUREMENT V2gRxMsgAuthNotifMaxDelay "The arbitrated Notification Max Delay parameter in the received message from EVSE" UWORD CU_V2GRXMSGAUTHNOTIFMAXDELAY 1 100 0.0 65535.0 ECU_ADDRESS 0x70017e60 BYTE_ORDER MSB_LAST /end MEASUREMENT
/begin COMPU_METHOD CU_V2GRXMSGAUTHNOTIFMAXDELAY "Conversion method for V2gRxMsgAuthNotifMaxDelay" RAT_FUNC "%10.0" "s" COEFFS 0.000000 1.000000 -0.000000 0.000000 0.000000 1.000000 /end COMPU_METHOD
/* Scalar measurable for DDE 'V2gRxMsgAuthRescode'. */
/begin MEASUREMENT V2gRxMsgAuthRescode "for message Yb: indicates the acknowledgment status of  this V2G messages received by the SECC." UBYTE CU_V2GRXMSGAUTHRESCODE 1 100 0.0 255.0 ECU_ADDRESS 0x70017c8b BYTE_ORDER MSB_LAST /end MEASUREMENT
/begin COMPU_METHOD CU_V2GRXMSGAUTHRESCODE "Conversion method for V2gRxMsgAuthRescode" RAT_FUNC "%10.0" "1" COEFFS 0.000000 1.000000 -0.000000 0.000000 0.000000 1.000000 /end COMPU_METHOD
/* Scalar measurable for DDE 'V2gRxMsgAuthTrg'. */
/begin MEASUREMENT V2gRxMsgAuthTrg "Trigger falg that on a rising edge indicates the event for receiving the PLC (V2G) message response Yb from EVSE" UBYTE CU_V2GRXMSGAUTHTRG 1 100 0.0 1.0 ECU_ADDRESS 0x70017e92 BYTE_ORDER MSB_LAST /end MEASUREMENT
/begin COMPU_METHOD CU_V2GRXMSGAUTHTRG "Conversion method for V2gRxMsgAuthTrg" RAT_FUNC "%10.0" "b" COEFFS 0.000000 1.000000 -0.000000 0.000000 0.000000 1.000000 /end COMPU_METHOD
/* Scalar measurable for DDE 'V2gRxMsgBptCtrlChgMaxCrnt'. */
/begin MEASUREMENT V2gRxMsgBptCtrlChgMaxCrnt "Maximum current that the EVSE can deliver" FLOAT32_IEEE CU_V2GRXMSGBPTCTRLCHGMAXCRNT 1 100 -32768000.0 32767000.0 ECU_ADDRESS 0x700181d8 BYTE_ORDER MSB_LAST /end MEASUREMENT
/begin COMPU_METHOD CU_V2GRXMSGBPTCTRLCHGMAXCRNT "Conversion method for V2gRxMsgBptCtrlChgMaxCrnt" RAT_FUNC "%10.0" "A" COEFFS 0.000000 1.000000 -0.000000 0.000000 0.000000 1.000000 /end COMPU_METHOD
/* Scalar measurable for DDE 'V2gRxMsgBptCtrlChgMaxCrnt_flg'. */
/begin MEASUREMENT V2gRxMsgBptCtrlChgMaxCrnt_flg "Indicates that the EVSEMaximumCurrentLimit parameter is available." UBYTE CU_V2GRXMSGBPTCTRLCHGMAXCRNT_F0 1 100 0.0 1.0 ECU_ADDRESS 0x70018495 BYTE_ORDER MSB_LAST /end MEASUREMENT
/begin COMPU_METHOD CU_V2GRXMSGBPTCTRLCHGMAXCRNT_F0 "Conversion method for V2gRxMsgBptCtrlChgMaxCrnt_flg" RAT_FUNC "%10.0" "b" COEFFS 0.000000 1.000000 -0.000000 0.000000 0.000000 1.000000 /end COMPU_METHOD
/* Scalar measurable for DDE 'V2gRxMsgBptCtrlChgMaxPwr'. */
/begin MEASUREMENT V2gRxMsgBptCtrlChgMaxPwr "Maximum power the EVSE can deliver" FLOAT32_IEEE CU_V2GRXMSGBPTCTRLCHGMAXPWR 1 100 -32768000.0 32767000.0 ECU_ADDRESS 0x70018300 BYTE_ORDER MSB_LAST /end MEASUREMENT
/begin COMPU_METHOD CU_V2GRXMSGBPTCTRLCHGMAXPWR "Conversion method for V2gRxMsgBptCtrlChgMaxPwr" RAT_FUNC "%10.0" "W" COEFFS 0.000000 1.000000 -0.000000 0.000000 0.000000 1.000000 /end COMPU_METHOD
/* Scalar measurable for DDE 'V2gRxMsgBptCtrlChgMaxPwr_flg'. */
/begin MEASUREMENT V2gRxMsgBptCtrlChgMaxPwr_flg "Indicates that the EVSEMaximumPowerLimit parameter is available." UBYTE CU_V2GRXMSGBPTCTRLCHGMAXPWR_FLG 1 100 0.0 1.0 ECU_ADDRESS 0x70018162 BYTE_ORDER MSB_LAST /end MEASUREMENT
/begin COMPU_METHOD CU_V2GRXMSGBPTCTRLCHGMAXPWR_FLG "Conversion method for V2gRxMsgBptCtrlChgMaxPwr_flg" RAT_FUNC "%10.0" "b" COEFFS 0.000000 1.000000 -0.000000 0.000000 0.000000 1.000000 /end COMPU_METHOD
/* Scalar measurable for DDE 'V2gRxMsgBptCtrlCrntLimReached'. */
/begin MEASUREMENT V2gRxMsgBptCtrlCrntLimReached "If set to TRUE, the EVSE has reached its current limit." UBYTE CU_V2GRXMSGBPTCTRLCRNTLIMREACH0 1 100 0.0 1.0 ECU_ADDRESS 0x70017e34 BYTE_ORDER MSB_LAST /end MEASUREMENT
/begin COMPU_METHOD CU_V2GRXMSGBPTCTRLCRNTLIMREACH0 "Conversion method for V2gRxMsgBptCtrlCrntLimReached" RAT_FUNC "%10.0" "b" COEFFS 0.000000 1.000000 -0.000000 0.000000 0.000000 1.000000 /end COMPU_METHOD
/* Scalar measurable for DDE 'V2gRxMsgBptCtrlDchgMaxCrnt'. */
/begin MEASUREMENT V2gRxMsgBptCtrlDchgMaxCrnt "Maximum current discharge that the EVSE can deliver" FLOAT32_IEEE CU_V2GRXMSGBPTCTRLDCHGMAXCRNT 1 100 -32768000.0 32767000.0 ECU_ADDRESS 0x70018190 BYTE_ORDER MSB_LAST /end MEASUREMENT
/begin COMPU_METHOD CU_V2GRXMSGBPTCTRLDCHGMAXCRNT "Conversion method for V2gRxMsgBptCtrlDchgMaxCrnt" RAT_FUNC "%10.0" "A" COEFFS 0.000000 1.000000 -0.000000 0.000000 0.000000 1.000000 /end COMPU_METHOD
/* Scalar measurable for DDE 'V2gRxMsgBptCtrlDchgMaxCrntFlg'. */
/begin MEASUREMENT V2gRxMsgBptCtrlDchgMaxCrntFlg "Indicates that the EVSEMaximumDischargeCurrentLimit parameter is available." UBYTE CU_V2GRXMSGBPTCTRLDCHGMAXCRNTF0 1 100 0.0 1.0 ECU_ADDRESS 0x70018459 BYTE_ORDER MSB_LAST /end MEASUREMENT
/begin COMPU_METHOD CU_V2GRXMSGBPTCTRLDCHGMAXCRNTF0 "Conversion method for V2gRxMsgBptCtrlDchgMaxCrntFlg" RAT_FUNC "%10.0" "b" COEFFS 0.000000 1.000000 -0.000000 0.000000 0.000000 1.000000 /end COMPU_METHOD
/* Scalar measurable for DDE 'V2gRxMsgBptCtrlDchgMaxPwr'. */
/begin MEASUREMENT V2gRxMsgBptCtrlDchgMaxPwr "Maximum power discharge that the EVSE can deliver" FLOAT32_IEEE CU_V2GRXMSGBPTCTRLDCHGMAXPWR 1 100 -32768000.0 32767000.0 ECU_ADDRESS 0x70017e44 BYTE_ORDER MSB_LAST /end MEASUREMENT
/begin COMPU_METHOD CU_V2GRXMSGBPTCTRLDCHGMAXPWR "Conversion method for V2gRxMsgBptCtrlDchgMaxPwr" RAT_FUNC "%10.0" "W" COEFFS 0.000000 1.000000 -0.000000 0.000000 0.000000 1.000000 /end COMPU_METHOD
/* Scalar measurable for DDE 'V2gRxMsgBptCtrlDchgMaxPwr_flg'. */
/begin MEASUREMENT V2gRxMsgBptCtrlDchgMaxPwr_flg "Indicates that the EVSEMaximumDischargePowerLimit parameter is available." UBYTE CU_V2GRXMSGBPTCTRLDCHGMAXPWR_F0 1 100 0.0 1.0 ECU_ADDRESS 0x70017c85 BYTE_ORDER MSB_LAST /end MEASUREMENT
/begin COMPU_METHOD CU_V2GRXMSGBPTCTRLDCHGMAXPWR_F0 "Conversion method for V2gRxMsgBptCtrlDchgMaxPwr_flg" RAT_FUNC "%10.0" "b" COEFFS 0.000000 1.000000 -0.000000 0.000000 0.000000 1.000000 /end COMPU_METHOD
/* Scalar measurable for DDE 'V2gRxMsgBptCtrlEvseCurrent'. */
/begin MEASUREMENT V2gRxMsgBptCtrlEvseCurrent "Present output current of the EVSE." FLOAT32_IEEE CU_V2GRXMSGBPTCTRLEVSECURRENT 1 100 -32768000.0 32767000.0 ECU_ADDRESS 0x700183a4 BYTE_ORDER MSB_LAST /end MEASUREMENT
/begin COMPU_METHOD CU_V2GRXMSGBPTCTRLEVSECURRENT "Conversion method for V2gRxMsgBptCtrlEvseCurrent" RAT_FUNC "%10.0" "A" COEFFS 0.000000 1.000000 -0.000000 0.000000 0.000000 1.000000 /end COMPU_METHOD
/* Scalar measurable for DDE 'V2gRxMsgBptCtrlEvseIdLen'. */
/begin MEASUREMENT V2gRxMsgBptCtrlEvseIdLen "Number of bytes in EVSE ID" UBYTE CU_V2GRXMSGBPTCTRLEVSEIDLEN 1 100 0.0 37.0 ECU_ADDRESS 0x700183c4 BYTE_ORDER MSB_LAST /end MEASUREMENT
/begin COMPU_METHOD CU_V2GRXMSGBPTCTRLEVSEIDLEN "Conversion method for V2gRxMsgBptCtrlEvseIdLen" RAT_FUNC "%10.0" "1" COEFFS 0.000000 1.000000 -0.000000 0.000000 0.000000 1.000000 /end COMPU_METHOD
/* Scalar measurable for DDE 'V2gRxMsgBptCtrlEvseId[0]'. */
/begin MEASUREMENT V2gRxMsgBptCtrlEvseId[0] "The ID that uniquely identifies the EVSE. Format is defined in DIN SPEC 91286" UBYTE CU_V2GRXMSGBPTCTRLEVSEID[0] 1 100 0.0 255.0 ECU_ADDRESS 0x7001811c BYTE_ORDER MSB_LAST /end MEASUREMENT
/begin COMPU_METHOD CU_V2GRXMSGBPTCTRLEVSEID[0] "Conversion method for V2gRxMsgBptCtrlEvseId[0]" RAT_FUNC "%10.0" "1" COEFFS 0.000000 1.000000 -0.000000 0.000000 0.000000 1.000000 /end COMPU_METHOD
/* Scalar measurable for DDE 'V2gRxMsgBptCtrlEvseId[10]'. */
/begin MEASUREMENT V2gRxMsgBptCtrlEvseId[10] "The ID that uniquely identifies the EVSE. Format is defined in DIN SPEC 91286" UBYTE CU_V2GRXMSGBPTCTRLEVSEID[10] 1 100 0.0 255.0 ECU_ADDRESS 0x70018126 BYTE_ORDER MSB_LAST /end MEASUREMENT
/begin COMPU_METHOD CU_V2GRXMSGBPTCTRLEVSEID[10] "Conversion method for V2gRxMsgBptCtrlEvseId[10]" RAT_FUNC "%10.0" "1" COEFFS 0.000000 1.000000 -0.000000 0.000000 0.000000 1.000000 /end COMPU_METHOD
/* Scalar measurable for DDE 'V2gRxMsgBptCtrlEvseId[11]'. */
/begin MEASUREMENT V2gRxMsgBptCtrlEvseId[11] "The ID that uniquely identifies the EVSE. Format is defined in DIN SPEC 91286" UBYTE CU_V2GRXMSGBPTCTRLEVSEID[11] 1 100 0.0 255.0 ECU_ADDRESS 0x70018127 BYTE_ORDER MSB_LAST /end MEASUREMENT
/begin COMPU_METHOD CU_V2GRXMSGBPTCTRLEVSEID[11] "Conversion method for V2gRxMsgBptCtrlEvseId[11]" RAT_FUNC "%10.0" "1" COEFFS 0.000000 1.000000 -0.000000 0.000000 0.000000 1.000000 /end COMPU_METHOD
/* Scalar measurable for DDE 'V2gRxMsgBptCtrlEvseId[12]'. */
/begin MEASUREMENT V2gRxMsgBptCtrlEvseId[12] "The ID that uniquely identifies the EVSE. Format is defined in DIN SPEC 91286" UBYTE CU_V2GRXMSGBPTCTRLEVSEID[12] 1 100 0.0 255.0 ECU_ADDRESS 0x70018128 BYTE_ORDER MSB_LAST /end MEASUREMENT
/begin COMPU_METHOD CU_V2GRXMSGBPTCTRLEVSEID[12] "Conversion method for V2gRxMsgBptCtrlEvseId[12]" RAT_FUNC "%10.0" "1" COEFFS 0.000000 1.000000 -0.000000 0.000000 0.000000 1.000000 /end COMPU_METHOD
/* Scalar measurable for DDE 'V2gRxMsgBptCtrlEvseId[13]'. */
/begin MEASUREMENT V2gRxMsgBptCtrlEvseId[13] "The ID that uniquely identifies the EVSE. Format is defined in DIN SPEC 91286" UBYTE CU_V2GRXMSGBPTCTRLEVSEID[13] 1 100 0.0 255.0 ECU_ADDRESS 0x70018129 BYTE_ORDER MSB_LAST /end MEASUREMENT
/begin COMPU_METHOD CU_V2GRXMSGBPTCTRLEVSEID[13] "Conversion method for V2gRxMsgBptCtrlEvseId[13]" RAT_FUNC "%10.0" "1" COEFFS 0.000000 1.000000 -0.000000 0.000000 0.000000 1.000000 /end COMPU_METHOD
/* Scalar measurable for DDE 'V2gRxMsgBptCtrlEvseId[14]'. */
/begin MEASUREMENT V2gRxMsgBptCtrlEvseId[14] "The ID that uniquely identifies the EVSE. Format is defined in DIN SPEC 91286" UBYTE CU_V2GRXMSGBPTCTRLEVSEID[14] 1 100 0.0 255.0 ECU_ADDRESS 0x7001812a BYTE_ORDER MSB_LAST /end MEASUREMENT
/begin COMPU_METHOD CU_V2GRXMSGBPTCTRLEVSEID[14] "Conversion method for V2gRxMsgBptCtrlEvseId[14]" RAT_FUNC "%10.0" "1" COEFFS 0.000000 1.000000 -0.000000 0.000000 0.000000 1.000000 /end COMPU_METHOD
/* Scalar measurable for DDE 'V2gRxMsgBptCtrlEvseId[15]'. */
/begin MEASUREMENT V2gRxMsgBptCtrlEvseId[15] "The ID that uniquely identifies the EVSE. Format is defined in DIN SPEC 91286" UBYTE CU_V2GRXMSGBPTCTRLEVSEID[15] 1 100 0.0 255.0 ECU_ADDRESS 0x7001812b BYTE_ORDER MSB_LAST /end MEASUREMENT
/begin COMPU_METHOD CU_V2GRXMSGBPTCTRLEVSEID[15] "Conversion method for V2gRxMsgBptCtrlEvseId[15]" RAT_FUNC "%10.0" "1" COEFFS 0.000000 1.000000 -0.000000 0.000000 0.000000 1.000000 /end COMPU_METHOD
/* Scalar measurable for DDE 'V2gRxMsgBptCtrlEvseId[16]'. */
/begin MEASUREMENT V2gRxMsgBptCtrlEvseId[16] "The ID that uniquely identifies the EVSE. Format is defined in DIN SPEC 91286" UBYTE CU_V2GRXMSGBPTCTRLEVSEID[16] 1 100 0.0 255.0 ECU_ADDRESS 0x7001812c BYTE_ORDER MSB_LAST /end MEASUREMENT
/begin COMPU_METHOD CU_V2GRXMSGBPTCTRLEVSEID[16] "Conversion method for V2gRxMsgBptCtrlEvseId[16]" RAT_FUNC "%10.0" "1" COEFFS 0.000000 1.000000 -0.000000 0.000000 0.000000 1.000000 /end COMPU_METHOD
/* Scalar measurable for DDE 'V2gRxMsgBptCtrlEvseId[17]'. */
/begin MEASUREMENT V2gRxMsgBptCtrlEvseId[17] "The ID that uniquely identifies the EVSE. Format is defined in DIN SPEC 91286" UBYTE CU_V2GRXMSGBPTCTRLEVSEID[17] 1 100 0.0 255.0 ECU_ADDRESS 0x7001812d BYTE_ORDER MSB_LAST /end MEASUREMENT
/begin COMPU_METHOD CU_V2GRXMSGBPTCTRLEVSEID[17] "Conversion method for V2gRxMsgBptCtrlEvseId[17]" RAT_FUNC "%10.0" "1" COEFFS 0.000000 1.000000 -0.000000 0.000000 0.000000 1.000000 /end COMPU_METHOD
/* Scalar measurable for DDE 'V2gRxMsgBptCtrlEvseId[18]'. */
/begin MEASUREMENT V2gRxMsgBptCtrlEvseId[18] "The ID that uniquely identifies the EVSE. Format is defined in DIN SPEC 91286" UBYTE CU_V2GRXMSGBPTCTRLEVSEID[18] 1 100 0.0 255.0 ECU_ADDRESS 0x7001812e BYTE_ORDER MSB_LAST /end MEASUREMENT
/begin COMPU_METHOD CU_V2GRXMSGBPTCTRLEVSEID[18] "Conversion method for V2gRxMsgBptCtrlEvseId[18]" RAT_FUNC "%10.0" "1" COEFFS 0.000000 1.000000 -0.000000 0.000000 0.000000 1.000000 /end COMPU_METHOD
/* Scalar measurable for DDE 'V2gRxMsgBptCtrlEvseId[19]'. */
/begin MEASUREMENT V2gRxMsgBptCtrlEvseId[19] "The ID that uniquely identifies the EVSE. Format is defined in DIN SPEC 91286" UBYTE CU_V2GRXMSGBPTCTRLEVSEID[19] 1 100 0.0 255.0 ECU_ADDRESS 0x7001812f BYTE_ORDER MSB_LAST /end MEASUREMENT
/begin COMPU_METHOD CU_V2GRXMSGBPTCTRLEVSEID[19] "Conversion method for V2gRxMsgBptCtrlEvseId[19]" RAT_FUNC "%10.0" "1" COEFFS 0.000000 1.000000 -0.000000 0.000000 0.000000 1.000000 /end COMPU_METHOD
/* Scalar measurable for DDE 'V2gRxMsgBptCtrlEvseId[1]'. */
/begin MEASUREMENT V2gRxMsgBptCtrlEvseId[1] "The ID that uniquely identifies the EVSE. Format is defined in DIN SPEC 91286" UBYTE CU_V2GRXMSGBPTCTRLEVSEID[1] 1 100 0.0 255.0 ECU_ADDRESS 0x7001811d BYTE_ORDER MSB_LAST /end MEASUREMENT
/begin COMPU_METHOD CU_V2GRXMSGBPTCTRLEVSEID[1] "Conversion method for V2gRxMsgBptCtrlEvseId[1]" RAT_FUNC "%10.0" "1" COEFFS 0.000000 1.000000 -0.000000 0.000000 0.000000 1.000000 /end COMPU_METHOD
/* Scalar measurable for DDE 'V2gRxMsgBptCtrlEvseId[20]'. */
/begin MEASUREMENT V2gRxMsgBptCtrlEvseId[20] "The ID that uniquely identifies the EVSE. Format is defined in DIN SPEC 91286" UBYTE CU_V2GRXMSGBPTCTRLEVSEID[20] 1 100 0.0 255.0 ECU_ADDRESS 0x70018130 BYTE_ORDER MSB_LAST /end MEASUREMENT
/begin COMPU_METHOD CU_V2GRXMSGBPTCTRLEVSEID[20] "Conversion method for V2gRxMsgBptCtrlEvseId[20]" RAT_FUNC "%10.0" "1" COEFFS 0.000000 1.000000 -0.000000 0.000000 0.000000 1.000000 /end COMPU_METHOD
/* Scalar measurable for DDE 'V2gRxMsgBptCtrlEvseId[21]'. */
/begin MEASUREMENT V2gRxMsgBptCtrlEvseId[21] "The ID that uniquely identifies the EVSE. Format is defined in DIN SPEC 91286" UBYTE CU_V2GRXMSGBPTCTRLEVSEID[21] 1 100 0.0 255.0 ECU_ADDRESS 0x70018131 BYTE_ORDER MSB_LAST /end MEASUREMENT
/begin COMPU_METHOD CU_V2GRXMSGBPTCTRLEVSEID[21] "Conversion method for V2gRxMsgBptCtrlEvseId[21]" RAT_FUNC "%10.0" "1" COEFFS 0.000000 1.000000 -0.000000 0.000000 0.000000 1.000000 /end COMPU_METHOD
/* Scalar measurable for DDE 'V2gRxMsgBptCtrlEvseId[22]'. */
/begin MEASUREMENT V2gRxMsgBptCtrlEvseId[22] "The ID that uniquely identifies the EVSE. Format is defined in DIN SPEC 91286" UBYTE CU_V2GRXMSGBPTCTRLEVSEID[22] 1 100 0.0 255.0 ECU_ADDRESS 0x70018132 BYTE_ORDER MSB_LAST /end MEASUREMENT
/begin COMPU_METHOD CU_V2GRXMSGBPTCTRLEVSEID[22] "Conversion method for V2gRxMsgBptCtrlEvseId[22]" RAT_FUNC "%10.0" "1" COEFFS 0.000000 1.000000 -0.000000 0.000000 0.000000 1.000000 /end COMPU_METHOD
/* Scalar measurable for DDE 'V2gRxMsgBptCtrlEvseId[23]'. */
/begin MEASUREMENT V2gRxMsgBptCtrlEvseId[23] "The ID that uniquely identifies the EVSE. Format is defined in DIN SPEC 91286" UBYTE CU_V2GRXMSGBPTCTRLEVSEID[23] 1 100 0.0 255.0 ECU_ADDRESS 0x70018133 BYTE_ORDER MSB_LAST /end MEASUREMENT
/begin COMPU_METHOD CU_V2GRXMSGBPTCTRLEVSEID[23] "Conversion method for V2gRxMsgBptCtrlEvseId[23]" RAT_FUNC "%10.0" "1" COEFFS 0.000000 1.000000 -0.000000 0.000000 0.000000 1.000000 /end COMPU_METHOD
/* Scalar measurable for DDE 'V2gRxMsgBptCtrlEvseId[24]'. */
/begin MEASUREMENT V2gRxMsgBptCtrlEvseId[24] "The ID that uniquely identifies the EVSE. Format is defined in DIN SPEC 91286" UBYTE CU_V2GRXMSGBPTCTRLEVSEID[24] 1 100 0.0 255.0 ECU_ADDRESS 0x70018134 BYTE_ORDER MSB_LAST /end MEASUREMENT
/begin COMPU_METHOD CU_V2GRXMSGBPTCTRLEVSEID[24] "Conversion method for V2gRxMsgBptCtrlEvseId[24]" RAT_FUNC "%10.0" "1" COEFFS 0.000000 1.000000 -0.000000 0.000000 0.000000 1.000000 /end COMPU_METHOD
/* Scalar measurable for DDE 'V2gRxMsgBptCtrlEvseId[25]'. */
/begin MEASUREMENT V2gRxMsgBptCtrlEvseId[25] "The ID that uniquely identifies the EVSE. Format is defined in DIN SPEC 91286" UBYTE CU_V2GRXMSGBPTCTRLEVSEID[25] 1 100 0.0 255.0 ECU_ADDRESS 0x70018135 BYTE_ORDER MSB_LAST /end MEASUREMENT
/begin COMPU_METHOD CU_V2GRXMSGBPTCTRLEVSEID[25] "Conversion method for V2gRxMsgBptCtrlEvseId[25]" RAT_FUNC "%10.0" "1" COEFFS 0.000000 1.000000 -0.000000 0.000000 0.000000 1.000000 /end COMPU_METHOD
/* Scalar measurable for DDE 'V2gRxMsgBptCtrlEvseId[26]'. */
/begin MEASUREMENT V2gRxMsgBptCtrlEvseId[26] "The ID that uniquely identifies the EVSE. Format is defined in DIN SPEC 91286" UBYTE CU_V2GRXMSGBPTCTRLEVSEID[26] 1 100 0.0 255.0 ECU_ADDRESS 0x70018136 BYTE_ORDER MSB_LAST /end MEASUREMENT
/begin COMPU_METHOD CU_V2GRXMSGBPTCTRLEVSEID[26] "Conversion method for V2gRxMsgBptCtrlEvseId[26]" RAT_FUNC "%10.0" "1" COEFFS 0.000000 1.000000 -0.000000 0.000000 0.000000 1.000000 /end COMPU_METHOD
/* Scalar measurable for DDE 'V2gRxMsgBptCtrlEvseId[27]'. */
/begin MEASUREMENT V2gRxMsgBptCtrlEvseId[27] "The ID that uniquely identifies the EVSE. Format is defined in DIN SPEC 91286" UBYTE CU_V2GRXMSGBPTCTRLEVSEID[27] 1 100 0.0 255.0 ECU_ADDRESS 0x70018137 BYTE_ORDER MSB_LAST /end MEASUREMENT
/begin COMPU_METHOD CU_V2GRXMSGBPTCTRLEVSEID[27] "Conversion method for V2gRxMsgBptCtrlEvseId[27]" RAT_FUNC "%10.0" "1" COEFFS 0.000000 1.000000 -0.000000 0.000000 0.000000 1.000000 /end COMPU_METHOD
/* Scalar measurable for DDE 'V2gRxMsgBptCtrlEvseId[28]'. */
/begin MEASUREMENT V2gRxMsgBptCtrlEvseId[28] "The ID that uniquely identifies the EVSE. Format is defined in DIN SPEC 91286" UBYTE CU_V2GRXMSGBPTCTRLEVSEID[28] 1 100 0.0 255.0 ECU_ADDRESS 0x70018138 BYTE_ORDER MSB_LAST /end MEASUREMENT
/begin COMPU_METHOD CU_V2GRXMSGBPTCTRLEVSEID[28] "Conversion method for V2gRxMsgBptCtrlEvseId[28]" RAT_FUNC "%10.0" "1" COEFFS 0.000000 1.000000 -0.000000 0.000000 0.000000 1.000000 /end COMPU_METHOD
/* Scalar measurable for DDE 'V2gRxMsgBptCtrlEvseId[29]'. */
/begin MEASUREMENT V2gRxMsgBptCtrlEvseId[29] "The ID that uniquely identifies the EVSE. Format is defined in DIN SPEC 91286" UBYTE CU_V2GRXMSGBPTCTRLEVSEID[29] 1 100 0.0 255.0 ECU_ADDRESS 0x70018139 BYTE_ORDER MSB_LAST /end MEASUREMENT
/begin COMPU_METHOD CU_V2GRXMSGBPTCTRLEVSEID[29] "Conversion method for V2gRxMsgBptCtrlEvseId[29]" RAT_FUNC "%10.0" "1" COEFFS 0.000000 1.000000 -0.000000 0.000000 0.000000 1.000000 /end COMPU_METHOD
/* Scalar measurable for DDE 'V2gRxMsgBptCtrlEvseId[2]'. */
/begin MEASUREMENT V2gRxMsgBptCtrlEvseId[2] "The ID that uniquely identifies the EVSE. Format is defined in DIN SPEC 91286" UBYTE CU_V2GRXMSGBPTCTRLEVSEID[2] 1 100 0.0 255.0 ECU_ADDRESS 0x7001811e BYTE_ORDER MSB_LAST /end MEASUREMENT
/begin COMPU_METHOD CU_V2GRXMSGBPTCTRLEVSEID[2] "Conversion method for V2gRxMsgBptCtrlEvseId[2]" RAT_FUNC "%10.0" "1" COEFFS 0.000000 1.000000 -0.000000 0.000000 0.000000 1.000000 /end COMPU_METHOD
/* Scalar measurable for DDE 'V2gRxMsgBptCtrlEvseId[30]'. */
/begin MEASUREMENT V2gRxMsgBptCtrlEvseId[30] "The ID that uniquely identifies the EVSE. Format is defined in DIN SPEC 91286" UBYTE CU_V2GRXMSGBPTCTRLEVSEID[30] 1 100 0.0 255.0 ECU_ADDRESS 0x7001813a BYTE_ORDER MSB_LAST /end MEASUREMENT
/begin COMPU_METHOD CU_V2GRXMSGBPTCTRLEVSEID[30] "Conversion method for V2gRxMsgBptCtrlEvseId[30]" RAT_FUNC "%10.0" "1" COEFFS 0.000000 1.000000 -0.000000 0.000000 0.000000 1.000000 /end COMPU_METHOD
/* Scalar measurable for DDE 'V2gRxMsgBptCtrlEvseId[31]'. */
/begin MEASUREMENT V2gRxMsgBptCtrlEvseId[31] "The ID that uniquely identifies the EVSE. Format is defined in DIN SPEC 91286" UBYTE CU_V2GRXMSGBPTCTRLEVSEID[31] 1 100 0.0 255.0 ECU_ADDRESS 0x7001813b BYTE_ORDER MSB_LAST /end MEASUREMENT
/begin COMPU_METHOD CU_V2GRXMSGBPTCTRLEVSEID[31] "Conversion method for V2gRxMsgBptCtrlEvseId[31]" RAT_FUNC "%10.0" "1" COEFFS 0.000000 1.000000 -0.000000 0.000000 0.000000 1.000000 /end COMPU_METHOD
/* Scalar measurable for DDE 'V2gRxMsgBptCtrlEvseId[32]'. */
/begin MEASUREMENT V2gRxMsgBptCtrlEvseId[32] "The ID that uniquely identifies the EVSE. Format is defined in DIN SPEC 91286" UBYTE CU_V2GRXMSGBPTCTRLEVSEID[32] 1 100 0.0 255.0 ECU_ADDRESS 0x7001813c BYTE_ORDER MSB_LAST /end MEASUREMENT
/begin COMPU_METHOD CU_V2GRXMSGBPTCTRLEVSEID[32] "Conversion method for V2gRxMsgBptCtrlEvseId[32]" RAT_FUNC "%10.0" "1" COEFFS 0.000000 1.000000 -0.000000 0.000000 0.000000 1.000000 /end COMPU_METHOD
/* Scalar measurable for DDE 'V2gRxMsgBptCtrlEvseId[33]'. */
/begin MEASUREMENT V2gRxMsgBptCtrlEvseId[33] "The ID that uniquely identifies the EVSE. Format is defined in DIN SPEC 91286" UBYTE CU_V2GRXMSGBPTCTRLEVSEID[33] 1 100 0.0 255.0 ECU_ADDRESS 0x7001813d BYTE_ORDER MSB_LAST /end MEASUREMENT
/begin COMPU_METHOD CU_V2GRXMSGBPTCTRLEVSEID[33] "Conversion method for V2gRxMsgBptCtrlEvseId[33]" RAT_FUNC "%10.0" "1" COEFFS 0.000000 1.000000 -0.000000 0.000000 0.000000 1.000000 /end COMPU_METHOD
/* Scalar measurable for DDE 'V2gRxMsgBptCtrlEvseId[34]'. */
/begin MEASUREMENT V2gRxMsgBptCtrlEvseId[34] "The ID that uniquely identifies the EVSE. Format is defined in DIN SPEC 91286" UBYTE CU_V2GRXMSGBPTCTRLEVSEID[34] 1 100 0.0 255.0 ECU_ADDRESS 0x7001813e BYTE_ORDER MSB_LAST /end MEASUREMENT
/begin COMPU_METHOD CU_V2GRXMSGBPTCTRLEVSEID[34] "Conversion method for V2gRxMsgBptCtrlEvseId[34]" RAT_FUNC "%10.0" "1" COEFFS 0.000000 1.000000 -0.000000 0.000000 0.000000 1.000000 /end COMPU_METHOD
/* Scalar measurable for DDE 'V2gRxMsgBptCtrlEvseId[35]'. */
/begin MEASUREMENT V2gRxMsgBptCtrlEvseId[35] "The ID that uniquely identifies the EVSE. Format is defined in DIN SPEC 91286" UBYTE CU_V2GRXMSGBPTCTRLEVSEID[35] 1 100 0.0 255.0 ECU_ADDRESS 0x7001813f BYTE_ORDER MSB_LAST /end MEASUREMENT
/begin COMPU_METHOD CU_V2GRXMSGBPTCTRLEVSEID[35] "Conversion method for V2gRxMsgBptCtrlEvseId[35]" RAT_FUNC "%10.0" "1" COEFFS 0.000000 1.000000 -0.000000 0.000000 0.000000 1.000000 /end COMPU_METHOD
/* Scalar measurable for DDE 'V2gRxMsgBptCtrlEvseId[36]'. */
/begin MEASUREMENT V2gRxMsgBptCtrlEvseId[36] "The ID that uniquely identifies the EVSE. Format is defined in DIN SPEC 91286" UBYTE CU_V2GRXMSGBPTCTRLEVSEID[36] 1 100 0.0 255.0 ECU_ADDRESS 0x70018140 BYTE_ORDER MSB_LAST /end MEASUREMENT
/begin COMPU_METHOD CU_V2GRXMSGBPTCTRLEVSEID[36] "Conversion method for V2gRxMsgBptCtrlEvseId[36]" RAT_FUNC "%10.0" "1" COEFFS 0.000000 1.000000 -0.000000 0.000000 0.000000 1.000000 /end COMPU_METHOD
/* Scalar measurable for DDE 'V2gRxMsgBptCtrlEvseId[37]'. */
/begin MEASUREMENT V2gRxMsgBptCtrlEvseId[37] "The ID that uniquely identifies the EVSE. Format is defined in DIN SPEC 91286" UBYTE CU_V2GRXMSGBPTCTRLEVSEID[37] 1 100 0.0 255.0 ECU_ADDRESS 0x70018141 BYTE_ORDER MSB_LAST /end MEASUREMENT
/begin COMPU_METHOD CU_V2GRXMSGBPTCTRLEVSEID[37] "Conversion method for V2gRxMsgBptCtrlEvseId[37]" RAT_FUNC "%10.0" "1" COEFFS 0.000000 1.000000 -0.000000 0.000000 0.000000 1.000000 /end COMPU_METHOD
/* Scalar measurable for DDE 'V2gRxMsgBptCtrlEvseId[3]'. */
/begin MEASUREMENT V2gRxMsgBptCtrlEvseId[3] "The ID that uniquely identifies the EVSE. Format is defined in DIN SPEC 91286" UBYTE CU_V2GRXMSGBPTCTRLEVSEID[3] 1 100 0.0 255.0 ECU_ADDRESS 0x7001811f BYTE_ORDER MSB_LAST /end MEASUREMENT
/begin COMPU_METHOD CU_V2GRXMSGBPTCTRLEVSEID[3] "Conversion method for V2gRxMsgBptCtrlEvseId[3]" RAT_FUNC "%10.0" "1" COEFFS 0.000000 1.000000 -0.000000 0.000000 0.000000 1.000000 /end COMPU_METHOD
/* Scalar measurable for DDE 'V2gRxMsgBptCtrlEvseId[4]'. */
/begin MEASUREMENT V2gRxMsgBptCtrlEvseId[4] "The ID that uniquely identifies the EVSE. Format is defined in DIN SPEC 91286" UBYTE CU_V2GRXMSGBPTCTRLEVSEID[4] 1 100 0.0 255.0 ECU_ADDRESS 0x70018120 BYTE_ORDER MSB_LAST /end MEASUREMENT
/begin COMPU_METHOD CU_V2GRXMSGBPTCTRLEVSEID[4] "Conversion method for V2gRxMsgBptCtrlEvseId[4]" RAT_FUNC "%10.0" "1" COEFFS 0.000000 1.000000 -0.000000 0.000000 0.000000 1.000000 /end COMPU_METHOD
/* Scalar measurable for DDE 'V2gRxMsgBptCtrlEvseId[5]'. */
/begin MEASUREMENT V2gRxMsgBptCtrlEvseId[5] "The ID that uniquely identifies the EVSE. Format is defined in DIN SPEC 91286" UBYTE CU_V2GRXMSGBPTCTRLEVSEID[5] 1 100 0.0 255.0 ECU_ADDRESS 0x70018121 BYTE_ORDER MSB_LAST /end MEASUREMENT
/begin COMPU_METHOD CU_V2GRXMSGBPTCTRLEVSEID[5] "Conversion method for V2gRxMsgBptCtrlEvseId[5]" RAT_FUNC "%10.0" "1" COEFFS 0.000000 1.000000 -0.000000 0.000000 0.000000 1.000000 /end COMPU_METHOD
/* Scalar measurable for DDE 'V2gRxMsgBptCtrlEvseId[6]'. */
/begin MEASUREMENT V2gRxMsgBptCtrlEvseId[6] "The ID that uniquely identifies the EVSE. Format is defined in DIN SPEC 91286" UBYTE CU_V2GRXMSGBPTCTRLEVSEID[6] 1 100 0.0 255.0 ECU_ADDRESS 0x70018122 BYTE_ORDER MSB_LAST /end MEASUREMENT
/begin COMPU_METHOD CU_V2GRXMSGBPTCTRLEVSEID[6] "Conversion method for V2gRxMsgBptCtrlEvseId[6]" RAT_FUNC "%10.0" "1" COEFFS 0.000000 1.000000 -0.000000 0.000000 0.000000 1.000000 /end COMPU_METHOD
/* Scalar measurable for DDE 'V2gRxMsgBptCtrlEvseId[7]'. */
/begin MEASUREMENT V2gRxMsgBptCtrlEvseId[7] "The ID that uniquely identifies the EVSE. Format is defined in DIN SPEC 91286" UBYTE CU_V2GRXMSGBPTCTRLEVSEID[7] 1 100 0.0 255.0 ECU_ADDRESS 0x70018123 BYTE_ORDER MSB_LAST /end MEASUREMENT
/begin COMPU_METHOD CU_V2GRXMSGBPTCTRLEVSEID[7] "Conversion method for V2gRxMsgBptCtrlEvseId[7]" RAT_FUNC "%10.0" "1" COEFFS 0.000000 1.000000 -0.000000 0.000000 0.000000 1.000000 /end COMPU_METHOD
/* Scalar measurable for DDE 'V2gRxMsgBptCtrlEvseId[8]'. */
/begin MEASUREMENT V2gRxMsgBptCtrlEvseId[8] "The ID that uniquely identifies the EVSE. Format is defined in DIN SPEC 91286" UBYTE CU_V2GRXMSGBPTCTRLEVSEID[8] 1 100 0.0 255.0 ECU_ADDRESS 0x70018124 BYTE_ORDER MSB_LAST /end MEASUREMENT
/begin COMPU_METHOD CU_V2GRXMSGBPTCTRLEVSEID[8] "Conversion method for V2gRxMsgBptCtrlEvseId[8]" RAT_FUNC "%10.0" "1" COEFFS 0.000000 1.000000 -0.000000 0.000000 0.000000 1.000000 /end COMPU_METHOD
/* Scalar measurable for DDE 'V2gRxMsgBptCtrlEvseId[9]'. */
/begin MEASUREMENT V2gRxMsgBptCtrlEvseId[9] "The ID that uniquely identifies the EVSE. Format is defined in DIN SPEC 91286" UBYTE CU_V2GRXMSGBPTCTRLEVSEID[9] 1 100 0.0 255.0 ECU_ADDRESS 0x70018125 BYTE_ORDER MSB_LAST /end MEASUREMENT
/begin COMPU_METHOD CU_V2GRXMSGBPTCTRLEVSEID[9] "Conversion method for V2gRxMsgBptCtrlEvseId[9]" RAT_FUNC "%10.0" "1" COEFFS 0.000000 1.000000 -0.000000 0.000000 0.000000 1.000000 /end COMPU_METHOD
/* Scalar measurable for DDE 'V2gRxMsgBptCtrlEvseMaxVolt'. */
/begin MEASUREMENT V2gRxMsgBptCtrlEvseMaxVolt "Maximum voltage the EVSE can deliver" FLOAT32_IEEE CU_V2GRXMSGBPTCTRLEVSEMAXVOLT 1 100 -32768000.0 32767000.0 ECU_ADDRESS 0x70017df0 BYTE_ORDER MSB_LAST /end MEASUREMENT
/begin COMPU_METHOD CU_V2GRXMSGBPTCTRLEVSEMAXVOLT "Conversion method for V2gRxMsgBptCtrlEvseMaxVolt" RAT_FUNC "%10.0" "V" COEFFS 0.000000 1.000000 -0.000000 0.000000 0.000000 1.000000 /end COMPU_METHOD
/* Scalar measurable for DDE 'V2gRxMsgBptCtrlEvseMaxVoltFlg'. */
/begin MEASUREMENT V2gRxMsgBptCtrlEvseMaxVoltFlg "Indicates that the EVSEMaximumVoltage parameter is available." UBYTE CU_V2GRXMSGBPTCTRLEVSEMAXVOLTF0 1 100 0.0 1.0 ECU_ADDRESS 0x70017c2e BYTE_ORDER MSB_LAST /end MEASUREMENT
/begin COMPU_METHOD CU_V2GRXMSGBPTCTRLEVSEMAXVOLTF0 "Conversion method for V2gRxMsgBptCtrlEvseMaxVoltFlg" RAT_FUNC "%10.0" "b" COEFFS 0.000000 1.000000 -0.000000 0.000000 0.000000 1.000000 /end COMPU_METHOD
/* Scalar measurable for DDE 'V2gRxMsgBptCtrlEvseMinVolt'. */
/begin MEASUREMENT V2gRxMsgBptCtrlEvseMinVolt "Maximum voltage the EVSE can deliver" FLOAT32_IEEE CU_V2GRXMSGBPTCTRLEVSEMINVOLT 1 100 -32768000.0 32767000.0 ECU_ADDRESS 0x7001835c BYTE_ORDER MSB_LAST /end MEASUREMENT
/begin COMPU_METHOD CU_V2GRXMSGBPTCTRLEVSEMINVOLT "Conversion method for V2gRxMsgBptCtrlEvseMinVolt" RAT_FUNC "%10.0" "V" COEFFS 0.000000 1.000000 -0.000000 0.000000 0.000000 1.000000 /end COMPU_METHOD
/* Scalar measurable for DDE 'V2gRxMsgBptCtrlEvseMinVoltFlg'. */
/begin MEASUREMENT V2gRxMsgBptCtrlEvseMinVoltFlg "Indicates that the EVSEMaximumVoltage parameter is available." UBYTE CU_V2GRXMSGBPTCTRLEVSEMINVOLTF0 1 100 0.0 1.0 ECU_ADDRESS 0x700181aa BYTE_ORDER MSB_LAST /end MEASUREMENT
/begin COMPU_METHOD CU_V2GRXMSGBPTCTRLEVSEMINVOLTF0 "Conversion method for V2gRxMsgBptCtrlEvseMinVoltFlg" RAT_FUNC "%10.0" "b" COEFFS 0.000000 1.000000 -0.000000 0.000000 0.000000 1.000000 /end COMPU_METHOD
/* Scalar measurable for DDE 'V2gRxMsgBptCtrlEvseVoltage'. */
/begin MEASUREMENT V2gRxMsgBptCtrlEvseVoltage "Present voltage of EVSE" FLOAT32_IEEE CU_V2GRXMSGBPTCTRLEVSEVOLTAGE 1 100 -32768000.0 32767000.0 ECU_ADDRESS 0x70017e8c BYTE_ORDER MSB_LAST /end MEASUREMENT
/begin COMPU_METHOD CU_V2GRXMSGBPTCTRLEVSEVOLTAGE "Conversion method for V2gRxMsgBptCtrlEvseVoltage" RAT_FUNC "%10.0" "V" COEFFS 0.000000 1.000000 -0.000000 0.000000 0.000000 1.000000 /end COMPU_METHOD
/* Scalar measurable for DDE 'V2gRxMsgBptCtrlNotif'. */
/begin MEASUREMENT V2gRxMsgBptCtrlNotif "The arbitrated Notification Max Delay parameter in the received message from EVSE" SLONG CU_V2GRXMSGBPTCTRLNOTIF 1 100 -2147483648.0 2147483647.0 ECU_ADDRESS 0x700181d0 BYTE_ORDER MSB_LAST /end MEASUREMENT
/begin COMPU_METHOD CU_V2GRXMSGBPTCTRLNOTIF "Conversion method for V2gRxMsgBptCtrlNotif" TAB_VERB "%12.0" "1" COMPU_TAB_REF CT_V2GRXMSGBPTCTRLNOTIF /end COMPU_METHOD
/begin COMPU_VTAB CT_V2GRXMSGBPTCTRLNOTIF "Conversion method for V2gRxMsgBptCtrlNotif" TAB_VERB 3 0 "NONE" 1 "STOPCHARGING" 2 "RENEGOTIATION" /end COMPU_VTAB
/* Scalar measurable for DDE 'V2gRxMsgBptCtrlNotifFlg'. */
/begin MEASUREMENT V2gRxMsgBptCtrlNotifFlg "The arbitrated Notification parameter in the received message from EVSE" UBYTE CU_V2GRXMSGBPTCTRLNOTIFFLG 1 100 0.0 1.0 ECU_ADDRESS 0x70018493 BYTE_ORDER MSB_LAST /end MEASUREMENT
/begin COMPU_METHOD CU_V2GRXMSGBPTCTRLNOTIFFLG "Conversion method for V2gRxMsgBptCtrlNotifFlg" RAT_FUNC "%10.0" "b" COEFFS 0.000000 1.000000 -0.000000 0.000000 0.000000 1.000000 /end COMPU_METHOD
/* Scalar measurable for DDE 'V2gRxMsgBptCtrlNotifMaxDelay'. */
/begin MEASUREMENT V2gRxMsgBptCtrlNotifMaxDelay "The arbitrated Notification Max Delay parameter in the received message from EVSE" UWORD CU_V2GRXMSGBPTCTRLNOTIFMAXDELAY 1 100 0.0 65535.0 ECU_ADDRESS 0x700182fa BYTE_ORDER MSB_LAST /end MEASUREMENT
/begin COMPU_METHOD CU_V2GRXMSGBPTCTRLNOTIFMAXDELAY "Conversion method for V2gRxMsgBptCtrlNotifMaxDelay" RAT_FUNC "%10.0" "s" COEFFS 0.000000 1.000000 -0.000000 0.000000 0.000000 1.000000 /end COMPU_METHOD
/* Scalar measurable for DDE 'V2gRxMsgBptCtrlPwrLimReached'. */
/begin MEASUREMENT V2gRxMsgBptCtrlPwrLimReached "If set to TRUE, the EVSE has reached its power limit." UBYTE CU_V2GRXMSGBPTCTRLPWRLIMREACHED 1 100 0.0 1.0 ECU_ADDRESS 0x70018160 BYTE_ORDER MSB_LAST /end MEASUREMENT
/begin COMPU_METHOD CU_V2GRXMSGBPTCTRLPWRLIMREACHED "Conversion method for V2gRxMsgBptCtrlPwrLimReached" RAT_FUNC "%10.0" "b" COEFFS 0.000000 1.000000 -0.000000 0.000000 0.000000 1.000000 /end COMPU_METHOD
/* Scalar measurable for DDE 'V2gRxMsgBptCtrlRescode'. */
/begin MEASUREMENT V2gRxMsgBptCtrlRescode "Indicates the acknowledgment status of  this V2G messages received by the SECC." UBYTE CU_V2GRXMSGBPTCTRLRESCODE 1 100 0.0 255.0 ECU_ADDRESS 0x70017ef2 BYTE_ORDER MSB_LAST /end MEASUREMENT
/begin COMPU_METHOD CU_V2GRXMSGBPTCTRLRESCODE "Conversion method for V2gRxMsgBptCtrlRescode" RAT_FUNC "%10.0" "1" COEFFS 0.000000 1.000000 -0.000000 0.000000 0.000000 1.000000 /end COMPU_METHOD
/* Scalar measurable for DDE 'V2gRxMsgBptCtrlSASchTupId'. */
/begin MEASUREMENT V2gRxMsgBptCtrlSASchTupId "The SaSchedule Tuple ID message received from the EVSE" UBYTE CU_V2GRXMSGBPTCTRLSASCHTUPID 1 100 0.0 255.0 ECU_ADDRESS 0x70017c61 BYTE_ORDER MSB_LAST /end MEASUREMENT
/begin COMPU_METHOD CU_V2GRXMSGBPTCTRLSASCHTUPID "Conversion method for V2gRxMsgBptCtrlSASchTupId" RAT_FUNC "%10.0" "1" COEFFS 0.000000 1.000000 -0.000000 0.000000 0.000000 1.000000 /end COMPU_METHOD
/* Scalar measurable for DDE 'V2gRxMsgBptCtrlSASchTupIdFlg'. */
/begin MEASUREMENT V2gRxMsgBptCtrlSASchTupIdFlg "Identifies the presence of the SaSchedule Tuple ID message received from the EVSE" UBYTE CU_V2GRXMSGBPTCTRLSASCHTUPIDFLG 1 100 0.0 1.0 ECU_ADDRESS 0x70017f18 BYTE_ORDER MSB_LAST /end MEASUREMENT
/begin COMPU_METHOD CU_V2GRXMSGBPTCTRLSASCHTUPIDFLG "Conversion method for V2gRxMsgBptCtrlSASchTupIdFlg" RAT_FUNC "%10.0" "b" COEFFS 0.000000 1.000000 -0.000000 0.000000 0.000000 1.000000 /end COMPU_METHOD
/* Scalar measurable for DDE 'V2gRxMsgBptCtrlTrg'. */
/begin MEASUREMENT V2gRxMsgBptCtrlTrg "Trigger flag that on a rising edge indicates the event for receiving the PLC (V2G) message response BidirectionalControlRes from EVSE" UBYTE CU_V2GRXMSGBPTCTRLTRG 1 100 0.0 1.0 ECU_ADDRESS 0x7001829a BYTE_ORDER MSB_LAST /end MEASUREMENT
/begin COMPU_METHOD CU_V2GRXMSGBPTCTRLTRG "Conversion method for V2gRxMsgBptCtrlTrg" RAT_FUNC "%10.0" "b" COEFFS 0.000000 1.000000 -0.000000 0.000000 0.000000 1.000000 /end COMPU_METHOD
/* Scalar measurable for DDE 'V2gRxMsgBptCtrlVoltLimReached'. */
/begin MEASUREMENT V2gRxMsgBptCtrlVoltLimReached "f set to TRUE, the EVSE has reached its voltage limit." UBYTE CU_V2GRXMSGBPTCTRLVOLTLIMREACH0 1 100 0.0 1.0 ECU_ADDRESS 0x7001808c BYTE_ORDER MSB_LAST /end MEASUREMENT
/begin COMPU_METHOD CU_V2GRXMSGBPTCTRLVOLTLIMREACH0 "Conversion method for V2gRxMsgBptCtrlVoltLimReached" RAT_FUNC "%10.0" "b" COEFFS 0.000000 1.000000 -0.000000 0.000000 0.000000 1.000000 /end COMPU_METHOD
/* Scalar measurable for DDE 'V2gRxMsgCblChkEvseProcessing'. */
/begin MEASUREMENT V2gRxMsgCblChkEvseProcessing "Message 4b: Parameter indicating that the EVSE has finished the processing that was initiated after the ContractAuthenticationReq or that the EVSE is still processing at the time the response message was sent." SLONG CU_V2GRXMSGCBLCHKEVSEPROCESSING 1 100 -2147483648.0 2147483647.0 ECU_ADDRESS 0x70017ea8 BYTE_ORDER MSB_LAST /end MEASUREMENT
/begin COMPU_METHOD CU_V2GRXMSGCBLCHKEVSEPROCESSING "Conversion method for V2gRxMsgCblChkEvseProcessing" TAB_VERB "%12.0" "enum" COMPU_TAB_REF CT_V2GRXMSGCBLCHKEVSEPROCESSING /end COMPU_METHOD
/begin COMPU_VTAB CT_V2GRXMSGCBLCHKEVSEPROCESSING "Conversion method for V2gRxMsgCblChkEvseProcessing" TAB_VERB 3 0 "FINISHED" 1 "ONGOING" 2 "ONGOING_WAITINGFORCUSTOMERINTERACTION" /end COMPU_VTAB
/* Scalar measurable for DDE 'V2gRxMsgCblChkEvseStatus'. */
/begin MEASUREMENT V2gRxMsgCblChkEvseStatus "Indicates the internal state of the EVSE." SLONG CU_V2GRXMSGCBLCHKEVSESTATUS 1 100 -2147483648.0 2147483647.0 ECU_ADDRESS 0x70017cf0 BYTE_ORDER MSB_LAST /end MEASUREMENT
/begin COMPU_METHOD CU_V2GRXMSGCBLCHKEVSESTATUS "Conversion method for V2gRxMsgCblChkEvseStatus" TAB_VERB "%12.0" "enum" COMPU_TAB_REF CT_V2GRXMSGCBLCHKEVSESTATUS /end COMPU_METHOD
/begin COMPU_VTAB CT_V2GRXMSGCBLCHKEVSESTATUS "Conversion method for V2gRxMsgCblChkEvseStatus" TAB_VERB 12 0 "EVSE_NOT_READY" 1 "EVSE_READY" 2 "EVSE_SHUTDOWN" 3 "EVSE_UTILITY_INTERRUPT" 4 "EVSE_ISOLATION_MONITOR_ACTV" 5 "EVSE_EMERGENCY_SHUTDOWN" 6 "EVSE_MALFUNCTION" 7 "EVSE_STATUS_RESERVED1" 8 "EVSE_STATUS_RESERVED2" 9 "EVSE_STATUS_RESERVED3" 10 "EVSE_STATUS_RESERVED4" 11 "EVSE_STATUS_RESERVED5" /end COMPU_VTAB
/* Scalar measurable for DDE 'V2gRxMsgCblChkIsolStatus'. */
/begin MEASUREMENT V2gRxMsgCblChkIsolStatus "Indicates the isolation condition" SLONG CU_V2GRXMSGCBLCHKISOLSTATUS 1 100 -2147483648.0 2147483647.0 ECU_ADDRESS 0x7001833c BYTE_ORDER MSB_LAST /end MEASUREMENT
/begin COMPU_METHOD CU_V2GRXMSGCBLCHKISOLSTATUS "Conversion method for V2gRxMsgCblChkIsolStatus" TAB_VERB "%12.0" "enum" COMPU_TAB_REF CT_V2GRXMSGCBLCHKISOLSTATUS /end COMPU_METHOD
/begin COMPU_VTAB CT_V2GRXMSGCBLCHKISOLSTATUS "Conversion method for V2gRxMsgCblChkIsolStatus" TAB_VERB 4 0 "ISOLATION_INVALID" 1 "ISOLATION_VALID" 2 "ISOLATION_WARNING" 3 "ISOLATION_FAULT" /end COMPU_VTAB
/* Scalar measurable for DDE 'V2gRxMsgCblChkIsolStatus_flg'. */
/begin MEASUREMENT V2gRxMsgCblChkIsolStatus_flg "Identifies the presence of the EVSEIsolationStatus parameter." UBYTE CU_V2GRXMSGCBLCHKISOLSTATUS_FLG 1 100 0.0 1.0 ECU_ADDRESS 0x70017d48 BYTE_ORDER MSB_LAST /end MEASUREMENT
/begin COMPU_METHOD CU_V2GRXMSGCBLCHKISOLSTATUS_FLG "Conversion method for V2gRxMsgCblChkIsolStatus_flg" RAT_FUNC "%10.0" "b" COEFFS 0.000000 1.000000 -0.000000 0.000000 0.000000 1.000000 /end COMPU_METHOD
/* Scalar measurable for DDE 'V2gRxMsgCblChkNotif'. */
/begin MEASUREMENT V2gRxMsgCblChkNotif "The arbitrated Notification Max Delay parameter in the received message from EVSE" SLONG CU_V2GRXMSGCBLCHKNOTIF 1 100 -2147483648.0 2147483647.0 ECU_ADDRESS 0x70017fe0 BYTE_ORDER MSB_LAST /end MEASUREMENT
/begin COMPU_METHOD CU_V2GRXMSGCBLCHKNOTIF "Conversion method for V2gRxMsgCblChkNotif" TAB_VERB "%12.0" "1" COMPU_TAB_REF CT_V2GRXMSGCBLCHKNOTIF /end COMPU_METHOD
/begin COMPU_VTAB CT_V2GRXMSGCBLCHKNOTIF "Conversion method for V2gRxMsgCblChkNotif" TAB_VERB 3 0 "NONE" 1 "STOPCHARGING" 2 "RENEGOTIATION" /end COMPU_VTAB
/* Scalar measurable for DDE 'V2gRxMsgCblChkNotifFlg'. */
/begin MEASUREMENT V2gRxMsgCblChkNotifFlg "The arbitrated Notification parameter in the received message from EVSE" UBYTE CU_V2GRXMSGCBLCHKNOTIFFLG 1 100 0.0 1.0 ECU_ADDRESS 0x70017e48 BYTE_ORDER MSB_LAST /end MEASUREMENT
/begin COMPU_METHOD CU_V2GRXMSGCBLCHKNOTIFFLG "Conversion method for V2gRxMsgCblChkNotifFlg" RAT_FUNC "%10.0" "b" COEFFS 0.000000 1.000000 -0.000000 0.000000 0.000000 1.000000 /end COMPU_METHOD
/* Scalar measurable for DDE 'V2gRxMsgCblChkNotifMaxDelay'. */
/begin MEASUREMENT V2gRxMsgCblChkNotifMaxDelay "The arbitrated Notification Max Delay parameter in the received message from EVSE" UWORD CU_V2GRXMSGCBLCHKNOTIFMAXDELAY 1 100 0.0 65535.0 ECU_ADDRESS 0x70017c86 BYTE_ORDER MSB_LAST /end MEASUREMENT
/begin COMPU_METHOD CU_V2GRXMSGCBLCHKNOTIFMAXDELAY "Conversion method for V2gRxMsgCblChkNotifMaxDelay" RAT_FUNC "%10.0" "s" COEFFS 0.000000 1.000000 -0.000000 0.000000 0.000000 1.000000 /end COMPU_METHOD
/* Scalar measurable for DDE 'V2gRxMsgCblChkRescode'. */
/begin MEASUREMENT V2gRxMsgCblChkRescode "for message 4b: indicates the acknowledgment status of  this V2G messages received by the SECC." UBYTE CU_V2GRXMSGCBLCHKRESCODE 1 100 0.0 255.0 ECU_ADDRESS 0x700183a8 BYTE_ORDER MSB_LAST /end MEASUREMENT
/begin COMPU_METHOD CU_V2GRXMSGCBLCHKRESCODE "Conversion method for V2gRxMsgCblChkRescode" RAT_FUNC "%10.0" "1" COEFFS 0.000000 1.000000 -0.000000 0.000000 0.000000 1.000000 /end COMPU_METHOD
/* Scalar measurable for DDE 'V2gRxMsgCblChkTrg'. */
/begin MEASUREMENT V2gRxMsgCblChkTrg "Trigger falg that on a rising edge indicates the event for receiving the PLC (V2G) message response 4b from EVSE" UBYTE CU_V2GRXMSGCBLCHKTRG 1 100 0.0 1.0 ECU_ADDRESS 0x70017ca8 BYTE_ORDER MSB_LAST /end MEASUREMENT
/begin COMPU_METHOD CU_V2GRXMSGCBLCHKTRG "Conversion method for V2gRxMsgCblChkTrg" RAT_FUNC "%10.0" "b" COEFFS 0.000000 1.000000 -0.000000 0.000000 0.000000 1.000000 /end COMPU_METHOD
/* Scalar measurable for DDE 'V2gRxMsgChgParDscCrntRegTol'. */
/begin MEASUREMENT V2gRxMsgChgParDscCrntRegTol "Absolute magnitude of the regulation tolerance of the EVSE." FLOAT32_IEEE CU_V2GRXMSGCHGPARDSCCRNTREGTOL 1 100 0.0 196605.0 ECU_ADDRESS 0x70017f88 BYTE_ORDER MSB_LAST /end MEASUREMENT
/begin COMPU_METHOD CU_V2GRXMSGCHGPARDSCCRNTREGTOL "Conversion method for V2gRxMsgChgParDscCrntRegTol" RAT_FUNC "%10.0" "A" COEFFS 0.000000 1.000000 -0.000000 0.000000 0.000000 1.000000 /end COMPU_METHOD
/* Scalar measurable for DDE 'V2gRxMsgChgParDscCrntRegTol_flg'. */
/begin MEASUREMENT V2gRxMsgChgParDscCrntRegTol_flg "Identifies the presence of the DC_EVSEChargeParameter and its sub-parameters." UBYTE CU_V2GRXMSGCHGPARDSCCRNTREGTOL1 1 100 0.0 1.0 ECU_ADDRESS 0x700182e5 BYTE_ORDER MSB_LAST /end MEASUREMENT
/begin COMPU_METHOD CU_V2GRXMSGCHGPARDSCCRNTREGTOL1 "Conversion method for V2gRxMsgChgParDscCrntRegTol_flg" RAT_FUNC "%10.0" "b" COEFFS 0.000000 1.000000 -0.000000 0.000000 0.000000 1.000000 /end COMPU_METHOD
/* Scalar measurable for DDE 'V2gRxMsgChgParDscDchgMaxCrnt'. */
/begin MEASUREMENT V2gRxMsgChgParDscDchgMaxCrnt "Maximum discharge current that the EVSE can deliver" FLOAT32_IEEE CU_V2GRXMSGCHGPARDSCDCHGMAXCRNT 1 100 -32768000.0 32767000.0 ECU_ADDRESS 0x70018158 BYTE_ORDER MSB_LAST /end MEASUREMENT
/begin COMPU_METHOD CU_V2GRXMSGCHGPARDSCDCHGMAXCRNT "Conversion method for V2gRxMsgChgParDscDchgMaxCrnt" RAT_FUNC "%10.0" "A" COEFFS 0.000000 1.000000 -0.000000 0.000000 0.000000 1.000000 /end COMPU_METHOD
/* Scalar measurable for DDE 'V2gRxMsgChgParDscDchgMaxCrntFlg'. */
/begin MEASUREMENT V2gRxMsgChgParDscDchgMaxCrntFlg "Identifies the presence of the maximum discharge current from the EVSE" UBYTE CU_V2GRXMSGCHGPARDSCDCHGMAXCRN0 1 100 0.0 1.0 ECU_ADDRESS 0x70017ef0 BYTE_ORDER MSB_LAST /end MEASUREMENT
/begin COMPU_METHOD CU_V2GRXMSGCHGPARDSCDCHGMAXCRN0 "Conversion method for V2gRxMsgChgParDscDchgMaxCrntFlg" RAT_FUNC "%10.0" "b" COEFFS 0.000000 1.000000 -0.000000 0.000000 0.000000 1.000000 /end COMPU_METHOD
/* Scalar measurable for DDE 'V2gRxMsgChgParDscDchgMaxPwr'. */
/begin MEASUREMENT V2gRxMsgChgParDscDchgMaxPwr "Maximum discharge power that the EVSE can deliver" FLOAT32_IEEE CU_V2GRXMSGCHGPARDSCDCHGMAXPWR 1 100 -32768000.0 32767000.0 ECU_ADDRESS 0x70017d74 BYTE_ORDER MSB_LAST /end MEASUREMENT
/begin COMPU_METHOD CU_V2GRXMSGCHGPARDSCDCHGMAXPWR "Conversion method for V2gRxMsgChgParDscDchgMaxPwr" RAT_FUNC "%10.0" "W" COEFFS 0.000000 1.000000 -0.000000 0.000000 0.000000 1.000000 /end COMPU_METHOD
/* Scalar measurable for DDE 'V2gRxMsgChgParDscDchgMaxPwr_flg'. */
/begin MEASUREMENT V2gRxMsgChgParDscDchgMaxPwr_flg "Identifies the presence of the maximum discharge power from the EVSE" UBYTE CU_V2GRXMSGCHGPARDSCDCHGMAXPWR1 1 100 0.0 1.0 ECU_ADDRESS 0x70017f16 BYTE_ORDER MSB_LAST /end MEASUREMENT
/begin COMPU_METHOD CU_V2GRXMSGCHGPARDSCDCHGMAXPWR1 "Conversion method for V2gRxMsgChgParDscDchgMaxPwr_flg" RAT_FUNC "%10.0" "b" COEFFS 0.000000 1.000000 -0.000000 0.000000 0.000000 1.000000 /end COMPU_METHOD
/* Scalar measurable for DDE 'V2gRxMsgChgParDscDchgMinCrnt'. */
/begin MEASUREMENT V2gRxMsgChgParDscDchgMinCrnt "Minimum discharge current that the EVSE can deliver" FLOAT32_IEEE CU_V2GRXMSGCHGPARDSCDCHGMINCRNT 1 100 -32768000.0 32767000.0 ECU_ADDRESS 0x70018294 BYTE_ORDER MSB_LAST /end MEASUREMENT
/begin COMPU_METHOD CU_V2GRXMSGCHGPARDSCDCHGMINCRNT "Conversion method for V2gRxMsgChgParDscDchgMinCrnt" RAT_FUNC "%10.0" "A" COEFFS 0.000000 1.000000 -0.000000 0.000000 0.000000 1.000000 /end COMPU_METHOD
/* Scalar measurable for DDE 'V2gRxMsgChgParDscDchgMinCrntFlg'. */
/begin MEASUREMENT V2gRxMsgChgParDscDchgMinCrntFlg "Identifies the presence of the minimum discharge current from the EVSE" UBYTE CU_V2GRXMSGCHGPARDSCDCHGMINCRN0 1 100 0.0 1.0 ECU_ADDRESS 0x70017c7b BYTE_ORDER MSB_LAST /end MEASUREMENT
/begin COMPU_METHOD CU_V2GRXMSGCHGPARDSCDCHGMINCRN0 "Conversion method for V2gRxMsgChgParDscDchgMinCrntFlg" RAT_FUNC "%10.0" "b" COEFFS 0.000000 1.000000 -0.000000 0.000000 0.000000 1.000000 /end COMPU_METHOD
/* Scalar measurable for DDE 'V2gRxMsgChgParDscEgy2Deliv'. */
/begin MEASUREMENT V2gRxMsgChgParDscEgy2Deliv "Amount of energy to be delivered by the EVSE." FLOAT32_IEEE CU_V2GRXMSGCHGPARDSCEGY2DELIV 1 100 0.0 196605.0 ECU_ADDRESS 0x7001839c BYTE_ORDER MSB_LAST /end MEASUREMENT
/begin COMPU_METHOD CU_V2GRXMSGCHGPARDSCEGY2DELIV "Conversion method for V2gRxMsgChgParDscEgy2Deliv" RAT_FUNC "%10.0" "Wh" COEFFS 0.000000 1.000000 -0.000000 0.000000 0.000000 1.000000 /end COMPU_METHOD
/* Scalar measurable for DDE 'V2gRxMsgChgParDscEgy2DelivFlg'. */
/begin MEASUREMENT V2gRxMsgChgParDscEgy2DelivFlg "Indicated the presente of the amount of energy signal to be delivered by the EVSE." UBYTE CU_V2GRXMSGCHGPARDSCEGY2DELIVF0 1 100 0.0 1.0 ECU_ADDRESS 0x700181f1 BYTE_ORDER MSB_LAST /end MEASUREMENT
/begin COMPU_METHOD CU_V2GRXMSGCHGPARDSCEGY2DELIVF0 "Conversion method for V2gRxMsgChgParDscEgy2DelivFlg" RAT_FUNC "%10.0" "b" COEFFS 0.000000 1.000000 -0.000000 0.000000 0.000000 1.000000 /end COMPU_METHOD
/* Scalar measurable for DDE 'V2gRxMsgChgParDscEvseProcessing'. */
/begin MEASUREMENT V2gRxMsgChgParDscEvseProcessing "Message 3b: Parameter indicating that the EVSE has finished the processing that was initiated after the ContractAuthenticationReq or that the EVSE is still processing at the time the response message was sent." SLONG CU_V2GRXMSGCHGPARDSCEVSEPROCES0 1 100 -2147483648.0 2147483647.0 ECU_ADDRESS 0x70017fa4 BYTE_ORDER MSB_LAST /end MEASUREMENT
/begin COMPU_METHOD CU_V2GRXMSGCHGPARDSCEVSEPROCES0 "Conversion method for V2gRxMsgChgParDscEvseProcessing" TAB_VERB "%12.0" "enum" COMPU_TAB_REF CT_V2GRXMSGCHGPARDSCEVSEPROCES0 /end COMPU_METHOD
/begin COMPU_VTAB CT_V2GRXMSGCHGPARDSCEVSEPROCES0 "Conversion method for V2gRxMsgChgParDscEvseProcessing" TAB_VERB 3 0 "FINISHED" 1 "ONGOING" 2 "ONGOING_WAITINGFORCUSTOMERINTERACTION" /end COMPU_VTAB
/* Scalar measurable for DDE 'V2gRxMsgChgParDscEvseStatus'. */
/begin MEASUREMENT V2gRxMsgChgParDscEvseStatus "Indicates the internal state of the EVSE." SLONG CU_V2GRXMSGCHGPARDSCEVSESTATUS 1 100 -2147483648.0 2147483647.0 ECU_ADDRESS 0x7001823c BYTE_ORDER MSB_LAST /end MEASUREMENT
/begin COMPU_METHOD CU_V2GRXMSGCHGPARDSCEVSESTATUS "Conversion method for V2gRxMsgChgParDscEvseStatus" TAB_VERB "%12.0" "enum" COMPU_TAB_REF CT_V2GRXMSGCHGPARDSCEVSESTATUS /end COMPU_METHOD
/begin COMPU_VTAB CT_V2GRXMSGCHGPARDSCEVSESTATUS "Conversion method for V2gRxMsgChgParDscEvseStatus" TAB_VERB 12 0 "EVSE_NOT_READY" 1 "EVSE_READY" 2 "EVSE_SHUTDOWN" 3 "EVSE_UTILITY_INTERRUPT" 4 "EVSE_ISOLATION_MONITOR_ACTV" 5 "EVSE_EMERGENCY_SHUTDOWN" 6 "EVSE_MALFUNCTION" 7 "EVSE_STATUS_RESERVED1" 8 "EVSE_STATUS_RESERVED2" 9 "EVSE_STATUS_RESERVED3" 10 "EVSE_STATUS_RESERVED4" 11 "EVSE_STATUS_RESERVED5" /end COMPU_VTAB
/* Scalar measurable for DDE 'V2gRxMsgChgParDscEvseStatus_flg'. */
/begin MEASUREMENT V2gRxMsgChgParDscEvseStatus_flg "Identifies the presence of the DC_EVSEChargeParameter and its sub-parameters." UBYTE CU_V2GRXMSGCHGPARDSCEVSESTATUS1 1 100 0.0 1.0 ECU_ADDRESS 0x70017c25 BYTE_ORDER MSB_LAST /end MEASUREMENT
/begin COMPU_METHOD CU_V2GRXMSGCHGPARDSCEVSESTATUS1 "Conversion method for V2gRxMsgChgParDscEvseStatus_flg" RAT_FUNC "%10.0" "b" COEFFS 0.000000 1.000000 -0.000000 0.000000 0.000000 1.000000 /end COMPU_METHOD
/* Scalar measurable for DDE 'V2gRxMsgChgParDscIsolStatus'. */
/begin MEASUREMENT V2gRxMsgChgParDscIsolStatus "Indicates the isolation condition" SLONG CU_V2GRXMSGCHGPARDSCISOLSTATUS 1 100 -2147483648.0 2147483647.0 ECU_ADDRESS 0x70017ee4 BYTE_ORDER MSB_LAST /end MEASUREMENT
/begin COMPU_METHOD CU_V2GRXMSGCHGPARDSCISOLSTATUS "Conversion method for V2gRxMsgChgParDscIsolStatus" TAB_VERB "%12.0" "enum" COMPU_TAB_REF CT_V2GRXMSGCHGPARDSCISOLSTATUS /end COMPU_METHOD
/begin COMPU_VTAB CT_V2GRXMSGCHGPARDSCISOLSTATUS "Conversion method for V2gRxMsgChgParDscIsolStatus" TAB_VERB 4 0 "ISOLATION_INVALID" 1 "ISOLATION_VALID" 2 "ISOLATION_WARNING" 3 "ISOLATION_FAULT" /end COMPU_VTAB
/* Scalar measurable for DDE 'V2gRxMsgChgParDscIsolStatus_flg'. */
/begin MEASUREMENT V2gRxMsgChgParDscIsolStatus_flg "Indicates the presence of the isolation condition" UBYTE CU_V2GRXMSGCHGPARDSCISOLSTATUS1 1 100 0.0 1.0 ECU_ADDRESS 0x70017d52 BYTE_ORDER MSB_LAST /end MEASUREMENT
/begin COMPU_METHOD CU_V2GRXMSGCHGPARDSCISOLSTATUS1 "Conversion method for V2gRxMsgChgParDscIsolStatus_flg" RAT_FUNC "%10.0" "b" COEFFS 0.000000 1.000000 -0.000000 0.000000 0.000000 1.000000 /end COMPU_METHOD
/* Scalar measurable for DDE 'V2gRxMsgChgParDscMaxCrnt'. */
/begin MEASUREMENT V2gRxMsgChgParDscMaxCrnt "Maximum current the EVSE can deliver" FLOAT32_IEEE CU_V2GRXMSGCHGPARDSCMAXCRNT 1 100 0.0 196605.0 ECU_ADDRESS 0x70018468 BYTE_ORDER MSB_LAST /end MEASUREMENT
/begin COMPU_METHOD CU_V2GRXMSGCHGPARDSCMAXCRNT "Conversion method for V2gRxMsgChgParDscMaxCrnt" RAT_FUNC "%10.0" "A" COEFFS 0.000000 1.000000 -0.000000 0.000000 0.000000 1.000000 /end COMPU_METHOD
/* Scalar measurable for DDE 'V2gRxMsgChgParDscMaxCrnt_flg'. */
/begin MEASUREMENT V2gRxMsgChgParDscMaxCrnt_flg "Identifies the presence of the DC_EVSEChargeParameter and its sub-parameters." UBYTE CU_V2GRXMSGCHGPARDSCMAXCRNT_FLG 1 100 0.0 1.0 ECU_ADDRESS 0x700182b1 BYTE_ORDER MSB_LAST /end MEASUREMENT
/begin COMPU_METHOD CU_V2GRXMSGCHGPARDSCMAXCRNT_FLG "Conversion method for V2gRxMsgChgParDscMaxCrnt_flg" RAT_FUNC "%10.0" "b" COEFFS 0.000000 1.000000 -0.000000 0.000000 0.000000 1.000000 /end COMPU_METHOD
/* Scalar measurable for DDE 'V2gRxMsgChgParDscMaxPwr'. */
/begin MEASUREMENT V2gRxMsgChgParDscMaxPwr "Maximum power the EVSE can deliver" FLOAT32_IEEE CU_V2GRXMSGCHGPARDSCMAXPWR 1 100 0.0 500000.0 ECU_ADDRESS 0x70018488 BYTE_ORDER MSB_LAST /end MEASUREMENT
/begin COMPU_METHOD CU_V2GRXMSGCHGPARDSCMAXPWR "Conversion method for V2gRxMsgChgParDscMaxPwr" RAT_FUNC "%10.0" "W" COEFFS 0.000000 1.000000 -0.000000 0.000000 0.000000 1.000000 /end COMPU_METHOD
/* Scalar measurable for DDE 'V2gRxMsgChgParDscMaxPwr_flg'. */
/begin MEASUREMENT V2gRxMsgChgParDscMaxPwr_flg "Identifies the presence of the DC_EVSEChargeParameter and its sub-parameters." UBYTE CU_V2GRXMSGCHGPARDSCMAXPWR_FLG 1 100 0.0 1.0 ECU_ADDRESS 0x70017e96 BYTE_ORDER MSB_LAST /end MEASUREMENT
/begin COMPU_METHOD CU_V2GRXMSGCHGPARDSCMAXPWR_FLG "Conversion method for V2gRxMsgChgParDscMaxPwr_flg" RAT_FUNC "%10.0" "b" COEFFS 0.000000 1.000000 -0.000000 0.000000 0.000000 1.000000 /end COMPU_METHOD
/* Scalar measurable for DDE 'V2gRxMsgChgParDscMaxVolt'. */
/begin MEASUREMENT V2gRxMsgChgParDscMaxVolt "Maximum voltage the EVSE can deliver" FLOAT32_IEEE CU_V2GRXMSGCHGPARDSCMAXVOLT 1 100 0.0 196605.0 ECU_ADDRESS 0x700181e0 BYTE_ORDER MSB_LAST /end MEASUREMENT
/begin COMPU_METHOD CU_V2GRXMSGCHGPARDSCMAXVOLT "Conversion method for V2gRxMsgChgParDscMaxVolt" RAT_FUNC "%10.0" "V" COEFFS 0.000000 1.000000 -0.000000 0.000000 0.000000 1.000000 /end COMPU_METHOD
/* Scalar measurable for DDE 'V2gRxMsgChgParDscMaxVolt_flg'. */
/begin MEASUREMENT V2gRxMsgChgParDscMaxVolt_flg "Identifies the presence of the DC_EVSEChargeParameter and its sub-parameters." UBYTE CU_V2GRXMSGCHGPARDSCMAXVOLT_FLG 1 100 0.0 1.0 ECU_ADDRESS 0x70017f92 BYTE_ORDER MSB_LAST /end MEASUREMENT
/begin COMPU_METHOD CU_V2GRXMSGCHGPARDSCMAXVOLT_FLG "Conversion method for V2gRxMsgChgParDscMaxVolt_flg" RAT_FUNC "%10.0" "b" COEFFS 0.000000 1.000000 -0.000000 0.000000 0.000000 1.000000 /end COMPU_METHOD
/* Scalar measurable for DDE 'V2gRxMsgChgParDscMinCrnt'. */
/begin MEASUREMENT V2gRxMsgChgParDscMinCrnt "Minimum current the EVSE can deliver with the expected accuracy" FLOAT32_IEEE CU_V2GRXMSGCHGPARDSCMINCRNT 1 100 0.0 196605.0 ECU_ADDRESS 0x70017e0c BYTE_ORDER MSB_LAST /end MEASUREMENT
/begin COMPU_METHOD CU_V2GRXMSGCHGPARDSCMINCRNT "Conversion method for V2gRxMsgChgParDscMinCrnt" RAT_FUNC "%10.0" "A" COEFFS 0.000000 1.000000 -0.000000 0.000000 0.000000 1.000000 /end COMPU_METHOD
/* Scalar measurable for DDE 'V2gRxMsgChgParDscMinCrnt_flg'. */
/begin MEASUREMENT V2gRxMsgChgParDscMinCrnt_flg "Identifies the presence of the DC_EVSEChargeParameter and its sub-parameters." UBYTE CU_V2GRXMSGCHGPARDSCMINCRNT_FLG 1 100 0.0 1.0 ECU_ADDRESS 0x70017c44 BYTE_ORDER MSB_LAST /end MEASUREMENT
/begin COMPU_METHOD CU_V2GRXMSGCHGPARDSCMINCRNT_FLG "Conversion method for V2gRxMsgChgParDscMinCrnt_flg" RAT_FUNC "%10.0" "b" COEFFS 0.000000 1.000000 -0.000000 0.000000 0.000000 1.000000 /end COMPU_METHOD
/* Scalar measurable for DDE 'V2gRxMsgChgParDscMinVolt'. */
/begin MEASUREMENT V2gRxMsgChgParDscMinVolt "Minimum voltage the EVSE can deliver with the expected accuracy." FLOAT32_IEEE CU_V2GRXMSGCHGPARDSCMINVOLT 1 100 0.0 196605.0 ECU_ADDRESS 0x70017de4 BYTE_ORDER MSB_LAST /end MEASUREMENT
/begin COMPU_METHOD CU_V2GRXMSGCHGPARDSCMINVOLT "Conversion method for V2gRxMsgChgParDscMinVolt" RAT_FUNC "%10.0" "V" COEFFS 0.000000 1.000000 -0.000000 0.000000 0.000000 1.000000 /end COMPU_METHOD
/* Scalar measurable for DDE 'V2gRxMsgChgParDscMinVolt_flg'. */
/begin MEASUREMENT V2gRxMsgChgParDscMinVolt_flg "Identifies the presence of the DC_EVSEChargeParameter and its sub-parameters." UBYTE CU_V2GRXMSGCHGPARDSCMINVOLT_FLG 1 100 0.0 1.0 ECU_ADDRESS 0x70017ce3 BYTE_ORDER MSB_LAST /end MEASUREMENT
/begin COMPU_METHOD CU_V2GRXMSGCHGPARDSCMINVOLT_FLG "Conversion method for V2gRxMsgChgParDscMinVolt_flg" RAT_FUNC "%10.0" "b" COEFFS 0.000000 1.000000 -0.000000 0.000000 0.000000 1.000000 /end COMPU_METHOD
/* Scalar measurable for DDE 'V2gRxMsgChgParDscNotif'. */
/begin MEASUREMENT V2gRxMsgChgParDscNotif "The arbitrated Notification Max Delay parameter in the received message from EVSE" SLONG CU_V2GRXMSGCHGPARDSCNOTIF 1 100 -2147483648.0 2147483647.0 ECU_ADDRESS 0x70017ed4 BYTE_ORDER MSB_LAST /end MEASUREMENT
/begin COMPU_METHOD CU_V2GRXMSGCHGPARDSCNOTIF "Conversion method for V2gRxMsgChgParDscNotif" TAB_VERB "%12.0" "1" COMPU_TAB_REF CT_V2GRXMSGCHGPARDSCNOTIF /end COMPU_METHOD
/begin COMPU_VTAB CT_V2GRXMSGCHGPARDSCNOTIF "Conversion method for V2gRxMsgChgParDscNotif" TAB_VERB 3 0 "NONE" 1 "STOPCHARGING" 2 "RENEGOTIATION" /end COMPU_VTAB
/* Scalar measurable for DDE 'V2gRxMsgChgParDscNotifFlg'. */
/begin MEASUREMENT V2gRxMsgChgParDscNotifFlg "The arbitrated Notification parameter in the received message from EVSE" UBYTE CU_V2GRXMSGCHGPARDSCNOTIFFLG 1 100 0.0 1.0 ECU_ADDRESS 0x70017e9e BYTE_ORDER MSB_LAST /end MEASUREMENT
/begin COMPU_METHOD CU_V2GRXMSGCHGPARDSCNOTIFFLG "Conversion method for V2gRxMsgChgParDscNotifFlg" RAT_FUNC "%10.0" "b" COEFFS 0.000000 1.000000 -0.000000 0.000000 0.000000 1.000000 /end COMPU_METHOD
/* Scalar measurable for DDE 'V2gRxMsgChgParDscNotifMaxDelay'. */
/begin MEASUREMENT V2gRxMsgChgParDscNotifMaxDelay "The arbitrated Notification Max Delay parameter in the received message from EVSE" UWORD CU_V2GRXMSGCHGPARDSCNOTIFMAXDE0 1 100 0.0 65535.0 ECU_ADDRESS 0x70017ca6 BYTE_ORDER MSB_LAST /end MEASUREMENT
/begin COMPU_METHOD CU_V2GRXMSGCHGPARDSCNOTIFMAXDE0 "Conversion method for V2gRxMsgChgParDscNotifMaxDelay" RAT_FUNC "%10.0" "s" COEFFS 0.000000 1.000000 -0.000000 0.000000 0.000000 1.000000 /end COMPU_METHOD
/* Scalar measurable for DDE 'V2gRxMsgChgParDscPkRipple'. */
/begin MEASUREMENT V2gRxMsgChgParDscPkRipple "Peak-to-peak magnitude of the current ripple of the EVSE." FLOAT32_IEEE CU_V2GRXMSGCHGPARDSCPKRIPPLE 1 100 0.0 196605.0 ECU_ADDRESS 0x70018088 BYTE_ORDER MSB_LAST /end MEASUREMENT
/begin COMPU_METHOD CU_V2GRXMSGCHGPARDSCPKRIPPLE "Conversion method for V2gRxMsgChgParDscPkRipple" RAT_FUNC "%10.0" "A" COEFFS 0.000000 1.000000 -0.000000 0.000000 0.000000 1.000000 /end COMPU_METHOD
/* Scalar measurable for DDE 'V2gRxMsgChgParDscPkRipple_flg'. */
/begin MEASUREMENT V2gRxMsgChgParDscPkRipple_flg "Identifies the presence of the DC_EVSEChargeParameter and its sub-parameters." UBYTE CU_V2GRXMSGCHGPARDSCPKRIPPLE_F0 1 100 0.0 1.0 ECU_ADDRESS 0x70017eb4 BYTE_ORDER MSB_LAST /end MEASUREMENT
/begin COMPU_METHOD CU_V2GRXMSGCHGPARDSCPKRIPPLE_F0 "Conversion method for V2gRxMsgChgParDscPkRipple_flg" RAT_FUNC "%10.0" "b" COEFFS 0.000000 1.000000 -0.000000 0.000000 0.000000 1.000000 /end COMPU_METHOD
/* Scalar measurable for DDE 'V2gRxMsgChgParDscRescode'. */
/begin MEASUREMENT V2gRxMsgChgParDscRescode "for message 3b: indicates the acknowledgment status of  this V2G messages received by the SECC." UBYTE CU_V2GRXMSGCHGPARDSCRESCODE 1 100 0.0 255.0 ECU_ADDRESS 0x70017da5 BYTE_ORDER MSB_LAST /end MEASUREMENT
/begin COMPU_METHOD CU_V2GRXMSGCHGPARDSCRESCODE "Conversion method for V2gRxMsgChgParDscRescode" RAT_FUNC "%10.0" "1" COEFFS 0.000000 1.000000 -0.000000 0.000000 0.000000 1.000000 /end COMPU_METHOD
/* Scalar measurable for DDE 'V2gRxMsgChgParDscTrg'. */
/begin MEASUREMENT V2gRxMsgChgParDscTrg "Trigger falg that on a rising edge indicates the event for receiving the PLC (V2G) message response 3b from EVSE" UBYTE CU_V2GRXMSGCHGPARDSCTRG 1 100 0.0 1.0 ECU_ADDRESS 0x70017c89 BYTE_ORDER MSB_LAST /end MEASUREMENT
/begin COMPU_METHOD CU_V2GRXMSGCHGPARDSCTRG "Conversion method for V2gRxMsgChgParDscTrg" RAT_FUNC "%10.0" "b" COEFFS 0.000000 1.000000 -0.000000 0.000000 0.000000 1.000000 /end COMPU_METHOD
/* Scalar measurable for DDE 'V2gRxMsgCrntDmdCrntLimReached'. */
/begin MEASUREMENT V2gRxMsgCrntDmdCrntLimReached "If set to TRUE, the EVSE has reached its current limit." UBYTE CU_V2GRXMSGCRNTDMDCRNTLIMREACH0 1 100 0.0 1.0 ECU_ADDRESS 0x70017f20 BYTE_ORDER MSB_LAST /end MEASUREMENT
/begin COMPU_METHOD CU_V2GRXMSGCRNTDMDCRNTLIMREACH0 "Conversion method for V2gRxMsgCrntDmdCrntLimReached" RAT_FUNC "%10.0" "b" COEFFS 0.000000 1.000000 -0.000000 0.000000 0.000000 1.000000 /end COMPU_METHOD
/* Scalar measurable for DDE 'V2gRxMsgCrntDmdEvseCurrent'. */
/begin MEASUREMENT V2gRxMsgCrntDmdEvseCurrent "Present output current of the EVSE." FLOAT32_IEEE CU_V2GRXMSGCRNTDMDEVSECURRENT 1 100 0.0 196605.0 ECU_ADDRESS 0x700182ac BYTE_ORDER MSB_LAST /end MEASUREMENT
/begin COMPU_METHOD CU_V2GRXMSGCRNTDMDEVSECURRENT "Conversion method for V2gRxMsgCrntDmdEvseCurrent" RAT_FUNC "%10.0" "A" COEFFS 0.000000 1.000000 -0.000000 0.000000 0.000000 1.000000 /end COMPU_METHOD
/* Scalar measurable for DDE 'V2gRxMsgCrntDmdEvseIdLen'. */
/begin MEASUREMENT V2gRxMsgCrntDmdEvseIdLen "Number of bytes in EVSE ID" UBYTE CU_V2GRXMSGCRNTDMDEVSEIDLEN 1 100 0.0 37.0 ECU_ADDRESS 0x700183a2 BYTE_ORDER MSB_LAST /end MEASUREMENT
/begin COMPU_METHOD CU_V2GRXMSGCRNTDMDEVSEIDLEN "Conversion method for V2gRxMsgCrntDmdEvseIdLen" RAT_FUNC "%10.0" "1" COEFFS 0.000000 1.000000 -0.000000 0.000000 0.000000 1.000000 /end COMPU_METHOD
/* Scalar measurable for DDE 'V2gRxMsgCrntDmdEvseId[0]'. */
/begin MEASUREMENT V2gRxMsgCrntDmdEvseId[0] "The ID that uniquely identifies the EVSE. Format is defined in DIN SPEC 91286" UBYTE CU_V2GRXMSGCRNTDMDEVSEID[0] 1 100 0.0 255.0 ECU_ADDRESS 0x7001805c BYTE_ORDER MSB_LAST /end MEASUREMENT
/begin COMPU_METHOD CU_V2GRXMSGCRNTDMDEVSEID[0] "Conversion method for V2gRxMsgCrntDmdEvseId[0]" RAT_FUNC "%10.0" "1" COEFFS 0.000000 1.000000 -0.000000 0.000000 0.000000 1.000000 /end COMPU_METHOD
/* Scalar measurable for DDE 'V2gRxMsgCrntDmdEvseId[10]'. */
/begin MEASUREMENT V2gRxMsgCrntDmdEvseId[10] "The ID that uniquely identifies the EVSE. Format is defined in DIN SPEC 91286" UBYTE CU_V2GRXMSGCRNTDMDEVSEID[10] 1 100 0.0 255.0 ECU_ADDRESS 0x70018066 BYTE_ORDER MSB_LAST /end MEASUREMENT
/begin COMPU_METHOD CU_V2GRXMSGCRNTDMDEVSEID[10] "Conversion method for V2gRxMsgCrntDmdEvseId[10]" RAT_FUNC "%10.0" "1" COEFFS 0.000000 1.000000 -0.000000 0.000000 0.000000 1.000000 /end COMPU_METHOD
/* Scalar measurable for DDE 'V2gRxMsgCrntDmdEvseId[11]'. */
/begin MEASUREMENT V2gRxMsgCrntDmdEvseId[11] "The ID that uniquely identifies the EVSE. Format is defined in DIN SPEC 91286" UBYTE CU_V2GRXMSGCRNTDMDEVSEID[11] 1 100 0.0 255.0 ECU_ADDRESS 0x70018067 BYTE_ORDER MSB_LAST /end MEASUREMENT
/begin COMPU_METHOD CU_V2GRXMSGCRNTDMDEVSEID[11] "Conversion method for V2gRxMsgCrntDmdEvseId[11]" RAT_FUNC "%10.0" "1" COEFFS 0.000000 1.000000 -0.000000 0.000000 0.000000 1.000000 /end COMPU_METHOD
/* Scalar measurable for DDE 'V2gRxMsgCrntDmdEvseId[12]'. */
/begin MEASUREMENT V2gRxMsgCrntDmdEvseId[12] "The ID that uniquely identifies the EVSE. Format is defined in DIN SPEC 91286" UBYTE CU_V2GRXMSGCRNTDMDEVSEID[12] 1 100 0.0 255.0 ECU_ADDRESS 0x70018068 BYTE_ORDER MSB_LAST /end MEASUREMENT
/begin COMPU_METHOD CU_V2GRXMSGCRNTDMDEVSEID[12] "Conversion method for V2gRxMsgCrntDmdEvseId[12]" RAT_FUNC "%10.0" "1" COEFFS 0.000000 1.000000 -0.000000 0.000000 0.000000 1.000000 /end COMPU_METHOD
/* Scalar measurable for DDE 'V2gRxMsgCrntDmdEvseId[13]'. */
/begin MEASUREMENT V2gRxMsgCrntDmdEvseId[13] "The ID that uniquely identifies the EVSE. Format is defined in DIN SPEC 91286" UBYTE CU_V2GRXMSGCRNTDMDEVSEID[13] 1 100 0.0 255.0 ECU_ADDRESS 0x70018069 BYTE_ORDER MSB_LAST /end MEASUREMENT
/begin COMPU_METHOD CU_V2GRXMSGCRNTDMDEVSEID[13] "Conversion method for V2gRxMsgCrntDmdEvseId[13]" RAT_FUNC "%10.0" "1" COEFFS 0.000000 1.000000 -0.000000 0.000000 0.000000 1.000000 /end COMPU_METHOD
/* Scalar measurable for DDE 'V2gRxMsgCrntDmdEvseId[14]'. */
/begin MEASUREMENT V2gRxMsgCrntDmdEvseId[14] "The ID that uniquely identifies the EVSE. Format is defined in DIN SPEC 91286" UBYTE CU_V2GRXMSGCRNTDMDEVSEID[14] 1 100 0.0 255.0 ECU_ADDRESS 0x7001806a BYTE_ORDER MSB_LAST /end MEASUREMENT
/begin COMPU_METHOD CU_V2GRXMSGCRNTDMDEVSEID[14] "Conversion method for V2gRxMsgCrntDmdEvseId[14]" RAT_FUNC "%10.0" "1" COEFFS 0.000000 1.000000 -0.000000 0.000000 0.000000 1.000000 /end COMPU_METHOD
/* Scalar measurable for DDE 'V2gRxMsgCrntDmdEvseId[15]'. */
/begin MEASUREMENT V2gRxMsgCrntDmdEvseId[15] "The ID that uniquely identifies the EVSE. Format is defined in DIN SPEC 91286" UBYTE CU_V2GRXMSGCRNTDMDEVSEID[15] 1 100 0.0 255.0 ECU_ADDRESS 0x7001806b BYTE_ORDER MSB_LAST /end MEASUREMENT
/begin COMPU_METHOD CU_V2GRXMSGCRNTDMDEVSEID[15] "Conversion method for V2gRxMsgCrntDmdEvseId[15]" RAT_FUNC "%10.0" "1" COEFFS 0.000000 1.000000 -0.000000 0.000000 0.000000 1.000000 /end COMPU_METHOD
/* Scalar measurable for DDE 'V2gRxMsgCrntDmdEvseId[16]'. */
/begin MEASUREMENT V2gRxMsgCrntDmdEvseId[16] "The ID that uniquely identifies the EVSE. Format is defined in DIN SPEC 91286" UBYTE CU_V2GRXMSGCRNTDMDEVSEID[16] 1 100 0.0 255.0 ECU_ADDRESS 0x7001806c BYTE_ORDER MSB_LAST /end MEASUREMENT
/begin COMPU_METHOD CU_V2GRXMSGCRNTDMDEVSEID[16] "Conversion method for V2gRxMsgCrntDmdEvseId[16]" RAT_FUNC "%10.0" "1" COEFFS 0.000000 1.000000 -0.000000 0.000000 0.000000 1.000000 /end COMPU_METHOD
/* Scalar measurable for DDE 'V2gRxMsgCrntDmdEvseId[17]'. */
/begin MEASUREMENT V2gRxMsgCrntDmdEvseId[17] "The ID that uniquely identifies the EVSE. Format is defined in DIN SPEC 91286" UBYTE CU_V2GRXMSGCRNTDMDEVSEID[17] 1 100 0.0 255.0 ECU_ADDRESS 0x7001806d BYTE_ORDER MSB_LAST /end MEASUREMENT
/begin COMPU_METHOD CU_V2GRXMSGCRNTDMDEVSEID[17] "Conversion method for V2gRxMsgCrntDmdEvseId[17]" RAT_FUNC "%10.0" "1" COEFFS 0.000000 1.000000 -0.000000 0.000000 0.000000 1.000000 /end COMPU_METHOD
/* Scalar measurable for DDE 'V2gRxMsgCrntDmdEvseId[18]'. */
/begin MEASUREMENT V2gRxMsgCrntDmdEvseId[18] "The ID that uniquely identifies the EVSE. Format is defined in DIN SPEC 91286" UBYTE CU_V2GRXMSGCRNTDMDEVSEID[18] 1 100 0.0 255.0 ECU_ADDRESS 0x7001806e BYTE_ORDER MSB_LAST /end MEASUREMENT
/begin COMPU_METHOD CU_V2GRXMSGCRNTDMDEVSEID[18] "Conversion method for V2gRxMsgCrntDmdEvseId[18]" RAT_FUNC "%10.0" "1" COEFFS 0.000000 1.000000 -0.000000 0.000000 0.000000 1.000000 /end COMPU_METHOD
/* Scalar measurable for DDE 'V2gRxMsgCrntDmdEvseId[19]'. */
/begin MEASUREMENT V2gRxMsgCrntDmdEvseId[19] "The ID that uniquely identifies the EVSE. Format is defined in DIN SPEC 91286" UBYTE CU_V2GRXMSGCRNTDMDEVSEID[19] 1 100 0.0 255.0 ECU_ADDRESS 0x7001806f BYTE_ORDER MSB_LAST /end MEASUREMENT
/begin COMPU_METHOD CU_V2GRXMSGCRNTDMDEVSEID[19] "Conversion method for V2gRxMsgCrntDmdEvseId[19]" RAT_FUNC "%10.0" "1" COEFFS 0.000000 1.000000 -0.000000 0.000000 0.000000 1.000000 /end COMPU_METHOD
/* Scalar measurable for DDE 'V2gRxMsgCrntDmdEvseId[1]'. */
/begin MEASUREMENT V2gRxMsgCrntDmdEvseId[1] "The ID that uniquely identifies the EVSE. Format is defined in DIN SPEC 91286" UBYTE CU_V2GRXMSGCRNTDMDEVSEID[1] 1 100 0.0 255.0 ECU_ADDRESS 0x7001805d BYTE_ORDER MSB_LAST /end MEASUREMENT
/begin COMPU_METHOD CU_V2GRXMSGCRNTDMDEVSEID[1] "Conversion method for V2gRxMsgCrntDmdEvseId[1]" RAT_FUNC "%10.0" "1" COEFFS 0.000000 1.000000 -0.000000 0.000000 0.000000 1.000000 /end COMPU_METHOD
/* Scalar measurable for DDE 'V2gRxMsgCrntDmdEvseId[20]'. */
/begin MEASUREMENT V2gRxMsgCrntDmdEvseId[20] "The ID that uniquely identifies the EVSE. Format is defined in DIN SPEC 91286" UBYTE CU_V2GRXMSGCRNTDMDEVSEID[20] 1 100 0.0 255.0 ECU_ADDRESS 0x70018070 BYTE_ORDER MSB_LAST /end MEASUREMENT
/begin COMPU_METHOD CU_V2GRXMSGCRNTDMDEVSEID[20] "Conversion method for V2gRxMsgCrntDmdEvseId[20]" RAT_FUNC "%10.0" "1" COEFFS 0.000000 1.000000 -0.000000 0.000000 0.000000 1.000000 /end COMPU_METHOD
/* Scalar measurable for DDE 'V2gRxMsgCrntDmdEvseId[21]'. */
/begin MEASUREMENT V2gRxMsgCrntDmdEvseId[21] "The ID that uniquely identifies the EVSE. Format is defined in DIN SPEC 91286" UBYTE CU_V2GRXMSGCRNTDMDEVSEID[21] 1 100 0.0 255.0 ECU_ADDRESS 0x70018071 BYTE_ORDER MSB_LAST /end MEASUREMENT
/begin COMPU_METHOD CU_V2GRXMSGCRNTDMDEVSEID[21] "Conversion method for V2gRxMsgCrntDmdEvseId[21]" RAT_FUNC "%10.0" "1" COEFFS 0.000000 1.000000 -0.000000 0.000000 0.000000 1.000000 /end COMPU_METHOD
/* Scalar measurable for DDE 'V2gRxMsgCrntDmdEvseId[22]'. */
/begin MEASUREMENT V2gRxMsgCrntDmdEvseId[22] "The ID that uniquely identifies the EVSE. Format is defined in DIN SPEC 91286" UBYTE CU_V2GRXMSGCRNTDMDEVSEID[22] 1 100 0.0 255.0 ECU_ADDRESS 0x70018072 BYTE_ORDER MSB_LAST /end MEASUREMENT
/begin COMPU_METHOD CU_V2GRXMSGCRNTDMDEVSEID[22] "Conversion method for V2gRxMsgCrntDmdEvseId[22]" RAT_FUNC "%10.0" "1" COEFFS 0.000000 1.000000 -0.000000 0.000000 0.000000 1.000000 /end COMPU_METHOD
/* Scalar measurable for DDE 'V2gRxMsgCrntDmdEvseId[23]'. */
/begin MEASUREMENT V2gRxMsgCrntDmdEvseId[23] "The ID that uniquely identifies the EVSE. Format is defined in DIN SPEC 91286" UBYTE CU_V2GRXMSGCRNTDMDEVSEID[23] 1 100 0.0 255.0 ECU_ADDRESS 0x70018073 BYTE_ORDER MSB_LAST /end MEASUREMENT
/begin COMPU_METHOD CU_V2GRXMSGCRNTDMDEVSEID[23] "Conversion method for V2gRxMsgCrntDmdEvseId[23]" RAT_FUNC "%10.0" "1" COEFFS 0.000000 1.000000 -0.000000 0.000000 0.000000 1.000000 /end COMPU_METHOD
/begin FUNCTION Signals "Group /ByType/Signals"
 /begin LOC_MEASUREMENT Iso2EvseId[5] Iso2EvseId[6] Iso2EvseId[7] Iso2EvseId[8] Iso2EvseId[9] Iso2PmtSelEvseStatPres Iso2PmtSelNotif Iso2PmtSelNotifMaxDelay Iso2PmtSelRescode Iso2PmtSelRxTrg Iso2PreChgEvsePresVolt Iso2PreChgEvseStatPres Iso2PreChgNotif Iso2PreChgNotifMaxDelay Iso2PreChgRescode Iso2PreChgRxTrg Iso2PwrDelivEvseProcessing Iso2PwrDelivEvseStatPres Iso2PwrDelivNotif Iso2PwrDelivNotifMaxDelay Iso2PwrDelivRescode Iso2PwrDelivRxTrg Iso2SesSetupNotif Iso2SesSetupNotifMaxDelay Iso2SesSetupRescode Iso2SesSetupRxTrg Iso2SesSetupTimestmp Iso2SesSetupTimestmpPres Iso2SesStopEvseStatPres Iso2SesStopNotif Iso2SesStopNotifMaxDelay Iso2SesStopRescode Iso2SesStopRxTrg Iso2SvcDetailEvseMaxDelay Iso2SvcDetailEvseStatPres Iso2SvcDetailNotif Iso2SvcDetailRescode Iso2SvcDetailRxTrg Iso2SvcDetailSvcId Iso2SvcDetailSvcParamSetLen Iso2SvcDetailSvcParamSetSizes[1 Iso2SvcDetailSvcParamSetSizes[2 Iso2SvcDetailSvcParamSetSizes[0 Iso2SvcDetailSvcParamSetSizes[3 Iso2SvcDetailSvcParamSetSizes[4 Iso2SvcDiscEgyTrnsLen Iso2SvcDiscEgyTrnsSvcFreeSvc[0] Iso2SvcDiscEgyTrnsSvcFreeSvc[1] Iso2SvcDiscEgyTrnsSvcFreeSvc[2] Iso2SvcDiscEgyTrnsSvcFreeSvc[3] Iso2SvcDiscEgyTrnsSvcFreeSvc[4] Iso2SvcDiscEgyTrnsSvcFreeSvc[5] Iso2SvcDiscEgyTrnsSvcFreeSvc[6] Iso2SvcDiscEgyTrnsSvcFreeSvc[7] Iso2SvcDiscEgyTrnsSvcIds[0] Iso2SvcDiscEgyTrnsSvcIds[1] Iso2SvcDiscEgyTrnsSvcIds[2] Iso2SvcDiscEgyTrnsSvcIds[3] Iso2SvcDiscEgyTrnsSvcIds[4] Iso2SvcDiscEgyTrnsSvcIds[5] Iso2SvcDiscEgyTrnsSvcIds[6] Iso2SvcDiscEgyTrnsSvcIds[7] Iso2SvcDiscEvseStatPres Iso2SvcDiscNotif Iso2SvcDiscNotifMaxDelay Iso2SvcDiscRescode Iso2SvcDiscRxTrg Iso2SvcDiscVasListLen Iso2WeldDetEvsePresVolt Iso2WeldDetEvseStatPres Iso2WeldDetNotif Iso2WeldDetNotifMaxDelay Iso2WeldDetRescode Iso2WeldDetRxTrg K3_ignition_MaxFlt K3_ignition_MaxFltActv K3_ignition_MinFlt K3_ignition_MinFltActv M2_HbrNVmon_MaxFlt M2_HbrNVmon_MaxFltActv M2_HbrNVmon_MinFlt M2_HbrNVmon_MinFltActv M3_HbrPVmon_MaxFlt M3_HbrPVmon_MaxFltActv M3_HbrPVmon_MinFlt M3_HbrPVmon_MinFltActv NotEcuRunning NotShutdownFromLowBatt ParamSetIdSelected PregEcuDateOfManufactureAvaila0 PregEcuDateOfManufactureDay PregEcuDateOfManufactureMonth PregEcuDateOfManufactureShift PregEcuDateOfManufactureYear PregEcuEngineeringPartNumberAv0 PregEcuEngineeringPartNumberID PregEcuEngineeringPartNumberPa0 PregEcuEngineeringPartNumberPr0 PregEcuFactoryBuildTypeA PregEcuFactoryBuildTypeAvailab0 PregEcuFactoryBuildTypeB PregEcuFactoryIdA PregEcuFactoryIdB PregEcuFactoryPartA PregEcuFactoryPartB PregEcuFactoryPartNumAvailable PregEcuLowerWordSerialNumber PregEcuLowerWordSerialNumberAv0 PregEcuPcbIssue PregEcuPcbIssueAvailable PregEcuPcbMod PregEcuSerialNumberInfoAvailab0 PregEcuSerialNumberInfoFirstKey PregEcuSerialNumberInfoLength PregEcuUpperWordSerialAvailable PregEcuUpperWordSerialNumber ServiceIdSelected ShutdownCmd ShutdownDelayed ShutdownFromLowBatt SimRessSoc SimRessVolt SvcSearchSt SysCpuLoading SysResetType SysStackUsed SysTaskDurLoopA SysTaskDurLoopB SysTaskDurLoopC SysTaskDurLoopCcs SysTaskPeriodOverrunLoopA SysTaskPeriodOverrunLoopB SysTimeSinceWakeMillisecond SysTimeSinceWakeSecond TLF35584DataFrom[0] TLF35584DataFrom[10] TLF35584DataFrom[11] TLF35584DataFrom[12] TLF35584DataFrom[13] TLF35584DataFrom[14] TLF35584DataFrom[15] TLF35584DataFrom[16] TLF35584DataFrom[17] TLF35584DataFrom[18] TLF35584DataFrom[19] TLF35584DataFrom[1] TLF35584DataFrom[20] TLF35584DataFrom[21] TLF35584DataFrom[22] TLF35584DataFrom[23] TLF35584DataFrom[24] TLF35584DataFrom[2] TLF35584DataFrom[3] TLF35584DataFrom[4] TLF35584DataFrom[5] TLF35584DataFrom[6] TLF35584DataFrom[7] TLF35584DataFrom[8] TLF35584DataFrom[9] TLF35584GetJobResult TLF35584JobResult TLF35584RqstdCmd[0] TLF35584RqstdCmd[10] TLF35584RqstdCmd[11] TLF35584RqstdCmd[12] TLF35584RqstdCmd[13] TLF35584RqstdCmd[14] TLF35584RqstdCmd[15] TLF35584RqstdCmd[16] TLF35584RqstdCmd[17] TLF35584RqstdCmd[18] TLF35584RqstdCmd[19] TLF35584RqstdCmd[1] TLF35584RqstdCmd[20] TLF35584RqstdCmd[21] TLF35584RqstdCmd[22] TLF35584RqstdCmd[23] TLF35584RqstdCmd[24] TLF35584RqstdCmd[2] TLF35584RqstdCmd[3] TLF35584RqstdCmd[4] TLF35584RqstdCmd[5] TLF35584RqstdCmd[6] TLF35584RqstdCmd[7] TLF35584RqstdCmd[8] TLF35584RqstdCmd[9] TLF35584Send TLF35584Size TLF35584UserData[0] TLF35584UserData[10] TLF35584UserData[11] TLF35584UserData[12] TLF35584UserData[13] TLF35584UserData[14] TLF35584UserData[15] TLF35584UserData[16] TLF35584UserData[17] TLF35584UserData[18] TLF35584UserData[19] TLF35584UserData[1] TLF35584UserData[20] TLF35584UserData[21] TLF35584UserData[22] TLF35584UserData[23] TLF35584UserData[24] TLF35584UserData[2] TLF35584UserData[3] TLF35584UserData[4] TLF35584UserData[5] TLF35584UserData[6] TLF35584UserData[7] TLF35584UserData[8] TLF35584UserData[9] TempIntDegC_MaxFlt TempIntDegC_MaxFltActv TempIntDegC_MinFlt TempIntDegC_MinFltActv TempInt_MaxFlt TempInt_MaxFltActv TempInt_MinFlt TempInt_MinFltActv V2gEcuConnectionSt V2gEcuPlcChipStatus V2gEcuPlcLinkStatus V2gEcuQcaErrCode V2gEcuSlacEvseAvgAttenuation V2gEcuSlacSessionState V2gEcuSlacState V2gEcuTcpStatus V2gEcuUnmatchedSlacPhase V2gEcuV2gConnectionErrCode V2gEvccIpAddress[0] V2gEvccIpAddress[1] V2gEvccIpAddress[2] V2gEvccIpAddress[3] V2gEvccIpAddress[4] V2gEvccIpAddress[5] V2gEvccIpAddress[6] V2gEvccIpAddress[7] V2gEvccMacAddress[0] V2gEvccMacAddress[1] V2gEvccMacAddress[2] V2gEvccMacAddress[3] V2gEvccMacAddress[4] V2gEvccMacAddress[5] V2gEvccTcpPortNumber V2gEvseIpAddress[0] V2gEvseIpAddress[1] V2gEvseIpAddress[2] V2gEvseIpAddress[3] V2gEvseIpAddress[4] V2gEvseIpAddress[5] V2gEvseIpAddress[6] V2gEvseIpAddress[7] V2gEvseMacAddress[0] V2gEvseMacAddress[1] V2gEvseMacAddress[2] V2gEvseMacAddress[3] V2gEvseMacAddress[4] V2gEvseMacAddress[5] V2gEvseTcpPortNumber V2gRxMsgAuthEvseProcessing V2gRxMsgAuthNotif V2gRxMsgAuthNotifFlg V2gRxMsgAuthNotifMaxDelay V2gRxMsgAuthRescode V2gRxMsgAuthTrg V2gRxMsgBptCtrlChgMaxCrnt V2gRxMsgBptCtrlChgMaxCrnt_flg V2gRxMsgBptCtrlChgMaxPwr V2gRxMsgBptCtrlChgMaxPwr_flg V2gRxMsgBptCtrlCrntLimReached V2gRxMsgBptCtrlDchgMaxCrnt V2gRxMsgBptCtrlDchgMaxCrntFlg V2gRxMsgBptCtrlDchgMaxPwr V2gRxMsgBptCtrlDchgMaxPwr_flg V2gRxMsgBptCtrlEvseCurrent V2gRxMsgBptCtrlEvseIdLen V2gRxMsgBptCtrlEvseId[0] V2gRxMsgBptCtrlEvseId[10] V2gRxMsgBptCtrlEvseId[11] V2gRxMsgBptCtrlEvseId[12] V2gRxMsgBptCtrlEvseId[13] V2gRxMsgBptCtrlEvseId[14] V2gRxMsgBptCtrlEvseId[15] V2gRxMsgBptCtrlEvseId[16] V2gRxMsgBptCtrlEvseId[17] V2gRxMsgBptCtrlEvseId[18] V2gRxMsgBptCtrlEvseId[19] V2gRxMsgBptCtrlEvseId[1] V2gRxMsgBptCtrlEvseId[20] V2gRxMsgBptCtrlEvseId[21] V2gRxMsgBptCtrlEvseId[22] V2gRxMsgBptCtrlEvseId[23] V2gRxMsgBptCtrlEvseId[24] V2gRxMsgBptCtrlEvseId[25] V2gRxMsgBptCtrlEvseId[26] V2gRxMsgBptCtrlEvseId[27] V2gRxMsgBptCtrlEvseId[28] V2gRxMsgBptCtrlEvseId[29] V2gRxMsgBptCtrlEvseId[2] V2gRxMsgBptCtrlEvseId[30] V2gRxMsgBptCtrlEvseId[31] V2gRxMsgBptCtrlEvseId[32] V2gRxMsgBptCtrlEvseId[33] V2gRxMsgBptCtrlEvseId[34] V2gRxMsgBptCtrlEvseId[35] V2gRxMsgBptCtrlEvseId[36] V2gRxMsgBptCtrlEvseId[37] V2gRxMsgBptCtrlEvseId[3] V2gRxMsgBptCtrlEvseId[4] V2gRxMsgBptCtrlEvseId[5] V2gRxMsgBptCtrlEvseId[6] V2gRxMsgBptCtrlEvseId[7] V2gRxMsgBptCtrlEvseId[8] V2gRxMsgBptCtrlEvseId[9] V2gRxMsgBptCtrlEvseMaxVolt V2gRxMsgBptCtrlEvseMaxVoltFlg V2gRxMsgBptCtrlEvseMinVolt V2gRxMsgBptCtrlEvseMinVoltFlg V2gRxMsgBptCtrlEvseVoltage V2gRxMsgBptCtrlNotif V2gRxMsgBptCtrlNotifFlg V2gRxMsgBptCtrlNotifMaxDelay V2gRxMsgBptCtrlPwrLimReached V2gRxMsgBptCtrlRescode V2gRxMsgBptCtrlSASchTupId V2gRxMsgBptCtrlSASchTupIdFlg V2gRxMsgBptCtrlTrg V2gRxMsgBptCtrlVoltLimReached V2gRxMsgCblChkEvseProcessing V2gRxMsgCblChkEvseStatus V2gRxMsgCblChkIsolStatus V2gRxMsgCblChkIsolStatus_flg V2gRxMsgCblChkNotif V2gRxMsgCblChkNotifFlg V2gRxMsgCblChkNotifMaxDelay V2gRxMsgCblChkRescode V2gRxMsgCblChkTrg V2gRxMsgChgParDscCrntRegTol V2gRxMsgChgParDscCrntRegTol_flg V2gRxMsgChgParDscDchgMaxCrnt V2gRxMsgChgParDscDchgMaxCrntFlg V2gRxMsgChgParDscDchgMaxPwr V2gRxMsgChgParDscDchgMaxPwr_flg V2gRxMsgChgParDscDchgMinCrnt V2gRxMsgChgParDscDchgMinCrntFlg V2gRxMsgChgParDscEgy2Deliv V2gRxMsgChgParDscEgy2DelivFlg V2gRxMsgChgParDscEvseProcessing V2gRxMsgChgParDscEvseStatus V2gRxMsgChgParDscEvseStatus_flg V2gRxMsgChgParDscIsolStatus V2gRxMsgChgParDscIsolStatus_flg V2gRxMsgChgParDscMaxCrnt V2gRxMsgChgParDscMaxCrnt_flg V2gRxMsgChgParDscMaxPwr V2gRxMsgChgParDscMaxPwr_flg V2gRxMsgChgParDscMaxVolt V2gRxMsgChgParDscMaxVolt_flg V2gRxMsgChgParDscMinCrnt V2gRxMsgChgParDscMinCrnt_flg V2gRxMsgChgParDscMinVolt V2gRxMsgChgParDscMinVolt_flg V2gRxMsgChgParDscNotif V2gRxMsgChgParDscNotifFlg V2gRxMsgChgParDscNotifMaxDelay V2gRxMsgChgParDscPkRipple V2gRxMsgChgParDscPkRipple_flg V2gRxMsgChgParDscRescode V2gRxMsgChgParDscTrg V2gRxMsgCrntDmdCrntLimReached V2gRxMsgCrntDmdEvseCurrent V2gRxMsgCrntDmdEvseIdLen V2gRxMsgCrntDmdEvseId[0] V2gRxMsgCrntDmdEvseId[10] V2gRxMsgCrntDmdEvseId[11] V2gRxMsgCrntDmdEvseId[12] V2gRxMsgCrntDmdEvseId[13] V2gRxMsgCrntDmdEvseId[14] V2gRxMsgCrntDmdEvseId[15] V2gRxMsgCrntDmdEvseId[16] V2gRxMsgCrntDmdEvseId[17] V2gRxMsgCrntDmdEvseId[18] V2gRxMsgCrntDmdEvseId[19] V2gRxMsgCrntDmdEvseId[1] V2gRxMsgCrntDmdEvseId[20] V2gRxMsgCrntDmdEvseId[21] V2gRxMsgCrntDmdEvseId[22] V2gRxMsgCrntDmdEvseId[23] /end LOC_MEASUREMENT
/end FUNCTION
/end MODULE
/end PROJECT
