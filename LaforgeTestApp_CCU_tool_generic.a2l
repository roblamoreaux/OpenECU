ASAP2_VERSION 1 31
/begin PROJECT LaForge_CCU_TestApp "Test Application for LaForge TC367"
/begin HEADER "Dana" VERSION "0_3_1" /end HEADER
/begin MODULE OpenECU_TC367_001 ""
/* Scalar measurable for DDE 'mpl_error_log_detailed[3].err_log.cpu_log.dpre[3]'. */
/begin MEASUREMENT mpl_error_log_detailed[3].err16 "CPU/MPU data protection read enable configuration register" ULONG CU_MPL_ERROR_LOG_DETAILED[3].18 1 100 0.0 4294967295.0 ECU_ADDRESS 0xf0240a2c BYTE_ORDER MSB_LAST /end MEASUREMENT
/begin COMPU_METHOD CU_MPL_ERROR_LOG_DETAILED[3].18 "Conversion method for mpl_error_log_detailed[3].err_log.cpu_log.dpre[3]" RAT_FUNC "%10.0" "(not defined)" COEFFS 0.000000 1.000000 -0.000000 0.000000 0.000000 1.000000 /end COMPU_METHOD
/* Scalar measurable for DDE 'mpl_error_log_detailed[3].err_log.cpu_log.dpre[4]'. */
/begin MEASUREMENT mpl_error_log_detailed[3].err61 "CPU/MPU data protection read enable configuration register" ULONG CU_MPL_ERROR_LOG_DETAILED[3].64 1 100 0.0 4294967295.0 ECU_ADDRESS 0xf0240a30 BYTE_ORDER MSB_LAST /end MEASUREMENT
/begin COMPU_METHOD CU_MPL_ERROR_LOG_DETAILED[3].64 "Conversion method for mpl_error_log_detailed[3].err_log.cpu_log.dpre[4]" RAT_FUNC "%10.0" "(not defined)" COEFFS 0.000000 1.000000 -0.000000 0.000000 0.000000 1.000000 /end COMPU_METHOD
/* Scalar measurable for DDE 'mpl_error_log_detailed[3].err_log.cpu_log.dpre[5]'. */
/begin MEASUREMENT mpl_error_log_detailed[3].err73 "CPU/MPU data protection read enable configuration register" ULONG CU_MPL_ERROR_LOG_DETAILED[3].76 1 100 0.0 4294967295.0 ECU_ADDRESS 0xf0240a34 BYTE_ORDER MSB_LAST /end MEASUREMENT
/begin COMPU_METHOD CU_MPL_ERROR_LOG_DETAILED[3].76 "Conversion method for mpl_error_log_detailed[3].err_log.cpu_log.dpre[5]" RAT_FUNC "%10.0" "(not defined)" COEFFS 0.000000 1.000000 -0.000000 0.000000 0.000000 1.000000 /end COMPU_METHOD
/* Scalar measurable for DDE 'mpl_error_log_detailed[3].err_log.cpu_log.dpwe[0]'. */
/begin MEASUREMENT mpl_error_log_detailed[3].err93 "CPU/MPU data protection write enable configuration register" ULONG CU_MPL_ERROR_LOG_DETAILED[3].96 1 100 0.0 4294967295.0 ECU_ADDRESS 0xf0240a38 BYTE_ORDER MSB_LAST /end MEASUREMENT
/begin COMPU_METHOD CU_MPL_ERROR_LOG_DETAILED[3].96 "Conversion method for mpl_error_log_detailed[3].err_log.cpu_log.dpwe[0]" RAT_FUNC "%10.0" "(not defined)" COEFFS 0.000000 1.000000 -0.000000 0.000000 0.000000 1.000000 /end COMPU_METHOD
/* Scalar measurable for DDE 'mpl_error_log_detailed[3].err_log.cpu_log.dpwe[1]'. */
/begin MEASUREMENT mpl_error_log_detailed[3].err44 "CPU/MPU data protection write enable configuration register" ULONG CU_MPL_ERROR_LOG_DETAILED[3].46 1 100 0.0 4294967295.0 ECU_ADDRESS 0xf0240a3c BYTE_ORDER MSB_LAST /end MEASUREMENT
/begin COMPU_METHOD CU_MPL_ERROR_LOG_DETAILED[3].46 "Conversion method for mpl_error_log_detailed[3].err_log.cpu_log.dpwe[1]" RAT_FUNC "%10.0" "(not defined)" COEFFS 0.000000 1.000000 -0.000000 0.000000 0.000000 1.000000 /end COMPU_METHOD
/* Scalar measurable for DDE 'mpl_error_log_detailed[3].err_log.cpu_log.dpwe[2]'. */
/begin MEASUREMENT mpl_error_log_detailed[3].err80 "CPU/MPU data protection write enable configuration register" ULONG CU_MPL_ERROR_LOG_DETAILED[3].83 1 100 0.0 4294967295.0 ECU_ADDRESS 0xf0240a40 BYTE_ORDER MSB_LAST /end MEASUREMENT
/begin COMPU_METHOD CU_MPL_ERROR_LOG_DETAILED[3].83 "Conversion method for mpl_error_log_detailed[3].err_log.cpu_log.dpwe[2]" RAT_FUNC "%10.0" "(not defined)" COEFFS 0.000000 1.000000 -0.000000 0.000000 0.000000 1.000000 /end COMPU_METHOD
/* Scalar measurable for DDE 'mpl_error_log_detailed[3].err_log.cpu_log.dpwe[3]'. */
/begin MEASUREMENT mpl_error_log_detailed[3].err60 "CPU/MPU data protection write enable configuration register" ULONG CU_MPL_ERROR_LOG_DETAILED[3].63 1 100 0.0 4294967295.0 ECU_ADDRESS 0xf0240a44 BYTE_ORDER MSB_LAST /end MEASUREMENT
/begin COMPU_METHOD CU_MPL_ERROR_LOG_DETAILED[3].63 "Conversion method for mpl_error_log_detailed[3].err_log.cpu_log.dpwe[3]" RAT_FUNC "%10.0" "(not defined)" COEFFS 0.000000 1.000000 -0.000000 0.000000 0.000000 1.000000 /end COMPU_METHOD
/* Scalar measurable for DDE 'mpl_error_log_detailed[3].err_log.cpu_log.dpwe[4]'. */
/begin MEASUREMENT mpl_error_log_detailed[3].err_1 "CPU/MPU data protection write enable configuration register" ULONG CU_MPL_ERROR_LOG_DETAILED[3].E1 1 100 0.0 4294967295.0 ECU_ADDRESS 0xf0240a48 BYTE_ORDER MSB_LAST /end MEASUREMENT
/begin COMPU_METHOD CU_MPL_ERROR_LOG_DETAILED[3].E1 "Conversion method for mpl_error_log_detailed[3].err_log.cpu_log.dpwe[4]" RAT_FUNC "%10.0" "(not defined)" COEFFS 0.000000 1.000000 -0.000000 0.000000 0.000000 1.000000 /end COMPU_METHOD
/* Scalar measurable for DDE 'mpl_error_log_detailed[3].err_log.cpu_log.dpwe[5]'. */
/begin MEASUREMENT mpl_error_log_detailed[3].err54 "CPU/MPU data protection write enable configuration register" ULONG CU_MPL_ERROR_LOG_DETAILED[3].57 1 100 0.0 4294967295.0 ECU_ADDRESS 0xf0240a4c BYTE_ORDER MSB_LAST /end MEASUREMENT
/begin COMPU_METHOD CU_MPL_ERROR_LOG_DETAILED[3].57 "Conversion method for mpl_error_log_detailed[3].err_log.cpu_log.dpwe[5]" RAT_FUNC "%10.0" "(not defined)" COEFFS 0.000000 1.000000 -0.000000 0.000000 0.000000 1.000000 /end COMPU_METHOD
/* Scalar measurable for DDE 'mpl_error_log_detailed[3].err_log.cpu_log.dstr'. */
/begin MEASUREMENT mpl_error_log_detailed[3].err37 "CPU data synchronous error trap register" ULONG CU_MPL_ERROR_LOG_DETAILED[3].39 1 100 0.0 4294967295.0 ECU_ADDRESS 0xf02408e8 BYTE_ORDER MSB_LAST /end MEASUREMENT
/begin COMPU_METHOD CU_MPL_ERROR_LOG_DETAILED[3].39 "Conversion method for mpl_error_log_detailed[3].err_log.cpu_log.dstr" RAT_FUNC "%10.0" "(not defined)" COEFFS 0.000000 1.000000 -0.000000 0.000000 0.000000 1.000000 /end COMPU_METHOD
/* Scalar measurable for DDE 'mpl_error_log_detailed[3].err_log.cpu_log.fcx'. */
/begin MEASUREMENT mpl_error_log_detailed[3].err08 "CPU free context list head pointer register" ULONG CU_MPL_ERROR_LOG_DETAILED[3].10 1 100 0.0 4294967295.0 ECU_ADDRESS 0xf0240a5c BYTE_ORDER MSB_LAST /end MEASUREMENT
/begin COMPU_METHOD CU_MPL_ERROR_LOG_DETAILED[3].10 "Conversion method for mpl_error_log_detailed[3].err_log.cpu_log.fcx" RAT_FUNC "%10.0" "(not defined)" COEFFS 0.000000 1.000000 -0.000000 0.000000 0.000000 1.000000 /end COMPU_METHOD
/* Scalar measurable for DDE 'mpl_error_log_detailed[3].err_log.cpu_log.flashcon0'. */
/begin MEASUREMENT mpl_error_log_detailed[3].er039 "CPU flash configuration register" ULONG CU_MPL_ERROR_LOG_DETAILED[3]042 1 100 0.0 4294967295.0 ECU_ADDRESS 0xf0240a70 BYTE_ORDER MSB_LAST /end MEASUREMENT
/begin COMPU_METHOD CU_MPL_ERROR_LOG_DETAILED[3]042 "Conversion method for mpl_error_log_detailed[3].err_log.cpu_log.flashcon0" RAT_FUNC "%10.0" "(not defined)" COEFFS 0.000000 1.000000 -0.000000 0.000000 0.000000 1.000000 /end COMPU_METHOD
/* Scalar measurable for DDE 'mpl_error_log_detailed[3].err_log.cpu_log.flashcon1'. */
/begin MEASUREMENT mpl_error_log_detailed[3].er038 "CPU flash configuration register" ULONG CU_MPL_ERROR_LOG_DETAILED[3]041 1 100 0.0 4294967295.0 ECU_ADDRESS 0xf0240a74 BYTE_ORDER MSB_LAST /end MEASUREMENT
/begin COMPU_METHOD CU_MPL_ERROR_LOG_DETAILED[3]041 "Conversion method for mpl_error_log_detailed[3].err_log.cpu_log.flashcon1" RAT_FUNC "%10.0" "(not defined)" COEFFS 0.000000 1.000000 -0.000000 0.000000 0.000000 1.000000 /end COMPU_METHOD
/* Scalar measurable for DDE 'mpl_error_log_detailed[3].err_log.cpu_log.flashcon2'. */
/begin MEASUREMENT mpl_error_log_detailed[3].er037 "CPU flash configuration register" ULONG CU_MPL_ERROR_LOG_DETAILED[3]040 1 100 0.0 4294967295.0 ECU_ADDRESS 0xf0240a78 BYTE_ORDER MSB_LAST /end MEASUREMENT
/begin COMPU_METHOD CU_MPL_ERROR_LOG_DETAILED[3]040 "Conversion method for mpl_error_log_detailed[3].err_log.cpu_log.flashcon2" RAT_FUNC "%10.0" "(not defined)" COEFFS 0.000000 1.000000 -0.000000 0.000000 0.000000 1.000000 /end COMPU_METHOD
/* Scalar measurable for DDE 'mpl_error_log_detailed[3].err_log.cpu_log.flashcon3'. */
/begin MEASUREMENT mpl_error_log_detailed[3].er036 "CPU flash configuration register" ULONG CU_MPL_ERROR_LOG_DETAILED[3]039 1 100 0.0 4294967295.0 ECU_ADDRESS 0xf0240a7c BYTE_ORDER MSB_LAST /end MEASUREMENT
/begin COMPU_METHOD CU_MPL_ERROR_LOG_DETAILED[3]039 "Conversion method for mpl_error_log_detailed[3].err_log.cpu_log.flashcon3" RAT_FUNC "%10.0" "(not defined)" COEFFS 0.000000 1.000000 -0.000000 0.000000 0.000000 1.000000 /end COMPU_METHOD
/* Scalar measurable for DDE 'mpl_error_log_detailed[3].err_log.cpu_log.fpu_trap_con'. */
/begin MEASUREMENT mpl_error_log_detailed[3].er001 "CPU/FPU trap control register" ULONG CU_MPL_ERROR_LOG_DETAILED[3]004 1 100 0.0 4294967295.0 ECU_ADDRESS 0xf0240910 BYTE_ORDER MSB_LAST /end MEASUREMENT
/begin COMPU_METHOD CU_MPL_ERROR_LOG_DETAILED[3]004 "Conversion method for mpl_error_log_detailed[3].err_log.cpu_log.fpu_trap_con" RAT_FUNC "%10.0" "(not defined)" COEFFS 0.000000 1.000000 -0.000000 0.000000 0.000000 1.000000 /end COMPU_METHOD
/* Scalar measurable for DDE 'mpl_error_log_detailed[3].err_log.cpu_log.fpu_trap_opc'. */
/begin MEASUREMENT mpl_error_log_detailed[3].er016 "CPU/FPU trap instruction opcode register" ULONG CU_MPL_ERROR_LOG_DETAILED[3]019 1 100 0.0 4294967295.0 ECU_ADDRESS 0xf0240918 BYTE_ORDER MSB_LAST /end MEASUREMENT
/begin COMPU_METHOD CU_MPL_ERROR_LOG_DETAILED[3]019 "Conversion method for mpl_error_log_detailed[3].err_log.cpu_log.fpu_trap_opc" RAT_FUNC "%10.0" "(not defined)" COEFFS 0.000000 1.000000 -0.000000 0.000000 0.000000 1.000000 /end COMPU_METHOD
/* Scalar measurable for DDE 'mpl_error_log_detailed[3].err_log.cpu_log.fpu_trap_pc'. */
/begin MEASUREMENT mpl_error_log_detailed[3].err81 "CPU/FPU trap instruction program control register" ULONG CU_MPL_ERROR_LOG_DETAILED[3].84 1 100 0.0 4294967295.0 ECU_ADDRESS 0xf0240914 BYTE_ORDER MSB_LAST /end MEASUREMENT
/begin COMPU_METHOD CU_MPL_ERROR_LOG_DETAILED[3].84 "Conversion method for mpl_error_log_detailed[3].err_log.cpu_log.fpu_trap_pc" RAT_FUNC "%10.0" "(not defined)" COEFFS 0.000000 1.000000 -0.000000 0.000000 0.000000 1.000000 /end COMPU_METHOD
/* Scalar measurable for DDE 'mpl_error_log_detailed[3].err_log.cpu_log.fpu_trap_src1'. */
/begin MEASUREMENT mpl_error_log_detailed[3].err94 "CPU/FPU trap instruction operand register" ULONG CU_MPL_ERROR_LOG_DETAILED[3].97 1 100 0.0 4294967295.0 ECU_ADDRESS 0xf024091c BYTE_ORDER MSB_LAST /end MEASUREMENT
/begin COMPU_METHOD CU_MPL_ERROR_LOG_DETAILED[3].97 "Conversion method for mpl_error_log_detailed[3].err_log.cpu_log.fpu_trap_src1" RAT_FUNC "%10.0" "(not defined)" COEFFS 0.000000 1.000000 -0.000000 0.000000 0.000000 1.000000 /end COMPU_METHOD
/* Scalar measurable for DDE 'mpl_error_log_detailed[3].err_log.cpu_log.fpu_trap_src2'. */
/begin MEASUREMENT mpl_error_log_detailed[3].err29 "CPU/FPU trap instruction operand register" ULONG CU_MPL_ERROR_LOG_DETAILED[3].31 1 100 0.0 4294967295.0 ECU_ADDRESS 0xf0240920 BYTE_ORDER MSB_LAST /end MEASUREMENT
/begin COMPU_METHOD CU_MPL_ERROR_LOG_DETAILED[3].31 "Conversion method for mpl_error_log_detailed[3].err_log.cpu_log.fpu_trap_src2" RAT_FUNC "%10.0" "(not defined)" COEFFS 0.000000 1.000000 -0.000000 0.000000 0.000000 1.000000 /end COMPU_METHOD
/* Scalar measurable for DDE 'mpl_error_log_detailed[3].err_log.cpu_log.fpu_trap_src3'. */
/begin MEASUREMENT mpl_error_log_detailed[3].err28 "CPU/FPU trap instruction operand register" ULONG CU_MPL_ERROR_LOG_DETAILED[3].30 1 100 0.0 4294967295.0 ECU_ADDRESS 0xf0240924 BYTE_ORDER MSB_LAST /end MEASUREMENT
/begin COMPU_METHOD CU_MPL_ERROR_LOG_DETAILED[3].30 "Conversion method for mpl_error_log_detailed[3].err_log.cpu_log.fpu_trap_src3" RAT_FUNC "%10.0" "(not defined)" COEFFS 0.000000 1.000000 -0.000000 0.000000 0.000000 1.000000 /end COMPU_METHOD
/* Scalar measurable for DDE 'mpl_error_log_detailed[3].err_log.cpu_log.icr'. */
/begin MEASUREMENT mpl_error_log_detailed[3].err39 "CPU interrupt control register" ULONG CU_MPL_ERROR_LOG_DETAILED[3].41 1 100 0.0 4294967295.0 ECU_ADDRESS 0xf0240a54 BYTE_ORDER MSB_LAST /end MEASUREMENT
/begin COMPU_METHOD CU_MPL_ERROR_LOG_DETAILED[3].41 "Conversion method for mpl_error_log_detailed[3].err_log.cpu_log.icr" RAT_FUNC "%10.0" "(not defined)" COEFFS 0.000000 1.000000 -0.000000 0.000000 0.000000 1.000000 /end COMPU_METHOD
/* Scalar measurable for DDE 'mpl_error_log_detailed[3].err_log.cpu_log.isp'. */
/begin MEASUREMENT mpl_error_log_detailed[3].er020 "CPU interrupt stack pointer register" ULONG CU_MPL_ERROR_LOG_DETAILED[3]023 1 100 0.0 4294967295.0 ECU_ADDRESS 0xf0240a58 BYTE_ORDER MSB_LAST /end MEASUREMENT
/begin COMPU_METHOD CU_MPL_ERROR_LOG_DETAILED[3]023 "Conversion method for mpl_error_log_detailed[3].err_log.cpu_log.isp" RAT_FUNC "%10.0" "(not defined)" COEFFS 0.000000 1.000000 -0.000000 0.000000 0.000000 1.000000 /end COMPU_METHOD
/* Scalar measurable for DDE 'mpl_error_log_detailed[3].err_log.cpu_log.lcx'. */
/begin MEASUREMENT mpl_error_log_detailed[3].err53 "CPU free context list limit pointer register" ULONG CU_MPL_ERROR_LOG_DETAILED[3].56 1 100 0.0 4294967295.0 ECU_ADDRESS 0xf0240a60 BYTE_ORDER MSB_LAST /end MEASUREMENT
/begin COMPU_METHOD CU_MPL_ERROR_LOG_DETAILED[3].56 "Conversion method for mpl_error_log_detailed[3].err_log.cpu_log.lcx" RAT_FUNC "%10.0" "(not defined)" COEFFS 0.000000 1.000000 -0.000000 0.000000 0.000000 1.000000 /end COMPU_METHOD
/* Scalar measurable for DDE 'mpl_error_log_detailed[3].err_log.cpu_log.pcon0'. */
/begin MEASUREMENT mpl_error_log_detailed[3].er014 "CPU program memory configuration register" ULONG CU_MPL_ERROR_LOG_DETAILED[3]017 1 100 0.0 4294967295.0 ECU_ADDRESS 0xf02408fc BYTE_ORDER MSB_LAST /end MEASUREMENT
/begin COMPU_METHOD CU_MPL_ERROR_LOG_DETAILED[3]017 "Conversion method for mpl_error_log_detailed[3].err_log.cpu_log.pcon0" RAT_FUNC "%10.0" "(not defined)" COEFFS 0.000000 1.000000 -0.000000 0.000000 0.000000 1.000000 /end COMPU_METHOD
/* Scalar measurable for DDE 'mpl_error_log_detailed[3].err_log.cpu_log.pcon1'. */
/begin MEASUREMENT mpl_error_log_detailed[3].er013 "CPU program memory configuration register" ULONG CU_MPL_ERROR_LOG_DETAILED[3]016 1 100 0.0 4294967295.0 ECU_ADDRESS 0xf0240900 BYTE_ORDER MSB_LAST /end MEASUREMENT
/begin COMPU_METHOD CU_MPL_ERROR_LOG_DETAILED[3]016 "Conversion method for mpl_error_log_detailed[3].err_log.cpu_log.pcon1" RAT_FUNC "%10.0" "(not defined)" COEFFS 0.000000 1.000000 -0.000000 0.000000 0.000000 1.000000 /end COMPU_METHOD
/* Scalar measurable for DDE 'mpl_error_log_detailed[3].err_log.cpu_log.pcon2'. */
/begin MEASUREMENT mpl_error_log_detailed[3].er032 "CPU program memory configuration register" ULONG CU_MPL_ERROR_LOG_DETAILED[3]035 1 100 0.0 4294967295.0 ECU_ADDRESS 0xf0240904 BYTE_ORDER MSB_LAST /end MEASUREMENT
/begin COMPU_METHOD CU_MPL_ERROR_LOG_DETAILED[3]035 "Conversion method for mpl_error_log_detailed[3].err_log.cpu_log.pcon2" RAT_FUNC "%10.0" "(not defined)" COEFFS 0.000000 1.000000 -0.000000 0.000000 0.000000 1.000000 /end COMPU_METHOD
/* Scalar measurable for DDE 'mpl_error_log_detailed[3].err_log.cpu_log.piear'. */
/begin MEASUREMENT mpl_error_log_detailed[3].err48 "CPU program integrity error address register" ULONG CU_MPL_ERROR_LOG_DETAILED[3].50 1 100 0.0 4294967295.0 ECU_ADDRESS 0xf0240908 BYTE_ORDER MSB_LAST /end MEASUREMENT
/begin COMPU_METHOD CU_MPL_ERROR_LOG_DETAILED[3].50 "Conversion method for mpl_error_log_detailed[3].err_log.cpu_log.piear" RAT_FUNC "%10.0" "(not defined)" COEFFS 0.000000 1.000000 -0.000000 0.000000 0.000000 1.000000 /end COMPU_METHOD
/* Scalar measurable for DDE 'mpl_error_log_detailed[3].err_log.cpu_log.pietr'. */
/begin MEASUREMENT mpl_error_log_detailed[3].err19 "CPU program integrity error trap register" ULONG CU_MPL_ERROR_LOG_DETAILED[3].21 1 100 0.0 4294967295.0 ECU_ADDRESS 0xf024090c BYTE_ORDER MSB_LAST /end MEASUREMENT
/begin COMPU_METHOD CU_MPL_ERROR_LOG_DETAILED[3].21 "Conversion method for mpl_error_log_detailed[3].err_log.cpu_log.pietr" RAT_FUNC "%10.0" "(not defined)" COEFFS 0.000000 1.000000 -0.000000 0.000000 0.000000 1.000000 /end COMPU_METHOD
/* Scalar measurable for DDE 'mpl_error_log_detailed[3].err_log.cpu_log.syscon'. */
/begin MEASUREMENT mpl_error_log_detailed[3].err03 "CPU system configuration register" ULONG CU_MPL_ERROR_LOG_DETAILED[3].04 1 100 0.0 4294967295.0 ECU_ADDRESS 0xf0240a6c BYTE_ORDER MSB_LAST /end MEASUREMENT
/begin COMPU_METHOD CU_MPL_ERROR_LOG_DETAILED[3].04 "Conversion method for mpl_error_log_detailed[3].err_log.cpu_log.syscon" RAT_FUNC "%10.0" "(not defined)" COEFFS 0.000000 1.000000 -0.000000 0.000000 0.000000 1.000000 /end COMPU_METHOD
/* Scalar measurable for DDE 'mpl_error_log_detailed[3].err_log.cpu_log.tps_con'. */
/begin MEASUREMENT mpl_error_log_detailed[3].er003 "CPU temporal protection system control register" ULONG CU_MPL_ERROR_LOG_DETAILED[3]006 1 100 0.0 4294967295.0 ECU_ADDRESS 0xf0240a50 BYTE_ORDER MSB_LAST /end MEASUREMENT
/begin COMPU_METHOD CU_MPL_ERROR_LOG_DETAILED[3]006 "Conversion method for mpl_error_log_detailed[3].err_log.cpu_log.tps_con" RAT_FUNC "%10.0" "(not defined)" COEFFS 0.000000 1.000000 -0.000000 0.000000 0.000000 1.000000 /end COMPU_METHOD
/* Scalar measurable for DDE 'mpl_error_log_detailed[3].err_log.csa.lower.A2'. */
/begin MEASUREMENT mpl_error_log_detailed[3].err11 "CPU address register" ULONG CU_MPL_ERROR_LOG_DETAILED[3].13 1 100 0.0 4294967295.0 ECU_ADDRESS 0xf02408b0 BYTE_ORDER MSB_LAST /end MEASUREMENT
/begin COMPU_METHOD CU_MPL_ERROR_LOG_DETAILED[3].13 "Conversion method for mpl_error_log_detailed[3].err_log.csa.lower.A2" RAT_FUNC "%10.0" "(not defined)" COEFFS 0.000000 1.000000 -0.000000 0.000000 0.000000 1.000000 /end COMPU_METHOD
/* Scalar measurable for DDE 'mpl_error_log_detailed[3].err_log.csa.lower.A3'. */
/begin MEASUREMENT mpl_error_log_detailed[3].err12 "CPU address register" ULONG CU_MPL_ERROR_LOG_DETAILED[3].14 1 100 0.0 4294967295.0 ECU_ADDRESS 0xf02408b4 BYTE_ORDER MSB_LAST /end MEASUREMENT
/begin COMPU_METHOD CU_MPL_ERROR_LOG_DETAILED[3].14 "Conversion method for mpl_error_log_detailed[3].err_log.csa.lower.A3" RAT_FUNC "%10.0" "(not defined)" COEFFS 0.000000 1.000000 -0.000000 0.000000 0.000000 1.000000 /end COMPU_METHOD
/* Scalar measurable for DDE 'mpl_error_log_detailed[3].err_log.csa.lower.A4'. */
/begin MEASUREMENT mpl_error_log_detailed[3].err14 "CPU address register" ULONG CU_MPL_ERROR_LOG_DETAILED[3].16 1 100 0.0 4294967295.0 ECU_ADDRESS 0xf02408c8 BYTE_ORDER MSB_LAST /end MEASUREMENT
/begin COMPU_METHOD CU_MPL_ERROR_LOG_DETAILED[3].16 "Conversion method for mpl_error_log_detailed[3].err_log.csa.lower.A4" RAT_FUNC "%10.0" "(not defined)" COEFFS 0.000000 1.000000 -0.000000 0.000000 0.000000 1.000000 /end COMPU_METHOD
/* Scalar measurable for DDE 'mpl_error_log_detailed[3].err_log.csa.lower.A5'. */
/begin MEASUREMENT mpl_error_log_detailed[3].err15 "CPU address register" ULONG CU_MPL_ERROR_LOG_DETAILED[3].17 1 100 0.0 4294967295.0 ECU_ADDRESS 0xf02408cc BYTE_ORDER MSB_LAST /end MEASUREMENT
/begin COMPU_METHOD CU_MPL_ERROR_LOG_DETAILED[3].17 "Conversion method for mpl_error_log_detailed[3].err_log.csa.lower.A5" RAT_FUNC "%10.0" "(not defined)" COEFFS 0.000000 1.000000 -0.000000 0.000000 0.000000 1.000000 /end COMPU_METHOD
/* Scalar measurable for DDE 'mpl_error_log_detailed[3].err_log.csa.lower.A6'. */
/begin MEASUREMENT mpl_error_log_detailed[3].err66 "CPU address register" ULONG CU_MPL_ERROR_LOG_DETAILED[3].69 1 100 0.0 4294967295.0 ECU_ADDRESS 0xf02408d0 BYTE_ORDER MSB_LAST /end MEASUREMENT
/begin COMPU_METHOD CU_MPL_ERROR_LOG_DETAILED[3].69 "Conversion method for mpl_error_log_detailed[3].err_log.csa.lower.A6" RAT_FUNC "%10.0" "(not defined)" COEFFS 0.000000 1.000000 -0.000000 0.000000 0.000000 1.000000 /end COMPU_METHOD
/* Scalar measurable for DDE 'mpl_error_log_detailed[3].err_log.csa.lower.A7'. */
/begin MEASUREMENT mpl_error_log_detailed[3].err13 "CPU address register" ULONG CU_MPL_ERROR_LOG_DETAILED[3].15 1 100 0.0 4294967295.0 ECU_ADDRESS 0xf02408d4 BYTE_ORDER MSB_LAST /end MEASUREMENT
/begin COMPU_METHOD CU_MPL_ERROR_LOG_DETAILED[3].15 "Conversion method for mpl_error_log_detailed[3].err_log.csa.lower.A7" RAT_FUNC "%10.0" "(not defined)" COEFFS 0.000000 1.000000 -0.000000 0.000000 0.000000 1.000000 /end COMPU_METHOD
/* Scalar measurable for DDE 'mpl_error_log_detailed[3].err_log.csa.lower.D0'. */
/begin MEASUREMENT mpl_error_log_detailed[3].err69 "CPU data register" ULONG CU_MPL_ERROR_LOG_DETAILED[3].72 1 100 0.0 4294967295.0 ECU_ADDRESS 0xf02408b8 BYTE_ORDER MSB_LAST /end MEASUREMENT
/begin COMPU_METHOD CU_MPL_ERROR_LOG_DETAILED[3].72 "Conversion method for mpl_error_log_detailed[3].err_log.csa.lower.D0" RAT_FUNC "%10.0" "(not defined)" COEFFS 0.000000 1.000000 -0.000000 0.000000 0.000000 1.000000 /end COMPU_METHOD
/* Scalar measurable for DDE 'mpl_error_log_detailed[3].err_log.csa.lower.D1'. */
/begin MEASUREMENT mpl_error_log_detailed[3].er030 "CPU data register" ULONG CU_MPL_ERROR_LOG_DETAILED[3]033 1 100 0.0 4294967295.0 ECU_ADDRESS 0xf02408bc BYTE_ORDER MSB_LAST /end MEASUREMENT
/begin COMPU_METHOD CU_MPL_ERROR_LOG_DETAILED[3]033 "Conversion method for mpl_error_log_detailed[3].err_log.csa.lower.D1" RAT_FUNC "%10.0" "(not defined)" COEFFS 0.000000 1.000000 -0.000000 0.000000 0.000000 1.000000 /end COMPU_METHOD
/* Scalar measurable for DDE 'mpl_error_log_detailed[3].err_log.csa.lower.D2'. */
/begin MEASUREMENT mpl_error_log_detailed[3].er031 "CPU data register" ULONG CU_MPL_ERROR_LOG_DETAILED[3]034 1 100 0.0 4294967295.0 ECU_ADDRESS 0xf02408c0 BYTE_ORDER MSB_LAST /end MEASUREMENT
/begin COMPU_METHOD CU_MPL_ERROR_LOG_DETAILED[3]034 "Conversion method for mpl_error_log_detailed[3].err_log.csa.lower.D2" RAT_FUNC "%10.0" "(not defined)" COEFFS 0.000000 1.000000 -0.000000 0.000000 0.000000 1.000000 /end COMPU_METHOD
/* Scalar measurable for DDE 'mpl_error_log_detailed[3].err_log.csa.lower.D3'. */
/begin MEASUREMENT mpl_error_log_detailed[3].err64 "CPU data register" ULONG CU_MPL_ERROR_LOG_DETAILED[3].67 1 100 0.0 4294967295.0 ECU_ADDRESS 0xf02408c4 BYTE_ORDER MSB_LAST /end MEASUREMENT
/begin COMPU_METHOD CU_MPL_ERROR_LOG_DETAILED[3].67 "Conversion method for mpl_error_log_detailed[3].err_log.csa.lower.D3" RAT_FUNC "%10.0" "(not defined)" COEFFS 0.000000 1.000000 -0.000000 0.000000 0.000000 1.000000 /end COMPU_METHOD
/* Scalar measurable for DDE 'mpl_error_log_detailed[3].err_log.csa.lower.D4'. */
/begin MEASUREMENT mpl_error_log_detailed[3].er027 "CPU data register" ULONG CU_MPL_ERROR_LOG_DETAILED[3]030 1 100 0.0 4294967295.0 ECU_ADDRESS 0xf02408d8 BYTE_ORDER MSB_LAST /end MEASUREMENT
/begin COMPU_METHOD CU_MPL_ERROR_LOG_DETAILED[3]030 "Conversion method for mpl_error_log_detailed[3].err_log.csa.lower.D4" RAT_FUNC "%10.0" "(not defined)" COEFFS 0.000000 1.000000 -0.000000 0.000000 0.000000 1.000000 /end COMPU_METHOD
/* Scalar measurable for DDE 'mpl_error_log_detailed[3].err_log.csa.lower.D5'. */
/begin MEASUREMENT mpl_error_log_detailed[3].er011 "CPU data register" ULONG CU_MPL_ERROR_LOG_DETAILED[3]014 1 100 0.0 4294967295.0 ECU_ADDRESS 0xf02408dc BYTE_ORDER MSB_LAST /end MEASUREMENT
/begin COMPU_METHOD CU_MPL_ERROR_LOG_DETAILED[3]014 "Conversion method for mpl_error_log_detailed[3].err_log.csa.lower.D5" RAT_FUNC "%10.0" "(not defined)" COEFFS 0.000000 1.000000 -0.000000 0.000000 0.000000 1.000000 /end COMPU_METHOD
/* Scalar measurable for DDE 'mpl_error_log_detailed[3].err_log.csa.lower.D6'. */
/begin MEASUREMENT mpl_error_log_detailed[3].er029 "CPU data register" ULONG CU_MPL_ERROR_LOG_DETAILED[3]032 1 100 0.0 4294967295.0 ECU_ADDRESS 0xf02408e0 BYTE_ORDER MSB_LAST /end MEASUREMENT
/begin COMPU_METHOD CU_MPL_ERROR_LOG_DETAILED[3]032 "Conversion method for mpl_error_log_detailed[3].err_log.csa.lower.D6" RAT_FUNC "%10.0" "(not defined)" COEFFS 0.000000 1.000000 -0.000000 0.000000 0.000000 1.000000 /end COMPU_METHOD
/* Scalar measurable for DDE 'mpl_error_log_detailed[3].err_log.csa.lower.D7'. */
/begin MEASUREMENT mpl_error_log_detailed[3].er028 "CPU data register" ULONG CU_MPL_ERROR_LOG_DETAILED[3]031 1 100 0.0 4294967295.0 ECU_ADDRESS 0xf02408e4 BYTE_ORDER MSB_LAST /end MEASUREMENT
/begin COMPU_METHOD CU_MPL_ERROR_LOG_DETAILED[3]031 "Conversion method for mpl_error_log_detailed[3].err_log.csa.lower.D7" RAT_FUNC "%10.0" "(not defined)" COEFFS 0.000000 1.000000 -0.000000 0.000000 0.000000 1.000000 /end COMPU_METHOD
/* Scalar measurable for DDE 'mpl_error_log_detailed[3].err_log.csa.lower.PC'. */
/begin MEASUREMENT mpl_error_log_detailed[3].err35 "CPU program counter" ULONG CU_MPL_ERROR_LOG_DETAILED[3].37 1 100 0.0 4294967295.0 ECU_ADDRESS 0xf02408ac BYTE_ORDER MSB_LAST /end MEASUREMENT
/begin COMPU_METHOD CU_MPL_ERROR_LOG_DETAILED[3].37 "Conversion method for mpl_error_log_detailed[3].err_log.csa.lower.PC" RAT_FUNC "%10.0" "(not defined)" COEFFS 0.000000 1.000000 -0.000000 0.000000 0.000000 1.000000 /end COMPU_METHOD
/* Scalar measurable for DDE 'mpl_error_log_detailed[3].err_log.csa.upper.A10'. */
/begin MEASUREMENT mpl_error_log_detailed[3].er000 "CPU address register (aka stack pointer)" ULONG CU_MPL_ERROR_LOG_DETAILED[3]003 1 100 0.0 4294967295.0 ECU_ADDRESS 0xf02408b0 BYTE_ORDER MSB_LAST /end MEASUREMENT
/begin COMPU_METHOD CU_MPL_ERROR_LOG_DETAILED[3]003 "Conversion method for mpl_error_log_detailed[3].err_log.csa.upper.A10" RAT_FUNC "%10.0" "(not defined)" COEFFS 0.000000 1.000000 -0.000000 0.000000 0.000000 1.000000 /end COMPU_METHOD
/* Scalar measurable for DDE 'mpl_error_log_detailed[3].err_log.csa.upper.A11'. */
/begin MEASUREMENT mpl_error_log_detailed[3].err40 "CPU address register (aka return address" ULONG CU_MPL_ERROR_LOG_DETAILED[3].42 1 100 0.0 4294967295.0 ECU_ADDRESS 0xf02408b4 BYTE_ORDER MSB_LAST /end MEASUREMENT
/begin COMPU_METHOD CU_MPL_ERROR_LOG_DETAILED[3].42 "Conversion method for mpl_error_log_detailed[3].err_log.csa.upper.A11" RAT_FUNC "%10.0" "(not defined)" COEFFS 0.000000 1.000000 -0.000000 0.000000 0.000000 1.000000 /end COMPU_METHOD
/* Scalar measurable for DDE 'mpl_error_log_detailed[3].err_log.csa.upper.A12'. */
/begin MEASUREMENT mpl_error_log_detailed[3].err99 "CPU address register" ULONG CU_MPL_ERROR_LOG_DETAILED[3]002 1 100 0.0 4294967295.0 ECU_ADDRESS 0xf02408c8 BYTE_ORDER MSB_LAST /end MEASUREMENT
/begin COMPU_METHOD CU_MPL_ERROR_LOG_DETAILED[3]002 "Conversion method for mpl_error_log_detailed[3].err_log.csa.upper.A12" RAT_FUNC "%10.0" "(not defined)" COEFFS 0.000000 1.000000 -0.000000 0.000000 0.000000 1.000000 /end COMPU_METHOD
/* Scalar measurable for DDE 'mpl_error_log_detailed[3].err_log.csa.upper.A13'. */
/begin MEASUREMENT mpl_error_log_detailed[3].err98 "CPU address register" ULONG CU_MPL_ERROR_LOG_DETAILED[3]001 1 100 0.0 4294967295.0 ECU_ADDRESS 0xf02408cc BYTE_ORDER MSB_LAST /end MEASUREMENT
/begin COMPU_METHOD CU_MPL_ERROR_LOG_DETAILED[3]001 "Conversion method for mpl_error_log_detailed[3].err_log.csa.upper.A13" RAT_FUNC "%10.0" "(not defined)" COEFFS 0.000000 1.000000 -0.000000 0.000000 0.000000 1.000000 /end COMPU_METHOD
/* Scalar measurable for DDE 'mpl_error_log_detailed[3].err_log.csa.upper.A14'. */
/begin MEASUREMENT mpl_error_log_detailed[3].err97 "CPU address register" ULONG CU_MPL_ERROR_LOG_DETAILED[3]000 1 100 0.0 4294967295.0 ECU_ADDRESS 0xf02408d0 BYTE_ORDER MSB_LAST /end MEASUREMENT
/begin COMPU_METHOD CU_MPL_ERROR_LOG_DETAILED[3]000 "Conversion method for mpl_error_log_detailed[3].err_log.csa.upper.A14" RAT_FUNC "%10.0" "(not defined)" COEFFS 0.000000 1.000000 -0.000000 0.000000 0.000000 1.000000 /end COMPU_METHOD
/* Scalar measurable for DDE 'mpl_error_log_detailed[3].err_log.csa.upper.A15'. */
/begin MEASUREMENT mpl_error_log_detailed[3].err96 "CPU address register" ULONG CU_MPL_ERROR_LOG_DETAILED[3].99 1 100 0.0 4294967295.0 ECU_ADDRESS 0xf02408d4 BYTE_ORDER MSB_LAST /end MEASUREMENT
/begin COMPU_METHOD CU_MPL_ERROR_LOG_DETAILED[3].99 "Conversion method for mpl_error_log_detailed[3].err_log.csa.upper.A15" RAT_FUNC "%10.0" "(not defined)" COEFFS 0.000000 1.000000 -0.000000 0.000000 0.000000 1.000000 /end COMPU_METHOD
/* Scalar measurable for DDE 'mpl_error_log_detailed[3].err_log.csa.upper.D10'. */
/begin MEASUREMENT mpl_error_log_detailed[3].er012 "CPU data register" ULONG CU_MPL_ERROR_LOG_DETAILED[3]015 1 100 0.0 4294967295.0 ECU_ADDRESS 0xf02408c0 BYTE_ORDER MSB_LAST /end MEASUREMENT
/begin COMPU_METHOD CU_MPL_ERROR_LOG_DETAILED[3]015 "Conversion method for mpl_error_log_detailed[3].err_log.csa.upper.D10" RAT_FUNC "%10.0" "(not defined)" COEFFS 0.000000 1.000000 -0.000000 0.000000 0.000000 1.000000 /end COMPU_METHOD
/* Scalar measurable for DDE 'mpl_error_log_detailed[3].err_log.csa.upper.D11'. */
/begin MEASUREMENT mpl_error_log_detailed[3].err78 "CPU data register" ULONG CU_MPL_ERROR_LOG_DETAILED[3].81 1 100 0.0 4294967295.0 ECU_ADDRESS 0xf02408c4 BYTE_ORDER MSB_LAST /end MEASUREMENT
/begin COMPU_METHOD CU_MPL_ERROR_LOG_DETAILED[3].81 "Conversion method for mpl_error_log_detailed[3].err_log.csa.upper.D11" RAT_FUNC "%10.0" "(not defined)" COEFFS 0.000000 1.000000 -0.000000 0.000000 0.000000 1.000000 /end COMPU_METHOD
/* Scalar measurable for DDE 'mpl_error_log_detailed[3].err_log.csa.upper.D12'. */
/begin MEASUREMENT mpl_error_log_detailed[3].err77 "CPU data register" ULONG CU_MPL_ERROR_LOG_DETAILED[3].80 1 100 0.0 4294967295.0 ECU_ADDRESS 0xf02408d8 BYTE_ORDER MSB_LAST /end MEASUREMENT
/begin COMPU_METHOD CU_MPL_ERROR_LOG_DETAILED[3].80 "Conversion method for mpl_error_log_detailed[3].err_log.csa.upper.D12" RAT_FUNC "%10.0" "(not defined)" COEFFS 0.000000 1.000000 -0.000000 0.000000 0.000000 1.000000 /end COMPU_METHOD
/* Scalar measurable for DDE 'mpl_error_log_detailed[3].err_log.csa.upper.D13'. */
/begin MEASUREMENT mpl_error_log_detailed[3].err91 "CPU data register" ULONG CU_MPL_ERROR_LOG_DETAILED[3].94 1 100 0.0 4294967295.0 ECU_ADDRESS 0xf02408dc BYTE_ORDER MSB_LAST /end MEASUREMENT
/begin COMPU_METHOD CU_MPL_ERROR_LOG_DETAILED[3].94 "Conversion method for mpl_error_log_detailed[3].err_log.csa.upper.D13" RAT_FUNC "%10.0" "(not defined)" COEFFS 0.000000 1.000000 -0.000000 0.000000 0.000000 1.000000 /end COMPU_METHOD
/* Scalar measurable for DDE 'mpl_error_log_detailed[3].err_log.csa.upper.D14'. */
/begin MEASUREMENT mpl_error_log_detailed[3].err75 "CPU data register" ULONG CU_MPL_ERROR_LOG_DETAILED[3].78 1 100 0.0 4294967295.0 ECU_ADDRESS 0xf02408e0 BYTE_ORDER MSB_LAST /end MEASUREMENT
/begin COMPU_METHOD CU_MPL_ERROR_LOG_DETAILED[3].78 "Conversion method for mpl_error_log_detailed[3].err_log.csa.upper.D14" RAT_FUNC "%10.0" "(not defined)" COEFFS 0.000000 1.000000 -0.000000 0.000000 0.000000 1.000000 /end COMPU_METHOD
/* Scalar measurable for DDE 'mpl_error_log_detailed[3].err_log.csa.upper.D15'. */
/begin MEASUREMENT mpl_error_log_detailed[3].err76 "CPU data register" ULONG CU_MPL_ERROR_LOG_DETAILED[3].79 1 100 0.0 4294967295.0 ECU_ADDRESS 0xf02408e4 BYTE_ORDER MSB_LAST /end MEASUREMENT
/begin COMPU_METHOD CU_MPL_ERROR_LOG_DETAILED[3].79 "Conversion method for mpl_error_log_detailed[3].err_log.csa.upper.D15" RAT_FUNC "%10.0" "(not defined)" COEFFS 0.000000 1.000000 -0.000000 0.000000 0.000000 1.000000 /end COMPU_METHOD
/* Scalar measurable for DDE 'mpl_error_log_detailed[3].err_log.csa.upper.D8'. */
/begin MEASUREMENT mpl_error_log_detailed[3].err58 "CPU data register" ULONG CU_MPL_ERROR_LOG_DETAILED[3].61 1 100 0.0 4294967295.0 ECU_ADDRESS 0xf02408b8 BYTE_ORDER MSB_LAST /end MEASUREMENT
/begin COMPU_METHOD CU_MPL_ERROR_LOG_DETAILED[3].61 "Conversion method for mpl_error_log_detailed[3].err_log.csa.upper.D8" RAT_FUNC "%10.0" "(not defined)" COEFFS 0.000000 1.000000 -0.000000 0.000000 0.000000 1.000000 /end COMPU_METHOD
/* Scalar measurable for DDE 'mpl_error_log_detailed[3].err_log.csa.upper.D9'. */
/begin MEASUREMENT mpl_error_log_detailed[3].er002 "CPU data register" ULONG CU_MPL_ERROR_LOG_DETAILED[3]005 1 100 0.0 4294967295.0 ECU_ADDRESS 0xf02408bc BYTE_ORDER MSB_LAST /end MEASUREMENT
/begin COMPU_METHOD CU_MPL_ERROR_LOG_DETAILED[3]005 "Conversion method for mpl_error_log_detailed[3].err_log.csa.upper.D9" RAT_FUNC "%10.0" "(not defined)" COEFFS 0.000000 1.000000 -0.000000 0.000000 0.000000 1.000000 /end COMPU_METHOD
/* Scalar measurable for DDE 'mpl_error_log_detailed[3].err_log.csa.upper.PSW'. */
/begin MEASUREMENT mpl_error_log_detailed[3].err41 "CPU program status word" ULONG CU_MPL_ERROR_LOG_DETAILED[3].43 1 100 0.0 4294967295.0 ECU_ADDRESS 0xf02408ac BYTE_ORDER MSB_LAST /end MEASUREMENT
/begin COMPU_METHOD CU_MPL_ERROR_LOG_DETAILED[3].43 "Conversion method for mpl_error_log_detailed[3].err_log.csa.upper.PSW" RAT_FUNC "%10.0" "(not defined)" COEFFS 0.000000 1.000000 -0.000000 0.000000 0.000000 1.000000 /end COMPU_METHOD
/* Scalar measurable for DDE 'mpl_error_log_detailed[3].err_log.run_task_id'. */
/begin MEASUREMENT mpl_error_log_detailed[3].er035 "Handle of PXROS task, zero if PXROS not started" ULONG CU_MPL_ERROR_LOG_DETAILED[3]038 1 100 0.0 4294967295.0 ECU_ADDRESS 0xf02408a4 BYTE_ORDER MSB_LAST /end MEASUREMENT
/begin COMPU_METHOD CU_MPL_ERROR_LOG_DETAILED[3]038 "Conversion method for mpl_error_log_detailed[3].err_log.run_task_id" RAT_FUNC "%10.0" "handle" COEFFS 0.000000 1.000000 -0.000000 0.000000 0.000000 1.000000 /end COMPU_METHOD
/* Scalar measurable for DDE 'mpl_error_log_detailed[3].err_log.smu_alarms.smu_ad[0]'. */
/begin MEASUREMENT mpl_error_log_detailed[3].er045 "CPU SMU alarm debug register" ULONG CU_MPL_ERROR_LOG_DETAILED[3]048 1 100 0.0 4294967295.0 ECU_ADDRESS 0xf0240ab0 BYTE_ORDER MSB_LAST /end MEASUREMENT
/begin COMPU_METHOD CU_MPL_ERROR_LOG_DETAILED[3]048 "Conversion method for mpl_error_log_detailed[3].err_log.smu_alarms.smu_ad[0]" RAT_FUNC "%10.0" "(not defined)" COEFFS 0.000000 1.000000 -0.000000 0.000000 0.000000 1.000000 /end COMPU_METHOD
/* Scalar measurable for DDE 'mpl_error_log_detailed[3].err_log.smu_alarms.smu_ad[10]'. */
/begin MEASUREMENT mpl_error_log_detailed[3].err95 "CPU SMU alarm debug register" ULONG CU_MPL_ERROR_LOG_DETAILED[3].98 1 100 0.0 4294967295.0 ECU_ADDRESS 0xf0240ad8 BYTE_ORDER MSB_LAST /end MEASUREMENT
/begin COMPU_METHOD CU_MPL_ERROR_LOG_DETAILED[3].98 "Conversion method for mpl_error_log_detailed[3].err_log.smu_alarms.smu_ad[10]" RAT_FUNC "%10.0" "(not defined)" COEFFS 0.000000 1.000000 -0.000000 0.000000 0.000000 1.000000 /end COMPU_METHOD
/* Scalar measurable for DDE 'mpl_error_log_detailed[3].err_log.smu_alarms.smu_ad[11]'. */
/begin MEASUREMENT mpl_error_log_detailed[3].err65 "CPU SMU alarm debug register" ULONG CU_MPL_ERROR_LOG_DETAILED[3].68 1 100 0.0 4294967295.0 ECU_ADDRESS 0xf0240adc BYTE_ORDER MSB_LAST /end MEASUREMENT
/begin COMPU_METHOD CU_MPL_ERROR_LOG_DETAILED[3].68 "Conversion method for mpl_error_log_detailed[3].err_log.smu_alarms.smu_ad[11]" RAT_FUNC "%10.0" "(not defined)" COEFFS 0.000000 1.000000 -0.000000 0.000000 0.000000 1.000000 /end COMPU_METHOD
/* Scalar measurable for DDE 'mpl_error_log_detailed[3].err_log.smu_alarms.smu_ad[1]'. */
/begin MEASUREMENT mpl_error_log_detailed[3].er033 "CPU SMU alarm debug register" ULONG CU_MPL_ERROR_LOG_DETAILED[3]036 1 100 0.0 4294967295.0 ECU_ADDRESS 0xf0240ab4 BYTE_ORDER MSB_LAST /end MEASUREMENT
/begin COMPU_METHOD CU_MPL_ERROR_LOG_DETAILED[3]036 "Conversion method for mpl_error_log_detailed[3].err_log.smu_alarms.smu_ad[1]" RAT_FUNC "%10.0" "(not defined)" COEFFS 0.000000 1.000000 -0.000000 0.000000 0.000000 1.000000 /end COMPU_METHOD
/* Scalar measurable for DDE 'mpl_error_log_detailed[3].err_log.smu_alarms.smu_ad[2]'. */
/begin MEASUREMENT mpl_error_log_detailed[3].er017 "CPU SMU alarm debug register" ULONG CU_MPL_ERROR_LOG_DETAILED[3]020 1 100 0.0 4294967295.0 ECU_ADDRESS 0xf0240ab8 BYTE_ORDER MSB_LAST /end MEASUREMENT
/begin COMPU_METHOD CU_MPL_ERROR_LOG_DETAILED[3]020 "Conversion method for mpl_error_log_detailed[3].err_log.smu_alarms.smu_ad[2]" RAT_FUNC "%10.0" "(not defined)" COEFFS 0.000000 1.000000 -0.000000 0.000000 0.000000 1.000000 /end COMPU_METHOD
/* Scalar measurable for DDE 'mpl_error_log_detailed[3].err_log.smu_alarms.smu_ad[3]'. */
/begin MEASUREMENT mpl_error_log_detailed[3].er007 "CPU SMU alarm debug register" ULONG CU_MPL_ERROR_LOG_DETAILED[3]010 1 100 0.0 4294967295.0 ECU_ADDRESS 0xf0240abc BYTE_ORDER MSB_LAST /end MEASUREMENT
/begin COMPU_METHOD CU_MPL_ERROR_LOG_DETAILED[3]010 "Conversion method for mpl_error_log_detailed[3].err_log.smu_alarms.smu_ad[3]" RAT_FUNC "%10.0" "(not defined)" COEFFS 0.000000 1.000000 -0.000000 0.000000 0.000000 1.000000 /end COMPU_METHOD
/* Scalar measurable for DDE 'mpl_error_log_detailed[3].err_log.smu_alarms.smu_ad[4]'. */
/begin MEASUREMENT mpl_error_log_detailed[3].err56 "CPU SMU alarm debug register" ULONG CU_MPL_ERROR_LOG_DETAILED[3].59 1 100 0.0 4294967295.0 ECU_ADDRESS 0xf0240ac0 BYTE_ORDER MSB_LAST /end MEASUREMENT
/begin COMPU_METHOD CU_MPL_ERROR_LOG_DETAILED[3].59 "Conversion method for mpl_error_log_detailed[3].err_log.smu_alarms.smu_ad[4]" RAT_FUNC "%10.0" "(not defined)" COEFFS 0.000000 1.000000 -0.000000 0.000000 0.000000 1.000000 /end COMPU_METHOD
/* Scalar measurable for DDE 'mpl_error_log_detailed[3].err_log.smu_alarms.smu_ad[5]'. */
/begin MEASUREMENT mpl_error_log_detailed[3].er025 "CPU SMU alarm debug register" ULONG CU_MPL_ERROR_LOG_DETAILED[3]028 1 100 0.0 4294967295.0 ECU_ADDRESS 0xf0240ac4 BYTE_ORDER MSB_LAST /end MEASUREMENT
/begin COMPU_METHOD CU_MPL_ERROR_LOG_DETAILED[3]028 "Conversion method for mpl_error_log_detailed[3].err_log.smu_alarms.smu_ad[5]" RAT_FUNC "%10.0" "(not defined)" COEFFS 0.000000 1.000000 -0.000000 0.000000 0.000000 1.000000 /end COMPU_METHOD
/* Scalar measurable for DDE 'mpl_error_log_detailed[3].err_log.smu_alarms.smu_ad[6]'. */
/begin MEASUREMENT mpl_error_log_detailed[3].err67 "CPU SMU alarm debug register" ULONG CU_MPL_ERROR_LOG_DETAILED[3].70 1 100 0.0 4294967295.0 ECU_ADDRESS 0xf0240ac8 BYTE_ORDER MSB_LAST /end MEASUREMENT
/begin COMPU_METHOD CU_MPL_ERROR_LOG_DETAILED[3].70 "Conversion method for mpl_error_log_detailed[3].err_log.smu_alarms.smu_ad[6]" RAT_FUNC "%10.0" "(not defined)" COEFFS 0.000000 1.000000 -0.000000 0.000000 0.000000 1.000000 /end COMPU_METHOD
/* Scalar measurable for DDE 'mpl_error_log_detailed[3].err_log.smu_alarms.smu_ad[7]'. */
/begin MEASUREMENT mpl_error_log_detailed[3].err_9 "CPU SMU alarm debug register" ULONG CU_MPL_ERROR_LOG_DETAILED[3].00 1 100 0.0 4294967295.0 ECU_ADDRESS 0xf0240acc BYTE_ORDER MSB_LAST /end MEASUREMENT
/begin COMPU_METHOD CU_MPL_ERROR_LOG_DETAILED[3].00 "Conversion method for mpl_error_log_detailed[3].err_log.smu_alarms.smu_ad[7]" RAT_FUNC "%10.0" "(not defined)" COEFFS 0.000000 1.000000 -0.000000 0.000000 0.000000 1.000000 /end COMPU_METHOD
/* Scalar measurable for DDE 'mpl_error_log_detailed[3].err_log.smu_alarms.smu_ad[8]'. */
/begin MEASUREMENT mpl_error_log_detailed[3].err51 "CPU SMU alarm debug register" ULONG CU_MPL_ERROR_LOG_DETAILED[3].53 1 100 0.0 4294967295.0 ECU_ADDRESS 0xf0240ad0 BYTE_ORDER MSB_LAST /end MEASUREMENT
/begin COMPU_METHOD CU_MPL_ERROR_LOG_DETAILED[3].53 "Conversion method for mpl_error_log_detailed[3].err_log.smu_alarms.smu_ad[8]" RAT_FUNC "%10.0" "(not defined)" COEFFS 0.000000 1.000000 -0.000000 0.000000 0.000000 1.000000 /end COMPU_METHOD
/* Scalar measurable for DDE 'mpl_error_log_detailed[3].err_log.smu_alarms.smu_ad[9]'. */
/begin MEASUREMENT mpl_error_log_detailed[3].err42 "CPU SMU alarm debug register" ULONG CU_MPL_ERROR_LOG_DETAILED[3].44 1 100 0.0 4294967295.0 ECU_ADDRESS 0xf0240ad4 BYTE_ORDER MSB_LAST /end MEASUREMENT
/begin COMPU_METHOD CU_MPL_ERROR_LOG_DETAILED[3].44 "Conversion method for mpl_error_log_detailed[3].err_log.smu_alarms.smu_ad[9]" RAT_FUNC "%10.0" "(not defined)" COEFFS 0.000000 1.000000 -0.000000 0.000000 0.000000 1.000000 /end COMPU_METHOD
/* Scalar measurable for DDE 'mpl_error_log_detailed[3].err_log.smu_alarms.smu_ag[0]'. */
/begin MEASUREMENT mpl_error_log_detailed[3].err74 "CPU SMU alarm status register" ULONG CU_MPL_ERROR_LOG_DETAILED[3].77 1 100 0.0 4294967295.0 ECU_ADDRESS 0xf0240a80 BYTE_ORDER MSB_LAST /end MEASUREMENT
/begin COMPU_METHOD CU_MPL_ERROR_LOG_DETAILED[3].77 "Conversion method for mpl_error_log_detailed[3].err_log.smu_alarms.smu_ag[0]" RAT_FUNC "%10.0" "(not defined)" COEFFS 0.000000 1.000000 -0.000000 0.000000 0.000000 1.000000 /end COMPU_METHOD
/* Scalar measurable for DDE 'mpl_error_log_detailed[3].err_log.smu_alarms.smu_ag[10]'. */
/begin MEASUREMENT mpl_error_log_detailed[3].err36 "CPU SMU alarm status register" ULONG CU_MPL_ERROR_LOG_DETAILED[3].38 1 100 0.0 4294967295.0 ECU_ADDRESS 0xf0240aa8 BYTE_ORDER MSB_LAST /end MEASUREMENT
/begin COMPU_METHOD CU_MPL_ERROR_LOG_DETAILED[3].38 "Conversion method for mpl_error_log_detailed[3].err_log.smu_alarms.smu_ag[10]" RAT_FUNC "%10.0" "(not defined)" COEFFS 0.000000 1.000000 -0.000000 0.000000 0.000000 1.000000 /end COMPU_METHOD
/* Scalar measurable for DDE 'mpl_error_log_detailed[3].err_log.smu_alarms.smu_ag[11]'. */
/begin MEASUREMENT mpl_error_log_detailed[3].err17 "CPU SMU alarm status register" ULONG CU_MPL_ERROR_LOG_DETAILED[3].19 1 100 0.0 4294967295.0 ECU_ADDRESS 0xf0240aac BYTE_ORDER MSB_LAST /end MEASUREMENT
/begin COMPU_METHOD CU_MPL_ERROR_LOG_DETAILED[3].19 "Conversion method for mpl_error_log_detailed[3].err_log.smu_alarms.smu_ag[11]" RAT_FUNC "%10.0" "(not defined)" COEFFS 0.000000 1.000000 -0.000000 0.000000 0.000000 1.000000 /end COMPU_METHOD
/* Scalar measurable for DDE 'mpl_error_log_detailed[3].err_log.smu_alarms.smu_ag[1]'. */
/begin MEASUREMENT mpl_error_log_detailed[3].err88 "CPU SMU alarm status register" ULONG CU_MPL_ERROR_LOG_DETAILED[3].91 1 100 0.0 4294967295.0 ECU_ADDRESS 0xf0240a84 BYTE_ORDER MSB_LAST /end MEASUREMENT
/begin COMPU_METHOD CU_MPL_ERROR_LOG_DETAILED[3].91 "Conversion method for mpl_error_log_detailed[3].err_log.smu_alarms.smu_ag[1]" RAT_FUNC "%10.0" "(not defined)" COEFFS 0.000000 1.000000 -0.000000 0.000000 0.000000 1.000000 /end COMPU_METHOD
/* Scalar measurable for DDE 'mpl_error_log_detailed[3].err_log.smu_alarms.smu_ag[2]'. */
/begin MEASUREMENT mpl_error_log_detailed[3].err10 "CPU SMU alarm status register" ULONG CU_MPL_ERROR_LOG_DETAILED[3].12 1 100 0.0 4294967295.0 ECU_ADDRESS 0xf0240a88 BYTE_ORDER MSB_LAST /end MEASUREMENT
/begin COMPU_METHOD CU_MPL_ERROR_LOG_DETAILED[3].12 "Conversion method for mpl_error_log_detailed[3].err_log.smu_alarms.smu_ag[2]" RAT_FUNC "%10.0" "(not defined)" COEFFS 0.000000 1.000000 -0.000000 0.000000 0.000000 1.000000 /end COMPU_METHOD
/* Scalar measurable for DDE 'mpl_error_log_detailed[3].err_log.smu_alarms.smu_ag[3]'. */
/begin MEASUREMENT mpl_error_log_detailed[3].er015 "CPU SMU alarm status register" ULONG CU_MPL_ERROR_LOG_DETAILED[3]018 1 100 0.0 4294967295.0 ECU_ADDRESS 0xf0240a8c BYTE_ORDER MSB_LAST /end MEASUREMENT
/begin COMPU_METHOD CU_MPL_ERROR_LOG_DETAILED[3]018 "Conversion method for mpl_error_log_detailed[3].err_log.smu_alarms.smu_ag[3]" RAT_FUNC "%10.0" "(not defined)" COEFFS 0.000000 1.000000 -0.000000 0.000000 0.000000 1.000000 /end COMPU_METHOD
/* Scalar measurable for DDE 'mpl_error_log_detailed[3].err_log.smu_alarms.smu_ag[4]'. */
/begin MEASUREMENT mpl_error_log_detailed[3].err26 "CPU SMU alarm status register" ULONG CU_MPL_ERROR_LOG_DETAILED[3].28 1 100 0.0 4294967295.0 ECU_ADDRESS 0xf0240a90 BYTE_ORDER MSB_LAST /end MEASUREMENT
/begin COMPU_METHOD CU_MPL_ERROR_LOG_DETAILED[3].28 "Conversion method for mpl_error_log_detailed[3].err_log.smu_alarms.smu_ag[4]" RAT_FUNC "%10.0" "(not defined)" COEFFS 0.000000 1.000000 -0.000000 0.000000 0.000000 1.000000 /end COMPU_METHOD
/* Scalar measurable for DDE 'mpl_error_log_detailed[3].err_log.smu_alarms.smu_ag[5]'. */
/begin MEASUREMENT mpl_error_log_detailed[3].er005 "CPU SMU alarm status register" ULONG CU_MPL_ERROR_LOG_DETAILED[3]008 1 100 0.0 4294967295.0 ECU_ADDRESS 0xf0240a94 BYTE_ORDER MSB_LAST /end MEASUREMENT
/begin COMPU_METHOD CU_MPL_ERROR_LOG_DETAILED[3]008 "Conversion method for mpl_error_log_detailed[3].err_log.smu_alarms.smu_ag[5]" RAT_FUNC "%10.0" "(not defined)" COEFFS 0.000000 1.000000 -0.000000 0.000000 0.000000 1.000000 /end COMPU_METHOD
/* Scalar measurable for DDE 'mpl_error_log_detailed[3].err_log.smu_alarms.smu_ag[6]'. */
/begin MEASUREMENT mpl_error_log_detailed[3].err25 "CPU SMU alarm status register" ULONG CU_MPL_ERROR_LOG_DETAILED[3].27 1 100 0.0 4294967295.0 ECU_ADDRESS 0xf0240a98 BYTE_ORDER MSB_LAST /end MEASUREMENT
/begin COMPU_METHOD CU_MPL_ERROR_LOG_DETAILED[3].27 "Conversion method for mpl_error_log_detailed[3].err_log.smu_alarms.smu_ag[6]" RAT_FUNC "%10.0" "(not defined)" COEFFS 0.000000 1.000000 -0.000000 0.000000 0.000000 1.000000 /end COMPU_METHOD
/* Scalar measurable for DDE 'mpl_error_log_detailed[3].err_log.smu_alarms.smu_ag[7]'. */
/begin MEASUREMENT mpl_error_log_detailed[3].err04 "CPU SMU alarm status register" ULONG CU_MPL_ERROR_LOG_DETAILED[3].05 1 100 0.0 4294967295.0 ECU_ADDRESS 0xf0240a9c BYTE_ORDER MSB_LAST /end MEASUREMENT
/begin COMPU_METHOD CU_MPL_ERROR_LOG_DETAILED[3].05 "Conversion method for mpl_error_log_detailed[3].err_log.smu_alarms.smu_ag[7]" RAT_FUNC "%10.0" "(not defined)" COEFFS 0.000000 1.000000 -0.000000 0.000000 0.000000 1.000000 /end COMPU_METHOD
/* Scalar measurable for DDE 'mpl_error_log_detailed[3].err_log.smu_alarms.smu_ag[8]'. */
/begin MEASUREMENT mpl_error_log_detailed[3].err05 "CPU SMU alarm status register" ULONG CU_MPL_ERROR_LOG_DETAILED[3].06 1 100 0.0 4294967295.0 ECU_ADDRESS 0xf0240aa0 BYTE_ORDER MSB_LAST /end MEASUREMENT
/begin COMPU_METHOD CU_MPL_ERROR_LOG_DETAILED[3].06 "Conversion method for mpl_error_log_detailed[3].err_log.smu_alarms.smu_ag[8]" RAT_FUNC "%10.0" "(not defined)" COEFFS 0.000000 1.000000 -0.000000 0.000000 0.000000 1.000000 /end COMPU_METHOD
/* Scalar measurable for DDE 'mpl_error_log_detailed[3].err_log.smu_alarms.smu_ag[9]'. */
/begin MEASUREMENT mpl_error_log_detailed[3].err22 "CPU SMU alarm status register" ULONG CU_MPL_ERROR_LOG_DETAILED[3].24 1 100 0.0 4294967295.0 ECU_ADDRESS 0xf0240aa4 BYTE_ORDER MSB_LAST /end MEASUREMENT
/begin COMPU_METHOD CU_MPL_ERROR_LOG_DETAILED[3].24 "Conversion method for mpl_error_log_detailed[3].err_log.smu_alarms.smu_ag[9]" RAT_FUNC "%10.0" "(not defined)" COEFFS 0.000000 1.000000 -0.000000 0.000000 0.000000 1.000000 /end COMPU_METHOD
/* Scalar measurable for DDE 'mpl_error_log_summary[0].id'. */
/begin MEASUREMENT mpl_error_log_summary[0].id "Error code of fault raised" SWORD CU_MPL_ERROR_LOG_SUMMARY[0].ID 1 100 0.0 32767.0 ECU_ADDRESS 0xf0240048 BYTE_ORDER MSB_LAST /end MEASUREMENT
/begin COMPU_METHOD CU_MPL_ERROR_LOG_SUMMARY[0].ID "Conversion method for mpl_error_log_summary[0].id" TAB_VERB "%12.0" "code" COMPU_TAB_REF CT_MPL_ERROR_LOG_SUMMARY[0].ID /end COMPU_METHOD
/begin COMPU_VTAB CT_MPL_ERROR_LOG_SUMMARY[0].ID "Conversion method for mpl_error_log_summary[0].id" TAB_VERB 464 0 "PIO_PSY_NO_ERROR" 1 "PIO_TRAP_0_TIN_0_VAF" 2 "PIO_TRAP_0_TIN_1_VAP" 3 "PIO_TRAP_0_TIN_UNKNOWN" 4 "PIO_TRAP_1_TIN_1_PRIV" 5 "PIO_TRAP_1_TIN_2_MPR" 6 "PIO_TRAP_1_TIN_3_MPW" 7 "PIO_TRAP_1_TIN_4_MPX" 8 "PIO_TRAP_1_TIN_5_MPP" 9 "PIO_TRAP_1_TIN_6_MPN" 10 "PIO_TRAP_1_TIN_7_GRWP" 11 "PIO_TRAP_1_TIN_UNKNOWN" 12 "PIO_TRAP_2_TIN_1_IOPC" 13 "PIO_TRAP_2_TIN_2_UOPC" 14 "PIO_TRAP_2_TIN_3_OPD" 15 "PIO_TRAP_2_TIN_4_ALN" 16 "PIO_TRAP_2_TIN_5_MEM" 17 "PIO_TRAP_2_TIN_UNKNOWN" 18 "PIO_TRAP_3_TIN_1_FCD" 19 "PIO_TRAP_3_TIN_2_FCD" 20 "PIO_TRAP_3_TIN_3_CDU" 21 "PIO_TRAP_3_TIN_4_FCU" 22 "PIO_TRAP_3_TIN_5_CSU" 23 "PIO_TRAP_3_TIN_6_CTYP" 24 "PIO_TRAP_3_TIN_7_NEST" 25 "PIO_TRAP_3_TIN_UNKNOWN" 26 "PIO_TRAP_4_TIN_1_PSE" 27 "PIO_TRAP_4_TIN_2_DSE" 28 "PIO_TRAP_4_TIN_3_DAE" 29 "PIO_TRAP_4_TIN_4_CAE" 30 "PIO_TRAP_4_TIN_4_CAE_UNEXPECTED" 31 "PIO_TRAP_4_TIN_4_CAE_UNEXPECTED_FW" 32 "PIO_TRAP_4_TIN_5_PIE" 33 "PIO_TRAP_4_TIN_6_DIE" 34 "PIO_TRAP_4_TIN_7_DIE" 35 "PIO_TRAP_4_TIN_5_6_UNEXPECTED" 36 "PIO_TRAP_4_TIN_UNKNOWN" 37 "PIO_TRAP_5_TIN_1_OVF" 38 "PIO_TRAP_5_TIN_2_SOVF" 39 "PIO_TRAP_5_TIN_UNKNOWN" 40 "PIO_TRAP_6_SYS_UNKNOWN" 41 "PIO_TRAP_7_TIN_0_NMI" 42 "PIO_TRAP_7_TIN_UNKNOWN" 43 "PIO_ISR_0_RESET" 44 "PIO_BSPI_FIRST" 45 "PIO_BSPI_TRANSFER_TIMEOUT" 46 "PIO_BSPI_TX_DMA_ERROR" 47 "PIO_BSPI_RX_DMA_ERROR" 48 "PIO_BSPI_DSPI_ERROR" 49 "PIO_BSPI_RX_FIFO_OVERFLOW" 50 "PIO_BSPI_TX_FIFO_UNDERFLOW" 51 "PIO_BSPI_TRANSFER_TERMINATED" 52 "PIO_BSPI_TRANSAC_FAILED" 53 "PIO_BSPI_INTERNAL_SOFTWARE_ERROR" 54 "PIO_BSPI_ISR_MINIMUM_DELAY_TIME_NOT_MET" 55 "PIO_BSPI_ISR_FALSE_INT" 56 "PIO_BSPI_DMA_SAFETY_ERROR" 57 "PIO_BSPI_LAST" 58 "PIO_P1WR_ISR_MINIMUM_DELAY_TIME_NOT_MET" 59 "PIO_PADC_BUFFER_INIT_FAILED" 60 "PIO_PAX_ADC_INPUT_INVALID_ARG" 61 "PIO_PAX_CHANNEL_INVALID" 62 "PIO_PAX_ADC_INPUT_CHANNEL_UNSUPPORTED" 63 "PIO_PAX_CC_OUTPUT_CHANNEL_UNSUPPORTED" 64 "PIO_PAX_AOT_OUTPUT_CHANNEL_UNSUPPORTED" 65 "PIO_PAX_ISR_MINIMUM_DELAY_TIME_NOT_MET" 66 "PIO_PCANOPEN_RESET" 67 "PIO_PCANOPEN_BUFFER_OUT_OF_RANGE" 68 "PIO_PCANOPEN_NULL_POINTER" 69 "PIO_PCCP_RESET" 70 "PIO_PCCU6_ISR_MINIMUM_DELAY_TIME_NOT_MET" 71 "PIO_PCFG_INTERNAL_SW_ERROR" 72 "PIO_PCX_ERR_BUS_ID_OUT_OF_RANGE" 73 "PIO_PCX_ERR_DATA_LENGTH_OUT_OF_RANGE" 74 "PIO_PCX_ERR_STD_ID_OUT_OF_RANGE" 75 "PIO_PCX_ERR_EXT_ID_OUT_OF_RANGE" 76 "PIO_PCX_ERR_SAME_TX_MSG_DIFFERING_ATTRIBS" 77 "PIO_PCX_ERR_TOO_MANY_TX_MSGS" 78 "PIO_PCX_ERR_DUPLICATE_RX_MSG" 79 "PIO_PCX_ERR_TOO_MANY_RX_MSGS" 80 "PIO_PCX_ERR_BIT_RATE_IN_CONFIG_DIFFERS" 81 "PIO_PCX_ERR_UNSUPPORTED_BIT_RATE" 82 "PIO_PCX_ERR_BUS_ID_IN_CONFIG" 83 "PIO_PCX_ERR_NO_BITRATE_TABLE_MATCH" 84 "PIO_PCX_ERR_PACK_MSG_INVALID_PARAM" 85 "PIO_PCX_ERR_PACK_MSG_FIELD_PARAM" 86 "PIO_PCX_ERR_UNPACK_MSG_INVALID_PARAM" 87 "PIO_PCX_ERR_UNPACK_MSG_FIELD_PARAM" 88 "PIO_PCX_ERR_PACK_VDB_MSG_INVALID_PARAM" 89 "PIO_PCX_ERR_UNPACK_VDB_MSG_INVALID_PARAM" 90 "PIO_PCX_ERR_SWITCHED_RATE_FOR_NONFD_BUS" 91 "PIO_PCX_ERR_RX_MSG_FOR_UNCONFIG_BUS_0" 92 "PIO_PCX_ERR_UNSUPPORTED_BUS_MODE" 93 "PIO_PCX_ERR_BUS_MODE_IN_CONFIG_DIFFERS" 94 "PIO_PCX_ERR_SAME_RX_MSG_DIFFERING_ATTRIBS" 95 "PIO_PCX_ERR_TX_MSG_FOR_UNCONFIG_BUS_0" 96 "PIO_PCX_ISR_MINIMUM_DELAY_TIME_NOT_MET" 97 "PIO_PDD_CHANNEL_INVALID" 98 "PIO_PDD_DIG_DATA_IN_CHANNEL_UNSUPPORTED" 99 "PIO_PDD_DIG_DATA_OUT_CHANNEL_UNSUPPORTED" 100 "PIO_PDG_ERR_FORCED_RESET" 101 "PIO_PDTC_UPDATE_INVALID_ARG" 102 "PIO_PDTC_CLEAR_ALL_INVALID_ARG" 103 "PIO_PDTC_CLEAR_ALL_IF_ACT_INVALID_ARG" 104 "PIO_PDTC_CLEAR_ALL_IF_INACT_INVALID_ARG" 105 "PIO_PDTC_GET_DTC_STATUS_INVALID_ARG" 106 "PIO_PDTC_MATCH_EXISTS_INVALID_ARG" 107 "PIO_PDTC_CLEAR_DTCS_INVALID_ARG" 108 "PIO_PDTC_BAD_LICENSE" 109 "PIO_PDX_DO_CHANNEL_UNSUPPORTED" 110 "PIO_PDX_DIG_IN_CHANNEL_UNSUPPORTED" 111 "PIO_PDX_FREQ_IN_CHANNEL_UNSUPPORTED" 112 "PIO_PDX_PERIOD_IN_CHANNEL_UNSUPPORTED" 113 "PIO_PDX_QDEC_FREQ_IN_INVALID_ARG" 114 "PIO_PDX_QDEC_FREQ_IN_CHANNEL_UNSUPPORTED" 115 "PIO_PDX_TPU_QFI_CHANNEL_DEVICE_ERROR" 116 "PIO_PDX_QDEC_IN_CHANNEL_UNSUPPORTED" 117 "PIO_PDX_TPU_QI_CHANNEL_DEVICE_ERROR" 118 "PIO_PDX_PWM_OUT_CHANNEL_UNSUPPORTED" 119 "PIO_PDX_PWM_IN_CHANNEL_UNSUPPORTED" 120 "PIO_PDX_CHANNEL_INVALID" 121 "PIO_PDX_HBRIDGE_INVALID_MODE" 122 "PIO_PDX_HBRIDGE_DECODE_ERROR" 123 "PIO_PDX_HBRIDGE_CHANNEL_GROUP_UNSUPPORTED" 124 "PIO_PEM_EXTERNAL_RAM_REQUIRED" 125 "PIO_PEM_MEM_CONFIG_UNKNOWN" 126 "PIO_PETH_ERR_DRIVER_INITIALIZATION_ERROR" 127 "PIO_PETH_ERR_NULL_CONFIGURATION_POINTER" 128 "PIO_PETH_ERR_DATA_LENGTH_OUT_OF_RANGE" 129 "PIO_PETH_ERR_TOO_MANY_TX_MSGS" 130 "PIO_PETH_ERR_NOT_SUPPORTED" 131 "PIO_PFF_HOLDING_ARRAY_INDEX_INVALID" 132 "PIO_PFF_HOLDING_ARRAY_STRT_END_INVALID" 133 "PIO_PFF_HOLDING_ARRAY_REC_DATA_INVALID" 134 "PIO_PFF_STORED_FF_DTC_INVALID" 135 "PIO_PFF_STORED_DTC_READ_FAILURE" 136 "PIO_PFF_CAPTURE_PID_DATA_FAILURE" 137 "PIO_PFF_STARTUP_FFNO_ERROR" 138 "PIO_PFF_NVM_ALLOCATION_EXCEEDED" 139 "PIO_PFS_ECC_ERROR_DURING_FLASH_OP" 140 "PIO_PFS_RUNTIME_CORRUPT_FILE_FOUND" 141 "PIO_PKN_ERR_KERNEL_STARTED_BELOW_KERNEL_LEVEL" 142 "PIO_PKN_ERR_INVALID_RESOURCE_HANDLE" 143 "PIO_PKN_ERR_TASK_NOT_DECLARED_AS_ACQUIRING_RESOURCE" 144 "PIO_PKN_ERR_INVALID_TASK_HANDLE" 145 "PIO_PKN_ERR_INVALID_PERIODIC_TASK_HANDLE" 146 "PIO_PKN_ERR_UNEXPECTED_EXCEPTION" 147 "PIO_PKN_ERR_TASK_RESOURCE_CORE_DIFFER" 148 "PIO_PKN_ERR_TASK_RELEASE_RESOURCE_FAIL" 149 "PIO_PKN_ERR_ACQUIRING_RESOURCE_PRIORITY_CHANGE_FAIL" 150 "PIO_PKN_ERR_RELEASING_RESOURCE_PRIORITY_CHANGE_FAIL" 151 "PIO_PKN_ERR_TASK_RELEASE_RESOURCE_NEVER_ACQ" 152 "PIO_PKN_ERR_CLEAR_RESOURCE_SET_TASK_PRIO" 153 "PIO_PKN_ERR_ACQUIRING_RESOURCE_ALREADY_ACQUIRED" 154 "PIO_PJ1939_INVALID_CHANNEL" 155 "PIO_PJ1939_PG_TRANSMIT_RING_DEQUEUE_FAIL" 156 "PIO_PJ1939_DM6_TRANSMIT_INVALID_ARG" 157 "PIO_PJ1939_DM12_TRANSMIT_INVALID_ARG" 158 "PIO_PJ1939_DM14_DECODE_INVALID_ARG" 159 "PIO_PJ1939_DM15_TRANSMIT_INVALID_ARG" 160 "PIO_PJ1939_DM16_DECODE_INVALID_ARG" 161 "PIO_PJ1939_DM23_TRANSMIT_INVALID_ARG" 162 "PIO_PJ1939_DM27_TRANSMIT_INVALID_ARG" 163 "PIO_PJ1939_DM28_TRANSMIT_INVALID_ARG" 164 "PIO_PJ1939_DM29_TRANSMIT_INVALID_ARG" 165 "PIO_PJ1939_DM31_TRANSMIT_INVALID_ARG" 166 "PIO_PJ1939_DM41_TRANSMIT_INVALID_ARG" 167 "PIO_PJ1939_DM42_TRANSMIT_INVALID_ARG" 168 "PIO_PJ1939_DM43_TRANSMIT_INVALID_ARG" 169 "PIO_PJ1939_DM44_TRANSMIT_INVALID_ARG" 170 "PIO_PJ1939_DM45_TRANSMIT_INVALID_ARG" 171 "PIO_PJ1939_DM46_TRANSMIT_INVALID_ARG" 172 "PIO_PJ1939_DM47_TRANSMIT_INVALID_ARG" 173 "PIO_PJ1939_DM48_TRANSMIT_INVALID_ARG" 174 "PIO_PJ1939_DM49_TRANSMIT_INVALID_ARG" 175 "PIO_PJ1939_DM50_TRANSMIT_INVALID_ARG" 176 "PIO_PJ1939_DM51_TRANSMIT_INVALID_ARG" 177 "PIO_PJ1939_DM52_TRANSMIT_INVALID_ARG" 178 "PIO_PJ1939_INVALID_RING_BUFFER_ARG" 179 "PIO_PJ1939_DM1_RECEIVE_INVALID_ARG" 180 "PIO_PJ1939_DM2_RECEIVE_INVALID_ARG" 181 "PIO_PMCAL_ADC_INIT_CHECK_ERROR" 182 "PIO_PSAF_ERROR_STANDBY_INIT" 183 "PIO_PSAF_ISR_MINIMUM_DELAY_TIME_NOT_MET" 184 "PIO_PSAF_ERROR_CLOCK_PLAUSIBILITY" 185 "PIO_PSC_DECODE_RESET_INVALID_ARG" 186 "PIO_PSC_ERR_FORCED_RESET" 187 "PIO_PSC_ERR_STANDY_ENTRY" 188 "PIO_PSC_ERR_VERSION_INVALID_PARAM" 189 "PIO_PSC_ERR_BUILD_DATE_INVALID_PARAM" 190 "PIO_PSC_ERR_PART_NUMBER_INVALID_PARAM" 191 "PIO_PSC_UNEXPECTED_CVN_CHANGE" 192 "PIO_PSC_ERR_HW_VERSION_UNKNOWN" 193 "PIO_PSENT_IN_CHANNEL_UNSUPPORTED" 194 "PIO_PSMC_INVALID_DATA" 195 "PIO_PSMC_INTERNAL_SW_ERROR" 196 "PIO_PSTP_SAFETPACK_INIT_FAILURE" 197 "PIO_PSTP_SMU_MODE_INVALID_DURING_INIT" 198 "PIO_PSTP_SMU_MODE_RUN_DURING_INIT" 199 "PIO_PSTP_SMU_FAIL_INIT" 200 "PIO_PSTP_SMU_FAIL_ALARM_CONFIG" 201 "PIO_PSTP_SMU_SW_ALARM_GROUP_0" 202 "PIO_PSTP_SMU_SW_ALARM_GROUP_1" 203 "PIO_PSTP_SMU_SW_ALARM_GROUP_2" 204 "PIO_PSTP_SMU_SW_ALARM_GROUP_3" 205 "PIO_PSTP_SMU_SW_ALARM_GROUP_4" 206 "PIO_PSTP_SMU_SW_ALARM_GROUP_5" 207 "PIO_PSTP_SMU_SW_ALARM_GROUP_6" 208 "PIO_PSTP_SMU_SW_ALARM_GROUP_7" 209 "PIO_PSTP_SMU_SW_ALARM_GROUP_8" 210 "PIO_PSTP_SMU_SW_ALARM_GROUP_9" 211 "PIO_PSTP_SMU_SW_ALARM_GROUP_10" 212 "PIO_PSTP_SMU_SW_ALARM_GROUP_11" 213 "PIO_PSTP_SMU_SW_ALARM_GROUP_12" 214 "PIO_PSTP_SMU_SW_ALARM_GROUP_13" 215 "PIO_PSTP_SMU_SW_ALARM_GROUP_14" 216 "PIO_PSTP_SMU_SW_ALARM_GROUP_15" 217 "PIO_PSTP_SWDGM_UNEXPECTED" 218 "PIO_PSTP_SWDGM_INIT_FAIL" 219 "PIO_PSTP_SWDGM_ACTIVATE_FAIL" 220 "PIO_PSTP_SWDGM_DEINIT_FAIL" 221 "PIO_PSTP_SWDGM_GETERRCNTR_FAIL" 222 "PIO_PSTP_SWDGM_GETINFO_FAIL" 223 "PIO_PSTP_SWDGM_GETSEED_FAIL" 224 "PIO_PSTP_SWDGM_USERREQ_FAIL" 225 "PIO_PSTP_SWDGM_SERVICE_FAIL" 226 "PIO_PSTP_TSTM_STARTUP_TEST_FAIL" 227 "PIO_PSTP_TSTM_RUNTIME_TEST_FAIL" 228 "PIO_PSTP_TSTM_INIT_FAIL" 229 "PIO_PSTP_TSTM_SWITCH_TO_RUN_FAIL" 230 "PIO_PSTP_TLF_TEST_FAIL" 231 "PIO_PSTP_TLF_MAXJOBS_FAIL" 232 "PIO_PSTP_SEID_INCORRECT" 233 "PIO_PSTP_CHECKPOINT_INCORRECT" 234 "PIO_PSTP_ERR_TASK_BUDGET_OVRRUN" 235 "PIO_PSTP_HTXTESTHND_INVALID_RESULT" 236 "PIO_PSTP_HTXTESTHND_TEST_NOT_EXECUTED" 237 "PIO_PSTP_HTXLBIST_CALLER_ADDR_ERR" 238 "PIO_PSTP_HTXLBIST_PORST_ERR" 239 "PIO_PSTP_HTXLBIST_TERMINATION_ERR" 240 "PIO_PSTP_HTXLBIST_DEFAULT_SIGNATURE_ERR" 241 "PIO_PSTP_HTXLBIST_CRC_ERR" 242 "PIO_PSTP_HTXLBIST_UNDEFINED_ERR" 243 "PIO_PSTP_HTXLBIST_INV_PARAM_ERR" 244 "PIO_PSTP_HTXSFRTST_CMP_INV_PARAM_ERR" 245 "PIO_PSTP_HTXSFRTST_CMP_OVERLOAD" 246 "PIO_PSTP_HTXSFRTST_CMP_VAL_ERR" 247 "PIO_PSTP_HTXSFRTST_CRC_INV_PARAM_ERR" 248 "PIO_PSTP_HTXSFRTST_CRC_DATAMISMATCH" 249 "PIO_PSTP_HTXREGMON_SMU_TIMEOUT" 250 "PIO_PSTP_HTXREGMON_ERR_UNDEFINED" 251 "PIO_PSTP_HTXREGMON_ERR_MTU_TIMEOUT_UND" 252 "PIO_PSTP_HTXREGMON_INV_PARAM_ERR" 253 "PIO_PSTP_HTXREGMON_ERR_MTU_FAILED" 254 "PIO_PSTP_HTXMONBIST_ERR_SMU_FLAG" 255 "PIO_PSTP_HTXMONBIST_ERR_PMS_FLAG" 256 "PIO_PSTP_HTXMONBIST_ERR_PMS_SMU_FLAG" 257 "PIO_PSTP_HTXMONBIST_ERR_TIMEOUT" 258 "PIO_PSTP_HTXMONBIST_ERR_UNSPECIFIED" 259 "PIO_PSTP_HTXMONBIST_ERR_SFR_CONFIG" 260 "PIO_PSTP_HTXDTSRESULT_A_FAILED_ERR_DIFF" 261 "PIO_PSTP_HTXDTSRESULT_B_FAILED_ERR_DIFF" 262 "PIO_PSTP_HTXSMUALIVEALARM_ERR_ALM_STS" 263 "PIO_PSTP_HTXSMUALIVEALARM_ERR_TRIG" 264 "PIO_PSTP_HTXSMUALIVEALARM_PREV_ALM_STS" 265 "PIO_PSTP_HTXSMUALIVEALARM_ERR_SMU_RUN" 266 "PIO_PSTP_HTXVMTMBIST_ERR_MTU_UNDEFINED" 267 "PIO_PSTP_HTXVMTMBIST_ERR_MTU_TIMEOUT_UND" 268 "PIO_PSTP_HTXVMTMBIST_INV_PARAM_ERR" 269 "PIO_PSTP_HTXFWCHECK_FAILED" 270 "PIO_PSTP_HTXFWCHECK_INV_PARAM_ERR" 271 "PIO_PSTP_HTXFWCHECK_RST_UNKNOWN" 272 "PIO_PSTP_HTXFWCHECK_SFR_NOT_CLEARED" 273 "PIO_PSTP_HTXFWCHECK_DATA_ERR" 274 "PIO_PSTP_HTXPFM_UNEXPECTED_ERROR" 275 "PIO_PSTP_HTXPFM_RAM_CORRUPTION" 276 "PIO_PSTP_HTXPFM_ILLEGAL_FUNCTION_ARGUMENT" 277 "PIO_PSTP_HTXPFM_SYSTEM_TIMER_READ_FAULT" 278 "PIO_PSTP_HTXPFM_ILLEGAL_REINIT" 279 "PIO_PSTP_HTXPFM_UNEXPECTED_SEID" 280 "PIO_PSTP_HTXPFM_LOGICAL_FAULT_DETECTED" 281 "PIO_PSTP_HTXPFM_DEADLINE_FAULT_DETECTED" 282 "PIO_PSTP_HTXPFM_TIMING_FAULT_DETECTED" 283 "PIO_PSTP_HTXPFM_ALIVENESS_FAULT_DETECTED" 284 "PIO_PSY_ERR_SMU_ASSERT" 285 "PIO_PTM_TIMER_ERROR" 286 "PIO_PUT_DEBOUNCE_BY_CYCLES_INVALID_ARG" 287 "PIO_PUT_LEAKY_BUCKET_INVALID_ARG" 288 "PIO_PUT_DEBOUNCE_BY_TIME_INVALID_ARG" 289 "PIO_PUT_DUTYCYCLE_PROCESSING_INVALID_ARG" 290 "PIO_PUT_STATE_PROCESSING_INVALID_ARG" 291 "PIO_PUT_ARRAY_SEARCH_INVALID_ARG" 292 "PIO_PUT_ERR_PACK_INVALID_PARAM" 293 "PIO_PUT_ERR_UNPACK_INVALID_PARAM" 294 "PIO_PXCP_RESET" 295 "PIO_PUART_MCAL_INIT_CHECK_ERROR" 296 "PIO_ALARM_0_TYPE_0_CPU" 297 "PIO_ALARM_0_TYPE_1_CPU" 298 "PIO_ALARM_0_TYPE_2_CPU" 299 "PIO_ALARM_0_TYPE_4_MTU" 300 "PIO_ALARM_0_TYPE_5_MTU" 301 "PIO_ALARM_0_TYPE_6_MTU" 302 "PIO_ALARM_0_TYPE_7_MTU" 303 "PIO_ALARM_0_TYPE_8_MTU" 304 "PIO_ALARM_0_TYPE_9_MTU" 305 "PIO_ALARM_0_TYPE_10_MTU" 306 "PIO_ALARM_0_TYPE_11_MTU" 307 "PIO_ALARM_0_TYPE_12_MTU" 308 "PIO_ALARM_0_TYPE_13_MTU" 309 "PIO_ALARM_0_TYPE_14_MTU" 310 "PIO_ALARM_0_TYPE_22_CPU" 311 "PIO_ALARM_0_TYPE_23_CPU" 312 "PIO_ALARM_0_TYPE_24_CPU" 313 "PIO_ALARM_1_TYPE_0_CPU" 314 "PIO_ALARM_1_TYPE_1_CPU" 315 "PIO_ALARM_1_TYPE_2_CPU" 316 "PIO_ALARM_1_TYPE_4_MTU" 317 "PIO_ALARM_1_TYPE_5_MTU" 318 "PIO_ALARM_1_TYPE_6_MTU" 319 "PIO_ALARM_1_TYPE_7_MTU" 320 "PIO_ALARM_1_TYPE_8_MTU" 321 "PIO_ALARM_1_TYPE_9_MTU" 322 "PIO_ALARM_1_TYPE_10_MTU" 323 "PIO_ALARM_1_TYPE_11_MTU" 324 "PIO_ALARM_1_TYPE_12_MTU" 325 "PIO_ALARM_1_TYPE_13_MTU" 326 "PIO_ALARM_1_TYPE_14_MTU" 327 "PIO_ALARM_1_TYPE_22_MTU" 328 "PIO_ALARM_1_TYPE_23_CPU" 329 "PIO_ALARM_1_TYPE_24_CPU" 330 "PIO_ALARM_6_TYPE_0_MTU" 331 "PIO_ALARM_6_TYPE_1_IOM" 332 "PIO_ALARM_6_TYPE_2_IR" 333 "PIO_ALARM_6_TYPE_4_SCU" 334 "PIO_ALARM_6_TYPE_5_PMS" 335 "PIO_ALARM_6_TYPE_6_DMA" 336 "PIO_ALARM_6_TYPE_7_SMU_CORE" 337 "PIO_ALARM_6_TYPE_8_CCU" 338 "PIO_ALARM_6_TYPE_10_GTM" 339 "PIO_ALARM_6_TYPE_11_GTM" 340 "PIO_ALARM_6_TYPE_12_GTM" 341 "PIO_ALARM_6_TYPE_13_ERAY" 342 "PIO_ALARM_6_TYPE_14_ERAY" 343 "PIO_ALARM_6_TYPE_15_SRAM" 344 "PIO_ALARM_6_TYPE_16_CAN" 345 "PIO_ALARM_6_TYPE_17_CAN" 346 "PIO_ALARM_6_TYPE_18_CAN" 347 "PIO_ALARM_6_TYPE_19_MISC" 348 "PIO_ALARM_6_TYPE_20_MISC" 349 "PIO_ALARM_6_TYPE_21_MISC" 350 "PIO_ALARM_6_TYPE_23_CBS" 351 "PIO_ALARM_6_TYPE_24_CCU" 352 "PIO_ALARM_6_TYPE_25_CCU" 353 "PIO_ALARM_7_TYPE_0_DAM0" 354 "PIO_ALARM_7_TYPE_1_LMU" 355 "PIO_ALARM_7_TYPE_2_LMU" 356 "PIO_ALARM_7_TYPE_17_XBAR0" 357 "PIO_ALARM_7_TYPE_20_SPB" 358 "PIO_ALARM_7_TYPE_22_FSI" 359 "PIO_ALARM_7_TYPE_23_FSI" 360 "PIO_ALARM_7_TYPE_24_FSI" 361 "PIO_ALARM_7_TYPE_25_FSI" 362 "PIO_ALARM_7_TYPE_26_FSI" 363 "PIO_ALARM_7_TYPE_27_FSI" 364 "PIO_ALARM_7_TYPE_28_FSI" 365 "PIO_ALARM_7_TYPE_29_FSI" 366 "PIO_ALARM_7_TYPE_30_FSI" 367 "PIO_ALARM_7_TYPE_31_FSI" 368 "PIO_ALARM_8_TYPE_0_SCU" 369 "PIO_ALARM_8_TYPE_1_CCU" 370 "PIO_ALARM_8_TYPE_2_CCU" 371 "PIO_ALARM_8_TYPE_3_SCU" 372 "PIO_ALARM_8_TYPE_4_SCU" 373 "PIO_ALARM_8_TYPE_5_SCU" 374 "PIO_ALARM_8_TYPE_6_SCU" 375 "PIO_ALARM_8_TYPE_7_SCU" 376 "PIO_ALARM_8_TYPE_8_SCU" 377 "PIO_ALARM_8_TYPE_9_SCU" 378 "PIO_ALARM_8_TYPE_10_SCU" 379 "PIO_ALARM_8_TYPE_11_SCU" 380 "PIO_ALARM_8_TYPE_16_SCU" 381 "PIO_ALARM_8_TYPE_17_SCU" 382 "PIO_ALARM_8_TYPE_18_SCU" 383 "PIO_ALARM_8_TYPE_19_SCU" 384 "PIO_ALARM_8_TYPE_20_SCU" 385 "PIO_ALARM_8_TYPE_21_SCU" 386 "PIO_ALARM_8_TYPE_22_IR" 387 "PIO_ALARM_8_TYPE_23_DMA" 388 "PIO_ALARM_8_TYPE_25_IOM" 389 "PIO_ALARM_8_TYPE_26_SCU" 390 "PIO_ALARM_8_TYPE_27_SCU" 391 "PIO_ALARM_8_TYPE_28_SCU" 392 "PIO_ALARM_8_TYPE_29_SCU" 393 "PIO_ALARM_8_TYPE_30_SCU" 394 "PIO_ALARM_8_TYPE_31_SCU" 395 "PIO_ALARM_9_TYPE_0_DTS" 396 "PIO_ALARM_9_TYPE_1_DTS" 397 "PIO_ALARM_9_TYPE_3_PMS" 398 "PIO_ALARM_9_TYPE_5_PMS" 399 "PIO_ALARM_9_TYPE_15_PMS" 400 "PIO_ALARM_9_TYPE_16_PMS" 401 "PIO_ALARM_9_TYPE_17_PMS" 402 "PIO_ALARM_10_TYPE_0_SW" 403 "PIO_ALARM_10_TYPE_1_SW" 404 "PIO_ALARM_10_TYPE_2_SW" 405 "PIO_ALARM_10_TYPE_3_SW" 406 "PIO_ALARM_10_TYPE_4_SW" 407 "PIO_ALARM_10_TYPE_5_SW" 408 "PIO_ALARM_10_TYPE_6_SW" 409 "PIO_ALARM_10_TYPE_7_SW" 410 "PIO_ALARM_10_TYPE_8_SW" 411 "PIO_ALARM_10_TYPE_9_SW" 412 "PIO_ALARM_10_TYPE_10_SW" 413 "PIO_ALARM_10_TYPE_11_SW" 414 "PIO_ALARM_10_TYPE_12_SW" 415 "PIO_ALARM_10_TYPE_13_SW" 416 "PIO_ALARM_10_TYPE_14_SW" 417 "PIO_ALARM_10_TYPE_15_SW" 418 "PIO_ALARM_10_TYPE_16_SMU_CORE" 419 "PIO_ALARM_10_TYPE_17_SMU_CORE" 420 "PIO_ALARM_10_TYPE_18_FSP" 421 "PIO_ALARM_10_TYPE_20_CCU" 422 "PIO_ALARM_10_TYPE_21_SFF" 423 "PIO_ALARM_10_TYPE_22_SFF" 424 "PIO_ALARM_11_TYPE_2_XBAR" 425 "PIO_ALARM_11_TYPE_3_XBAR" 426 "PIO_ALARM_11_TYPE_4_DMU" 427 "PIO_ALARM_11_TYPE_5_DMU" 428 "PIO_ALARM_11_TYPE_9_SFIBRIDGE1" 429 "PIO_ALARM_11_TYPE_10_HSSL" 430 "PIO_ALARM_11_TYPE_12_CONVERTER" 431 "PIO_ALARM_11_TYPE_13_XBAR" 432 "PIO_ALARM_20_TYPE_4_EVR" 433 "PIO_ALARM_20_TYPE_5_EVR" 434 "PIO_ALARM_20_TYPE_6_EVR" 435 "PIO_ALARM_20_TYPE_7_EVR" 436 "PIO_ALARM_20_TYPE_8_EVR" 437 "PIO_ALARM_20_TYPE_9_EVR" 438 "PIO_ALARM_20_TYPE_10_EVR" 439 "PIO_ALARM_20_TYPE_11_EVR" 440 "PIO_ALARM_20_TYPE_12_EVR" 441 "PIO_ALARM_20_TYPE_13_EVR" 442 "PIO_ALARM_20_TYPE_14_EVR" 443 "PIO_ALARM_20_TYPE_15_EVR" 444 "PIO_ALARM_21_TYPE_0_HSM" 445 "PIO_ALARM_21_TYPE_1_HSM" 446 "PIO_ALARM_21_TYPE_2_HSM" 447 "PIO_ALARM_21_TYPE_3_HSM" 448 "PIO_ALARM_21_TYPE_4_HSM" 449 "PIO_ALARM_21_TYPE_5_HSM" 450 "PIO_ALARM_21_TYPE_7_SMU" 451 "PIO_ALARM_21_TYPE_8_PMS" 452 "PIO_ALARM_21_TYPE_9_PMS" 453 "PIO_ALARM_21_TYPE_10_PMS" 454 "PIO_ALARM_21_TYPE_11_PMS" 455 "PIO_ALARM_21_TYPE_12_PMS" 456 "PIO_ALARM_21_TYPE_13_PMS" 457 "PIO_ALARM_21_TYPE_14_PMS" 458 "PIO_ALARM_21_TYPE_15_CCU" 459 "PIO_ALARM_21_TYPE_16_SMU_CORE" 460 "PIO_ALARM_MULTIPLE" 461 "PIO_ALARM_RESERVED" 462 "PIO_ALARM_UNEXPECTED" 463 "PIO_ERROR_ID_LAST" /end COMPU_VTAB
/* Scalar measurable for DDE 'mpl_error_log_summary[0].mode'. */
/begin MEASUREMENT mpl_error_log_summary[0].mode "Mode of the software when fault raised" SBYTE CU_MPL_ERROR_LOG_SUMMARY[0].MO0 1 100 0.0 127.0 ECU_ADDRESS 0xf024004a BYTE_ORDER MSB_LAST /end MEASUREMENT
/begin COMPU_METHOD CU_MPL_ERROR_LOG_SUMMARY[0].MO0 "Conversion method for mpl_error_log_summary[0].mode" TAB_VERB "%12.0" "code" COMPU_TAB_REF CT_MPL_ERROR_LOG_SUMMARY[0].MO0 /end COMPU_METHOD
/begin COMPU_VTAB CT_MPL_ERROR_LOG_SUMMARY[0].MO0 "Conversion method for mpl_error_log_summary[0].mode" TAB_VERB 4 0 "PIO_EXEC_MODE_UNKNOWN" 1 "PIO_EXEC_MODE_PRG" 2 "PIO_EXEC_MODE_APP" 3 "PIO_EXEC_MODE_LAST" /end COMPU_VTAB
/* Scalar measurable for DDE 'mpl_error_log_summary[0].reaction'. */
/begin MEASUREMENT mpl_error_log_summary[0].react0 "Reaction to the fault raised" SBYTE CU_MPL_ERROR_LOG_SUMMARY[0].RE0 1 100 0.0 127.0 ECU_ADDRESS 0xf024004b BYTE_ORDER MSB_LAST /end MEASUREMENT
/begin COMPU_METHOD CU_MPL_ERROR_LOG_SUMMARY[0].RE0 "Conversion method for mpl_error_log_summary[0].reaction" TAB_VERB "%12.0" "code" COMPU_TAB_REF CT_MPL_ERROR_LOG_SUMMARY[0].RE0 /end COMPU_METHOD
/begin COMPU_VTAB CT_MPL_ERROR_LOG_SUMMARY[0].RE0 "Conversion method for mpl_error_log_summary[0].reaction" TAB_VERB 6 0 "PIO_CONTINUE" 1 "PIO_RESET" 2 "PIO_RECORD_AND_CONTINUE" 3 "PIO_RECORD_AND_RESET" 4 "PIO_RESET_AND_RECORD" 5 "PIO_FAULT_REACTION_LAST" /end COMPU_VTAB
/* Scalar measurable for DDE 'mpl_error_log_summary[1].id'. */
/begin MEASUREMENT mpl_error_log_summary[1].id "Error code of fault raised" SWORD CU_MPL_ERROR_LOG_SUMMARY[1].ID 1 100 0.0 32767.0 ECU_ADDRESS 0xf024004c BYTE_ORDER MSB_LAST /end MEASUREMENT
/begin COMPU_METHOD CU_MPL_ERROR_LOG_SUMMARY[1].ID "Conversion method for mpl_error_log_summary[1].id" TAB_VERB "%12.0" "code" COMPU_TAB_REF CT_MPL_ERROR_LOG_SUMMARY[1].ID /end COMPU_METHOD
/begin COMPU_VTAB CT_MPL_ERROR_LOG_SUMMARY[1].ID "Conversion method for mpl_error_log_summary[1].id" TAB_VERB 464 0 "PIO_PSY_NO_ERROR" 1 "PIO_TRAP_0_TIN_0_VAF" 2 "PIO_TRAP_0_TIN_1_VAP" 3 "PIO_TRAP_0_TIN_UNKNOWN" 4 "PIO_TRAP_1_TIN_1_PRIV" 5 "PIO_TRAP_1_TIN_2_MPR" 6 "PIO_TRAP_1_TIN_3_MPW" 7 "PIO_TRAP_1_TIN_4_MPX" 8 "PIO_TRAP_1_TIN_5_MPP" 9 "PIO_TRAP_1_TIN_6_MPN" 10 "PIO_TRAP_1_TIN_7_GRWP" 11 "PIO_TRAP_1_TIN_UNKNOWN" 12 "PIO_TRAP_2_TIN_1_IOPC" 13 "PIO_TRAP_2_TIN_2_UOPC" 14 "PIO_TRAP_2_TIN_3_OPD" 15 "PIO_TRAP_2_TIN_4_ALN" 16 "PIO_TRAP_2_TIN_5_MEM" 17 "PIO_TRAP_2_TIN_UNKNOWN" 18 "PIO_TRAP_3_TIN_1_FCD" 19 "PIO_TRAP_3_TIN_2_FCD" 20 "PIO_TRAP_3_TIN_3_CDU" 21 "PIO_TRAP_3_TIN_4_FCU" 22 "PIO_TRAP_3_TIN_5_CSU" 23 "PIO_TRAP_3_TIN_6_CTYP" 24 "PIO_TRAP_3_TIN_7_NEST" 25 "PIO_TRAP_3_TIN_UNKNOWN" 26 "PIO_TRAP_4_TIN_1_PSE" 27 "PIO_TRAP_4_TIN_2_DSE" 28 "PIO_TRAP_4_TIN_3_DAE" 29 "PIO_TRAP_4_TIN_4_CAE" 30 "PIO_TRAP_4_TIN_4_CAE_UNEXPECTED" 31 "PIO_TRAP_4_TIN_4_CAE_UNEXPECTED_FW" 32 "PIO_TRAP_4_TIN_5_PIE" 33 "PIO_TRAP_4_TIN_6_DIE" 34 "PIO_TRAP_4_TIN_7_DIE" 35 "PIO_TRAP_4_TIN_5_6_UNEXPECTED" 36 "PIO_TRAP_4_TIN_UNKNOWN" 37 "PIO_TRAP_5_TIN_1_OVF" 38 "PIO_TRAP_5_TIN_2_SOVF" 39 "PIO_TRAP_5_TIN_UNKNOWN" 40 "PIO_TRAP_6_SYS_UNKNOWN" 41 "PIO_TRAP_7_TIN_0_NMI" 42 "PIO_TRAP_7_TIN_UNKNOWN" 43 "PIO_ISR_0_RESET" 44 "PIO_BSPI_FIRST" 45 "PIO_BSPI_TRANSFER_TIMEOUT" 46 "PIO_BSPI_TX_DMA_ERROR" 47 "PIO_BSPI_RX_DMA_ERROR" 48 "PIO_BSPI_DSPI_ERROR" 49 "PIO_BSPI_RX_FIFO_OVERFLOW" 50 "PIO_BSPI_TX_FIFO_UNDERFLOW" 51 "PIO_BSPI_TRANSFER_TERMINATED" 52 "PIO_BSPI_TRANSAC_FAILED" 53 "PIO_BSPI_INTERNAL_SOFTWARE_ERROR" 54 "PIO_BSPI_ISR_MINIMUM_DELAY_TIME_NOT_MET" 55 "PIO_BSPI_ISR_FALSE_INT" 56 "PIO_BSPI_DMA_SAFETY_ERROR" 57 "PIO_BSPI_LAST" 58 "PIO_P1WR_ISR_MINIMUM_DELAY_TIME_NOT_MET" 59 "PIO_PADC_BUFFER_INIT_FAILED" 60 "PIO_PAX_ADC_INPUT_INVALID_ARG" 61 "PIO_PAX_CHANNEL_INVALID" 62 "PIO_PAX_ADC_INPUT_CHANNEL_UNSUPPORTED" 63 "PIO_PAX_CC_OUTPUT_CHANNEL_UNSUPPORTED" 64 "PIO_PAX_AOT_OUTPUT_CHANNEL_UNSUPPORTED" 65 "PIO_PAX_ISR_MINIMUM_DELAY_TIME_NOT_MET" 66 "PIO_PCANOPEN_RESET" 67 "PIO_PCANOPEN_BUFFER_OUT_OF_RANGE" 68 "PIO_PCANOPEN_NULL_POINTER" 69 "PIO_PCCP_RESET" 70 "PIO_PCCU6_ISR_MINIMUM_DELAY_TIME_NOT_MET" 71 "PIO_PCFG_INTERNAL_SW_ERROR" 72 "PIO_PCX_ERR_BUS_ID_OUT_OF_RANGE" 73 "PIO_PCX_ERR_DATA_LENGTH_OUT_OF_RANGE" 74 "PIO_PCX_ERR_STD_ID_OUT_OF_RANGE" 75 "PIO_PCX_ERR_EXT_ID_OUT_OF_RANGE" 76 "PIO_PCX_ERR_SAME_TX_MSG_DIFFERING_ATTRIBS" 77 "PIO_PCX_ERR_TOO_MANY_TX_MSGS" 78 "PIO_PCX_ERR_DUPLICATE_RX_MSG" 79 "PIO_PCX_ERR_TOO_MANY_RX_MSGS" 80 "PIO_PCX_ERR_BIT_RATE_IN_CONFIG_DIFFERS" 81 "PIO_PCX_ERR_UNSUPPORTED_BIT_RATE" 82 "PIO_PCX_ERR_BUS_ID_IN_CONFIG" 83 "PIO_PCX_ERR_NO_BITRATE_TABLE_MATCH" 84 "PIO_PCX_ERR_PACK_MSG_INVALID_PARAM" 85 "PIO_PCX_ERR_PACK_MSG_FIELD_PARAM" 86 "PIO_PCX_ERR_UNPACK_MSG_INVALID_PARAM" 87 "PIO_PCX_ERR_UNPACK_MSG_FIELD_PARAM" 88 "PIO_PCX_ERR_PACK_VDB_MSG_INVALID_PARAM" 89 "PIO_PCX_ERR_UNPACK_VDB_MSG_INVALID_PARAM" 90 "PIO_PCX_ERR_SWITCHED_RATE_FOR_NONFD_BUS" 91 "PIO_PCX_ERR_RX_MSG_FOR_UNCONFIG_BUS_0" 92 "PIO_PCX_ERR_UNSUPPORTED_BUS_MODE" 93 "PIO_PCX_ERR_BUS_MODE_IN_CONFIG_DIFFERS" 94 "PIO_PCX_ERR_SAME_RX_MSG_DIFFERING_ATTRIBS" 95 "PIO_PCX_ERR_TX_MSG_FOR_UNCONFIG_BUS_0" 96 "PIO_PCX_ISR_MINIMUM_DELAY_TIME_NOT_MET" 97 "PIO_PDD_CHANNEL_INVALID" 98 "PIO_PDD_DIG_DATA_IN_CHANNEL_UNSUPPORTED" 99 "PIO_PDD_DIG_DATA_OUT_CHANNEL_UNSUPPORTED" 100 "PIO_PDG_ERR_FORCED_RESET" 101 "PIO_PDTC_UPDATE_INVALID_ARG" 102 "PIO_PDTC_CLEAR_ALL_INVALID_ARG" 103 "PIO_PDTC_CLEAR_ALL_IF_ACT_INVALID_ARG" 104 "PIO_PDTC_CLEAR_ALL_IF_INACT_INVALID_ARG" 105 "PIO_PDTC_GET_DTC_STATUS_INVALID_ARG" 106 "PIO_PDTC_MATCH_EXISTS_INVALID_ARG" 107 "PIO_PDTC_CLEAR_DTCS_INVALID_ARG" 108 "PIO_PDTC_BAD_LICENSE" 109 "PIO_PDX_DO_CHANNEL_UNSUPPORTED" 110 "PIO_PDX_DIG_IN_CHANNEL_UNSUPPORTED" 111 "PIO_PDX_FREQ_IN_CHANNEL_UNSUPPORTED" 112 "PIO_PDX_PERIOD_IN_CHANNEL_UNSUPPORTED" 113 "PIO_PDX_QDEC_FREQ_IN_INVALID_ARG" 114 "PIO_PDX_QDEC_FREQ_IN_CHANNEL_UNSUPPORTED" 115 "PIO_PDX_TPU_QFI_CHANNEL_DEVICE_ERROR" 116 "PIO_PDX_QDEC_IN_CHANNEL_UNSUPPORTED" 117 "PIO_PDX_TPU_QI_CHANNEL_DEVICE_ERROR" 118 "PIO_PDX_PWM_OUT_CHANNEL_UNSUPPORTED" 119 "PIO_PDX_PWM_IN_CHANNEL_UNSUPPORTED" 120 "PIO_PDX_CHANNEL_INVALID" 121 "PIO_PDX_HBRIDGE_INVALID_MODE" 122 "PIO_PDX_HBRIDGE_DECODE_ERROR" 123 "PIO_PDX_HBRIDGE_CHANNEL_GROUP_UNSUPPORTED" 124 "PIO_PEM_EXTERNAL_RAM_REQUIRED" 125 "PIO_PEM_MEM_CONFIG_UNKNOWN" 126 "PIO_PETH_ERR_DRIVER_INITIALIZATION_ERROR" 127 "PIO_PETH_ERR_NULL_CONFIGURATION_POINTER" 128 "PIO_PETH_ERR_DATA_LENGTH_OUT_OF_RANGE" 129 "PIO_PETH_ERR_TOO_MANY_TX_MSGS" 130 "PIO_PETH_ERR_NOT_SUPPORTED" 131 "PIO_PFF_HOLDING_ARRAY_INDEX_INVALID" 132 "PIO_PFF_HOLDING_ARRAY_STRT_END_INVALID" 133 "PIO_PFF_HOLDING_ARRAY_REC_DATA_INVALID" 134 "PIO_PFF_STORED_FF_DTC_INVALID" 135 "PIO_PFF_STORED_DTC_READ_FAILURE" 136 "PIO_PFF_CAPTURE_PID_DATA_FAILURE" 137 "PIO_PFF_STARTUP_FFNO_ERROR" 138 "PIO_PFF_NVM_ALLOCATION_EXCEEDED" 139 "PIO_PFS_ECC_ERROR_DURING_FLASH_OP" 140 "PIO_PFS_RUNTIME_CORRUPT_FILE_FOUND" 141 "PIO_PKN_ERR_KERNEL_STARTED_BELOW_KERNEL_LEVEL" 142 "PIO_PKN_ERR_INVALID_RESOURCE_HANDLE" 143 "PIO_PKN_ERR_TASK_NOT_DECLARED_AS_ACQUIRING_RESOURCE" 144 "PIO_PKN_ERR_INVALID_TASK_HANDLE" 145 "PIO_PKN_ERR_INVALID_PERIODIC_TASK_HANDLE" 146 "PIO_PKN_ERR_UNEXPECTED_EXCEPTION" 147 "PIO_PKN_ERR_TASK_RESOURCE_CORE_DIFFER" 148 "PIO_PKN_ERR_TASK_RELEASE_RESOURCE_FAIL" 149 "PIO_PKN_ERR_ACQUIRING_RESOURCE_PRIORITY_CHANGE_FAIL" 150 "PIO_PKN_ERR_RELEASING_RESOURCE_PRIORITY_CHANGE_FAIL" 151 "PIO_PKN_ERR_TASK_RELEASE_RESOURCE_NEVER_ACQ" 152 "PIO_PKN_ERR_CLEAR_RESOURCE_SET_TASK_PRIO" 153 "PIO_PKN_ERR_ACQUIRING_RESOURCE_ALREADY_ACQUIRED" 154 "PIO_PJ1939_INVALID_CHANNEL" 155 "PIO_PJ1939_PG_TRANSMIT_RING_DEQUEUE_FAIL" 156 "PIO_PJ1939_DM6_TRANSMIT_INVALID_ARG" 157 "PIO_PJ1939_DM12_TRANSMIT_INVALID_ARG" 158 "PIO_PJ1939_DM14_DECODE_INVALID_ARG" 159 "PIO_PJ1939_DM15_TRANSMIT_INVALID_ARG" 160 "PIO_PJ1939_DM16_DECODE_INVALID_ARG" 161 "PIO_PJ1939_DM23_TRANSMIT_INVALID_ARG" 162 "PIO_PJ1939_DM27_TRANSMIT_INVALID_ARG" 163 "PIO_PJ1939_DM28_TRANSMIT_INVALID_ARG" 164 "PIO_PJ1939_DM29_TRANSMIT_INVALID_ARG" 165 "PIO_PJ1939_DM31_TRANSMIT_INVALID_ARG" 166 "PIO_PJ1939_DM41_TRANSMIT_INVALID_ARG" 167 "PIO_PJ1939_DM42_TRANSMIT_INVALID_ARG" 168 "PIO_PJ1939_DM43_TRANSMIT_INVALID_ARG" 169 "PIO_PJ1939_DM44_TRANSMIT_INVALID_ARG" 170 "PIO_PJ1939_DM45_TRANSMIT_INVALID_ARG" 171 "PIO_PJ1939_DM46_TRANSMIT_INVALID_ARG" 172 "PIO_PJ1939_DM47_TRANSMIT_INVALID_ARG" 173 "PIO_PJ1939_DM48_TRANSMIT_INVALID_ARG" 174 "PIO_PJ1939_DM49_TRANSMIT_INVALID_ARG" 175 "PIO_PJ1939_DM50_TRANSMIT_INVALID_ARG" 176 "PIO_PJ1939_DM51_TRANSMIT_INVALID_ARG" 177 "PIO_PJ1939_DM52_TRANSMIT_INVALID_ARG" 178 "PIO_PJ1939_INVALID_RING_BUFFER_ARG" 179 "PIO_PJ1939_DM1_RECEIVE_INVALID_ARG" 180 "PIO_PJ1939_DM2_RECEIVE_INVALID_ARG" 181 "PIO_PMCAL_ADC_INIT_CHECK_ERROR" 182 "PIO_PSAF_ERROR_STANDBY_INIT" 183 "PIO_PSAF_ISR_MINIMUM_DELAY_TIME_NOT_MET" 184 "PIO_PSAF_ERROR_CLOCK_PLAUSIBILITY" 185 "PIO_PSC_DECODE_RESET_INVALID_ARG" 186 "PIO_PSC_ERR_FORCED_RESET" 187 "PIO_PSC_ERR_STANDY_ENTRY" 188 "PIO_PSC_ERR_VERSION_INVALID_PARAM" 189 "PIO_PSC_ERR_BUILD_DATE_INVALID_PARAM" 190 "PIO_PSC_ERR_PART_NUMBER_INVALID_PARAM" 191 "PIO_PSC_UNEXPECTED_CVN_CHANGE" 192 "PIO_PSC_ERR_HW_VERSION_UNKNOWN" 193 "PIO_PSENT_IN_CHANNEL_UNSUPPORTED" 194 "PIO_PSMC_INVALID_DATA" 195 "PIO_PSMC_INTERNAL_SW_ERROR" 196 "PIO_PSTP_SAFETPACK_INIT_FAILURE" 197 "PIO_PSTP_SMU_MODE_INVALID_DURING_INIT" 198 "PIO_PSTP_SMU_MODE_RUN_DURING_INIT" 199 "PIO_PSTP_SMU_FAIL_INIT" 200 "PIO_PSTP_SMU_FAIL_ALARM_CONFIG" 201 "PIO_PSTP_SMU_SW_ALARM_GROUP_0" 202 "PIO_PSTP_SMU_SW_ALARM_GROUP_1" 203 "PIO_PSTP_SMU_SW_ALARM_GROUP_2" 204 "PIO_PSTP_SMU_SW_ALARM_GROUP_3" 205 "PIO_PSTP_SMU_SW_ALARM_GROUP_4" 206 "PIO_PSTP_SMU_SW_ALARM_GROUP_5" 207 "PIO_PSTP_SMU_SW_ALARM_GROUP_6" 208 "PIO_PSTP_SMU_SW_ALARM_GROUP_7" 209 "PIO_PSTP_SMU_SW_ALARM_GROUP_8" 210 "PIO_PSTP_SMU_SW_ALARM_GROUP_9" 211 "PIO_PSTP_SMU_SW_ALARM_GROUP_10" 212 "PIO_PSTP_SMU_SW_ALARM_GROUP_11" 213 "PIO_PSTP_SMU_SW_ALARM_GROUP_12" 214 "PIO_PSTP_SMU_SW_ALARM_GROUP_13" 215 "PIO_PSTP_SMU_SW_ALARM_GROUP_14" 216 "PIO_PSTP_SMU_SW_ALARM_GROUP_15" 217 "PIO_PSTP_SWDGM_UNEXPECTED" 218 "PIO_PSTP_SWDGM_INIT_FAIL" 219 "PIO_PSTP_SWDGM_ACTIVATE_FAIL" 220 "PIO_PSTP_SWDGM_DEINIT_FAIL" 221 "PIO_PSTP_SWDGM_GETERRCNTR_FAIL" 222 "PIO_PSTP_SWDGM_GETINFO_FAIL" 223 "PIO_PSTP_SWDGM_GETSEED_FAIL" 224 "PIO_PSTP_SWDGM_USERREQ_FAIL" 225 "PIO_PSTP_SWDGM_SERVICE_FAIL" 226 "PIO_PSTP_TSTM_STARTUP_TEST_FAIL" 227 "PIO_PSTP_TSTM_RUNTIME_TEST_FAIL" 228 "PIO_PSTP_TSTM_INIT_FAIL" 229 "PIO_PSTP_TSTM_SWITCH_TO_RUN_FAIL" 230 "PIO_PSTP_TLF_TEST_FAIL" 231 "PIO_PSTP_TLF_MAXJOBS_FAIL" 232 "PIO_PSTP_SEID_INCORRECT" 233 "PIO_PSTP_CHECKPOINT_INCORRECT" 234 "PIO_PSTP_ERR_TASK_BUDGET_OVRRUN" 235 "PIO_PSTP_HTXTESTHND_INVALID_RESULT" 236 "PIO_PSTP_HTXTESTHND_TEST_NOT_EXECUTED" 237 "PIO_PSTP_HTXLBIST_CALLER_ADDR_ERR" 238 "PIO_PSTP_HTXLBIST_PORST_ERR" 239 "PIO_PSTP_HTXLBIST_TERMINATION_ERR" 240 "PIO_PSTP_HTXLBIST_DEFAULT_SIGNATURE_ERR" 241 "PIO_PSTP_HTXLBIST_CRC_ERR" 242 "PIO_PSTP_HTXLBIST_UNDEFINED_ERR" 243 "PIO_PSTP_HTXLBIST_INV_PARAM_ERR" 244 "PIO_PSTP_HTXSFRTST_CMP_INV_PARAM_ERR" 245 "PIO_PSTP_HTXSFRTST_CMP_OVERLOAD" 246 "PIO_PSTP_HTXSFRTST_CMP_VAL_ERR" 247 "PIO_PSTP_HTXSFRTST_CRC_INV_PARAM_ERR" 248 "PIO_PSTP_HTXSFRTST_CRC_DATAMISMATCH" 249 "PIO_PSTP_HTXREGMON_SMU_TIMEOUT" 250 "PIO_PSTP_HTXREGMON_ERR_UNDEFINED" 251 "PIO_PSTP_HTXREGMON_ERR_MTU_TIMEOUT_UND" 252 "PIO_PSTP_HTXREGMON_INV_PARAM_ERR" 253 "PIO_PSTP_HTXREGMON_ERR_MTU_FAILED" 254 "PIO_PSTP_HTXMONBIST_ERR_SMU_FLAG" 255 "PIO_PSTP_HTXMONBIST_ERR_PMS_FLAG" 256 "PIO_PSTP_HTXMONBIST_ERR_PMS_SMU_FLAG" 257 "PIO_PSTP_HTXMONBIST_ERR_TIMEOUT" 258 "PIO_PSTP_HTXMONBIST_ERR_UNSPECIFIED" 259 "PIO_PSTP_HTXMONBIST_ERR_SFR_CONFIG" 260 "PIO_PSTP_HTXDTSRESULT_A_FAILED_ERR_DIFF" 261 "PIO_PSTP_HTXDTSRESULT_B_FAILED_ERR_DIFF" 262 "PIO_PSTP_HTXSMUALIVEALARM_ERR_ALM_STS" 263 "PIO_PSTP_HTXSMUALIVEALARM_ERR_TRIG" 264 "PIO_PSTP_HTXSMUALIVEALARM_PREV_ALM_STS" 265 "PIO_PSTP_HTXSMUALIVEALARM_ERR_SMU_RUN" 266 "PIO_PSTP_HTXVMTMBIST_ERR_MTU_UNDEFINED" 267 "PIO_PSTP_HTXVMTMBIST_ERR_MTU_TIMEOUT_UND" 268 "PIO_PSTP_HTXVMTMBIST_INV_PARAM_ERR" 269 "PIO_PSTP_HTXFWCHECK_FAILED" 270 "PIO_PSTP_HTXFWCHECK_INV_PARAM_ERR" 271 "PIO_PSTP_HTXFWCHECK_RST_UNKNOWN" 272 "PIO_PSTP_HTXFWCHECK_SFR_NOT_CLEARED" 273 "PIO_PSTP_HTXFWCHECK_DATA_ERR" 274 "PIO_PSTP_HTXPFM_UNEXPECTED_ERROR" 275 "PIO_PSTP_HTXPFM_RAM_CORRUPTION" 276 "PIO_PSTP_HTXPFM_ILLEGAL_FUNCTION_ARGUMENT" 277 "PIO_PSTP_HTXPFM_SYSTEM_TIMER_READ_FAULT" 278 "PIO_PSTP_HTXPFM_ILLEGAL_REINIT" 279 "PIO_PSTP_HTXPFM_UNEXPECTED_SEID" 280 "PIO_PSTP_HTXPFM_LOGICAL_FAULT_DETECTED" 281 "PIO_PSTP_HTXPFM_DEADLINE_FAULT_DETECTED" 282 "PIO_PSTP_HTXPFM_TIMING_FAULT_DETECTED" 283 "PIO_PSTP_HTXPFM_ALIVENESS_FAULT_DETECTED" 284 "PIO_PSY_ERR_SMU_ASSERT" 285 "PIO_PTM_TIMER_ERROR" 286 "PIO_PUT_DEBOUNCE_BY_CYCLES_INVALID_ARG" 287 "PIO_PUT_LEAKY_BUCKET_INVALID_ARG" 288 "PIO_PUT_DEBOUNCE_BY_TIME_INVALID_ARG" 289 "PIO_PUT_DUTYCYCLE_PROCESSING_INVALID_ARG" 290 "PIO_PUT_STATE_PROCESSING_INVALID_ARG" 291 "PIO_PUT_ARRAY_SEARCH_INVALID_ARG" 292 "PIO_PUT_ERR_PACK_INVALID_PARAM" 293 "PIO_PUT_ERR_UNPACK_INVALID_PARAM" 294 "PIO_PXCP_RESET" 295 "PIO_PUART_MCAL_INIT_CHECK_ERROR" 296 "PIO_ALARM_0_TYPE_0_CPU" 297 "PIO_ALARM_0_TYPE_1_CPU" 298 "PIO_ALARM_0_TYPE_2_CPU" 299 "PIO_ALARM_0_TYPE_4_MTU" 300 "PIO_ALARM_0_TYPE_5_MTU" 301 "PIO_ALARM_0_TYPE_6_MTU" 302 "PIO_ALARM_0_TYPE_7_MTU" 303 "PIO_ALARM_0_TYPE_8_MTU" 304 "PIO_ALARM_0_TYPE_9_MTU" 305 "PIO_ALARM_0_TYPE_10_MTU" 306 "PIO_ALARM_0_TYPE_11_MTU" 307 "PIO_ALARM_0_TYPE_12_MTU" 308 "PIO_ALARM_0_TYPE_13_MTU" 309 "PIO_ALARM_0_TYPE_14_MTU" 310 "PIO_ALARM_0_TYPE_22_CPU" 311 "PIO_ALARM_0_TYPE_23_CPU" 312 "PIO_ALARM_0_TYPE_24_CPU" 313 "PIO_ALARM_1_TYPE_0_CPU" 314 "PIO_ALARM_1_TYPE_1_CPU" 315 "PIO_ALARM_1_TYPE_2_CPU" 316 "PIO_ALARM_1_TYPE_4_MTU" 317 "PIO_ALARM_1_TYPE_5_MTU" 318 "PIO_ALARM_1_TYPE_6_MTU" 319 "PIO_ALARM_1_TYPE_7_MTU" 320 "PIO_ALARM_1_TYPE_8_MTU" 321 "PIO_ALARM_1_TYPE_9_MTU" 322 "PIO_ALARM_1_TYPE_10_MTU" 323 "PIO_ALARM_1_TYPE_11_MTU" 324 "PIO_ALARM_1_TYPE_12_MTU" 325 "PIO_ALARM_1_TYPE_13_MTU" 326 "PIO_ALARM_1_TYPE_14_MTU" 327 "PIO_ALARM_1_TYPE_22_MTU" 328 "PIO_ALARM_1_TYPE_23_CPU" 329 "PIO_ALARM_1_TYPE_24_CPU" 330 "PIO_ALARM_6_TYPE_0_MTU" 331 "PIO_ALARM_6_TYPE_1_IOM" 332 "PIO_ALARM_6_TYPE_2_IR" 333 "PIO_ALARM_6_TYPE_4_SCU" 334 "PIO_ALARM_6_TYPE_5_PMS" 335 "PIO_ALARM_6_TYPE_6_DMA" 336 "PIO_ALARM_6_TYPE_7_SMU_CORE" 337 "PIO_ALARM_6_TYPE_8_CCU" 338 "PIO_ALARM_6_TYPE_10_GTM" 339 "PIO_ALARM_6_TYPE_11_GTM" 340 "PIO_ALARM_6_TYPE_12_GTM" 341 "PIO_ALARM_6_TYPE_13_ERAY" 342 "PIO_ALARM_6_TYPE_14_ERAY" 343 "PIO_ALARM_6_TYPE_15_SRAM" 344 "PIO_ALARM_6_TYPE_16_CAN" 345 "PIO_ALARM_6_TYPE_17_CAN" 346 "PIO_ALARM_6_TYPE_18_CAN" 347 "PIO_ALARM_6_TYPE_19_MISC" 348 "PIO_ALARM_6_TYPE_20_MISC" 349 "PIO_ALARM_6_TYPE_21_MISC" 350 "PIO_ALARM_6_TYPE_23_CBS" 351 "PIO_ALARM_6_TYPE_24_CCU" 352 "PIO_ALARM_6_TYPE_25_CCU" 353 "PIO_ALARM_7_TYPE_0_DAM0" 354 "PIO_ALARM_7_TYPE_1_LMU" 355 "PIO_ALARM_7_TYPE_2_LMU" 356 "PIO_ALARM_7_TYPE_17_XBAR0" 357 "PIO_ALARM_7_TYPE_20_SPB" 358 "PIO_ALARM_7_TYPE_22_FSI" 359 "PIO_ALARM_7_TYPE_23_FSI" 360 "PIO_ALARM_7_TYPE_24_FSI" 361 "PIO_ALARM_7_TYPE_25_FSI" 362 "PIO_ALARM_7_TYPE_26_FSI" 363 "PIO_ALARM_7_TYPE_27_FSI" 364 "PIO_ALARM_7_TYPE_28_FSI" 365 "PIO_ALARM_7_TYPE_29_FSI" 366 "PIO_ALARM_7_TYPE_30_FSI" 367 "PIO_ALARM_7_TYPE_31_FSI" 368 "PIO_ALARM_8_TYPE_0_SCU" 369 "PIO_ALARM_8_TYPE_1_CCU" 370 "PIO_ALARM_8_TYPE_2_CCU" 371 "PIO_ALARM_8_TYPE_3_SCU" 372 "PIO_ALARM_8_TYPE_4_SCU" 373 "PIO_ALARM_8_TYPE_5_SCU" 374 "PIO_ALARM_8_TYPE_6_SCU" 375 "PIO_ALARM_8_TYPE_7_SCU" 376 "PIO_ALARM_8_TYPE_8_SCU" 377 "PIO_ALARM_8_TYPE_9_SCU" 378 "PIO_ALARM_8_TYPE_10_SCU" 379 "PIO_ALARM_8_TYPE_11_SCU" 380 "PIO_ALARM_8_TYPE_16_SCU" 381 "PIO_ALARM_8_TYPE_17_SCU" 382 "PIO_ALARM_8_TYPE_18_SCU" 383 "PIO_ALARM_8_TYPE_19_SCU" 384 "PIO_ALARM_8_TYPE_20_SCU" 385 "PIO_ALARM_8_TYPE_21_SCU" 386 "PIO_ALARM_8_TYPE_22_IR" 387 "PIO_ALARM_8_TYPE_23_DMA" 388 "PIO_ALARM_8_TYPE_25_IOM" 389 "PIO_ALARM_8_TYPE_26_SCU" 390 "PIO_ALARM_8_TYPE_27_SCU" 391 "PIO_ALARM_8_TYPE_28_SCU" 392 "PIO_ALARM_8_TYPE_29_SCU" 393 "PIO_ALARM_8_TYPE_30_SCU" 394 "PIO_ALARM_8_TYPE_31_SCU" 395 "PIO_ALARM_9_TYPE_0_DTS" 396 "PIO_ALARM_9_TYPE_1_DTS" 397 "PIO_ALARM_9_TYPE_3_PMS" 398 "PIO_ALARM_9_TYPE_5_PMS" 399 "PIO_ALARM_9_TYPE_15_PMS" 400 "PIO_ALARM_9_TYPE_16_PMS" 401 "PIO_ALARM_9_TYPE_17_PMS" 402 "PIO_ALARM_10_TYPE_0_SW" 403 "PIO_ALARM_10_TYPE_1_SW" 404 "PIO_ALARM_10_TYPE_2_SW" 405 "PIO_ALARM_10_TYPE_3_SW" 406 "PIO_ALARM_10_TYPE_4_SW" 407 "PIO_ALARM_10_TYPE_5_SW" 408 "PIO_ALARM_10_TYPE_6_SW" 409 "PIO_ALARM_10_TYPE_7_SW" 410 "PIO_ALARM_10_TYPE_8_SW" 411 "PIO_ALARM_10_TYPE_9_SW" 412 "PIO_ALARM_10_TYPE_10_SW" 413 "PIO_ALARM_10_TYPE_11_SW" 414 "PIO_ALARM_10_TYPE_12_SW" 415 "PIO_ALARM_10_TYPE_13_SW" 416 "PIO_ALARM_10_TYPE_14_SW" 417 "PIO_ALARM_10_TYPE_15_SW" 418 "PIO_ALARM_10_TYPE_16_SMU_CORE" 419 "PIO_ALARM_10_TYPE_17_SMU_CORE" 420 "PIO_ALARM_10_TYPE_18_FSP" 421 "PIO_ALARM_10_TYPE_20_CCU" 422 "PIO_ALARM_10_TYPE_21_SFF" 423 "PIO_ALARM_10_TYPE_22_SFF" 424 "PIO_ALARM_11_TYPE_2_XBAR" 425 "PIO_ALARM_11_TYPE_3_XBAR" 426 "PIO_ALARM_11_TYPE_4_DMU" 427 "PIO_ALARM_11_TYPE_5_DMU" 428 "PIO_ALARM_11_TYPE_9_SFIBRIDGE1" 429 "PIO_ALARM_11_TYPE_10_HSSL" 430 "PIO_ALARM_11_TYPE_12_CONVERTER" 431 "PIO_ALARM_11_TYPE_13_XBAR" 432 "PIO_ALARM_20_TYPE_4_EVR" 433 "PIO_ALARM_20_TYPE_5_EVR" 434 "PIO_ALARM_20_TYPE_6_EVR" 435 "PIO_ALARM_20_TYPE_7_EVR" 436 "PIO_ALARM_20_TYPE_8_EVR" 437 "PIO_ALARM_20_TYPE_9_EVR" 438 "PIO_ALARM_20_TYPE_10_EVR" 439 "PIO_ALARM_20_TYPE_11_EVR" 440 "PIO_ALARM_20_TYPE_12_EVR" 441 "PIO_ALARM_20_TYPE_13_EVR" 442 "PIO_ALARM_20_TYPE_14_EVR" 443 "PIO_ALARM_20_TYPE_15_EVR" 444 "PIO_ALARM_21_TYPE_0_HSM" 445 "PIO_ALARM_21_TYPE_1_HSM" 446 "PIO_ALARM_21_TYPE_2_HSM" 447 "PIO_ALARM_21_TYPE_3_HSM" 448 "PIO_ALARM_21_TYPE_4_HSM" 449 "PIO_ALARM_21_TYPE_5_HSM" 450 "PIO_ALARM_21_TYPE_7_SMU" 451 "PIO_ALARM_21_TYPE_8_PMS" 452 "PIO_ALARM_21_TYPE_9_PMS" 453 "PIO_ALARM_21_TYPE_10_PMS" 454 "PIO_ALARM_21_TYPE_11_PMS" 455 "PIO_ALARM_21_TYPE_12_PMS" 456 "PIO_ALARM_21_TYPE_13_PMS" 457 "PIO_ALARM_21_TYPE_14_PMS" 458 "PIO_ALARM_21_TYPE_15_CCU" 459 "PIO_ALARM_21_TYPE_16_SMU_CORE" 460 "PIO_ALARM_MULTIPLE" 461 "PIO_ALARM_RESERVED" 462 "PIO_ALARM_UNEXPECTED" 463 "PIO_ERROR_ID_LAST" /end COMPU_VTAB
/* Scalar measurable for DDE 'mpl_error_log_summary[1].mode'. */
/begin MEASUREMENT mpl_error_log_summary[1].mode "Mode of the software when fault raised" SBYTE CU_MPL_ERROR_LOG_SUMMARY[1].MO0 1 100 0.0 127.0 ECU_ADDRESS 0xf024004e BYTE_ORDER MSB_LAST /end MEASUREMENT
/begin COMPU_METHOD CU_MPL_ERROR_LOG_SUMMARY[1].MO0 "Conversion method for mpl_error_log_summary[1].mode" TAB_VERB "%12.0" "code" COMPU_TAB_REF CT_MPL_ERROR_LOG_SUMMARY[1].MO0 /end COMPU_METHOD
/begin COMPU_VTAB CT_MPL_ERROR_LOG_SUMMARY[1].MO0 "Conversion method for mpl_error_log_summary[1].mode" TAB_VERB 4 0 "PIO_EXEC_MODE_UNKNOWN" 1 "PIO_EXEC_MODE_PRG" 2 "PIO_EXEC_MODE_APP" 3 "PIO_EXEC_MODE_LAST" /end COMPU_VTAB
/* Scalar measurable for DDE 'mpl_error_log_summary[1].reaction'. */
/begin MEASUREMENT mpl_error_log_summary[1].react0 "Reaction to the fault raised" SBYTE CU_MPL_ERROR_LOG_SUMMARY[1].RE0 1 100 0.0 127.0 ECU_ADDRESS 0xf024004f BYTE_ORDER MSB_LAST /end MEASUREMENT
/begin COMPU_METHOD CU_MPL_ERROR_LOG_SUMMARY[1].RE0 "Conversion method for mpl_error_log_summary[1].reaction" TAB_VERB "%12.0" "code" COMPU_TAB_REF CT_MPL_ERROR_LOG_SUMMARY[1].RE0 /end COMPU_METHOD
/begin COMPU_VTAB CT_MPL_ERROR_LOG_SUMMARY[1].RE0 "Conversion method for mpl_error_log_summary[1].reaction" TAB_VERB 6 0 "PIO_CONTINUE" 1 "PIO_RESET" 2 "PIO_RECORD_AND_CONTINUE" 3 "PIO_RECORD_AND_RESET" 4 "PIO_RESET_AND_RECORD" 5 "PIO_FAULT_REACTION_LAST" /end COMPU_VTAB
/* Scalar measurable for DDE 'mpl_error_log_summary[2].id'. */
/begin MEASUREMENT mpl_error_log_summary[2].id "Error code of fault raised" SWORD CU_MPL_ERROR_LOG_SUMMARY[2].ID 1 100 0.0 32767.0 ECU_ADDRESS 0xf0240050 BYTE_ORDER MSB_LAST /end MEASUREMENT
/begin COMPU_METHOD CU_MPL_ERROR_LOG_SUMMARY[2].ID "Conversion method for mpl_error_log_summary[2].id" TAB_VERB "%12.0" "code" COMPU_TAB_REF CT_MPL_ERROR_LOG_SUMMARY[2].ID /end COMPU_METHOD
/begin COMPU_VTAB CT_MPL_ERROR_LOG_SUMMARY[2].ID "Conversion method for mpl_error_log_summary[2].id" TAB_VERB 464 0 "PIO_PSY_NO_ERROR" 1 "PIO_TRAP_0_TIN_0_VAF" 2 "PIO_TRAP_0_TIN_1_VAP" 3 "PIO_TRAP_0_TIN_UNKNOWN" 4 "PIO_TRAP_1_TIN_1_PRIV" 5 "PIO_TRAP_1_TIN_2_MPR" 6 "PIO_TRAP_1_TIN_3_MPW" 7 "PIO_TRAP_1_TIN_4_MPX" 8 "PIO_TRAP_1_TIN_5_MPP" 9 "PIO_TRAP_1_TIN_6_MPN" 10 "PIO_TRAP_1_TIN_7_GRWP" 11 "PIO_TRAP_1_TIN_UNKNOWN" 12 "PIO_TRAP_2_TIN_1_IOPC" 13 "PIO_TRAP_2_TIN_2_UOPC" 14 "PIO_TRAP_2_TIN_3_OPD" 15 "PIO_TRAP_2_TIN_4_ALN" 16 "PIO_TRAP_2_TIN_5_MEM" 17 "PIO_TRAP_2_TIN_UNKNOWN" 18 "PIO_TRAP_3_TIN_1_FCD" 19 "PIO_TRAP_3_TIN_2_FCD" 20 "PIO_TRAP_3_TIN_3_CDU" 21 "PIO_TRAP_3_TIN_4_FCU" 22 "PIO_TRAP_3_TIN_5_CSU" 23 "PIO_TRAP_3_TIN_6_CTYP" 24 "PIO_TRAP_3_TIN_7_NEST" 25 "PIO_TRAP_3_TIN_UNKNOWN" 26 "PIO_TRAP_4_TIN_1_PSE" 27 "PIO_TRAP_4_TIN_2_DSE" 28 "PIO_TRAP_4_TIN_3_DAE" 29 "PIO_TRAP_4_TIN_4_CAE" 30 "PIO_TRAP_4_TIN_4_CAE_UNEXPECTED" 31 "PIO_TRAP_4_TIN_4_CAE_UNEXPECTED_FW" 32 "PIO_TRAP_4_TIN_5_PIE" 33 "PIO_TRAP_4_TIN_6_DIE" 34 "PIO_TRAP_4_TIN_7_DIE" 35 "PIO_TRAP_4_TIN_5_6_UNEXPECTED" 36 "PIO_TRAP_4_TIN_UNKNOWN" 37 "PIO_TRAP_5_TIN_1_OVF" 38 "PIO_TRAP_5_TIN_2_SOVF" 39 "PIO_TRAP_5_TIN_UNKNOWN" 40 "PIO_TRAP_6_SYS_UNKNOWN" 41 "PIO_TRAP_7_TIN_0_NMI" 42 "PIO_TRAP_7_TIN_UNKNOWN" 43 "PIO_ISR_0_RESET" 44 "PIO_BSPI_FIRST" 45 "PIO_BSPI_TRANSFER_TIMEOUT" 46 "PIO_BSPI_TX_DMA_ERROR" 47 "PIO_BSPI_RX_DMA_ERROR" 48 "PIO_BSPI_DSPI_ERROR" 49 "PIO_BSPI_RX_FIFO_OVERFLOW" 50 "PIO_BSPI_TX_FIFO_UNDERFLOW" 51 "PIO_BSPI_TRANSFER_TERMINATED" 52 "PIO_BSPI_TRANSAC_FAILED" 53 "PIO_BSPI_INTERNAL_SOFTWARE_ERROR" 54 "PIO_BSPI_ISR_MINIMUM_DELAY_TIME_NOT_MET" 55 "PIO_BSPI_ISR_FALSE_INT" 56 "PIO_BSPI_DMA_SAFETY_ERROR" 57 "PIO_BSPI_LAST" 58 "PIO_P1WR_ISR_MINIMUM_DELAY_TIME_NOT_MET" 59 "PIO_PADC_BUFFER_INIT_FAILED" 60 "PIO_PAX_ADC_INPUT_INVALID_ARG" 61 "PIO_PAX_CHANNEL_INVALID" 62 "PIO_PAX_ADC_INPUT_CHANNEL_UNSUPPORTED" 63 "PIO_PAX_CC_OUTPUT_CHANNEL_UNSUPPORTED" 64 "PIO_PAX_AOT_OUTPUT_CHANNEL_UNSUPPORTED" 65 "PIO_PAX_ISR_MINIMUM_DELAY_TIME_NOT_MET" 66 "PIO_PCANOPEN_RESET" 67 "PIO_PCANOPEN_BUFFER_OUT_OF_RANGE" 68 "PIO_PCANOPEN_NULL_POINTER" 69 "PIO_PCCP_RESET" 70 "PIO_PCCU6_ISR_MINIMUM_DELAY_TIME_NOT_MET" 71 "PIO_PCFG_INTERNAL_SW_ERROR" 72 "PIO_PCX_ERR_BUS_ID_OUT_OF_RANGE" 73 "PIO_PCX_ERR_DATA_LENGTH_OUT_OF_RANGE" 74 "PIO_PCX_ERR_STD_ID_OUT_OF_RANGE" 75 "PIO_PCX_ERR_EXT_ID_OUT_OF_RANGE" 76 "PIO_PCX_ERR_SAME_TX_MSG_DIFFERING_ATTRIBS" 77 "PIO_PCX_ERR_TOO_MANY_TX_MSGS" 78 "PIO_PCX_ERR_DUPLICATE_RX_MSG" 79 "PIO_PCX_ERR_TOO_MANY_RX_MSGS" 80 "PIO_PCX_ERR_BIT_RATE_IN_CONFIG_DIFFERS" 81 "PIO_PCX_ERR_UNSUPPORTED_BIT_RATE" 82 "PIO_PCX_ERR_BUS_ID_IN_CONFIG" 83 "PIO_PCX_ERR_NO_BITRATE_TABLE_MATCH" 84 "PIO_PCX_ERR_PACK_MSG_INVALID_PARAM" 85 "PIO_PCX_ERR_PACK_MSG_FIELD_PARAM" 86 "PIO_PCX_ERR_UNPACK_MSG_INVALID_PARAM" 87 "PIO_PCX_ERR_UNPACK_MSG_FIELD_PARAM" 88 "PIO_PCX_ERR_PACK_VDB_MSG_INVALID_PARAM" 89 "PIO_PCX_ERR_UNPACK_VDB_MSG_INVALID_PARAM" 90 "PIO_PCX_ERR_SWITCHED_RATE_FOR_NONFD_BUS" 91 "PIO_PCX_ERR_RX_MSG_FOR_UNCONFIG_BUS_0" 92 "PIO_PCX_ERR_UNSUPPORTED_BUS_MODE" 93 "PIO_PCX_ERR_BUS_MODE_IN_CONFIG_DIFFERS" 94 "PIO_PCX_ERR_SAME_RX_MSG_DIFFERING_ATTRIBS" 95 "PIO_PCX_ERR_TX_MSG_FOR_UNCONFIG_BUS_0" 96 "PIO_PCX_ISR_MINIMUM_DELAY_TIME_NOT_MET" 97 "PIO_PDD_CHANNEL_INVALID" 98 "PIO_PDD_DIG_DATA_IN_CHANNEL_UNSUPPORTED" 99 "PIO_PDD_DIG_DATA_OUT_CHANNEL_UNSUPPORTED" 100 "PIO_PDG_ERR_FORCED_RESET" 101 "PIO_PDTC_UPDATE_INVALID_ARG" 102 "PIO_PDTC_CLEAR_ALL_INVALID_ARG" 103 "PIO_PDTC_CLEAR_ALL_IF_ACT_INVALID_ARG" 104 "PIO_PDTC_CLEAR_ALL_IF_INACT_INVALID_ARG" 105 "PIO_PDTC_GET_DTC_STATUS_INVALID_ARG" 106 "PIO_PDTC_MATCH_EXISTS_INVALID_ARG" 107 "PIO_PDTC_CLEAR_DTCS_INVALID_ARG" 108 "PIO_PDTC_BAD_LICENSE" 109 "PIO_PDX_DO_CHANNEL_UNSUPPORTED" 110 "PIO_PDX_DIG_IN_CHANNEL_UNSUPPORTED" 111 "PIO_PDX_FREQ_IN_CHANNEL_UNSUPPORTED" 112 "PIO_PDX_PERIOD_IN_CHANNEL_UNSUPPORTED" 113 "PIO_PDX_QDEC_FREQ_IN_INVALID_ARG" 114 "PIO_PDX_QDEC_FREQ_IN_CHANNEL_UNSUPPORTED" 115 "PIO_PDX_TPU_QFI_CHANNEL_DEVICE_ERROR" 116 "PIO_PDX_QDEC_IN_CHANNEL_UNSUPPORTED" 117 "PIO_PDX_TPU_QI_CHANNEL_DEVICE_ERROR" 118 "PIO_PDX_PWM_OUT_CHANNEL_UNSUPPORTED" 119 "PIO_PDX_PWM_IN_CHANNEL_UNSUPPORTED" 120 "PIO_PDX_CHANNEL_INVALID" 121 "PIO_PDX_HBRIDGE_INVALID_MODE" 122 "PIO_PDX_HBRIDGE_DECODE_ERROR" 123 "PIO_PDX_HBRIDGE_CHANNEL_GROUP_UNSUPPORTED" 124 "PIO_PEM_EXTERNAL_RAM_REQUIRED" 125 "PIO_PEM_MEM_CONFIG_UNKNOWN" 126 "PIO_PETH_ERR_DRIVER_INITIALIZATION_ERROR" 127 "PIO_PETH_ERR_NULL_CONFIGURATION_POINTER" 128 "PIO_PETH_ERR_DATA_LENGTH_OUT_OF_RANGE" 129 "PIO_PETH_ERR_TOO_MANY_TX_MSGS" 130 "PIO_PETH_ERR_NOT_SUPPORTED" 131 "PIO_PFF_HOLDING_ARRAY_INDEX_INVALID" 132 "PIO_PFF_HOLDING_ARRAY_STRT_END_INVALID" 133 "PIO_PFF_HOLDING_ARRAY_REC_DATA_INVALID" 134 "PIO_PFF_STORED_FF_DTC_INVALID" 135 "PIO_PFF_STORED_DTC_READ_FAILURE" 136 "PIO_PFF_CAPTURE_PID_DATA_FAILURE" 137 "PIO_PFF_STARTUP_FFNO_ERROR" 138 "PIO_PFF_NVM_ALLOCATION_EXCEEDED" 139 "PIO_PFS_ECC_ERROR_DURING_FLASH_OP" 140 "PIO_PFS_RUNTIME_CORRUPT_FILE_FOUND" 141 "PIO_PKN_ERR_KERNEL_STARTED_BELOW_KERNEL_LEVEL" 142 "PIO_PKN_ERR_INVALID_RESOURCE_HANDLE" 143 "PIO_PKN_ERR_TASK_NOT_DECLARED_AS_ACQUIRING_RESOURCE" 144 "PIO_PKN_ERR_INVALID_TASK_HANDLE" 145 "PIO_PKN_ERR_INVALID_PERIODIC_TASK_HANDLE" 146 "PIO_PKN_ERR_UNEXPECTED_EXCEPTION" 147 "PIO_PKN_ERR_TASK_RESOURCE_CORE_DIFFER" 148 "PIO_PKN_ERR_TASK_RELEASE_RESOURCE_FAIL" 149 "PIO_PKN_ERR_ACQUIRING_RESOURCE_PRIORITY_CHANGE_FAIL" 150 "PIO_PKN_ERR_RELEASING_RESOURCE_PRIORITY_CHANGE_FAIL" 151 "PIO_PKN_ERR_TASK_RELEASE_RESOURCE_NEVER_ACQ" 152 "PIO_PKN_ERR_CLEAR_RESOURCE_SET_TASK_PRIO" 153 "PIO_PKN_ERR_ACQUIRING_RESOURCE_ALREADY_ACQUIRED" 154 "PIO_PJ1939_INVALID_CHANNEL" 155 "PIO_PJ1939_PG_TRANSMIT_RING_DEQUEUE_FAIL" 156 "PIO_PJ1939_DM6_TRANSMIT_INVALID_ARG" 157 "PIO_PJ1939_DM12_TRANSMIT_INVALID_ARG" 158 "PIO_PJ1939_DM14_DECODE_INVALID_ARG" 159 "PIO_PJ1939_DM15_TRANSMIT_INVALID_ARG" 160 "PIO_PJ1939_DM16_DECODE_INVALID_ARG" 161 "PIO_PJ1939_DM23_TRANSMIT_INVALID_ARG" 162 "PIO_PJ1939_DM27_TRANSMIT_INVALID_ARG" 163 "PIO_PJ1939_DM28_TRANSMIT_INVALID_ARG" 164 "PIO_PJ1939_DM29_TRANSMIT_INVALID_ARG" 165 "PIO_PJ1939_DM31_TRANSMIT_INVALID_ARG" 166 "PIO_PJ1939_DM41_TRANSMIT_INVALID_ARG" 167 "PIO_PJ1939_DM42_TRANSMIT_INVALID_ARG" 168 "PIO_PJ1939_DM43_TRANSMIT_INVALID_ARG" 169 "PIO_PJ1939_DM44_TRANSMIT_INVALID_ARG" 170 "PIO_PJ1939_DM45_TRANSMIT_INVALID_ARG" 171 "PIO_PJ1939_DM46_TRANSMIT_INVALID_ARG" 172 "PIO_PJ1939_DM47_TRANSMIT_INVALID_ARG" 173 "PIO_PJ1939_DM48_TRANSMIT_INVALID_ARG" 174 "PIO_PJ1939_DM49_TRANSMIT_INVALID_ARG" 175 "PIO_PJ1939_DM50_TRANSMIT_INVALID_ARG" 176 "PIO_PJ1939_DM51_TRANSMIT_INVALID_ARG" 177 "PIO_PJ1939_DM52_TRANSMIT_INVALID_ARG" 178 "PIO_PJ1939_INVALID_RING_BUFFER_ARG" 179 "PIO_PJ1939_DM1_RECEIVE_INVALID_ARG" 180 "PIO_PJ1939_DM2_RECEIVE_INVALID_ARG" 181 "PIO_PMCAL_ADC_INIT_CHECK_ERROR" 182 "PIO_PSAF_ERROR_STANDBY_INIT" 183 "PIO_PSAF_ISR_MINIMUM_DELAY_TIME_NOT_MET" 184 "PIO_PSAF_ERROR_CLOCK_PLAUSIBILITY" 185 "PIO_PSC_DECODE_RESET_INVALID_ARG" 186 "PIO_PSC_ERR_FORCED_RESET" 187 "PIO_PSC_ERR_STANDY_ENTRY" 188 "PIO_PSC_ERR_VERSION_INVALID_PARAM" 189 "PIO_PSC_ERR_BUILD_DATE_INVALID_PARAM" 190 "PIO_PSC_ERR_PART_NUMBER_INVALID_PARAM" 191 "PIO_PSC_UNEXPECTED_CVN_CHANGE" 192 "PIO_PSC_ERR_HW_VERSION_UNKNOWN" 193 "PIO_PSENT_IN_CHANNEL_UNSUPPORTED" 194 "PIO_PSMC_INVALID_DATA" 195 "PIO_PSMC_INTERNAL_SW_ERROR" 196 "PIO_PSTP_SAFETPACK_INIT_FAILURE" 197 "PIO_PSTP_SMU_MODE_INVALID_DURING_INIT" 198 "PIO_PSTP_SMU_MODE_RUN_DURING_INIT" 199 "PIO_PSTP_SMU_FAIL_INIT" 200 "PIO_PSTP_SMU_FAIL_ALARM_CONFIG" 201 "PIO_PSTP_SMU_SW_ALARM_GROUP_0" 202 "PIO_PSTP_SMU_SW_ALARM_GROUP_1" 203 "PIO_PSTP_SMU_SW_ALARM_GROUP_2" 204 "PIO_PSTP_SMU_SW_ALARM_GROUP_3" 205 "PIO_PSTP_SMU_SW_ALARM_GROUP_4" 206 "PIO_PSTP_SMU_SW_ALARM_GROUP_5" 207 "PIO_PSTP_SMU_SW_ALARM_GROUP_6" 208 "PIO_PSTP_SMU_SW_ALARM_GROUP_7" 209 "PIO_PSTP_SMU_SW_ALARM_GROUP_8" 210 "PIO_PSTP_SMU_SW_ALARM_GROUP_9" 211 "PIO_PSTP_SMU_SW_ALARM_GROUP_10" 212 "PIO_PSTP_SMU_SW_ALARM_GROUP_11" 213 "PIO_PSTP_SMU_SW_ALARM_GROUP_12" 214 "PIO_PSTP_SMU_SW_ALARM_GROUP_13" 215 "PIO_PSTP_SMU_SW_ALARM_GROUP_14" 216 "PIO_PSTP_SMU_SW_ALARM_GROUP_15" 217 "PIO_PSTP_SWDGM_UNEXPECTED" 218 "PIO_PSTP_SWDGM_INIT_FAIL" 219 "PIO_PSTP_SWDGM_ACTIVATE_FAIL" 220 "PIO_PSTP_SWDGM_DEINIT_FAIL" 221 "PIO_PSTP_SWDGM_GETERRCNTR_FAIL" 222 "PIO_PSTP_SWDGM_GETINFO_FAIL" 223 "PIO_PSTP_SWDGM_GETSEED_FAIL" 224 "PIO_PSTP_SWDGM_USERREQ_FAIL" 225 "PIO_PSTP_SWDGM_SERVICE_FAIL" 226 "PIO_PSTP_TSTM_STARTUP_TEST_FAIL" 227 "PIO_PSTP_TSTM_RUNTIME_TEST_FAIL" 228 "PIO_PSTP_TSTM_INIT_FAIL" 229 "PIO_PSTP_TSTM_SWITCH_TO_RUN_FAIL" 230 "PIO_PSTP_TLF_TEST_FAIL" 231 "PIO_PSTP_TLF_MAXJOBS_FAIL" 232 "PIO_PSTP_SEID_INCORRECT" 233 "PIO_PSTP_CHECKPOINT_INCORRECT" 234 "PIO_PSTP_ERR_TASK_BUDGET_OVRRUN" 235 "PIO_PSTP_HTXTESTHND_INVALID_RESULT" 236 "PIO_PSTP_HTXTESTHND_TEST_NOT_EXECUTED" 237 "PIO_PSTP_HTXLBIST_CALLER_ADDR_ERR" 238 "PIO_PSTP_HTXLBIST_PORST_ERR" 239 "PIO_PSTP_HTXLBIST_TERMINATION_ERR" 240 "PIO_PSTP_HTXLBIST_DEFAULT_SIGNATURE_ERR" 241 "PIO_PSTP_HTXLBIST_CRC_ERR" 242 "PIO_PSTP_HTXLBIST_UNDEFINED_ERR" 243 "PIO_PSTP_HTXLBIST_INV_PARAM_ERR" 244 "PIO_PSTP_HTXSFRTST_CMP_INV_PARAM_ERR" 245 "PIO_PSTP_HTXSFRTST_CMP_OVERLOAD" 246 "PIO_PSTP_HTXSFRTST_CMP_VAL_ERR" 247 "PIO_PSTP_HTXSFRTST_CRC_INV_PARAM_ERR" 248 "PIO_PSTP_HTXSFRTST_CRC_DATAMISMATCH" 249 "PIO_PSTP_HTXREGMON_SMU_TIMEOUT" 250 "PIO_PSTP_HTXREGMON_ERR_UNDEFINED" 251 "PIO_PSTP_HTXREGMON_ERR_MTU_TIMEOUT_UND" 252 "PIO_PSTP_HTXREGMON_INV_PARAM_ERR" 253 "PIO_PSTP_HTXREGMON_ERR_MTU_FAILED" 254 "PIO_PSTP_HTXMONBIST_ERR_SMU_FLAG" 255 "PIO_PSTP_HTXMONBIST_ERR_PMS_FLAG" 256 "PIO_PSTP_HTXMONBIST_ERR_PMS_SMU_FLAG" 257 "PIO_PSTP_HTXMONBIST_ERR_TIMEOUT" 258 "PIO_PSTP_HTXMONBIST_ERR_UNSPECIFIED" 259 "PIO_PSTP_HTXMONBIST_ERR_SFR_CONFIG" 260 "PIO_PSTP_HTXDTSRESULT_A_FAILED_ERR_DIFF" 261 "PIO_PSTP_HTXDTSRESULT_B_FAILED_ERR_DIFF" 262 "PIO_PSTP_HTXSMUALIVEALARM_ERR_ALM_STS" 263 "PIO_PSTP_HTXSMUALIVEALARM_ERR_TRIG" 264 "PIO_PSTP_HTXSMUALIVEALARM_PREV_ALM_STS" 265 "PIO_PSTP_HTXSMUALIVEALARM_ERR_SMU_RUN" 266 "PIO_PSTP_HTXVMTMBIST_ERR_MTU_UNDEFINED" 267 "PIO_PSTP_HTXVMTMBIST_ERR_MTU_TIMEOUT_UND" 268 "PIO_PSTP_HTXVMTMBIST_INV_PARAM_ERR" 269 "PIO_PSTP_HTXFWCHECK_FAILED" 270 "PIO_PSTP_HTXFWCHECK_INV_PARAM_ERR" 271 "PIO_PSTP_HTXFWCHECK_RST_UNKNOWN" 272 "PIO_PSTP_HTXFWCHECK_SFR_NOT_CLEARED" 273 "PIO_PSTP_HTXFWCHECK_DATA_ERR" 274 "PIO_PSTP_HTXPFM_UNEXPECTED_ERROR" 275 "PIO_PSTP_HTXPFM_RAM_CORRUPTION" 276 "PIO_PSTP_HTXPFM_ILLEGAL_FUNCTION_ARGUMENT" 277 "PIO_PSTP_HTXPFM_SYSTEM_TIMER_READ_FAULT" 278 "PIO_PSTP_HTXPFM_ILLEGAL_REINIT" 279 "PIO_PSTP_HTXPFM_UNEXPECTED_SEID" 280 "PIO_PSTP_HTXPFM_LOGICAL_FAULT_DETECTED" 281 "PIO_PSTP_HTXPFM_DEADLINE_FAULT_DETECTED" 282 "PIO_PSTP_HTXPFM_TIMING_FAULT_DETECTED" 283 "PIO_PSTP_HTXPFM_ALIVENESS_FAULT_DETECTED" 284 "PIO_PSY_ERR_SMU_ASSERT" 285 "PIO_PTM_TIMER_ERROR" 286 "PIO_PUT_DEBOUNCE_BY_CYCLES_INVALID_ARG" 287 "PIO_PUT_LEAKY_BUCKET_INVALID_ARG" 288 "PIO_PUT_DEBOUNCE_BY_TIME_INVALID_ARG" 289 "PIO_PUT_DUTYCYCLE_PROCESSING_INVALID_ARG" 290 "PIO_PUT_STATE_PROCESSING_INVALID_ARG" 291 "PIO_PUT_ARRAY_SEARCH_INVALID_ARG" 292 "PIO_PUT_ERR_PACK_INVALID_PARAM" 293 "PIO_PUT_ERR_UNPACK_INVALID_PARAM" 294 "PIO_PXCP_RESET" 295 "PIO_PUART_MCAL_INIT_CHECK_ERROR" 296 "PIO_ALARM_0_TYPE_0_CPU" 297 "PIO_ALARM_0_TYPE_1_CPU" 298 "PIO_ALARM_0_TYPE_2_CPU" 299 "PIO_ALARM_0_TYPE_4_MTU" 300 "PIO_ALARM_0_TYPE_5_MTU" 301 "PIO_ALARM_0_TYPE_6_MTU" 302 "PIO_ALARM_0_TYPE_7_MTU" 303 "PIO_ALARM_0_TYPE_8_MTU" 304 "PIO_ALARM_0_TYPE_9_MTU" 305 "PIO_ALARM_0_TYPE_10_MTU" 306 "PIO_ALARM_0_TYPE_11_MTU" 307 "PIO_ALARM_0_TYPE_12_MTU" 308 "PIO_ALARM_0_TYPE_13_MTU" 309 "PIO_ALARM_0_TYPE_14_MTU" 310 "PIO_ALARM_0_TYPE_22_CPU" 311 "PIO_ALARM_0_TYPE_23_CPU" 312 "PIO_ALARM_0_TYPE_24_CPU" 313 "PIO_ALARM_1_TYPE_0_CPU" 314 "PIO_ALARM_1_TYPE_1_CPU" 315 "PIO_ALARM_1_TYPE_2_CPU" 316 "PIO_ALARM_1_TYPE_4_MTU" 317 "PIO_ALARM_1_TYPE_5_MTU" 318 "PIO_ALARM_1_TYPE_6_MTU" 319 "PIO_ALARM_1_TYPE_7_MTU" 320 "PIO_ALARM_1_TYPE_8_MTU" 321 "PIO_ALARM_1_TYPE_9_MTU" 322 "PIO_ALARM_1_TYPE_10_MTU" 323 "PIO_ALARM_1_TYPE_11_MTU" 324 "PIO_ALARM_1_TYPE_12_MTU" 325 "PIO_ALARM_1_TYPE_13_MTU" 326 "PIO_ALARM_1_TYPE_14_MTU" 327 "PIO_ALARM_1_TYPE_22_MTU" 328 "PIO_ALARM_1_TYPE_23_CPU" 329 "PIO_ALARM_1_TYPE_24_CPU" 330 "PIO_ALARM_6_TYPE_0_MTU" 331 "PIO_ALARM_6_TYPE_1_IOM" 332 "PIO_ALARM_6_TYPE_2_IR" 333 "PIO_ALARM_6_TYPE_4_SCU" 334 "PIO_ALARM_6_TYPE_5_PMS" 335 "PIO_ALARM_6_TYPE_6_DMA" 336 "PIO_ALARM_6_TYPE_7_SMU_CORE" 337 "PIO_ALARM_6_TYPE_8_CCU" 338 "PIO_ALARM_6_TYPE_10_GTM" 339 "PIO_ALARM_6_TYPE_11_GTM" 340 "PIO_ALARM_6_TYPE_12_GTM" 341 "PIO_ALARM_6_TYPE_13_ERAY" 342 "PIO_ALARM_6_TYPE_14_ERAY" 343 "PIO_ALARM_6_TYPE_15_SRAM" 344 "PIO_ALARM_6_TYPE_16_CAN" 345 "PIO_ALARM_6_TYPE_17_CAN" 346 "PIO_ALARM_6_TYPE_18_CAN" 347 "PIO_ALARM_6_TYPE_19_MISC" 348 "PIO_ALARM_6_TYPE_20_MISC" 349 "PIO_ALARM_6_TYPE_21_MISC" 350 "PIO_ALARM_6_TYPE_23_CBS" 351 "PIO_ALARM_6_TYPE_24_CCU" 352 "PIO_ALARM_6_TYPE_25_CCU" 353 "PIO_ALARM_7_TYPE_0_DAM0" 354 "PIO_ALARM_7_TYPE_1_LMU" 355 "PIO_ALARM_7_TYPE_2_LMU" 356 "PIO_ALARM_7_TYPE_17_XBAR0" 357 "PIO_ALARM_7_TYPE_20_SPB" 358 "PIO_ALARM_7_TYPE_22_FSI" 359 "PIO_ALARM_7_TYPE_23_FSI" 360 "PIO_ALARM_7_TYPE_24_FSI" 361 "PIO_ALARM_7_TYPE_25_FSI" 362 "PIO_ALARM_7_TYPE_26_FSI" 363 "PIO_ALARM_7_TYPE_27_FSI" 364 "PIO_ALARM_7_TYPE_28_FSI" 365 "PIO_ALARM_7_TYPE_29_FSI" 366 "PIO_ALARM_7_TYPE_30_FSI" 367 "PIO_ALARM_7_TYPE_31_FSI" 368 "PIO_ALARM_8_TYPE_0_SCU" 369 "PIO_ALARM_8_TYPE_1_CCU" 370 "PIO_ALARM_8_TYPE_2_CCU" 371 "PIO_ALARM_8_TYPE_3_SCU" 372 "PIO_ALARM_8_TYPE_4_SCU" 373 "PIO_ALARM_8_TYPE_5_SCU" 374 "PIO_ALARM_8_TYPE_6_SCU" 375 "PIO_ALARM_8_TYPE_7_SCU" 376 "PIO_ALARM_8_TYPE_8_SCU" 377 "PIO_ALARM_8_TYPE_9_SCU" 378 "PIO_ALARM_8_TYPE_10_SCU" 379 "PIO_ALARM_8_TYPE_11_SCU" 380 "PIO_ALARM_8_TYPE_16_SCU" 381 "PIO_ALARM_8_TYPE_17_SCU" 382 "PIO_ALARM_8_TYPE_18_SCU" 383 "PIO_ALARM_8_TYPE_19_SCU" 384 "PIO_ALARM_8_TYPE_20_SCU" 385 "PIO_ALARM_8_TYPE_21_SCU" 386 "PIO_ALARM_8_TYPE_22_IR" 387 "PIO_ALARM_8_TYPE_23_DMA" 388 "PIO_ALARM_8_TYPE_25_IOM" 389 "PIO_ALARM_8_TYPE_26_SCU" 390 "PIO_ALARM_8_TYPE_27_SCU" 391 "PIO_ALARM_8_TYPE_28_SCU" 392 "PIO_ALARM_8_TYPE_29_SCU" 393 "PIO_ALARM_8_TYPE_30_SCU" 394 "PIO_ALARM_8_TYPE_31_SCU" 395 "PIO_ALARM_9_TYPE_0_DTS" 396 "PIO_ALARM_9_TYPE_1_DTS" 397 "PIO_ALARM_9_TYPE_3_PMS" 398 "PIO_ALARM_9_TYPE_5_PMS" 399 "PIO_ALARM_9_TYPE_15_PMS" 400 "PIO_ALARM_9_TYPE_16_PMS" 401 "PIO_ALARM_9_TYPE_17_PMS" 402 "PIO_ALARM_10_TYPE_0_SW" 403 "PIO_ALARM_10_TYPE_1_SW" 404 "PIO_ALARM_10_TYPE_2_SW" 405 "PIO_ALARM_10_TYPE_3_SW" 406 "PIO_ALARM_10_TYPE_4_SW" 407 "PIO_ALARM_10_TYPE_5_SW" 408 "PIO_ALARM_10_TYPE_6_SW" 409 "PIO_ALARM_10_TYPE_7_SW" 410 "PIO_ALARM_10_TYPE_8_SW" 411 "PIO_ALARM_10_TYPE_9_SW" 412 "PIO_ALARM_10_TYPE_10_SW" 413 "PIO_ALARM_10_TYPE_11_SW" 414 "PIO_ALARM_10_TYPE_12_SW" 415 "PIO_ALARM_10_TYPE_13_SW" 416 "PIO_ALARM_10_TYPE_14_SW" 417 "PIO_ALARM_10_TYPE_15_SW" 418 "PIO_ALARM_10_TYPE_16_SMU_CORE" 419 "PIO_ALARM_10_TYPE_17_SMU_CORE" 420 "PIO_ALARM_10_TYPE_18_FSP" 421 "PIO_ALARM_10_TYPE_20_CCU" 422 "PIO_ALARM_10_TYPE_21_SFF" 423 "PIO_ALARM_10_TYPE_22_SFF" 424 "PIO_ALARM_11_TYPE_2_XBAR" 425 "PIO_ALARM_11_TYPE_3_XBAR" 426 "PIO_ALARM_11_TYPE_4_DMU" 427 "PIO_ALARM_11_TYPE_5_DMU" 428 "PIO_ALARM_11_TYPE_9_SFIBRIDGE1" 429 "PIO_ALARM_11_TYPE_10_HSSL" 430 "PIO_ALARM_11_TYPE_12_CONVERTER" 431 "PIO_ALARM_11_TYPE_13_XBAR" 432 "PIO_ALARM_20_TYPE_4_EVR" 433 "PIO_ALARM_20_TYPE_5_EVR" 434 "PIO_ALARM_20_TYPE_6_EVR" 435 "PIO_ALARM_20_TYPE_7_EVR" 436 "PIO_ALARM_20_TYPE_8_EVR" 437 "PIO_ALARM_20_TYPE_9_EVR" 438 "PIO_ALARM_20_TYPE_10_EVR" 439 "PIO_ALARM_20_TYPE_11_EVR" 440 "PIO_ALARM_20_TYPE_12_EVR" 441 "PIO_ALARM_20_TYPE_13_EVR" 442 "PIO_ALARM_20_TYPE_14_EVR" 443 "PIO_ALARM_20_TYPE_15_EVR" 444 "PIO_ALARM_21_TYPE_0_HSM" 445 "PIO_ALARM_21_TYPE_1_HSM" 446 "PIO_ALARM_21_TYPE_2_HSM" 447 "PIO_ALARM_21_TYPE_3_HSM" 448 "PIO_ALARM_21_TYPE_4_HSM" 449 "PIO_ALARM_21_TYPE_5_HSM" 450 "PIO_ALARM_21_TYPE_7_SMU" 451 "PIO_ALARM_21_TYPE_8_PMS" 452 "PIO_ALARM_21_TYPE_9_PMS" 453 "PIO_ALARM_21_TYPE_10_PMS" 454 "PIO_ALARM_21_TYPE_11_PMS" 455 "PIO_ALARM_21_TYPE_12_PMS" 456 "PIO_ALARM_21_TYPE_13_PMS" 457 "PIO_ALARM_21_TYPE_14_PMS" 458 "PIO_ALARM_21_TYPE_15_CCU" 459 "PIO_ALARM_21_TYPE_16_SMU_CORE" 460 "PIO_ALARM_MULTIPLE" 461 "PIO_ALARM_RESERVED" 462 "PIO_ALARM_UNEXPECTED" 463 "PIO_ERROR_ID_LAST" /end COMPU_VTAB
/* Scalar measurable for DDE 'mpl_error_log_summary[2].mode'. */
/begin MEASUREMENT mpl_error_log_summary[2].mode "Mode of the software when fault raised" SBYTE CU_MPL_ERROR_LOG_SUMMARY[2].MO0 1 100 0.0 127.0 ECU_ADDRESS 0xf0240052 BYTE_ORDER MSB_LAST /end MEASUREMENT
/begin COMPU_METHOD CU_MPL_ERROR_LOG_SUMMARY[2].MO0 "Conversion method for mpl_error_log_summary[2].mode" TAB_VERB "%12.0" "code" COMPU_TAB_REF CT_MPL_ERROR_LOG_SUMMARY[2].MO0 /end COMPU_METHOD
/begin COMPU_VTAB CT_MPL_ERROR_LOG_SUMMARY[2].MO0 "Conversion method for mpl_error_log_summary[2].mode" TAB_VERB 4 0 "PIO_EXEC_MODE_UNKNOWN" 1 "PIO_EXEC_MODE_PRG" 2 "PIO_EXEC_MODE_APP" 3 "PIO_EXEC_MODE_LAST" /end COMPU_VTAB
/* Scalar measurable for DDE 'mpl_error_log_summary[2].reaction'. */
/begin MEASUREMENT mpl_error_log_summary[2].react0 "Reaction to the fault raised" SBYTE CU_MPL_ERROR_LOG_SUMMARY[2].RE0 1 100 0.0 127.0 ECU_ADDRESS 0xf0240053 BYTE_ORDER MSB_LAST /end MEASUREMENT
/begin COMPU_METHOD CU_MPL_ERROR_LOG_SUMMARY[2].RE0 "Conversion method for mpl_error_log_summary[2].reaction" TAB_VERB "%12.0" "code" COMPU_TAB_REF CT_MPL_ERROR_LOG_SUMMARY[2].RE0 /end COMPU_METHOD
/begin COMPU_VTAB CT_MPL_ERROR_LOG_SUMMARY[2].RE0 "Conversion method for mpl_error_log_summary[2].reaction" TAB_VERB 6 0 "PIO_CONTINUE" 1 "PIO_RESET" 2 "PIO_RECORD_AND_CONTINUE" 3 "PIO_RECORD_AND_RESET" 4 "PIO_RESET_AND_RECORD" 5 "PIO_FAULT_REACTION_LAST" /end COMPU_VTAB
/* Scalar measurable for DDE 'mpl_error_log_summary[3].id'. */
/begin MEASUREMENT mpl_error_log_summary[3].id "Error code of fault raised" SWORD CU_MPL_ERROR_LOG_SUMMARY[3].ID 1 100 0.0 32767.0 ECU_ADDRESS 0xf0240054 BYTE_ORDER MSB_LAST /end MEASUREMENT
/begin COMPU_METHOD CU_MPL_ERROR_LOG_SUMMARY[3].ID "Conversion method for mpl_error_log_summary[3].id" TAB_VERB "%12.0" "code" COMPU_TAB_REF CT_MPL_ERROR_LOG_SUMMARY[3].ID /end COMPU_METHOD
/begin COMPU_VTAB CT_MPL_ERROR_LOG_SUMMARY[3].ID "Conversion method for mpl_error_log_summary[3].id" TAB_VERB 464 0 "PIO_PSY_NO_ERROR" 1 "PIO_TRAP_0_TIN_0_VAF" 2 "PIO_TRAP_0_TIN_1_VAP" 3 "PIO_TRAP_0_TIN_UNKNOWN" 4 "PIO_TRAP_1_TIN_1_PRIV" 5 "PIO_TRAP_1_TIN_2_MPR" 6 "PIO_TRAP_1_TIN_3_MPW" 7 "PIO_TRAP_1_TIN_4_MPX" 8 "PIO_TRAP_1_TIN_5_MPP" 9 "PIO_TRAP_1_TIN_6_MPN" 10 "PIO_TRAP_1_TIN_7_GRWP" 11 "PIO_TRAP_1_TIN_UNKNOWN" 12 "PIO_TRAP_2_TIN_1_IOPC" 13 "PIO_TRAP_2_TIN_2_UOPC" 14 "PIO_TRAP_2_TIN_3_OPD" 15 "PIO_TRAP_2_TIN_4_ALN" 16 "PIO_TRAP_2_TIN_5_MEM" 17 "PIO_TRAP_2_TIN_UNKNOWN" 18 "PIO_TRAP_3_TIN_1_FCD" 19 "PIO_TRAP_3_TIN_2_FCD" 20 "PIO_TRAP_3_TIN_3_CDU" 21 "PIO_TRAP_3_TIN_4_FCU" 22 "PIO_TRAP_3_TIN_5_CSU" 23 "PIO_TRAP_3_TIN_6_CTYP" 24 "PIO_TRAP_3_TIN_7_NEST" 25 "PIO_TRAP_3_TIN_UNKNOWN" 26 "PIO_TRAP_4_TIN_1_PSE" 27 "PIO_TRAP_4_TIN_2_DSE" 28 "PIO_TRAP_4_TIN_3_DAE" 29 "PIO_TRAP_4_TIN_4_CAE" 30 "PIO_TRAP_4_TIN_4_CAE_UNEXPECTED" 31 "PIO_TRAP_4_TIN_4_CAE_UNEXPECTED_FW" 32 "PIO_TRAP_4_TIN_5_PIE" 33 "PIO_TRAP_4_TIN_6_DIE" 34 "PIO_TRAP_4_TIN_7_DIE" 35 "PIO_TRAP_4_TIN_5_6_UNEXPECTED" 36 "PIO_TRAP_4_TIN_UNKNOWN" 37 "PIO_TRAP_5_TIN_1_OVF" 38 "PIO_TRAP_5_TIN_2_SOVF" 39 "PIO_TRAP_5_TIN_UNKNOWN" 40 "PIO_TRAP_6_SYS_UNKNOWN" 41 "PIO_TRAP_7_TIN_0_NMI" 42 "PIO_TRAP_7_TIN_UNKNOWN" 43 "PIO_ISR_0_RESET" 44 "PIO_BSPI_FIRST" 45 "PIO_BSPI_TRANSFER_TIMEOUT" 46 "PIO_BSPI_TX_DMA_ERROR" 47 "PIO_BSPI_RX_DMA_ERROR" 48 "PIO_BSPI_DSPI_ERROR" 49 "PIO_BSPI_RX_FIFO_OVERFLOW" 50 "PIO_BSPI_TX_FIFO_UNDERFLOW" 51 "PIO_BSPI_TRANSFER_TERMINATED" 52 "PIO_BSPI_TRANSAC_FAILED" 53 "PIO_BSPI_INTERNAL_SOFTWARE_ERROR" 54 "PIO_BSPI_ISR_MINIMUM_DELAY_TIME_NOT_MET" 55 "PIO_BSPI_ISR_FALSE_INT" 56 "PIO_BSPI_DMA_SAFETY_ERROR" 57 "PIO_BSPI_LAST" 58 "PIO_P1WR_ISR_MINIMUM_DELAY_TIME_NOT_MET" 59 "PIO_PADC_BUFFER_INIT_FAILED" 60 "PIO_PAX_ADC_INPUT_INVALID_ARG" 61 "PIO_PAX_CHANNEL_INVALID" 62 "PIO_PAX_ADC_INPUT_CHANNEL_UNSUPPORTED" 63 "PIO_PAX_CC_OUTPUT_CHANNEL_UNSUPPORTED" 64 "PIO_PAX_AOT_OUTPUT_CHANNEL_UNSUPPORTED" 65 "PIO_PAX_ISR_MINIMUM_DELAY_TIME_NOT_MET" 66 "PIO_PCANOPEN_RESET" 67 "PIO_PCANOPEN_BUFFER_OUT_OF_RANGE" 68 "PIO_PCANOPEN_NULL_POINTER" 69 "PIO_PCCP_RESET" 70 "PIO_PCCU6_ISR_MINIMUM_DELAY_TIME_NOT_MET" 71 "PIO_PCFG_INTERNAL_SW_ERROR" 72 "PIO_PCX_ERR_BUS_ID_OUT_OF_RANGE" 73 "PIO_PCX_ERR_DATA_LENGTH_OUT_OF_RANGE" 74 "PIO_PCX_ERR_STD_ID_OUT_OF_RANGE" 75 "PIO_PCX_ERR_EXT_ID_OUT_OF_RANGE" 76 "PIO_PCX_ERR_SAME_TX_MSG_DIFFERING_ATTRIBS" 77 "PIO_PCX_ERR_TOO_MANY_TX_MSGS" 78 "PIO_PCX_ERR_DUPLICATE_RX_MSG" 79 "PIO_PCX_ERR_TOO_MANY_RX_MSGS" 80 "PIO_PCX_ERR_BIT_RATE_IN_CONFIG_DIFFERS" 81 "PIO_PCX_ERR_UNSUPPORTED_BIT_RATE" 82 "PIO_PCX_ERR_BUS_ID_IN_CONFIG" 83 "PIO_PCX_ERR_NO_BITRATE_TABLE_MATCH" 84 "PIO_PCX_ERR_PACK_MSG_INVALID_PARAM" 85 "PIO_PCX_ERR_PACK_MSG_FIELD_PARAM" 86 "PIO_PCX_ERR_UNPACK_MSG_INVALID_PARAM" 87 "PIO_PCX_ERR_UNPACK_MSG_FIELD_PARAM" 88 "PIO_PCX_ERR_PACK_VDB_MSG_INVALID_PARAM" 89 "PIO_PCX_ERR_UNPACK_VDB_MSG_INVALID_PARAM" 90 "PIO_PCX_ERR_SWITCHED_RATE_FOR_NONFD_BUS" 91 "PIO_PCX_ERR_RX_MSG_FOR_UNCONFIG_BUS_0" 92 "PIO_PCX_ERR_UNSUPPORTED_BUS_MODE" 93 "PIO_PCX_ERR_BUS_MODE_IN_CONFIG_DIFFERS" 94 "PIO_PCX_ERR_SAME_RX_MSG_DIFFERING_ATTRIBS" 95 "PIO_PCX_ERR_TX_MSG_FOR_UNCONFIG_BUS_0" 96 "PIO_PCX_ISR_MINIMUM_DELAY_TIME_NOT_MET" 97 "PIO_PDD_CHANNEL_INVALID" 98 "PIO_PDD_DIG_DATA_IN_CHANNEL_UNSUPPORTED" 99 "PIO_PDD_DIG_DATA_OUT_CHANNEL_UNSUPPORTED" 100 "PIO_PDG_ERR_FORCED_RESET" 101 "PIO_PDTC_UPDATE_INVALID_ARG" 102 "PIO_PDTC_CLEAR_ALL_INVALID_ARG" 103 "PIO_PDTC_CLEAR_ALL_IF_ACT_INVALID_ARG" 104 "PIO_PDTC_CLEAR_ALL_IF_INACT_INVALID_ARG" 105 "PIO_PDTC_GET_DTC_STATUS_INVALID_ARG" 106 "PIO_PDTC_MATCH_EXISTS_INVALID_ARG" 107 "PIO_PDTC_CLEAR_DTCS_INVALID_ARG" 108 "PIO_PDTC_BAD_LICENSE" 109 "PIO_PDX_DO_CHANNEL_UNSUPPORTED" 110 "PIO_PDX_DIG_IN_CHANNEL_UNSUPPORTED" 111 "PIO_PDX_FREQ_IN_CHANNEL_UNSUPPORTED" 112 "PIO_PDX_PERIOD_IN_CHANNEL_UNSUPPORTED" 113 "PIO_PDX_QDEC_FREQ_IN_INVALID_ARG" 114 "PIO_PDX_QDEC_FREQ_IN_CHANNEL_UNSUPPORTED" 115 "PIO_PDX_TPU_QFI_CHANNEL_DEVICE_ERROR" 116 "PIO_PDX_QDEC_IN_CHANNEL_UNSUPPORTED" 117 "PIO_PDX_TPU_QI_CHANNEL_DEVICE_ERROR" 118 "PIO_PDX_PWM_OUT_CHANNEL_UNSUPPORTED" 119 "PIO_PDX_PWM_IN_CHANNEL_UNSUPPORTED" 120 "PIO_PDX_CHANNEL_INVALID" 121 "PIO_PDX_HBRIDGE_INVALID_MODE" 122 "PIO_PDX_HBRIDGE_DECODE_ERROR" 123 "PIO_PDX_HBRIDGE_CHANNEL_GROUP_UNSUPPORTED" 124 "PIO_PEM_EXTERNAL_RAM_REQUIRED" 125 "PIO_PEM_MEM_CONFIG_UNKNOWN" 126 "PIO_PETH_ERR_DRIVER_INITIALIZATION_ERROR" 127 "PIO_PETH_ERR_NULL_CONFIGURATION_POINTER" 128 "PIO_PETH_ERR_DATA_LENGTH_OUT_OF_RANGE" 129 "PIO_PETH_ERR_TOO_MANY_TX_MSGS" 130 "PIO_PETH_ERR_NOT_SUPPORTED" 131 "PIO_PFF_HOLDING_ARRAY_INDEX_INVALID" 132 "PIO_PFF_HOLDING_ARRAY_STRT_END_INVALID" 133 "PIO_PFF_HOLDING_ARRAY_REC_DATA_INVALID" 134 "PIO_PFF_STORED_FF_DTC_INVALID" 135 "PIO_PFF_STORED_DTC_READ_FAILURE" 136 "PIO_PFF_CAPTURE_PID_DATA_FAILURE" 137 "PIO_PFF_STARTUP_FFNO_ERROR" 138 "PIO_PFF_NVM_ALLOCATION_EXCEEDED" 139 "PIO_PFS_ECC_ERROR_DURING_FLASH_OP" 140 "PIO_PFS_RUNTIME_CORRUPT_FILE_FOUND" 141 "PIO_PKN_ERR_KERNEL_STARTED_BELOW_KERNEL_LEVEL" 142 "PIO_PKN_ERR_INVALID_RESOURCE_HANDLE" 143 "PIO_PKN_ERR_TASK_NOT_DECLARED_AS_ACQUIRING_RESOURCE" 144 "PIO_PKN_ERR_INVALID_TASK_HANDLE" 145 "PIO_PKN_ERR_INVALID_PERIODIC_TASK_HANDLE" 146 "PIO_PKN_ERR_UNEXPECTED_EXCEPTION" 147 "PIO_PKN_ERR_TASK_RESOURCE_CORE_DIFFER" 148 "PIO_PKN_ERR_TASK_RELEASE_RESOURCE_FAIL" 149 "PIO_PKN_ERR_ACQUIRING_RESOURCE_PRIORITY_CHANGE_FAIL" 150 "PIO_PKN_ERR_RELEASING_RESOURCE_PRIORITY_CHANGE_FAIL" 151 "PIO_PKN_ERR_TASK_RELEASE_RESOURCE_NEVER_ACQ" 152 "PIO_PKN_ERR_CLEAR_RESOURCE_SET_TASK_PRIO" 153 "PIO_PKN_ERR_ACQUIRING_RESOURCE_ALREADY_ACQUIRED" 154 "PIO_PJ1939_INVALID_CHANNEL" 155 "PIO_PJ1939_PG_TRANSMIT_RING_DEQUEUE_FAIL" 156 "PIO_PJ1939_DM6_TRANSMIT_INVALID_ARG" 157 "PIO_PJ1939_DM12_TRANSMIT_INVALID_ARG" 158 "PIO_PJ1939_DM14_DECODE_INVALID_ARG" 159 "PIO_PJ1939_DM15_TRANSMIT_INVALID_ARG" 160 "PIO_PJ1939_DM16_DECODE_INVALID_ARG" 161 "PIO_PJ1939_DM23_TRANSMIT_INVALID_ARG" 162 "PIO_PJ1939_DM27_TRANSMIT_INVALID_ARG" 163 "PIO_PJ1939_DM28_TRANSMIT_INVALID_ARG" 164 "PIO_PJ1939_DM29_TRANSMIT_INVALID_ARG" 165 "PIO_PJ1939_DM31_TRANSMIT_INVALID_ARG" 166 "PIO_PJ1939_DM41_TRANSMIT_INVALID_ARG" 167 "PIO_PJ1939_DM42_TRANSMIT_INVALID_ARG" 168 "PIO_PJ1939_DM43_TRANSMIT_INVALID_ARG" 169 "PIO_PJ1939_DM44_TRANSMIT_INVALID_ARG" 170 "PIO_PJ1939_DM45_TRANSMIT_INVALID_ARG" 171 "PIO_PJ1939_DM46_TRANSMIT_INVALID_ARG" 172 "PIO_PJ1939_DM47_TRANSMIT_INVALID_ARG" 173 "PIO_PJ1939_DM48_TRANSMIT_INVALID_ARG" 174 "PIO_PJ1939_DM49_TRANSMIT_INVALID_ARG" 175 "PIO_PJ1939_DM50_TRANSMIT_INVALID_ARG" 176 "PIO_PJ1939_DM51_TRANSMIT_INVALID_ARG" 177 "PIO_PJ1939_DM52_TRANSMIT_INVALID_ARG" 178 "PIO_PJ1939_INVALID_RING_BUFFER_ARG" 179 "PIO_PJ1939_DM1_RECEIVE_INVALID_ARG" 180 "PIO_PJ1939_DM2_RECEIVE_INVALID_ARG" 181 "PIO_PMCAL_ADC_INIT_CHECK_ERROR" 182 "PIO_PSAF_ERROR_STANDBY_INIT" 183 "PIO_PSAF_ISR_MINIMUM_DELAY_TIME_NOT_MET" 184 "PIO_PSAF_ERROR_CLOCK_PLAUSIBILITY" 185 "PIO_PSC_DECODE_RESET_INVALID_ARG" 186 "PIO_PSC_ERR_FORCED_RESET" 187 "PIO_PSC_ERR_STANDY_ENTRY" 188 "PIO_PSC_ERR_VERSION_INVALID_PARAM" 189 "PIO_PSC_ERR_BUILD_DATE_INVALID_PARAM" 190 "PIO_PSC_ERR_PART_NUMBER_INVALID_PARAM" 191 "PIO_PSC_UNEXPECTED_CVN_CHANGE" 192 "PIO_PSC_ERR_HW_VERSION_UNKNOWN" 193 "PIO_PSENT_IN_CHANNEL_UNSUPPORTED" 194 "PIO_PSMC_INVALID_DATA" 195 "PIO_PSMC_INTERNAL_SW_ERROR" 196 "PIO_PSTP_SAFETPACK_INIT_FAILURE" 197 "PIO_PSTP_SMU_MODE_INVALID_DURING_INIT" 198 "PIO_PSTP_SMU_MODE_RUN_DURING_INIT" 199 "PIO_PSTP_SMU_FAIL_INIT" 200 "PIO_PSTP_SMU_FAIL_ALARM_CONFIG" 201 "PIO_PSTP_SMU_SW_ALARM_GROUP_0" 202 "PIO_PSTP_SMU_SW_ALARM_GROUP_1" 203 "PIO_PSTP_SMU_SW_ALARM_GROUP_2" 204 "PIO_PSTP_SMU_SW_ALARM_GROUP_3" 205 "PIO_PSTP_SMU_SW_ALARM_GROUP_4" 206 "PIO_PSTP_SMU_SW_ALARM_GROUP_5" 207 "PIO_PSTP_SMU_SW_ALARM_GROUP_6" 208 "PIO_PSTP_SMU_SW_ALARM_GROUP_7" 209 "PIO_PSTP_SMU_SW_ALARM_GROUP_8" 210 "PIO_PSTP_SMU_SW_ALARM_GROUP_9" 211 "PIO_PSTP_SMU_SW_ALARM_GROUP_10" 212 "PIO_PSTP_SMU_SW_ALARM_GROUP_11" 213 "PIO_PSTP_SMU_SW_ALARM_GROUP_12" 214 "PIO_PSTP_SMU_SW_ALARM_GROUP_13" 215 "PIO_PSTP_SMU_SW_ALARM_GROUP_14" 216 "PIO_PSTP_SMU_SW_ALARM_GROUP_15" 217 "PIO_PSTP_SWDGM_UNEXPECTED" 218 "PIO_PSTP_SWDGM_INIT_FAIL" 219 "PIO_PSTP_SWDGM_ACTIVATE_FAIL" 220 "PIO_PSTP_SWDGM_DEINIT_FAIL" 221 "PIO_PSTP_SWDGM_GETERRCNTR_FAIL" 222 "PIO_PSTP_SWDGM_GETINFO_FAIL" 223 "PIO_PSTP_SWDGM_GETSEED_FAIL" 224 "PIO_PSTP_SWDGM_USERREQ_FAIL" 225 "PIO_PSTP_SWDGM_SERVICE_FAIL" 226 "PIO_PSTP_TSTM_STARTUP_TEST_FAIL" 227 "PIO_PSTP_TSTM_RUNTIME_TEST_FAIL" 228 "PIO_PSTP_TSTM_INIT_FAIL" 229 "PIO_PSTP_TSTM_SWITCH_TO_RUN_FAIL" 230 "PIO_PSTP_TLF_TEST_FAIL" 231 "PIO_PSTP_TLF_MAXJOBS_FAIL" 232 "PIO_PSTP_SEID_INCORRECT" 233 "PIO_PSTP_CHECKPOINT_INCORRECT" 234 "PIO_PSTP_ERR_TASK_BUDGET_OVRRUN" 235 "PIO_PSTP_HTXTESTHND_INVALID_RESULT" 236 "PIO_PSTP_HTXTESTHND_TEST_NOT_EXECUTED" 237 "PIO_PSTP_HTXLBIST_CALLER_ADDR_ERR" 238 "PIO_PSTP_HTXLBIST_PORST_ERR" 239 "PIO_PSTP_HTXLBIST_TERMINATION_ERR" 240 "PIO_PSTP_HTXLBIST_DEFAULT_SIGNATURE_ERR" 241 "PIO_PSTP_HTXLBIST_CRC_ERR" 242 "PIO_PSTP_HTXLBIST_UNDEFINED_ERR" 243 "PIO_PSTP_HTXLBIST_INV_PARAM_ERR" 244 "PIO_PSTP_HTXSFRTST_CMP_INV_PARAM_ERR" 245 "PIO_PSTP_HTXSFRTST_CMP_OVERLOAD" 246 "PIO_PSTP_HTXSFRTST_CMP_VAL_ERR" 247 "PIO_PSTP_HTXSFRTST_CRC_INV_PARAM_ERR" 248 "PIO_PSTP_HTXSFRTST_CRC_DATAMISMATCH" 249 "PIO_PSTP_HTXREGMON_SMU_TIMEOUT" 250 "PIO_PSTP_HTXREGMON_ERR_UNDEFINED" 251 "PIO_PSTP_HTXREGMON_ERR_MTU_TIMEOUT_UND" 252 "PIO_PSTP_HTXREGMON_INV_PARAM_ERR" 253 "PIO_PSTP_HTXREGMON_ERR_MTU_FAILED" 254 "PIO_PSTP_HTXMONBIST_ERR_SMU_FLAG" 255 "PIO_PSTP_HTXMONBIST_ERR_PMS_FLAG" 256 "PIO_PSTP_HTXMONBIST_ERR_PMS_SMU_FLAG" 257 "PIO_PSTP_HTXMONBIST_ERR_TIMEOUT" 258 "PIO_PSTP_HTXMONBIST_ERR_UNSPECIFIED" 259 "PIO_PSTP_HTXMONBIST_ERR_SFR_CONFIG" 260 "PIO_PSTP_HTXDTSRESULT_A_FAILED_ERR_DIFF" 261 "PIO_PSTP_HTXDTSRESULT_B_FAILED_ERR_DIFF" 262 "PIO_PSTP_HTXSMUALIVEALARM_ERR_ALM_STS" 263 "PIO_PSTP_HTXSMUALIVEALARM_ERR_TRIG" 264 "PIO_PSTP_HTXSMUALIVEALARM_PREV_ALM_STS" 265 "PIO_PSTP_HTXSMUALIVEALARM_ERR_SMU_RUN" 266 "PIO_PSTP_HTXVMTMBIST_ERR_MTU_UNDEFINED" 267 "PIO_PSTP_HTXVMTMBIST_ERR_MTU_TIMEOUT_UND" 268 "PIO_PSTP_HTXVMTMBIST_INV_PARAM_ERR" 269 "PIO_PSTP_HTXFWCHECK_FAILED" 270 "PIO_PSTP_HTXFWCHECK_INV_PARAM_ERR" 271 "PIO_PSTP_HTXFWCHECK_RST_UNKNOWN" 272 "PIO_PSTP_HTXFWCHECK_SFR_NOT_CLEARED" 273 "PIO_PSTP_HTXFWCHECK_DATA_ERR" 274 "PIO_PSTP_HTXPFM_UNEXPECTED_ERROR" 275 "PIO_PSTP_HTXPFM_RAM_CORRUPTION" 276 "PIO_PSTP_HTXPFM_ILLEGAL_FUNCTION_ARGUMENT" 277 "PIO_PSTP_HTXPFM_SYSTEM_TIMER_READ_FAULT" 278 "PIO_PSTP_HTXPFM_ILLEGAL_REINIT" 279 "PIO_PSTP_HTXPFM_UNEXPECTED_SEID" 280 "PIO_PSTP_HTXPFM_LOGICAL_FAULT_DETECTED" 281 "PIO_PSTP_HTXPFM_DEADLINE_FAULT_DETECTED" 282 "PIO_PSTP_HTXPFM_TIMING_FAULT_DETECTED" 283 "PIO_PSTP_HTXPFM_ALIVENESS_FAULT_DETECTED" 284 "PIO_PSY_ERR_SMU_ASSERT" 285 "PIO_PTM_TIMER_ERROR" 286 "PIO_PUT_DEBOUNCE_BY_CYCLES_INVALID_ARG" 287 "PIO_PUT_LEAKY_BUCKET_INVALID_ARG" 288 "PIO_PUT_DEBOUNCE_BY_TIME_INVALID_ARG" 289 "PIO_PUT_DUTYCYCLE_PROCESSING_INVALID_ARG" 290 "PIO_PUT_STATE_PROCESSING_INVALID_ARG" 291 "PIO_PUT_ARRAY_SEARCH_INVALID_ARG" 292 "PIO_PUT_ERR_PACK_INVALID_PARAM" 293 "PIO_PUT_ERR_UNPACK_INVALID_PARAM" 294 "PIO_PXCP_RESET" 295 "PIO_PUART_MCAL_INIT_CHECK_ERROR" 296 "PIO_ALARM_0_TYPE_0_CPU" 297 "PIO_ALARM_0_TYPE_1_CPU" 298 "PIO_ALARM_0_TYPE_2_CPU" 299 "PIO_ALARM_0_TYPE_4_MTU" 300 "PIO_ALARM_0_TYPE_5_MTU" 301 "PIO_ALARM_0_TYPE_6_MTU" 302 "PIO_ALARM_0_TYPE_7_MTU" 303 "PIO_ALARM_0_TYPE_8_MTU" 304 "PIO_ALARM_0_TYPE_9_MTU" 305 "PIO_ALARM_0_TYPE_10_MTU" 306 "PIO_ALARM_0_TYPE_11_MTU" 307 "PIO_ALARM_0_TYPE_12_MTU" 308 "PIO_ALARM_0_TYPE_13_MTU" 309 "PIO_ALARM_0_TYPE_14_MTU" 310 "PIO_ALARM_0_TYPE_22_CPU" 311 "PIO_ALARM_0_TYPE_23_CPU" 312 "PIO_ALARM_0_TYPE_24_CPU" 313 "PIO_ALARM_1_TYPE_0_CPU" 314 "PIO_ALARM_1_TYPE_1_CPU" 315 "PIO_ALARM_1_TYPE_2_CPU" 316 "PIO_ALARM_1_TYPE_4_MTU" 317 "PIO_ALARM_1_TYPE_5_MTU" 318 "PIO_ALARM_1_TYPE_6_MTU" 319 "PIO_ALARM_1_TYPE_7_MTU" 320 "PIO_ALARM_1_TYPE_8_MTU" 321 "PIO_ALARM_1_TYPE_9_MTU" 322 "PIO_ALARM_1_TYPE_10_MTU" 323 "PIO_ALARM_1_TYPE_11_MTU" 324 "PIO_ALARM_1_TYPE_12_MTU" 325 "PIO_ALARM_1_TYPE_13_MTU" 326 "PIO_ALARM_1_TYPE_14_MTU" 327 "PIO_ALARM_1_TYPE_22_MTU" 328 "PIO_ALARM_1_TYPE_23_CPU" 329 "PIO_ALARM_1_TYPE_24_CPU" 330 "PIO_ALARM_6_TYPE_0_MTU" 331 "PIO_ALARM_6_TYPE_1_IOM" 332 "PIO_ALARM_6_TYPE_2_IR" 333 "PIO_ALARM_6_TYPE_4_SCU" 334 "PIO_ALARM_6_TYPE_5_PMS" 335 "PIO_ALARM_6_TYPE_6_DMA" 336 "PIO_ALARM_6_TYPE_7_SMU_CORE" 337 "PIO_ALARM_6_TYPE_8_CCU" 338 "PIO_ALARM_6_TYPE_10_GTM" 339 "PIO_ALARM_6_TYPE_11_GTM" 340 "PIO_ALARM_6_TYPE_12_GTM" 341 "PIO_ALARM_6_TYPE_13_ERAY" 342 "PIO_ALARM_6_TYPE_14_ERAY" 343 "PIO_ALARM_6_TYPE_15_SRAM" 344 "PIO_ALARM_6_TYPE_16_CAN" 345 "PIO_ALARM_6_TYPE_17_CAN" 346 "PIO_ALARM_6_TYPE_18_CAN" 347 "PIO_ALARM_6_TYPE_19_MISC" 348 "PIO_ALARM_6_TYPE_20_MISC" 349 "PIO_ALARM_6_TYPE_21_MISC" 350 "PIO_ALARM_6_TYPE_23_CBS" 351 "PIO_ALARM_6_TYPE_24_CCU" 352 "PIO_ALARM_6_TYPE_25_CCU" 353 "PIO_ALARM_7_TYPE_0_DAM0" 354 "PIO_ALARM_7_TYPE_1_LMU" 355 "PIO_ALARM_7_TYPE_2_LMU" 356 "PIO_ALARM_7_TYPE_17_XBAR0" 357 "PIO_ALARM_7_TYPE_20_SPB" 358 "PIO_ALARM_7_TYPE_22_FSI" 359 "PIO_ALARM_7_TYPE_23_FSI" 360 "PIO_ALARM_7_TYPE_24_FSI" 361 "PIO_ALARM_7_TYPE_25_FSI" 362 "PIO_ALARM_7_TYPE_26_FSI" 363 "PIO_ALARM_7_TYPE_27_FSI" 364 "PIO_ALARM_7_TYPE_28_FSI" 365 "PIO_ALARM_7_TYPE_29_FSI" 366 "PIO_ALARM_7_TYPE_30_FSI" 367 "PIO_ALARM_7_TYPE_31_FSI" 368 "PIO_ALARM_8_TYPE_0_SCU" 369 "PIO_ALARM_8_TYPE_1_CCU" 370 "PIO_ALARM_8_TYPE_2_CCU" 371 "PIO_ALARM_8_TYPE_3_SCU" 372 "PIO_ALARM_8_TYPE_4_SCU" 373 "PIO_ALARM_8_TYPE_5_SCU" 374 "PIO_ALARM_8_TYPE_6_SCU" 375 "PIO_ALARM_8_TYPE_7_SCU" 376 "PIO_ALARM_8_TYPE_8_SCU" 377 "PIO_ALARM_8_TYPE_9_SCU" 378 "PIO_ALARM_8_TYPE_10_SCU" 379 "PIO_ALARM_8_TYPE_11_SCU" 380 "PIO_ALARM_8_TYPE_16_SCU" 381 "PIO_ALARM_8_TYPE_17_SCU" 382 "PIO_ALARM_8_TYPE_18_SCU" 383 "PIO_ALARM_8_TYPE_19_SCU" 384 "PIO_ALARM_8_TYPE_20_SCU" 385 "PIO_ALARM_8_TYPE_21_SCU" 386 "PIO_ALARM_8_TYPE_22_IR" 387 "PIO_ALARM_8_TYPE_23_DMA" 388 "PIO_ALARM_8_TYPE_25_IOM" 389 "PIO_ALARM_8_TYPE_26_SCU" 390 "PIO_ALARM_8_TYPE_27_SCU" 391 "PIO_ALARM_8_TYPE_28_SCU" 392 "PIO_ALARM_8_TYPE_29_SCU" 393 "PIO_ALARM_8_TYPE_30_SCU" 394 "PIO_ALARM_8_TYPE_31_SCU" 395 "PIO_ALARM_9_TYPE_0_DTS" 396 "PIO_ALARM_9_TYPE_1_DTS" 397 "PIO_ALARM_9_TYPE_3_PMS" 398 "PIO_ALARM_9_TYPE_5_PMS" 399 "PIO_ALARM_9_TYPE_15_PMS" 400 "PIO_ALARM_9_TYPE_16_PMS" 401 "PIO_ALARM_9_TYPE_17_PMS" 402 "PIO_ALARM_10_TYPE_0_SW" 403 "PIO_ALARM_10_TYPE_1_SW" 404 "PIO_ALARM_10_TYPE_2_SW" 405 "PIO_ALARM_10_TYPE_3_SW" 406 "PIO_ALARM_10_TYPE_4_SW" 407 "PIO_ALARM_10_TYPE_5_SW" 408 "PIO_ALARM_10_TYPE_6_SW" 409 "PIO_ALARM_10_TYPE_7_SW" 410 "PIO_ALARM_10_TYPE_8_SW" 411 "PIO_ALARM_10_TYPE_9_SW" 412 "PIO_ALARM_10_TYPE_10_SW" 413 "PIO_ALARM_10_TYPE_11_SW" 414 "PIO_ALARM_10_TYPE_12_SW" 415 "PIO_ALARM_10_TYPE_13_SW" 416 "PIO_ALARM_10_TYPE_14_SW" 417 "PIO_ALARM_10_TYPE_15_SW" 418 "PIO_ALARM_10_TYPE_16_SMU_CORE" 419 "PIO_ALARM_10_TYPE_17_SMU_CORE" 420 "PIO_ALARM_10_TYPE_18_FSP" 421 "PIO_ALARM_10_TYPE_20_CCU" 422 "PIO_ALARM_10_TYPE_21_SFF" 423 "PIO_ALARM_10_TYPE_22_SFF" 424 "PIO_ALARM_11_TYPE_2_XBAR" 425 "PIO_ALARM_11_TYPE_3_XBAR" 426 "PIO_ALARM_11_TYPE_4_DMU" 427 "PIO_ALARM_11_TYPE_5_DMU" 428 "PIO_ALARM_11_TYPE_9_SFIBRIDGE1" 429 "PIO_ALARM_11_TYPE_10_HSSL" 430 "PIO_ALARM_11_TYPE_12_CONVERTER" 431 "PIO_ALARM_11_TYPE_13_XBAR" 432 "PIO_ALARM_20_TYPE_4_EVR" 433 "PIO_ALARM_20_TYPE_5_EVR" 434 "PIO_ALARM_20_TYPE_6_EVR" 435 "PIO_ALARM_20_TYPE_7_EVR" 436 "PIO_ALARM_20_TYPE_8_EVR" 437 "PIO_ALARM_20_TYPE_9_EVR" 438 "PIO_ALARM_20_TYPE_10_EVR" 439 "PIO_ALARM_20_TYPE_11_EVR" 440 "PIO_ALARM_20_TYPE_12_EVR" 441 "PIO_ALARM_20_TYPE_13_EVR" 442 "PIO_ALARM_20_TYPE_14_EVR" 443 "PIO_ALARM_20_TYPE_15_EVR" 444 "PIO_ALARM_21_TYPE_0_HSM" 445 "PIO_ALARM_21_TYPE_1_HSM" 446 "PIO_ALARM_21_TYPE_2_HSM" 447 "PIO_ALARM_21_TYPE_3_HSM" 448 "PIO_ALARM_21_TYPE_4_HSM" 449 "PIO_ALARM_21_TYPE_5_HSM" 450 "PIO_ALARM_21_TYPE_7_SMU" 451 "PIO_ALARM_21_TYPE_8_PMS" 452 "PIO_ALARM_21_TYPE_9_PMS" 453 "PIO_ALARM_21_TYPE_10_PMS" 454 "PIO_ALARM_21_TYPE_11_PMS" 455 "PIO_ALARM_21_TYPE_12_PMS" 456 "PIO_ALARM_21_TYPE_13_PMS" 457 "PIO_ALARM_21_TYPE_14_PMS" 458 "PIO_ALARM_21_TYPE_15_CCU" 459 "PIO_ALARM_21_TYPE_16_SMU_CORE" 460 "PIO_ALARM_MULTIPLE" 461 "PIO_ALARM_RESERVED" 462 "PIO_ALARM_UNEXPECTED" 463 "PIO_ERROR_ID_LAST" /end COMPU_VTAB
/* Scalar measurable for DDE 'mpl_error_log_summary[3].mode'. */
/begin MEASUREMENT mpl_error_log_summary[3].mode "Mode of the software when fault raised" SBYTE CU_MPL_ERROR_LOG_SUMMARY[3].MO0 1 100 0.0 127.0 ECU_ADDRESS 0xf0240056 BYTE_ORDER MSB_LAST /end MEASUREMENT
/begin COMPU_METHOD CU_MPL_ERROR_LOG_SUMMARY[3].MO0 "Conversion method for mpl_error_log_summary[3].mode" TAB_VERB "%12.0" "code" COMPU_TAB_REF CT_MPL_ERROR_LOG_SUMMARY[3].MO0 /end COMPU_METHOD
/begin COMPU_VTAB CT_MPL_ERROR_LOG_SUMMARY[3].MO0 "Conversion method for mpl_error_log_summary[3].mode" TAB_VERB 4 0 "PIO_EXEC_MODE_UNKNOWN" 1 "PIO_EXEC_MODE_PRG" 2 "PIO_EXEC_MODE_APP" 3 "PIO_EXEC_MODE_LAST" /end COMPU_VTAB
/* Scalar measurable for DDE 'mpl_error_log_summary[3].reaction'. */
/begin MEASUREMENT mpl_error_log_summary[3].react0 "Reaction to the fault raised" SBYTE CU_MPL_ERROR_LOG_SUMMARY[3].RE0 1 100 0.0 127.0 ECU_ADDRESS 0xf0240057 BYTE_ORDER MSB_LAST /end MEASUREMENT
/begin COMPU_METHOD CU_MPL_ERROR_LOG_SUMMARY[3].RE0 "Conversion method for mpl_error_log_summary[3].reaction" TAB_VERB "%12.0" "code" COMPU_TAB_REF CT_MPL_ERROR_LOG_SUMMARY[3].RE0 /end COMPU_METHOD
/begin COMPU_VTAB CT_MPL_ERROR_LOG_SUMMARY[3].RE0 "Conversion method for mpl_error_log_summary[3].reaction" TAB_VERB 6 0 "PIO_CONTINUE" 1 "PIO_RESET" 2 "PIO_RECORD_AND_CONTINUE" 3 "PIO_RECORD_AND_RESET" 4 "PIO_RESET_AND_RECORD" 5 "PIO_FAULT_REACTION_LAST" /end COMPU_VTAB
/* Scalar measurable for DDE 'mpl_flp_div_by_zero'. */
/begin MEASUREMENT mpl_flp_div_by_zero "Set if FLP division by zero has occurred since the last reset, clear otherwise." UBYTE CU_MPL_FLP_DIV_BY_ZERO 1 100 0.0 255.0 ECU_ADDRESS 0x70013cf2 BYTE_ORDER MSB_LAST /end MEASUREMENT
/begin COMPU_METHOD CU_MPL_FLP_DIV_BY_ZERO "Conversion method for mpl_flp_div_by_zero" RAT_FUNC "%10.0" "flag" COEFFS 0.000000 1.000000 -0.000000 0.000000 0.000000 1.000000 /end COMPU_METHOD
/* Scalar measurable for DDE 'mpl_flp_inexact'. */
/begin MEASUREMENT mpl_flp_inexact "Set if an inexact FLP result has occurred since the last reset, clear otherwise." UBYTE CU_MPL_FLP_INEXACT 1 100 0.0 255.0 ECU_ADDRESS 0x70013cf1 BYTE_ORDER MSB_LAST /end MEASUREMENT
/begin COMPU_METHOD CU_MPL_FLP_INEXACT "Conversion method for mpl_flp_inexact" RAT_FUNC "%10.0" "flag" COEFFS 0.000000 1.000000 -0.000000 0.000000 0.000000 1.000000 /end COMPU_METHOD
/* Scalar measurable for DDE 'mpl_flp_invalid'. */
/begin MEASUREMENT mpl_flp_invalid "Set if an invalid FLP result has occurred since the last reset, clear otherwise." UBYTE CU_MPL_FLP_INVALID 1 100 0.0 255.0 ECU_ADDRESS 0x70013cf0 BYTE_ORDER MSB_LAST /end MEASUREMENT
/begin COMPU_METHOD CU_MPL_FLP_INVALID "Conversion method for mpl_flp_invalid" RAT_FUNC "%10.0" "flag" COEFFS 0.000000 1.000000 -0.000000 0.000000 0.000000 1.000000 /end COMPU_METHOD
/* Scalar measurable for DDE 'mpl_flp_overflow'. */
/begin MEASUREMENT mpl_flp_overflow "Set if FLP overflow has occurred since the last reset, clear otherwise." UBYTE CU_MPL_FLP_OVERFLOW 1 100 0.0 255.0 ECU_ADDRESS 0x70013cf4 BYTE_ORDER MSB_LAST /end MEASUREMENT
/begin COMPU_METHOD CU_MPL_FLP_OVERFLOW "Conversion method for mpl_flp_overflow" RAT_FUNC "%10.0" "flag" COEFFS 0.000000 1.000000 -0.000000 0.000000 0.000000 1.000000 /end COMPU_METHOD
/* Scalar measurable for DDE 'mpl_flp_underflow'. */
/begin MEASUREMENT mpl_flp_underflow "Set if FLP underflow has occurred since the last reset, clear otherwise." UBYTE CU_MPL_FLP_UNDERFLOW 1 100 0.0 255.0 ECU_ADDRESS 0x70013cf3 BYTE_ORDER MSB_LAST /end MEASUREMENT
/begin COMPU_METHOD CU_MPL_FLP_UNDERFLOW "Conversion method for mpl_flp_underflow" RAT_FUNC "%10.0" "flag" COEFFS 0.000000 1.000000 -0.000000 0.000000 0.000000 1.000000 /end COMPU_METHOD
/* Scalar measurable for DDE 'mpl_init_task_c0.stack.isr.status'. */
/begin MEASUREMENT mpl_init_task_c0.stack.isr.sta0 "Current status of stack performance measurement for task: init_task_c0" SLONG CU_MPL_INIT_TASK_C0.STACK.ISR.1 1 100 0.0 255.0 ECU_ADDRESS 0x700139b0 BYTE_ORDER MSB_LAST /end MEASUREMENT
/begin COMPU_METHOD CU_MPL_INIT_TASK_C0.STACK.ISR.1 "Conversion method for mpl_init_task_c0.stack.isr.status" TAB_VERB "%12.0" "(not defined)" COMPU_TAB_REF CT_MPL_INIT_TASK_C0.STACK.ISR.1 /end COMPU_METHOD
/begin COMPU_VTAB CT_MPL_INIT_TASK_C0.STACK.ISR.1 "Conversion method for mpl_init_task_c0.stack.isr.status" TAB_VERB 5 0 "PKN_TASK_STK_STAT_NR_IN_PROG" 1 "PKN_TASK_STACK_DATA_STATUS_VALID" 2 "PKN_TASK_STK_STAT_NR_GROW_SPEC" 3 "PKN_TASK_STK_STAT_NR_ALLOC_SPEC" 4 "PKN_TASK_STK_STAT_NR_INV_SPEC" /end COMPU_VTAB
/* Scalar measurable for DDE 'mpl_init_task_c0.stack.isr.used'. */
/begin MEASUREMENT mpl_init_task_c0.stack.isr.used "Used bytes of interrupt stack for task named: init_task_c0" ULONG CU_MPL_INIT_TASK_C0.STACK.ISR.0 1 100 0.0 4294967295.0 ECU_ADDRESS 0x700139ac BYTE_ORDER MSB_LAST /end MEASUREMENT
/begin COMPU_METHOD CU_MPL_INIT_TASK_C0.STACK.ISR.0 "Conversion method for mpl_init_task_c0.stack.isr.used" RAT_FUNC "%10.0" "bytes" COEFFS 0.000000 1.000000 -0.000000 0.000000 0.000000 1.000000 /end COMPU_METHOD
/* Scalar measurable for DDE 'mpl_init_task_c0.stack.task.status'. */
/begin MEASUREMENT mpl_init_task_c0.stack.task.st0 "Current status of stack performance measurement for task: init_task_c0" SLONG CU_MPL_INIT_TASK_C0.STACK.TASK0 1 100 0.0 255.0 ECU_ADDRESS 0x700139c0 BYTE_ORDER MSB_LAST /end MEASUREMENT
/begin COMPU_METHOD CU_MPL_INIT_TASK_C0.STACK.TASK0 "Conversion method for mpl_init_task_c0.stack.task.status" TAB_VERB "%12.0" "(not defined)" COMPU_TAB_REF CT_MPL_INIT_TASK_C0.STACK.TASK0 /end COMPU_METHOD
/begin COMPU_VTAB CT_MPL_INIT_TASK_C0.STACK.TASK0 "Conversion method for mpl_init_task_c0.stack.task.status" TAB_VERB 5 0 "PKN_TASK_STK_STAT_NR_IN_PROG" 1 "PKN_TASK_STACK_DATA_STATUS_VALID" 2 "PKN_TASK_STK_STAT_NR_GROW_SPEC" 3 "PKN_TASK_STK_STAT_NR_ALLOC_SPEC" 4 "PKN_TASK_STK_STAT_NR_INV_SPEC" /end COMPU_VTAB
/* Scalar measurable for DDE 'mpl_init_task_c0.stack.task.used'. */
/begin MEASUREMENT mpl_init_task_c0.stack.task.us0 "Used bytes of task stack for task named: init_task_c0" ULONG CU_MPL_INIT_TASK_C0.STACK.TASK1 1 100 0.0 4294967295.0 ECU_ADDRESS 0x700139bc BYTE_ORDER MSB_LAST /end MEASUREMENT
/begin COMPU_METHOD CU_MPL_INIT_TASK_C0.STACK.TASK1 "Conversion method for mpl_init_task_c0.stack.task.used" RAT_FUNC "%10.0" "bytes" COEFFS 0.000000 1.000000 -0.000000 0.000000 0.000000 1.000000 /end COMPU_METHOD
/* Scalar measurable for DDE 'mpl_init_task_c0.timing.overruns'. */
/begin MEASUREMENT mpl_init_task_c0.timing.overru0 ": init_task_c0" UBYTE CU_MPL_INIT_TASK_C0.TIMING.OVE0 1 100 0.0 255.0 ECU_ADDRESS 0x700139a0 BYTE_ORDER MSB_LAST /end MEASUREMENT
/begin COMPU_METHOD CU_MPL_INIT_TASK_C0.TIMING.OVE0 "Conversion method for mpl_init_task_c0.timing.overruns" RAT_FUNC "%10.0" "count" COEFFS 0.000000 1.000000 -0.000000 0.000000 0.000000 1.000000 /end COMPU_METHOD
/* Scalar measurable for DDE 'mpl_init_task_c0.timing.runs'. */
/begin MEASUREMENT mpl_init_task_c0.timing.runs ": init_task_c0" ULONG CU_MPL_INIT_TASK_C0.TIMING.RUNS 1 100 0.0 4294967295.0 ECU_ADDRESS 0x7001399c BYTE_ORDER MSB_LAST /end MEASUREMENT
/begin COMPU_METHOD CU_MPL_INIT_TASK_C0.TIMING.RUNS "Conversion method for mpl_init_task_c0.timing.runs" RAT_FUNC "%10.0" "count" COEFFS 0.000000 1.000000 -0.000000 0.000000 0.000000 1.000000 /end COMPU_METHOD
/* Scalar measurable for DDE 'mpl_max_cpu_loaded_1000ms_c0'. */
/begin MEASUREMENT mpl_max_cpu_loaded_1000ms_c0 "Maximum CPU0 loading seen since startup" UBYTE CU_MPL_MAX_CPU_LOADED_1000MS_C0 1 100 0.0 255.0 ECU_ADDRESS 0x70013c41 BYTE_ORDER MSB_LAST /end MEASUREMENT
/begin COMPU_METHOD CU_MPL_MAX_CPU_LOADED_1000MS_C0 "Conversion method for mpl_max_cpu_loaded_1000ms_c0" RAT_FUNC "%10.0" "%" COEFFS 0.000000 1.000000 -0.000000 0.000000 0.000000 1.000000 /end COMPU_METHOD
/* Scalar measurable for DDE 'mpl_max_cpu_loaded_1000ms_c1'. */
/begin MEASUREMENT mpl_max_cpu_loaded_1000ms_c1 "Maximum CPU1 loading seen since startup" UBYTE CU_MPL_MAX_CPU_LOADED_1000MS_C1 1 100 0.0 255.0 ECU_ADDRESS 0x70013c43 BYTE_ORDER MSB_LAST /end MEASUREMENT
/begin COMPU_METHOD CU_MPL_MAX_CPU_LOADED_1000MS_C1 "Conversion method for mpl_max_cpu_loaded_1000ms_c1" RAT_FUNC "%10.0" "%" COEFFS 0.000000 1.000000 -0.000000 0.000000 0.000000 1.000000 /end COMPU_METHOD
/* Scalar measurable for DDE 'mpl_max_cpu_loaded_50ms_c0'. */
/begin MEASUREMENT mpl_max_cpu_loaded_50ms_c0 "Maximum CPU0 loading seen since startup" UBYTE CU_MPL_MAX_CPU_LOADED_50MS_C0 1 100 0.0 255.0 ECU_ADDRESS 0x70013c40 BYTE_ORDER MSB_LAST /end MEASUREMENT
/begin COMPU_METHOD CU_MPL_MAX_CPU_LOADED_50MS_C0 "Conversion method for mpl_max_cpu_loaded_50ms_c0" RAT_FUNC "%10.0" "%" COEFFS 0.000000 1.000000 -0.000000 0.000000 0.000000 1.000000 /end COMPU_METHOD
/* Scalar measurable for DDE 'mpl_max_cpu_loaded_50ms_c1'. */
/begin MEASUREMENT mpl_max_cpu_loaded_50ms_c1 "Maximum CPU1 loading seen since startup" UBYTE CU_MPL_MAX_CPU_LOADED_50MS_C1 1 100 0.0 255.0 ECU_ADDRESS 0x70013c42 BYTE_ORDER MSB_LAST /end MEASUREMENT
/begin COMPU_METHOD CU_MPL_MAX_CPU_LOADED_50MS_C1 "Conversion method for mpl_max_cpu_loaded_50ms_c1" RAT_FUNC "%10.0" "%" COEFFS 0.000000 1.000000 -0.000000 0.000000 0.000000 1.000000 /end COMPU_METHOD
/* Scalar measurable for DDE 'mpl_max_cpu_loaded_c0'. */
/begin MEASUREMENT mpl_max_cpu_loaded_c0 "Maximum CPU0 loading seen since startup" UBYTE CU_MPL_MAX_CPU_LOADED_C0 1 100 0.0 255.0 ECU_ADDRESS 0x70013c40 BYTE_ORDER MSB_LAST /end MEASUREMENT
/begin COMPU_METHOD CU_MPL_MAX_CPU_LOADED_C0 "Conversion method for mpl_max_cpu_loaded_c0" RAT_FUNC "%10.0" "%" COEFFS 0.000000 1.000000 -0.000000 0.000000 0.000000 1.000000 /end COMPU_METHOD
/* Scalar measurable for DDE 'mpl_max_cpu_loaded_c1'. */
/begin MEASUREMENT mpl_max_cpu_loaded_c1 "Maximum CPU1 loading seen since startup" UBYTE CU_MPL_MAX_CPU_LOADED_C1 1 100 0.0 255.0 ECU_ADDRESS 0x70013c42 BYTE_ORDER MSB_LAST /end MEASUREMENT
/begin COMPU_METHOD CU_MPL_MAX_CPU_LOADED_C1 "Conversion method for mpl_max_cpu_loaded_c1" RAT_FUNC "%10.0" "%" COEFFS 0.000000 1.000000 -0.000000 0.000000 0.000000 1.000000 /end COMPU_METHOD
/* Scalar measurable for DDE 'mpl_mode'. */
/begin MEASUREMENT mpl_mode "Software execution mode" SBYTE CU_MPL_MODE 1 100 0.0 1.0 ECU_ADDRESS 0xf0240000 BYTE_ORDER MSB_LAST /end MEASUREMENT
/begin COMPU_METHOD CU_MPL_MODE "Conversion method for mpl_mode" TAB_VERB "%12.0" "mode" COMPU_TAB_REF CT_MPL_MODE /end COMPU_METHOD
/begin COMPU_VTAB CT_MPL_MODE "Conversion method for mpl_mode" TAB_VERB 4 0 "PIO_EXEC_MODE_UNKNOWN" 1 "PIO_EXEC_MODE_PRG" 2 "PIO_EXEC_MODE_APP" 3 "PIO_EXEC_MODE_LAST" /end COMPU_VTAB
/* Scalar measurable for DDE 'mpl_mode_run_time'. */
/begin MEASUREMENT mpl_mode_run_time "Time since startup" ULONG CU_MPL_MODE_RUN_TIME 1 100 0.0 4294967295.0 ECU_ADDRESS 0xf0240004 BYTE_ORDER MSB_LAST /end MEASUREMENT
/begin COMPU_METHOD CU_MPL_MODE_RUN_TIME "Conversion method for mpl_mode_run_time" RAT_FUNC "%10.0" "seconds" COEFFS 0.000000 1.000000 -0.000000 0.000000 0.000000 1.000000 /end COMPU_METHOD
/* Scalar measurable for DDE 'mpl_pax_task.stack.isr.status'. */
/begin MEASUREMENT mpl_pax_task.stack.isr.status "Current status of stack performance measurement for task: pax_task" SLONG CU_MPL_PAX_TASK.STACK.ISR.STAT0 1 100 0.0 255.0 ECU_ADDRESS 0x70017128 BYTE_ORDER MSB_LAST /end MEASUREMENT
/begin COMPU_METHOD CU_MPL_PAX_TASK.STACK.ISR.STAT0 "Conversion method for mpl_pax_task.stack.isr.status" TAB_VERB "%12.0" "(not defined)" COMPU_TAB_REF CT_MPL_PAX_TASK.STACK.ISR.STAT0 /end COMPU_METHOD
/begin COMPU_VTAB CT_MPL_PAX_TASK.STACK.ISR.STAT0 "Conversion method for mpl_pax_task.stack.isr.status" TAB_VERB 5 0 "PKN_TASK_STK_STAT_NR_IN_PROG" 1 "PKN_TASK_STACK_DATA_STATUS_VALID" 2 "PKN_TASK_STK_STAT_NR_GROW_SPEC" 3 "PKN_TASK_STK_STAT_NR_ALLOC_SPEC" 4 "PKN_TASK_STK_STAT_NR_INV_SPEC" /end COMPU_VTAB
/* Scalar measurable for DDE 'mpl_pax_task.stack.isr.used'. */
/begin MEASUREMENT mpl_pax_task.stack.isr.used "Used bytes of interrupt stack for task named: pax_task" ULONG CU_MPL_PAX_TASK.STACK.ISR.USED 1 100 0.0 4294967295.0 ECU_ADDRESS 0x70017124 BYTE_ORDER MSB_LAST /end MEASUREMENT
/begin COMPU_METHOD CU_MPL_PAX_TASK.STACK.ISR.USED "Conversion method for mpl_pax_task.stack.isr.used" RAT_FUNC "%10.0" "bytes" COEFFS 0.000000 1.000000 -0.000000 0.000000 0.000000 1.000000 /end COMPU_METHOD
/* Scalar measurable for DDE 'mpl_pax_task.stack.task.status'. */
/begin MEASUREMENT mpl_pax_task.stack.task.status "Current status of stack performance measurement for task: pax_task" SLONG CU_MPL_PAX_TASK.STACK.TASK.STA0 1 100 0.0 255.0 ECU_ADDRESS 0x70017138 BYTE_ORDER MSB_LAST /end MEASUREMENT
/begin COMPU_METHOD CU_MPL_PAX_TASK.STACK.TASK.STA0 "Conversion method for mpl_pax_task.stack.task.status" TAB_VERB "%12.0" "(not defined)" COMPU_TAB_REF CT_MPL_PAX_TASK.STACK.TASK.STA0 /end COMPU_METHOD
/begin COMPU_VTAB CT_MPL_PAX_TASK.STACK.TASK.STA0 "Conversion method for mpl_pax_task.stack.task.status" TAB_VERB 5 0 "PKN_TASK_STK_STAT_NR_IN_PROG" 1 "PKN_TASK_STACK_DATA_STATUS_VALID" 2 "PKN_TASK_STK_STAT_NR_GROW_SPEC" 3 "PKN_TASK_STK_STAT_NR_ALLOC_SPEC" 4 "PKN_TASK_STK_STAT_NR_INV_SPEC" /end COMPU_VTAB
/* Scalar measurable for DDE 'mpl_pax_task.stack.task.used'. */
/begin MEASUREMENT mpl_pax_task.stack.task.used "Used bytes of task stack for task named: pax_task" ULONG CU_MPL_PAX_TASK.STACK.TASK.USED 1 100 0.0 4294967295.0 ECU_ADDRESS 0x70017134 BYTE_ORDER MSB_LAST /end MEASUREMENT
/begin COMPU_METHOD CU_MPL_PAX_TASK.STACK.TASK.USED "Conversion method for mpl_pax_task.stack.task.used" RAT_FUNC "%10.0" "bytes" COEFFS 0.000000 1.000000 -0.000000 0.000000 0.000000 1.000000 /end COMPU_METHOD
/* Scalar measurable for DDE 'mpl_pax_task.timing.max_task_time'. */
/begin MEASUREMENT mpl_pax_task.timing.max_task_t0 "Maximum duration of task since reset: pax_task" ULONG CU_MPL_PAX_TASK.TIMING.MAX_TAS0 1 100 0.0 42949672.0 ECU_ADDRESS 0x7001cabc BYTE_ORDER MSB_LAST /end MEASUREMENT
/begin COMPU_METHOD CU_MPL_PAX_TASK.TIMING.MAX_TAS0 "Conversion method for mpl_pax_task.timing.max_task_time" RAT_FUNC "%10.0" "microseconds" COEFFS 0.000000 100.000000 -0.000000 0.000000 0.000000 1.000000 /end COMPU_METHOD
/* Scalar measurable for DDE 'mpl_pax_task.timing.overruns'. */
/begin MEASUREMENT mpl_pax_task.timing.overruns ": pax_task" UBYTE CU_MPL_PAX_TASK.TIMING.OVERRUNS 1 100 0.0 255.0 ECU_ADDRESS 0x70017118 BYTE_ORDER MSB_LAST /end MEASUREMENT
/begin COMPU_METHOD CU_MPL_PAX_TASK.TIMING.OVERRUNS "Conversion method for mpl_pax_task.timing.overruns" RAT_FUNC "%10.0" "count" COEFFS 0.000000 1.000000 -0.000000 0.000000 0.000000 1.000000 /end COMPU_METHOD
/* Scalar measurable for DDE 'mpl_pax_task.timing.runs'. */
/begin MEASUREMENT mpl_pax_task.timing.runs ": pax_task" ULONG CU_MPL_PAX_TASK.TIMING.RUNS 1 100 0.0 4294967295.0 ECU_ADDRESS 0x70017114 BYTE_ORDER MSB_LAST /end MEASUREMENT
/begin COMPU_METHOD CU_MPL_PAX_TASK.TIMING.RUNS "Conversion method for mpl_pax_task.timing.runs" RAT_FUNC "%10.0" "count" COEFFS 0.000000 1.000000 -0.000000 0.000000 0.000000 1.000000 /end COMPU_METHOD
/* Scalar measurable for DDE 'mpl_pax_task.timing.task_time'. */
/begin MEASUREMENT mpl_pax_task.timing.task_time "Duration of task: pax_task" ULONG CU_MPL_PAX_TASK.TIMING.TASK_TI0 1 100 0.0 42949672.0 ECU_ADDRESS 0x7001ca60 BYTE_ORDER MSB_LAST /end MEASUREMENT
/begin COMPU_METHOD CU_MPL_PAX_TASK.TIMING.TASK_TI0 "Conversion method for mpl_pax_task.timing.task_time" RAT_FUNC "%10.0" "microseconds" COEFFS 0.000000 100.000000 -0.000000 0.000000 0.000000 1.000000 /end COMPU_METHOD
/* Scalar measurable for DDE 'mpl_pcp_client.stack.isr.status'. */
/begin MEASUREMENT mpl_pcp_client.stack.isr.status "Current status of stack performance measurement for task: pcp_client" SLONG CU_MPL_PCP_CLIENT.STACK.ISR.ST0 1 100 0.0 255.0 ECU_ADDRESS 0x70016e58 BYTE_ORDER MSB_LAST /end MEASUREMENT
/begin COMPU_METHOD CU_MPL_PCP_CLIENT.STACK.ISR.ST0 "Conversion method for mpl_pcp_client.stack.isr.status" TAB_VERB "%12.0" "(not defined)" COMPU_TAB_REF CT_MPL_PCP_CLIENT.STACK.ISR.ST0 /end COMPU_METHOD
/begin COMPU_VTAB CT_MPL_PCP_CLIENT.STACK.ISR.ST0 "Conversion method for mpl_pcp_client.stack.isr.status" TAB_VERB 5 0 "PKN_TASK_STK_STAT_NR_IN_PROG" 1 "PKN_TASK_STACK_DATA_STATUS_VALID" 2 "PKN_TASK_STK_STAT_NR_GROW_SPEC" 3 "PKN_TASK_STK_STAT_NR_ALLOC_SPEC" 4 "PKN_TASK_STK_STAT_NR_INV_SPEC" /end COMPU_VTAB
/* Scalar measurable for DDE 'mpl_pcp_client.stack.isr.used'. */
/begin MEASUREMENT mpl_pcp_client.stack.isr.used "Used bytes of interrupt stack for task named: pcp_client" ULONG CU_MPL_PCP_CLIENT.STACK.ISR.US0 1 100 0.0 4294967295.0 ECU_ADDRESS 0x70016e54 BYTE_ORDER MSB_LAST /end MEASUREMENT
/begin COMPU_METHOD CU_MPL_PCP_CLIENT.STACK.ISR.US0 "Conversion method for mpl_pcp_client.stack.isr.used" RAT_FUNC "%10.0" "bytes" COEFFS 0.000000 1.000000 -0.000000 0.000000 0.000000 1.000000 /end COMPU_METHOD
/* Scalar measurable for DDE 'mpl_pcp_client.stack.task.status'. */
/begin MEASUREMENT mpl_pcp_client.stack.task.stat0 "Current status of stack performance measurement for task: pcp_client" SLONG CU_MPL_PCP_CLIENT.STACK.TASK.S0 1 100 0.0 255.0 ECU_ADDRESS 0x70016e68 BYTE_ORDER MSB_LAST /end MEASUREMENT
/begin COMPU_METHOD CU_MPL_PCP_CLIENT.STACK.TASK.S0 "Conversion method for mpl_pcp_client.stack.task.status" TAB_VERB "%12.0" "(not defined)" COMPU_TAB_REF CT_MPL_PCP_CLIENT.STACK.TASK.S0 /end COMPU_METHOD
/begin COMPU_VTAB CT_MPL_PCP_CLIENT.STACK.TASK.S0 "Conversion method for mpl_pcp_client.stack.task.status" TAB_VERB 5 0 "PKN_TASK_STK_STAT_NR_IN_PROG" 1 "PKN_TASK_STACK_DATA_STATUS_VALID" 2 "PKN_TASK_STK_STAT_NR_GROW_SPEC" 3 "PKN_TASK_STK_STAT_NR_ALLOC_SPEC" 4 "PKN_TASK_STK_STAT_NR_INV_SPEC" /end COMPU_VTAB
/* Scalar measurable for DDE 'mpl_pcp_client.stack.task.used'. */
/begin MEASUREMENT mpl_pcp_client.stack.task.used "Used bytes of task stack for task named: pcp_client" ULONG CU_MPL_PCP_CLIENT.STACK.TASK.U0 1 100 0.0 4294967295.0 ECU_ADDRESS 0x70016e64 BYTE_ORDER MSB_LAST /end MEASUREMENT
/begin COMPU_METHOD CU_MPL_PCP_CLIENT.STACK.TASK.U0 "Conversion method for mpl_pcp_client.stack.task.used" RAT_FUNC "%10.0" "bytes" COEFFS 0.000000 1.000000 -0.000000 0.000000 0.000000 1.000000 /end COMPU_METHOD
/* Scalar measurable for DDE 'mpl_pcp_client.timing.max_task_time'. */
/begin MEASUREMENT mpl_pcp_client.timing.max_task0 "Maximum duration of task since reset: pcp_client" ULONG CU_MPL_PCP_CLIENT.TIMING.MAX_T0 1 100 0.0 42949672.0 ECU_ADDRESS 0x7001cae4 BYTE_ORDER MSB_LAST /end MEASUREMENT
/begin COMPU_METHOD CU_MPL_PCP_CLIENT.TIMING.MAX_T0 "Conversion method for mpl_pcp_client.timing.max_task_time" RAT_FUNC "%10.0" "microseconds" COEFFS 0.000000 100.000000 -0.000000 0.000000 0.000000 1.000000 /end COMPU_METHOD
/* Scalar measurable for DDE 'mpl_pcp_client.timing.overruns'. */
/begin MEASUREMENT mpl_pcp_client.timing.overruns ": pcp_client" UBYTE CU_MPL_PCP_CLIENT.TIMING.OVERR0 1 100 0.0 255.0 ECU_ADDRESS 0x70016e48 BYTE_ORDER MSB_LAST /end MEASUREMENT
/begin COMPU_METHOD CU_MPL_PCP_CLIENT.TIMING.OVERR0 "Conversion method for mpl_pcp_client.timing.overruns" RAT_FUNC "%10.0" "count" COEFFS 0.000000 1.000000 -0.000000 0.000000 0.000000 1.000000 /end COMPU_METHOD
/* Scalar measurable for DDE 'mpl_pcp_client.timing.runs'. */
/begin MEASUREMENT mpl_pcp_client.timing.runs ": pcp_client" ULONG CU_MPL_PCP_CLIENT.TIMING.RUNS 1 100 0.0 4294967295.0 ECU_ADDRESS 0x70016e44 BYTE_ORDER MSB_LAST /end MEASUREMENT
/begin COMPU_METHOD CU_MPL_PCP_CLIENT.TIMING.RUNS "Conversion method for mpl_pcp_client.timing.runs" RAT_FUNC "%10.0" "count" COEFFS 0.000000 1.000000 -0.000000 0.000000 0.000000 1.000000 /end COMPU_METHOD
/* Scalar measurable for DDE 'mpl_pcp_client.timing.task_time'. */
/begin MEASUREMENT mpl_pcp_client.timing.task_time "Duration of task: pcp_client" ULONG CU_MPL_PCP_CLIENT.TIMING.TASK_0 1 100 0.0 42949672.0 ECU_ADDRESS 0x7001ca88 BYTE_ORDER MSB_LAST /end MEASUREMENT
/begin COMPU_METHOD CU_MPL_PCP_CLIENT.TIMING.TASK_0 "Conversion method for mpl_pcp_client.timing.task_time" RAT_FUNC "%10.0" "microseconds" COEFFS 0.000000 100.000000 -0.000000 0.000000 0.000000 1.000000 /end COMPU_METHOD
/* Scalar measurable for DDE 'mpl_pcx_can_callback.stack.isr.status'. */
/begin MEASUREMENT mpl_pcx_can_callback.stack.isr0 "Current status of stack performance measurement for task: pcx_can_callback" SLONG CU_MPL_PCX_CAN_CALLBACK.STACK.0 1 100 0.0 255.0 ECU_ADDRESS 0x70017200 BYTE_ORDER MSB_LAST /end MEASUREMENT
/begin COMPU_METHOD CU_MPL_PCX_CAN_CALLBACK.STACK.0 "Conversion method for mpl_pcx_can_callback.stack.isr.status" TAB_VERB "%12.0" "(not defined)" COMPU_TAB_REF CT_MPL_PCX_CAN_CALLBACK.STACK.0 /end COMPU_METHOD
/begin COMPU_VTAB CT_MPL_PCX_CAN_CALLBACK.STACK.0 "Conversion method for mpl_pcx_can_callback.stack.isr.status" TAB_VERB 5 0 "PKN_TASK_STK_STAT_NR_IN_PROG" 1 "PKN_TASK_STACK_DATA_STATUS_VALID" 2 "PKN_TASK_STK_STAT_NR_GROW_SPEC" 3 "PKN_TASK_STK_STAT_NR_ALLOC_SPEC" 4 "PKN_TASK_STK_STAT_NR_INV_SPEC" /end COMPU_VTAB
/* Scalar measurable for DDE 'mpl_pcx_can_callback.stack.isr.used'. */
/begin MEASUREMENT mpl_pcx_can_callback.stack.isr1 "Used bytes of interrupt stack for task named: pcx_can_callback" ULONG CU_MPL_PCX_CAN_CALLBACK.STACK.1 1 100 0.0 4294967295.0 ECU_ADDRESS 0x700171fc BYTE_ORDER MSB_LAST /end MEASUREMENT
/begin COMPU_METHOD CU_MPL_PCX_CAN_CALLBACK.STACK.1 "Conversion method for mpl_pcx_can_callback.stack.isr.used" RAT_FUNC "%10.0" "bytes" COEFFS 0.000000 1.000000 -0.000000 0.000000 0.000000 1.000000 /end COMPU_METHOD
/* Scalar measurable for DDE 'mpl_pcx_can_callback.stack.task.status'. */
/begin MEASUREMENT mpl_pcx_can_callback.stack.tas0 "Current status of stack performance measurement for task: pcx_can_callback" SLONG CU_MPL_PCX_CAN_CALLBACK.STACK.2 1 100 0.0 255.0 ECU_ADDRESS 0x70017210 BYTE_ORDER MSB_LAST /end MEASUREMENT
/begin COMPU_METHOD CU_MPL_PCX_CAN_CALLBACK.STACK.2 "Conversion method for mpl_pcx_can_callback.stack.task.status" TAB_VERB "%12.0" "(not defined)" COMPU_TAB_REF CT_MPL_PCX_CAN_CALLBACK.STACK.2 /end COMPU_METHOD
/begin COMPU_VTAB CT_MPL_PCX_CAN_CALLBACK.STACK.2 "Conversion method for mpl_pcx_can_callback.stack.task.status" TAB_VERB 5 0 "PKN_TASK_STK_STAT_NR_IN_PROG" 1 "PKN_TASK_STACK_DATA_STATUS_VALID" 2 "PKN_TASK_STK_STAT_NR_GROW_SPEC" 3 "PKN_TASK_STK_STAT_NR_ALLOC_SPEC" 4 "PKN_TASK_STK_STAT_NR_INV_SPEC" /end COMPU_VTAB
/* Scalar measurable for DDE 'mpl_pcx_can_callback.stack.task.used'. */
/begin MEASUREMENT mpl_pcx_can_callback.stack.tas1 "Used bytes of task stack for task named: pcx_can_callback" ULONG CU_MPL_PCX_CAN_CALLBACK.STACK.3 1 100 0.0 4294967295.0 ECU_ADDRESS 0x7001720c BYTE_ORDER MSB_LAST /end MEASUREMENT
/begin COMPU_METHOD CU_MPL_PCX_CAN_CALLBACK.STACK.3 "Conversion method for mpl_pcx_can_callback.stack.task.used" RAT_FUNC "%10.0" "bytes" COEFFS 0.000000 1.000000 -0.000000 0.000000 0.000000 1.000000 /end COMPU_METHOD
/* Scalar measurable for DDE 'mpl_pcx_can_callback.timing.max_task_time'. */
/begin MEASUREMENT mpl_pcx_can_callback.timing.ma0 "Maximum duration of task since reset: pcx_can_callback" ULONG CU_MPL_PCX_CAN_CALLBACK.TIMING2 1 100 0.0 42949672.0 ECU_ADDRESS 0x7001cab0 BYTE_ORDER MSB_LAST /end MEASUREMENT
/begin COMPU_METHOD CU_MPL_PCX_CAN_CALLBACK.TIMING2 "Conversion method for mpl_pcx_can_callback.timing.max_task_time" RAT_FUNC "%10.0" "microseconds" COEFFS 0.000000 100.000000 -0.000000 0.000000 0.000000 1.000000 /end COMPU_METHOD
/* Scalar measurable for DDE 'mpl_pcx_can_callback.timing.overruns'. */
/begin MEASUREMENT mpl_pcx_can_callback.timing.ov0 ": pcx_can_callback" UBYTE CU_MPL_PCX_CAN_CALLBACK.TIMING0 1 100 0.0 255.0 ECU_ADDRESS 0x700171f0 BYTE_ORDER MSB_LAST /end MEASUREMENT
/begin COMPU_METHOD CU_MPL_PCX_CAN_CALLBACK.TIMING0 "Conversion method for mpl_pcx_can_callback.timing.overruns" RAT_FUNC "%10.0" "count" COEFFS 0.000000 1.000000 -0.000000 0.000000 0.000000 1.000000 /end COMPU_METHOD
/* Scalar measurable for DDE 'mpl_pcx_can_callback.timing.runs'. */
/begin MEASUREMENT mpl_pcx_can_callback.timing.ru0 ": pcx_can_callback" ULONG CU_MPL_PCX_CAN_CALLBACK.TIMING1 1 100 0.0 4294967295.0 ECU_ADDRESS 0x700171ec BYTE_ORDER MSB_LAST /end MEASUREMENT
/begin COMPU_METHOD CU_MPL_PCX_CAN_CALLBACK.TIMING1 "Conversion method for mpl_pcx_can_callback.timing.runs" RAT_FUNC "%10.0" "count" COEFFS 0.000000 1.000000 -0.000000 0.000000 0.000000 1.000000 /end COMPU_METHOD
/* Scalar measurable for DDE 'mpl_pcx_can_callback.timing.task_time'. */
/begin MEASUREMENT mpl_pcx_can_callback.timing.ta0 "Duration of task: pcx_can_callback" ULONG CU_MPL_PCX_CAN_CALLBACK.TIMING3 1 100 0.0 42949672.0 ECU_ADDRESS 0x7001ca54 BYTE_ORDER MSB_LAST /end MEASUREMENT
/begin COMPU_METHOD CU_MPL_PCX_CAN_CALLBACK.TIMING3 "Conversion method for mpl_pcx_can_callback.timing.task_time" RAT_FUNC "%10.0" "microseconds" COEFFS 0.000000 100.000000 -0.000000 0.000000 0.000000 1.000000 /end COMPU_METHOD
/* Scalar measurable for DDE 'mpl_pcx_gw_qemptier.stack.isr.status'. */
/begin MEASUREMENT mpl_pcx_gw_qemptier.stack.isr.0 "Current status of stack performance measurement for task: pcx_gw_qemptier" SLONG CU_MPL_PCX_GW_QEMPTIER.STACK.I0 1 100 0.0 255.0 ECU_ADDRESS 0x70017248 BYTE_ORDER MSB_LAST /end MEASUREMENT
/begin COMPU_METHOD CU_MPL_PCX_GW_QEMPTIER.STACK.I0 "Conversion method for mpl_pcx_gw_qemptier.stack.isr.status" TAB_VERB "%12.0" "(not defined)" COMPU_TAB_REF CT_MPL_PCX_GW_QEMPTIER.STACK.I0 /end COMPU_METHOD
/begin COMPU_VTAB CT_MPL_PCX_GW_QEMPTIER.STACK.I0 "Conversion method for mpl_pcx_gw_qemptier.stack.isr.status" TAB_VERB 5 0 "PKN_TASK_STK_STAT_NR_IN_PROG" 1 "PKN_TASK_STACK_DATA_STATUS_VALID" 2 "PKN_TASK_STK_STAT_NR_GROW_SPEC" 3 "PKN_TASK_STK_STAT_NR_ALLOC_SPEC" 4 "PKN_TASK_STK_STAT_NR_INV_SPEC" /end COMPU_VTAB
/* Scalar measurable for DDE 'mpl_pcx_gw_qemptier.stack.isr.used'. */
/begin MEASUREMENT mpl_pcx_gw_qemptier.stack.isr.1 "Used bytes of interrupt stack for task named: pcx_gw_qemptier" ULONG CU_MPL_PCX_GW_QEMPTIER.STACK.I1 1 100 0.0 4294967295.0 ECU_ADDRESS 0x70017244 BYTE_ORDER MSB_LAST /end MEASUREMENT
/begin COMPU_METHOD CU_MPL_PCX_GW_QEMPTIER.STACK.I1 "Conversion method for mpl_pcx_gw_qemptier.stack.isr.used" RAT_FUNC "%10.0" "bytes" COEFFS 0.000000 1.000000 -0.000000 0.000000 0.000000 1.000000 /end COMPU_METHOD
/* Scalar measurable for DDE 'mpl_pcx_gw_qemptier.stack.task.status'. */
/begin MEASUREMENT mpl_pcx_gw_qemptier.stack.task1 "Current status of stack performance measurement for task: pcx_gw_qemptier" SLONG CU_MPL_PCX_GW_QEMPTIER.STACK.T1 1 100 0.0 255.0 ECU_ADDRESS 0x70017258 BYTE_ORDER MSB_LAST /end MEASUREMENT
/begin COMPU_METHOD CU_MPL_PCX_GW_QEMPTIER.STACK.T1 "Conversion method for mpl_pcx_gw_qemptier.stack.task.status" TAB_VERB "%12.0" "(not defined)" COMPU_TAB_REF CT_MPL_PCX_GW_QEMPTIER.STACK.T1 /end COMPU_METHOD
/begin COMPU_VTAB CT_MPL_PCX_GW_QEMPTIER.STACK.T1 "Conversion method for mpl_pcx_gw_qemptier.stack.task.status" TAB_VERB 5 0 "PKN_TASK_STK_STAT_NR_IN_PROG" 1 "PKN_TASK_STACK_DATA_STATUS_VALID" 2 "PKN_TASK_STK_STAT_NR_GROW_SPEC" 3 "PKN_TASK_STK_STAT_NR_ALLOC_SPEC" 4 "PKN_TASK_STK_STAT_NR_INV_SPEC" /end COMPU_VTAB
/* Scalar measurable for DDE 'mpl_pcx_gw_qemptier.stack.task.used'. */
/begin MEASUREMENT mpl_pcx_gw_qemptier.stack.task0 "Used bytes of task stack for task named: pcx_gw_qemptier" ULONG CU_MPL_PCX_GW_QEMPTIER.STACK.T0 1 100 0.0 4294967295.0 ECU_ADDRESS 0x70017254 BYTE_ORDER MSB_LAST /end MEASUREMENT
/begin COMPU_METHOD CU_MPL_PCX_GW_QEMPTIER.STACK.T0 "Conversion method for mpl_pcx_gw_qemptier.stack.task.used" RAT_FUNC "%10.0" "bytes" COEFFS 0.000000 1.000000 -0.000000 0.000000 0.000000 1.000000 /end COMPU_METHOD
/* Scalar measurable for DDE 'mpl_pcx_gw_qemptier.timing.max_task_time'. */
/begin MEASUREMENT mpl_pcx_gw_qemptier.timing.max0 "Maximum duration of task since reset: pcx_gw_qemptier" ULONG CU_MPL_PCX_GW_QEMPTIER.TIMING.0 1 100 0.0 42949672.0 ECU_ADDRESS 0x7001caac BYTE_ORDER MSB_LAST /end MEASUREMENT
/begin COMPU_METHOD CU_MPL_PCX_GW_QEMPTIER.TIMING.0 "Conversion method for mpl_pcx_gw_qemptier.timing.max_task_time" RAT_FUNC "%10.0" "microseconds" COEFFS 0.000000 100.000000 -0.000000 0.000000 0.000000 1.000000 /end COMPU_METHOD
/* Scalar measurable for DDE 'mpl_pcx_gw_qemptier.timing.overruns'. */
/begin MEASUREMENT mpl_pcx_gw_qemptier.timing.ove0 ": pcx_gw_qemptier" UBYTE CU_MPL_PCX_GW_QEMPTIER.TIMING.1 1 100 0.0 255.0 ECU_ADDRESS 0x70017238 BYTE_ORDER MSB_LAST /end MEASUREMENT
/begin COMPU_METHOD CU_MPL_PCX_GW_QEMPTIER.TIMING.1 "Conversion method for mpl_pcx_gw_qemptier.timing.overruns" RAT_FUNC "%10.0" "count" COEFFS 0.000000 1.000000 -0.000000 0.000000 0.000000 1.000000 /end COMPU_METHOD
/* Scalar measurable for DDE 'mpl_pcx_gw_qemptier.timing.runs'. */
/begin MEASUREMENT mpl_pcx_gw_qemptier.timing.runs ": pcx_gw_qemptier" ULONG CU_MPL_PCX_GW_QEMPTIER.TIMING.3 1 100 0.0 4294967295.0 ECU_ADDRESS 0x70017234 BYTE_ORDER MSB_LAST /end MEASUREMENT
/begin COMPU_METHOD CU_MPL_PCX_GW_QEMPTIER.TIMING.3 "Conversion method for mpl_pcx_gw_qemptier.timing.runs" RAT_FUNC "%10.0" "count" COEFFS 0.000000 1.000000 -0.000000 0.000000 0.000000 1.000000 /end COMPU_METHOD
/* Scalar measurable for DDE 'mpl_pcx_gw_qemptier.timing.task_time'. */
/begin MEASUREMENT mpl_pcx_gw_qemptier.timing.tas0 "Duration of task: pcx_gw_qemptier" ULONG CU_MPL_PCX_GW_QEMPTIER.TIMING.2 1 100 0.0 42949672.0 ECU_ADDRESS 0x7001ca50 BYTE_ORDER MSB_LAST /end MEASUREMENT
/begin COMPU_METHOD CU_MPL_PCX_GW_QEMPTIER.TIMING.2 "Conversion method for mpl_pcx_gw_qemptier.timing.task_time" RAT_FUNC "%10.0" "microseconds" COEFFS 0.000000 100.000000 -0.000000 0.000000 0.000000 1.000000 /end COMPU_METHOD
/* Scalar measurable for DDE 'mpl_pcx_periodic.stack.isr.status'. */
/begin MEASUREMENT mpl_pcx_periodic.stack.isr.sta0 "Current status of stack performance measurement for task: pcx_periodic" SLONG CU_MPL_PCX_PERIODIC.STACK.ISR.1 1 100 0.0 255.0 ECU_ADDRESS 0x70016f78 BYTE_ORDER MSB_LAST /end MEASUREMENT
/begin COMPU_METHOD CU_MPL_PCX_PERIODIC.STACK.ISR.1 "Conversion method for mpl_pcx_periodic.stack.isr.status" TAB_VERB "%12.0" "(not defined)" COMPU_TAB_REF CT_MPL_PCX_PERIODIC.STACK.ISR.1 /end COMPU_METHOD
/begin COMPU_VTAB CT_MPL_PCX_PERIODIC.STACK.ISR.1 "Conversion method for mpl_pcx_periodic.stack.isr.status" TAB_VERB 5 0 "PKN_TASK_STK_STAT_NR_IN_PROG" 1 "PKN_TASK_STACK_DATA_STATUS_VALID" 2 "PKN_TASK_STK_STAT_NR_GROW_SPEC" 3 "PKN_TASK_STK_STAT_NR_ALLOC_SPEC" 4 "PKN_TASK_STK_STAT_NR_INV_SPEC" /end COMPU_VTAB
/* Scalar measurable for DDE 'mpl_pcx_periodic.stack.isr.used'. */
/begin MEASUREMENT mpl_pcx_periodic.stack.isr.used "Used bytes of interrupt stack for task named: pcx_periodic" ULONG CU_MPL_PCX_PERIODIC.STACK.ISR.0 1 100 0.0 4294967295.0 ECU_ADDRESS 0x70016f74 BYTE_ORDER MSB_LAST /end MEASUREMENT
/begin COMPU_METHOD CU_MPL_PCX_PERIODIC.STACK.ISR.0 "Conversion method for mpl_pcx_periodic.stack.isr.used" RAT_FUNC "%10.0" "bytes" COEFFS 0.000000 1.000000 -0.000000 0.000000 0.000000 1.000000 /end COMPU_METHOD
/* Scalar measurable for DDE 'mpl_pcx_periodic.stack.task.status'. */
/begin MEASUREMENT mpl_pcx_periodic.stack.task.st0 "Current status of stack performance measurement for task: pcx_periodic" SLONG CU_MPL_PCX_PERIODIC.STACK.TASK1 1 100 0.0 255.0 ECU_ADDRESS 0x70016f88 BYTE_ORDER MSB_LAST /end MEASUREMENT
/begin COMPU_METHOD CU_MPL_PCX_PERIODIC.STACK.TASK1 "Conversion method for mpl_pcx_periodic.stack.task.status" TAB_VERB "%12.0" "(not defined)" COMPU_TAB_REF CT_MPL_PCX_PERIODIC.STACK.TASK1 /end COMPU_METHOD
/begin COMPU_VTAB CT_MPL_PCX_PERIODIC.STACK.TASK1 "Conversion method for mpl_pcx_periodic.stack.task.status" TAB_VERB 5 0 "PKN_TASK_STK_STAT_NR_IN_PROG" 1 "PKN_TASK_STACK_DATA_STATUS_VALID" 2 "PKN_TASK_STK_STAT_NR_GROW_SPEC" 3 "PKN_TASK_STK_STAT_NR_ALLOC_SPEC" 4 "PKN_TASK_STK_STAT_NR_INV_SPEC" /end COMPU_VTAB
/* Scalar measurable for DDE 'mpl_pcx_periodic.stack.task.used'. */
/begin MEASUREMENT mpl_pcx_periodic.stack.task.us0 "Used bytes of task stack for task named: pcx_periodic" ULONG CU_MPL_PCX_PERIODIC.STACK.TASK0 1 100 0.0 4294967295.0 ECU_ADDRESS 0x70016f84 BYTE_ORDER MSB_LAST /end MEASUREMENT
/begin COMPU_METHOD CU_MPL_PCX_PERIODIC.STACK.TASK0 "Conversion method for mpl_pcx_periodic.stack.task.used" RAT_FUNC "%10.0" "bytes" COEFFS 0.000000 1.000000 -0.000000 0.000000 0.000000 1.000000 /end COMPU_METHOD
/* Scalar measurable for DDE 'mpl_pcx_periodic.timing.max_task_time'. */
/begin MEASUREMENT mpl_pcx_periodic.timing.max_ta0 "Maximum duration of task since reset: pcx_periodic" ULONG CU_MPL_PCX_PERIODIC.TIMING.MAX0 1 100 0.0 42949672.0 ECU_ADDRESS 0x7001cad4 BYTE_ORDER MSB_LAST /end MEASUREMENT
/begin COMPU_METHOD CU_MPL_PCX_PERIODIC.TIMING.MAX0 "Conversion method for mpl_pcx_periodic.timing.max_task_time" RAT_FUNC "%10.0" "microseconds" COEFFS 0.000000 100.000000 -0.000000 0.000000 0.000000 1.000000 /end COMPU_METHOD
/* Scalar measurable for DDE 'mpl_pcx_periodic.timing.overruns'. */
/begin MEASUREMENT mpl_pcx_periodic.timing.overru0 ": pcx_periodic" UBYTE CU_MPL_PCX_PERIODIC.TIMING.OVE0 1 100 0.0 255.0 ECU_ADDRESS 0x70016f68 BYTE_ORDER MSB_LAST /end MEASUREMENT
/begin COMPU_METHOD CU_MPL_PCX_PERIODIC.TIMING.OVE0 "Conversion method for mpl_pcx_periodic.timing.overruns" RAT_FUNC "%10.0" "count" COEFFS 0.000000 1.000000 -0.000000 0.000000 0.000000 1.000000 /end COMPU_METHOD
/* Scalar measurable for DDE 'mpl_pcx_periodic.timing.runs'. */
/begin MEASUREMENT mpl_pcx_periodic.timing.runs ": pcx_periodic" ULONG CU_MPL_PCX_PERIODIC.TIMING.RUNS 1 100 0.0 4294967295.0 ECU_ADDRESS 0x70016f64 BYTE_ORDER MSB_LAST /end MEASUREMENT
/begin COMPU_METHOD CU_MPL_PCX_PERIODIC.TIMING.RUNS "Conversion method for mpl_pcx_periodic.timing.runs" RAT_FUNC "%10.0" "count" COEFFS 0.000000 1.000000 -0.000000 0.000000 0.000000 1.000000 /end COMPU_METHOD
/* Scalar measurable for DDE 'mpl_pcx_periodic.timing.task_time'. */
/begin MEASUREMENT mpl_pcx_periodic.timing.task_t0 "Duration of task: pcx_periodic" ULONG CU_MPL_PCX_PERIODIC.TIMING.TAS0 1 100 0.0 42949672.0 ECU_ADDRESS 0x7001ca78 BYTE_ORDER MSB_LAST /end MEASUREMENT
/begin COMPU_METHOD CU_MPL_PCX_PERIODIC.TIMING.TAS0 "Conversion method for mpl_pcx_periodic.timing.task_time" RAT_FUNC "%10.0" "microseconds" COEFFS 0.000000 100.000000 -0.000000 0.000000 0.000000 1.000000 /end COMPU_METHOD
/* Scalar measurable for DDE 'mpl_pcx_qemptier.stack.isr.status'. */
/begin MEASUREMENT mpl_pcx_qemptier.stack.isr.sta0 "Current status of stack performance measurement for task: pcx_qemptier" SLONG CU_MPL_PCX_QEMPTIER.STACK.ISR.0 1 100 0.0 255.0 ECU_ADDRESS 0x70017098 BYTE_ORDER MSB_LAST /end MEASUREMENT
/begin COMPU_METHOD CU_MPL_PCX_QEMPTIER.STACK.ISR.0 "Conversion method for mpl_pcx_qemptier.stack.isr.status" TAB_VERB "%12.0" "(not defined)" COMPU_TAB_REF CT_MPL_PCX_QEMPTIER.STACK.ISR.0 /end COMPU_METHOD
/begin COMPU_VTAB CT_MPL_PCX_QEMPTIER.STACK.ISR.0 "Conversion method for mpl_pcx_qemptier.stack.isr.status" TAB_VERB 5 0 "PKN_TASK_STK_STAT_NR_IN_PROG" 1 "PKN_TASK_STACK_DATA_STATUS_VALID" 2 "PKN_TASK_STK_STAT_NR_GROW_SPEC" 3 "PKN_TASK_STK_STAT_NR_ALLOC_SPEC" 4 "PKN_TASK_STK_STAT_NR_INV_SPEC" /end COMPU_VTAB
/* Scalar measurable for DDE 'mpl_pcx_qemptier.stack.isr.used'. */
/begin MEASUREMENT mpl_pcx_qemptier.stack.isr.used "Used bytes of interrupt stack for task named: pcx_qemptier" ULONG CU_MPL_PCX_QEMPTIER.STACK.ISR.1 1 100 0.0 4294967295.0 ECU_ADDRESS 0x70017094 BYTE_ORDER MSB_LAST /end MEASUREMENT
/begin COMPU_METHOD CU_MPL_PCX_QEMPTIER.STACK.ISR.1 "Conversion method for mpl_pcx_qemptier.stack.isr.used" RAT_FUNC "%10.0" "bytes" COEFFS 0.000000 1.000000 -0.000000 0.000000 0.000000 1.000000 /end COMPU_METHOD
/* Scalar measurable for DDE 'mpl_pcx_qemptier.stack.task.status'. */
/begin MEASUREMENT mpl_pcx_qemptier.stack.task.st0 "Current status of stack performance measurement for task: pcx_qemptier" SLONG CU_MPL_PCX_QEMPTIER.STACK.TASK0 1 100 0.0 255.0 ECU_ADDRESS 0x700170a8 BYTE_ORDER MSB_LAST /end MEASUREMENT
/begin COMPU_METHOD CU_MPL_PCX_QEMPTIER.STACK.TASK0 "Conversion method for mpl_pcx_qemptier.stack.task.status" TAB_VERB "%12.0" "(not defined)" COMPU_TAB_REF CT_MPL_PCX_QEMPTIER.STACK.TASK0 /end COMPU_METHOD
/begin COMPU_VTAB CT_MPL_PCX_QEMPTIER.STACK.TASK0 "Conversion method for mpl_pcx_qemptier.stack.task.status" TAB_VERB 5 0 "PKN_TASK_STK_STAT_NR_IN_PROG" 1 "PKN_TASK_STACK_DATA_STATUS_VALID" 2 "PKN_TASK_STK_STAT_NR_GROW_SPEC" 3 "PKN_TASK_STK_STAT_NR_ALLOC_SPEC" 4 "PKN_TASK_STK_STAT_NR_INV_SPEC" /end COMPU_VTAB
/* Scalar measurable for DDE 'mpl_pcx_qemptier.stack.task.used'. */
/begin MEASUREMENT mpl_pcx_qemptier.stack.task.us0 "Used bytes of task stack for task named: pcx_qemptier" ULONG CU_MPL_PCX_QEMPTIER.STACK.TASK1 1 100 0.0 4294967295.0 ECU_ADDRESS 0x700170a4 BYTE_ORDER MSB_LAST /end MEASUREMENT
/begin COMPU_METHOD CU_MPL_PCX_QEMPTIER.STACK.TASK1 "Conversion method for mpl_pcx_qemptier.stack.task.used" RAT_FUNC "%10.0" "bytes" COEFFS 0.000000 1.000000 -0.000000 0.000000 0.000000 1.000000 /end COMPU_METHOD
/* Scalar measurable for DDE 'mpl_pcx_qemptier.timing.max_task_time'. */
/begin MEASUREMENT mpl_pcx_qemptier.timing.max_ta0 "Maximum duration of task since reset: pcx_qemptier" ULONG CU_MPL_PCX_QEMPTIER.TIMING.MAX0 1 100 0.0 42949672.0 ECU_ADDRESS 0x7001cac4 BYTE_ORDER MSB_LAST /end MEASUREMENT
/begin COMPU_METHOD CU_MPL_PCX_QEMPTIER.TIMING.MAX0 "Conversion method for mpl_pcx_qemptier.timing.max_task_time" RAT_FUNC "%10.0" "microseconds" COEFFS 0.000000 100.000000 -0.000000 0.000000 0.000000 1.000000 /end COMPU_METHOD
/* Scalar measurable for DDE 'mpl_pcx_qemptier.timing.overruns'. */
/begin MEASUREMENT mpl_pcx_qemptier.timing.overru0 ": pcx_qemptier" UBYTE CU_MPL_PCX_QEMPTIER.TIMING.OVE0 1 100 0.0 255.0 ECU_ADDRESS 0x70017088 BYTE_ORDER MSB_LAST /end MEASUREMENT
/begin COMPU_METHOD CU_MPL_PCX_QEMPTIER.TIMING.OVE0 "Conversion method for mpl_pcx_qemptier.timing.overruns" RAT_FUNC "%10.0" "count" COEFFS 0.000000 1.000000 -0.000000 0.000000 0.000000 1.000000 /end COMPU_METHOD
/* Scalar measurable for DDE 'mpl_pcx_qemptier.timing.runs'. */
/begin MEASUREMENT mpl_pcx_qemptier.timing.runs ": pcx_qemptier" ULONG CU_MPL_PCX_QEMPTIER.TIMING.RUNS 1 100 0.0 4294967295.0 ECU_ADDRESS 0x70017084 BYTE_ORDER MSB_LAST /end MEASUREMENT
/begin COMPU_METHOD CU_MPL_PCX_QEMPTIER.TIMING.RUNS "Conversion method for mpl_pcx_qemptier.timing.runs" RAT_FUNC "%10.0" "count" COEFFS 0.000000 1.000000 -0.000000 0.000000 0.000000 1.000000 /end COMPU_METHOD
/* Scalar measurable for DDE 'mpl_pcx_qemptier.timing.task_time'. */
/begin MEASUREMENT mpl_pcx_qemptier.timing.task_t0 "Duration of task: pcx_qemptier" ULONG CU_MPL_PCX_QEMPTIER.TIMING.TAS0 1 100 0.0 42949672.0 ECU_ADDRESS 0x7001ca68 BYTE_ORDER MSB_LAST /end MEASUREMENT
/begin COMPU_METHOD CU_MPL_PCX_QEMPTIER.TIMING.TAS0 "Conversion method for mpl_pcx_qemptier.timing.task_time" RAT_FUNC "%10.0" "microseconds" COEFFS 0.000000 100.000000 -0.000000 0.000000 0.000000 1.000000 /end COMPU_METHOD
/* Scalar measurable for DDE 'mpl_pdg_client.stack.isr.status'. */
/begin MEASUREMENT mpl_pdg_client.stack.isr.status "Current status of stack performance measurement for task: pdg_client" SLONG CU_MPL_PDG_CLIENT.STACK.ISR.ST0 1 100 0.0 255.0 ECU_ADDRESS 0x70016fc0 BYTE_ORDER MSB_LAST /end MEASUREMENT
/begin COMPU_METHOD CU_MPL_PDG_CLIENT.STACK.ISR.ST0 "Conversion method for mpl_pdg_client.stack.isr.status" TAB_VERB "%12.0" "(not defined)" COMPU_TAB_REF CT_MPL_PDG_CLIENT.STACK.ISR.ST0 /end COMPU_METHOD
/begin COMPU_VTAB CT_MPL_PDG_CLIENT.STACK.ISR.ST0 "Conversion method for mpl_pdg_client.stack.isr.status" TAB_VERB 5 0 "PKN_TASK_STK_STAT_NR_IN_PROG" 1 "PKN_TASK_STACK_DATA_STATUS_VALID" 2 "PKN_TASK_STK_STAT_NR_GROW_SPEC" 3 "PKN_TASK_STK_STAT_NR_ALLOC_SPEC" 4 "PKN_TASK_STK_STAT_NR_INV_SPEC" /end COMPU_VTAB
/* Scalar measurable for DDE 'mpl_pdg_client.stack.isr.used'. */
/begin MEASUREMENT mpl_pdg_client.stack.isr.used "Used bytes of interrupt stack for task named: pdg_client" ULONG CU_MPL_PDG_CLIENT.STACK.ISR.US0 1 100 0.0 4294967295.0 ECU_ADDRESS 0x70016fbc BYTE_ORDER MSB_LAST /end MEASUREMENT
/begin COMPU_METHOD CU_MPL_PDG_CLIENT.STACK.ISR.US0 "Conversion method for mpl_pdg_client.stack.isr.used" RAT_FUNC "%10.0" "bytes" COEFFS 0.000000 1.000000 -0.000000 0.000000 0.000000 1.000000 /end COMPU_METHOD
/* Scalar measurable for DDE 'mpl_pdg_client.stack.task.status'. */
/begin MEASUREMENT mpl_pdg_client.stack.task.stat0 "Current status of stack performance measurement for task: pdg_client" SLONG CU_MPL_PDG_CLIENT.STACK.TASK.S0 1 100 0.0 255.0 ECU_ADDRESS 0x70016fd0 BYTE_ORDER MSB_LAST /end MEASUREMENT
/begin COMPU_METHOD CU_MPL_PDG_CLIENT.STACK.TASK.S0 "Conversion method for mpl_pdg_client.stack.task.status" TAB_VERB "%12.0" "(not defined)" COMPU_TAB_REF CT_MPL_PDG_CLIENT.STACK.TASK.S0 /end COMPU_METHOD
/begin COMPU_VTAB CT_MPL_PDG_CLIENT.STACK.TASK.S0 "Conversion method for mpl_pdg_client.stack.task.status" TAB_VERB 5 0 "PKN_TASK_STK_STAT_NR_IN_PROG" 1 "PKN_TASK_STACK_DATA_STATUS_VALID" 2 "PKN_TASK_STK_STAT_NR_GROW_SPEC" 3 "PKN_TASK_STK_STAT_NR_ALLOC_SPEC" 4 "PKN_TASK_STK_STAT_NR_INV_SPEC" /end COMPU_VTAB
/* Scalar measurable for DDE 'mpl_pdg_client.stack.task.used'. */
/begin MEASUREMENT mpl_pdg_client.stack.task.used "Used bytes of task stack for task named: pdg_client" ULONG CU_MPL_PDG_CLIENT.STACK.TASK.U0 1 100 0.0 4294967295.0 ECU_ADDRESS 0x70016fcc BYTE_ORDER MSB_LAST /end MEASUREMENT
/begin COMPU_METHOD CU_MPL_PDG_CLIENT.STACK.TASK.U0 "Conversion method for mpl_pdg_client.stack.task.used" RAT_FUNC "%10.0" "bytes" COEFFS 0.000000 1.000000 -0.000000 0.000000 0.000000 1.000000 /end COMPU_METHOD
/* Scalar measurable for DDE 'mpl_pdg_client.timing.max_task_time'. */
/begin MEASUREMENT mpl_pdg_client.timing.max_task0 "Maximum duration of task since reset: pdg_client" ULONG CU_MPL_PDG_CLIENT.TIMING.MAX_T0 1 100 0.0 42949672.0 ECU_ADDRESS 0x7001cad0 BYTE_ORDER MSB_LAST /end MEASUREMENT
/begin COMPU_METHOD CU_MPL_PDG_CLIENT.TIMING.MAX_T0 "Conversion method for mpl_pdg_client.timing.max_task_time" RAT_FUNC "%10.0" "microseconds" COEFFS 0.000000 100.000000 -0.000000 0.000000 0.000000 1.000000 /end COMPU_METHOD
/* Scalar measurable for DDE 'mpl_pdg_client.timing.overruns'. */
/begin MEASUREMENT mpl_pdg_client.timing.overruns ": pdg_client" UBYTE CU_MPL_PDG_CLIENT.TIMING.OVERR0 1 100 0.0 255.0 ECU_ADDRESS 0x70016fb0 BYTE_ORDER MSB_LAST /end MEASUREMENT
/begin COMPU_METHOD CU_MPL_PDG_CLIENT.TIMING.OVERR0 "Conversion method for mpl_pdg_client.timing.overruns" RAT_FUNC "%10.0" "count" COEFFS 0.000000 1.000000 -0.000000 0.000000 0.000000 1.000000 /end COMPU_METHOD
/* Scalar measurable for DDE 'mpl_pdg_client.timing.runs'. */
/begin MEASUREMENT mpl_pdg_client.timing.runs ": pdg_client" ULONG CU_MPL_PDG_CLIENT.TIMING.RUNS 1 100 0.0 4294967295.0 ECU_ADDRESS 0x70016fac BYTE_ORDER MSB_LAST /end MEASUREMENT
/begin COMPU_METHOD CU_MPL_PDG_CLIENT.TIMING.RUNS "Conversion method for mpl_pdg_client.timing.runs" RAT_FUNC "%10.0" "count" COEFFS 0.000000 1.000000 -0.000000 0.000000 0.000000 1.000000 /end COMPU_METHOD
/* Scalar measurable for DDE 'mpl_pdg_client.timing.task_time'. */
/begin MEASUREMENT mpl_pdg_client.timing.task_time "Duration of task: pdg_client" ULONG CU_MPL_PDG_CLIENT.TIMING.TASK_0 1 100 0.0 42949672.0 ECU_ADDRESS 0x7001ca74 BYTE_ORDER MSB_LAST /end MEASUREMENT
/begin COMPU_METHOD CU_MPL_PDG_CLIENT.TIMING.TASK_0 "Conversion method for mpl_pdg_client.timing.task_time" RAT_FUNC "%10.0" "microseconds" COEFFS 0.000000 100.000000 -0.000000 0.000000 0.000000 1.000000 /end COMPU_METHOD
/* Scalar measurable for DDE 'mpl_pdx_task.stack.isr.status'. */
/begin MEASUREMENT mpl_pdx_task.stack.isr.status "Current status of stack performance measurement for task: pdx_task" SLONG CU_MPL_PDX_TASK.STACK.ISR.STAT0 1 100 0.0 255.0 ECU_ADDRESS 0x700170e0 BYTE_ORDER MSB_LAST /end MEASUREMENT
/begin COMPU_METHOD CU_MPL_PDX_TASK.STACK.ISR.STAT0 "Conversion method for mpl_pdx_task.stack.isr.status" TAB_VERB "%12.0" "(not defined)" COMPU_TAB_REF CT_MPL_PDX_TASK.STACK.ISR.STAT0 /end COMPU_METHOD
/begin COMPU_VTAB CT_MPL_PDX_TASK.STACK.ISR.STAT0 "Conversion method for mpl_pdx_task.stack.isr.status" TAB_VERB 5 0 "PKN_TASK_STK_STAT_NR_IN_PROG" 1 "PKN_TASK_STACK_DATA_STATUS_VALID" 2 "PKN_TASK_STK_STAT_NR_GROW_SPEC" 3 "PKN_TASK_STK_STAT_NR_ALLOC_SPEC" 4 "PKN_TASK_STK_STAT_NR_INV_SPEC" /end COMPU_VTAB
/* Scalar measurable for DDE 'mpl_pdx_task.stack.isr.used'. */
/begin MEASUREMENT mpl_pdx_task.stack.isr.used "Used bytes of interrupt stack for task named: pdx_task" ULONG CU_MPL_PDX_TASK.STACK.ISR.USED 1 100 0.0 4294967295.0 ECU_ADDRESS 0x700170dc BYTE_ORDER MSB_LAST /end MEASUREMENT
/begin COMPU_METHOD CU_MPL_PDX_TASK.STACK.ISR.USED "Conversion method for mpl_pdx_task.stack.isr.used" RAT_FUNC "%10.0" "bytes" COEFFS 0.000000 1.000000 -0.000000 0.000000 0.000000 1.000000 /end COMPU_METHOD
/* Scalar measurable for DDE 'mpl_pdx_task.stack.task.status'. */
/begin MEASUREMENT mpl_pdx_task.stack.task.status "Current status of stack performance measurement for task: pdx_task" SLONG CU_MPL_PDX_TASK.STACK.TASK.STA0 1 100 0.0 255.0 ECU_ADDRESS 0x700170f0 BYTE_ORDER MSB_LAST /end MEASUREMENT
/begin COMPU_METHOD CU_MPL_PDX_TASK.STACK.TASK.STA0 "Conversion method for mpl_pdx_task.stack.task.status" TAB_VERB "%12.0" "(not defined)" COMPU_TAB_REF CT_MPL_PDX_TASK.STACK.TASK.STA0 /end COMPU_METHOD
/begin COMPU_VTAB CT_MPL_PDX_TASK.STACK.TASK.STA0 "Conversion method for mpl_pdx_task.stack.task.status" TAB_VERB 5 0 "PKN_TASK_STK_STAT_NR_IN_PROG" 1 "PKN_TASK_STACK_DATA_STATUS_VALID" 2 "PKN_TASK_STK_STAT_NR_GROW_SPEC" 3 "PKN_TASK_STK_STAT_NR_ALLOC_SPEC" 4 "PKN_TASK_STK_STAT_NR_INV_SPEC" /end COMPU_VTAB
/* Scalar measurable for DDE 'mpl_pdx_task.stack.task.used'. */
/begin MEASUREMENT mpl_pdx_task.stack.task.used "Used bytes of task stack for task named: pdx_task" ULONG CU_MPL_PDX_TASK.STACK.TASK.USED 1 100 0.0 4294967295.0 ECU_ADDRESS 0x700170ec BYTE_ORDER MSB_LAST /end MEASUREMENT
/begin COMPU_METHOD CU_MPL_PDX_TASK.STACK.TASK.USED "Conversion method for mpl_pdx_task.stack.task.used" RAT_FUNC "%10.0" "bytes" COEFFS 0.000000 1.000000 -0.000000 0.000000 0.000000 1.000000 /end COMPU_METHOD
/* Scalar measurable for DDE 'mpl_pdx_task.timing.max_task_time'. */
/begin MEASUREMENT mpl_pdx_task.timing.max_task_t0 "Maximum duration of task since reset: pdx_task" ULONG CU_MPL_PDX_TASK.TIMING.MAX_TAS0 1 100 0.0 42949672.0 ECU_ADDRESS 0x7001cac0 BYTE_ORDER MSB_LAST /end MEASUREMENT
/begin COMPU_METHOD CU_MPL_PDX_TASK.TIMING.MAX_TAS0 "Conversion method for mpl_pdx_task.timing.max_task_time" RAT_FUNC "%10.0" "microseconds" COEFFS 0.000000 100.000000 -0.000000 0.000000 0.000000 1.000000 /end COMPU_METHOD
/* Scalar measurable for DDE 'mpl_pdx_task.timing.overruns'. */
/begin MEASUREMENT mpl_pdx_task.timing.overruns ": pdx_task" UBYTE CU_MPL_PDX_TASK.TIMING.OVERRUNS 1 100 0.0 255.0 ECU_ADDRESS 0x700170d0 BYTE_ORDER MSB_LAST /end MEASUREMENT
/begin COMPU_METHOD CU_MPL_PDX_TASK.TIMING.OVERRUNS "Conversion method for mpl_pdx_task.timing.overruns" RAT_FUNC "%10.0" "count" COEFFS 0.000000 1.000000 -0.000000 0.000000 0.000000 1.000000 /end COMPU_METHOD
/* Scalar measurable for DDE 'mpl_pdx_task.timing.runs'. */
/begin MEASUREMENT mpl_pdx_task.timing.runs ": pdx_task" ULONG CU_MPL_PDX_TASK.TIMING.RUNS 1 100 0.0 4294967295.0 ECU_ADDRESS 0x700170cc BYTE_ORDER MSB_LAST /end MEASUREMENT
/begin COMPU_METHOD CU_MPL_PDX_TASK.TIMING.RUNS "Conversion method for mpl_pdx_task.timing.runs" RAT_FUNC "%10.0" "count" COEFFS 0.000000 1.000000 -0.000000 0.000000 0.000000 1.000000 /end COMPU_METHOD
/* Scalar measurable for DDE 'mpl_pdx_task.timing.task_time'. */
/begin MEASUREMENT mpl_pdx_task.timing.task_time "Duration of task: pdx_task" ULONG CU_MPL_PDX_TASK.TIMING.TASK_TI0 1 100 0.0 42949672.0 ECU_ADDRESS 0x7001ca64 BYTE_ORDER MSB_LAST /end MEASUREMENT
/begin COMPU_METHOD CU_MPL_PDX_TASK.TIMING.TASK_TI0 "Conversion method for mpl_pdx_task.timing.task_time" RAT_FUNC "%10.0" "microseconds" COEFFS 0.000000 100.000000 -0.000000 0.000000 0.000000 1.000000 /end COMPU_METHOD
/* Scalar measurable for DDE 'mpl_pfc_periodic.stack.isr.status'. */
/begin MEASUREMENT mpl_pfc_periodic.stack.isr.sta0 "Current status of stack performance measurement for task: pfc_periodic" SLONG CU_MPL_PFC_PERIODIC.STACK.ISR.0 1 100 0.0 255.0 ECU_ADDRESS 0x70017368 BYTE_ORDER MSB_LAST /end MEASUREMENT
/begin COMPU_METHOD CU_MPL_PFC_PERIODIC.STACK.ISR.0 "Conversion method for mpl_pfc_periodic.stack.isr.status" TAB_VERB "%12.0" "(not defined)" COMPU_TAB_REF CT_MPL_PFC_PERIODIC.STACK.ISR.0 /end COMPU_METHOD
/begin COMPU_VTAB CT_MPL_PFC_PERIODIC.STACK.ISR.0 "Conversion method for mpl_pfc_periodic.stack.isr.status" TAB_VERB 5 0 "PKN_TASK_STK_STAT_NR_IN_PROG" 1 "PKN_TASK_STACK_DATA_STATUS_VALID" 2 "PKN_TASK_STK_STAT_NR_GROW_SPEC" 3 "PKN_TASK_STK_STAT_NR_ALLOC_SPEC" 4 "PKN_TASK_STK_STAT_NR_INV_SPEC" /end COMPU_VTAB
/* Scalar measurable for DDE 'mpl_pfc_periodic.stack.isr.used'. */
/begin MEASUREMENT mpl_pfc_periodic.stack.isr.used "Used bytes of interrupt stack for task named: pfc_periodic" ULONG CU_MPL_PFC_PERIODIC.STACK.ISR.1 1 100 0.0 4294967295.0 ECU_ADDRESS 0x70017364 BYTE_ORDER MSB_LAST /end MEASUREMENT
/begin COMPU_METHOD CU_MPL_PFC_PERIODIC.STACK.ISR.1 "Conversion method for mpl_pfc_periodic.stack.isr.used" RAT_FUNC "%10.0" "bytes" COEFFS 0.000000 1.000000 -0.000000 0.000000 0.000000 1.000000 /end COMPU_METHOD
/* Scalar measurable for DDE 'mpl_pfc_periodic.stack.task.status'. */
/begin MEASUREMENT mpl_pfc_periodic.stack.task.st0 "Current status of stack performance measurement for task: pfc_periodic" SLONG CU_MPL_PFC_PERIODIC.STACK.TASK1 1 100 0.0 255.0 ECU_ADDRESS 0x70017378 BYTE_ORDER MSB_LAST /end MEASUREMENT
/begin COMPU_METHOD CU_MPL_PFC_PERIODIC.STACK.TASK1 "Conversion method for mpl_pfc_periodic.stack.task.status" TAB_VERB "%12.0" "(not defined)" COMPU_TAB_REF CT_MPL_PFC_PERIODIC.STACK.TASK1 /end COMPU_METHOD
/begin COMPU_VTAB CT_MPL_PFC_PERIODIC.STACK.TASK1 "Conversion method for mpl_pfc_periodic.stack.task.status" TAB_VERB 5 0 "PKN_TASK_STK_STAT_NR_IN_PROG" 1 "PKN_TASK_STACK_DATA_STATUS_VALID" 2 "PKN_TASK_STK_STAT_NR_GROW_SPEC" 3 "PKN_TASK_STK_STAT_NR_ALLOC_SPEC" 4 "PKN_TASK_STK_STAT_NR_INV_SPEC" /end COMPU_VTAB
/* Scalar measurable for DDE 'mpl_pfc_periodic.stack.task.used'. */
/begin MEASUREMENT mpl_pfc_periodic.stack.task.us0 "Used bytes of task stack for task named: pfc_periodic" ULONG CU_MPL_PFC_PERIODIC.STACK.TASK0 1 100 0.0 4294967295.0 ECU_ADDRESS 0x70017374 BYTE_ORDER MSB_LAST /end MEASUREMENT
/begin COMPU_METHOD CU_MPL_PFC_PERIODIC.STACK.TASK0 "Conversion method for mpl_pfc_periodic.stack.task.used" RAT_FUNC "%10.0" "bytes" COEFFS 0.000000 1.000000 -0.000000 0.000000 0.000000 1.000000 /end COMPU_METHOD
/* Scalar measurable for DDE 'mpl_pfc_periodic.timing.max_task_time'. */
/begin MEASUREMENT mpl_pfc_periodic.timing.max_ta0 "Maximum duration of task since reset: pfc_periodic" ULONG CU_MPL_PFC_PERIODIC.TIMING.MAX0 1 100 0.0 42949672.0 ECU_ADDRESS 0x7001ca9c BYTE_ORDER MSB_LAST /end MEASUREMENT
/begin COMPU_METHOD CU_MPL_PFC_PERIODIC.TIMING.MAX0 "Conversion method for mpl_pfc_periodic.timing.max_task_time" RAT_FUNC "%10.0" "microseconds" COEFFS 0.000000 100.000000 -0.000000 0.000000 0.000000 1.000000 /end COMPU_METHOD
/* Scalar measurable for DDE 'mpl_pfc_periodic.timing.overruns'. */
/begin MEASUREMENT mpl_pfc_periodic.timing.overru0 ": pfc_periodic" UBYTE CU_MPL_PFC_PERIODIC.TIMING.OVE0 1 100 0.0 255.0 ECU_ADDRESS 0x70017358 BYTE_ORDER MSB_LAST /end MEASUREMENT
/begin COMPU_METHOD CU_MPL_PFC_PERIODIC.TIMING.OVE0 "Conversion method for mpl_pfc_periodic.timing.overruns" RAT_FUNC "%10.0" "count" COEFFS 0.000000 1.000000 -0.000000 0.000000 0.000000 1.000000 /end COMPU_METHOD
/* Scalar measurable for DDE 'mpl_pfc_periodic.timing.runs'. */
/begin MEASUREMENT mpl_pfc_periodic.timing.runs ": pfc_periodic" ULONG CU_MPL_PFC_PERIODIC.TIMING.RUNS 1 100 0.0 4294967295.0 ECU_ADDRESS 0x70017354 BYTE_ORDER MSB_LAST /end MEASUREMENT
/begin COMPU_METHOD CU_MPL_PFC_PERIODIC.TIMING.RUNS "Conversion method for mpl_pfc_periodic.timing.runs" RAT_FUNC "%10.0" "count" COEFFS 0.000000 1.000000 -0.000000 0.000000 0.000000 1.000000 /end COMPU_METHOD
/* Scalar measurable for DDE 'mpl_pfc_periodic.timing.task_time'. */
/begin MEASUREMENT mpl_pfc_periodic.timing.task_t0 "Duration of task: pfc_periodic" ULONG CU_MPL_PFC_PERIODIC.TIMING.TAS0 1 100 0.0 42949672.0 ECU_ADDRESS 0x7001ca40 BYTE_ORDER MSB_LAST /end MEASUREMENT
/begin COMPU_METHOD CU_MPL_PFC_PERIODIC.TIMING.TAS0 "Conversion method for mpl_pfc_periodic.timing.task_time" RAT_FUNC "%10.0" "microseconds" COEFFS 0.000000 100.000000 -0.000000 0.000000 0.000000 1.000000 /end COMPU_METHOD
/* Scalar measurable for DDE 'mpl_pff_client.stack.isr.status'. */
/begin MEASUREMENT mpl_pff_client.stack.isr.status "Current status of stack performance measurement for task: pff_client" SLONG CU_MPL_PFF_CLIENT.STACK.ISR.ST0 1 100 0.0 255.0 ECU_ADDRESS 0x700171b8 BYTE_ORDER MSB_LAST /end MEASUREMENT
/begin COMPU_METHOD CU_MPL_PFF_CLIENT.STACK.ISR.ST0 "Conversion method for mpl_pff_client.stack.isr.status" TAB_VERB "%12.0" "(not defined)" COMPU_TAB_REF CT_MPL_PFF_CLIENT.STACK.ISR.ST0 /end COMPU_METHOD
/begin COMPU_VTAB CT_MPL_PFF_CLIENT.STACK.ISR.ST0 "Conversion method for mpl_pff_client.stack.isr.status" TAB_VERB 5 0 "PKN_TASK_STK_STAT_NR_IN_PROG" 1 "PKN_TASK_STACK_DATA_STATUS_VALID" 2 "PKN_TASK_STK_STAT_NR_GROW_SPEC" 3 "PKN_TASK_STK_STAT_NR_ALLOC_SPEC" 4 "PKN_TASK_STK_STAT_NR_INV_SPEC" /end COMPU_VTAB
/* Scalar measurable for DDE 'mpl_pff_client.stack.isr.used'. */
/begin MEASUREMENT mpl_pff_client.stack.isr.used "Used bytes of interrupt stack for task named: pff_client" ULONG CU_MPL_PFF_CLIENT.STACK.ISR.US0 1 100 0.0 4294967295.0 ECU_ADDRESS 0x700171b4 BYTE_ORDER MSB_LAST /end MEASUREMENT
/begin COMPU_METHOD CU_MPL_PFF_CLIENT.STACK.ISR.US0 "Conversion method for mpl_pff_client.stack.isr.used" RAT_FUNC "%10.0" "bytes" COEFFS 0.000000 1.000000 -0.000000 0.000000 0.000000 1.000000 /end COMPU_METHOD
/* Scalar measurable for DDE 'mpl_pff_client.stack.task.status'. */
/begin MEASUREMENT mpl_pff_client.stack.task.stat0 "Current status of stack performance measurement for task: pff_client" SLONG CU_MPL_PFF_CLIENT.STACK.TASK.S0 1 100 0.0 255.0 ECU_ADDRESS 0x700171c8 BYTE_ORDER MSB_LAST /end MEASUREMENT
/begin COMPU_METHOD CU_MPL_PFF_CLIENT.STACK.TASK.S0 "Conversion method for mpl_pff_client.stack.task.status" TAB_VERB "%12.0" "(not defined)" COMPU_TAB_REF CT_MPL_PFF_CLIENT.STACK.TASK.S0 /end COMPU_METHOD
/begin COMPU_VTAB CT_MPL_PFF_CLIENT.STACK.TASK.S0 "Conversion method for mpl_pff_client.stack.task.status" TAB_VERB 5 0 "PKN_TASK_STK_STAT_NR_IN_PROG" 1 "PKN_TASK_STACK_DATA_STATUS_VALID" 2 "PKN_TASK_STK_STAT_NR_GROW_SPEC" 3 "PKN_TASK_STK_STAT_NR_ALLOC_SPEC" 4 "PKN_TASK_STK_STAT_NR_INV_SPEC" /end COMPU_VTAB
/* Scalar measurable for DDE 'mpl_pff_client.stack.task.used'. */
/begin MEASUREMENT mpl_pff_client.stack.task.used "Used bytes of task stack for task named: pff_client" ULONG CU_MPL_PFF_CLIENT.STACK.TASK.U0 1 100 0.0 4294967295.0 ECU_ADDRESS 0x700171c4 BYTE_ORDER MSB_LAST /end MEASUREMENT
/begin COMPU_METHOD CU_MPL_PFF_CLIENT.STACK.TASK.U0 "Conversion method for mpl_pff_client.stack.task.used" RAT_FUNC "%10.0" "bytes" COEFFS 0.000000 1.000000 -0.000000 0.000000 0.000000 1.000000 /end COMPU_METHOD
/* Scalar measurable for DDE 'mpl_pff_client.timing.max_task_time'. */
/begin MEASUREMENT mpl_pff_client.timing.max_task0 "Maximum duration of task since reset: pff_client" ULONG CU_MPL_PFF_CLIENT.TIMING.MAX_T0 1 100 0.0 42949672.0 ECU_ADDRESS 0x7001cab4 BYTE_ORDER MSB_LAST /end MEASUREMENT
/begin COMPU_METHOD CU_MPL_PFF_CLIENT.TIMING.MAX_T0 "Conversion method for mpl_pff_client.timing.max_task_time" RAT_FUNC "%10.0" "microseconds" COEFFS 0.000000 100.000000 -0.000000 0.000000 0.000000 1.000000 /end COMPU_METHOD
/* Scalar measurable for DDE 'mpl_pff_client.timing.overruns'. */
/begin MEASUREMENT mpl_pff_client.timing.overruns ": pff_client" UBYTE CU_MPL_PFF_CLIENT.TIMING.OVERR0 1 100 0.0 255.0 ECU_ADDRESS 0x700171a8 BYTE_ORDER MSB_LAST /end MEASUREMENT
/begin COMPU_METHOD CU_MPL_PFF_CLIENT.TIMING.OVERR0 "Conversion method for mpl_pff_client.timing.overruns" RAT_FUNC "%10.0" "count" COEFFS 0.000000 1.000000 -0.000000 0.000000 0.000000 1.000000 /end COMPU_METHOD
/* Scalar measurable for DDE 'mpl_pff_client.timing.runs'. */
/begin MEASUREMENT mpl_pff_client.timing.runs ": pff_client" ULONG CU_MPL_PFF_CLIENT.TIMING.RUNS 1 100 0.0 4294967295.0 ECU_ADDRESS 0x700171a4 BYTE_ORDER MSB_LAST /end MEASUREMENT
/begin COMPU_METHOD CU_MPL_PFF_CLIENT.TIMING.RUNS "Conversion method for mpl_pff_client.timing.runs" RAT_FUNC "%10.0" "count" COEFFS 0.000000 1.000000 -0.000000 0.000000 0.000000 1.000000 /end COMPU_METHOD
/* Scalar measurable for DDE 'mpl_pff_client.timing.task_time'. */
/begin MEASUREMENT mpl_pff_client.timing.task_time "Duration of task: pff_client" ULONG CU_MPL_PFF_CLIENT.TIMING.TASK_0 1 100 0.0 42949672.0 ECU_ADDRESS 0x7001ca58 BYTE_ORDER MSB_LAST /end MEASUREMENT
/begin COMPU_METHOD CU_MPL_PFF_CLIENT.TIMING.TASK_0 "Conversion method for mpl_pff_client.timing.task_time" RAT_FUNC "%10.0" "microseconds" COEFFS 0.000000 100.000000 -0.000000 0.000000 0.000000 1.000000 /end COMPU_METHOD
/* Scalar measurable for DDE 'mpl_pfs_client.stack.isr.status'. */
/begin MEASUREMENT mpl_pfs_client.stack.isr.status "Current status of stack performance measurement for task: pfs_client" SLONG CU_MPL_PFS_CLIENT.STACK.ISR.ST0 1 100 0.0 255.0 ECU_ADDRESS 0x70017170 BYTE_ORDER MSB_LAST /end MEASUREMENT
/begin COMPU_METHOD CU_MPL_PFS_CLIENT.STACK.ISR.ST0 "Conversion method for mpl_pfs_client.stack.isr.status" TAB_VERB "%12.0" "(not defined)" COMPU_TAB_REF CT_MPL_PFS_CLIENT.STACK.ISR.ST0 /end COMPU_METHOD
/begin COMPU_VTAB CT_MPL_PFS_CLIENT.STACK.ISR.ST0 "Conversion method for mpl_pfs_client.stack.isr.status" TAB_VERB 5 0 "PKN_TASK_STK_STAT_NR_IN_PROG" 1 "PKN_TASK_STACK_DATA_STATUS_VALID" 2 "PKN_TASK_STK_STAT_NR_GROW_SPEC" 3 "PKN_TASK_STK_STAT_NR_ALLOC_SPEC" 4 "PKN_TASK_STK_STAT_NR_INV_SPEC" /end COMPU_VTAB
/* Scalar measurable for DDE 'mpl_pfs_client.stack.isr.used'. */
/begin MEASUREMENT mpl_pfs_client.stack.isr.used "Used bytes of interrupt stack for task named: pfs_client" ULONG CU_MPL_PFS_CLIENT.STACK.ISR.US0 1 100 0.0 4294967295.0 ECU_ADDRESS 0x7001716c BYTE_ORDER MSB_LAST /end MEASUREMENT
/begin COMPU_METHOD CU_MPL_PFS_CLIENT.STACK.ISR.US0 "Conversion method for mpl_pfs_client.stack.isr.used" RAT_FUNC "%10.0" "bytes" COEFFS 0.000000 1.000000 -0.000000 0.000000 0.000000 1.000000 /end COMPU_METHOD
/* Scalar measurable for DDE 'mpl_pfs_client.stack.task.status'. */
/begin MEASUREMENT mpl_pfs_client.stack.task.stat0 "Current status of stack performance measurement for task: pfs_client" SLONG CU_MPL_PFS_CLIENT.STACK.TASK.S0 1 100 0.0 255.0 ECU_ADDRESS 0x70017180 BYTE_ORDER MSB_LAST /end MEASUREMENT
/begin COMPU_METHOD CU_MPL_PFS_CLIENT.STACK.TASK.S0 "Conversion method for mpl_pfs_client.stack.task.status" TAB_VERB "%12.0" "(not defined)" COMPU_TAB_REF CT_MPL_PFS_CLIENT.STACK.TASK.S0 /end COMPU_METHOD
/begin COMPU_VTAB CT_MPL_PFS_CLIENT.STACK.TASK.S0 "Conversion method for mpl_pfs_client.stack.task.status" TAB_VERB 5 0 "PKN_TASK_STK_STAT_NR_IN_PROG" 1 "PKN_TASK_STACK_DATA_STATUS_VALID" 2 "PKN_TASK_STK_STAT_NR_GROW_SPEC" 3 "PKN_TASK_STK_STAT_NR_ALLOC_SPEC" 4 "PKN_TASK_STK_STAT_NR_INV_SPEC" /end COMPU_VTAB
/* Scalar measurable for DDE 'mpl_pfs_client.stack.task.used'. */
/begin MEASUREMENT mpl_pfs_client.stack.task.used "Used bytes of task stack for task named: pfs_client" ULONG CU_MPL_PFS_CLIENT.STACK.TASK.U0 1 100 0.0 4294967295.0 ECU_ADDRESS 0x7001717c BYTE_ORDER MSB_LAST /end MEASUREMENT
/begin COMPU_METHOD CU_MPL_PFS_CLIENT.STACK.TASK.U0 "Conversion method for mpl_pfs_client.stack.task.used" RAT_FUNC "%10.0" "bytes" COEFFS 0.000000 1.000000 -0.000000 0.000000 0.000000 1.000000 /end COMPU_METHOD
/* Scalar measurable for DDE 'mpl_pfs_client.timing.max_task_time'. */
/begin MEASUREMENT mpl_pfs_client.timing.max_task0 "Maximum duration of task since reset: pfs_client" ULONG CU_MPL_PFS_CLIENT.TIMING.MAX_T0 1 100 0.0 42949672.0 ECU_ADDRESS 0x7001cab8 BYTE_ORDER MSB_LAST /end MEASUREMENT
/begin COMPU_METHOD CU_MPL_PFS_CLIENT.TIMING.MAX_T0 "Conversion method for mpl_pfs_client.timing.max_task_time" RAT_FUNC "%10.0" "microseconds" COEFFS 0.000000 100.000000 -0.000000 0.000000 0.000000 1.000000 /end COMPU_METHOD
/* Scalar measurable for DDE 'mpl_pfs_client.timing.overruns'. */
/begin MEASUREMENT mpl_pfs_client.timing.overruns ": pfs_client" UBYTE CU_MPL_PFS_CLIENT.TIMING.OVERR0 1 100 0.0 255.0 ECU_ADDRESS 0x70017160 BYTE_ORDER MSB_LAST /end MEASUREMENT
/begin COMPU_METHOD CU_MPL_PFS_CLIENT.TIMING.OVERR0 "Conversion method for mpl_pfs_client.timing.overruns" RAT_FUNC "%10.0" "count" COEFFS 0.000000 1.000000 -0.000000 0.000000 0.000000 1.000000 /end COMPU_METHOD
/* Scalar measurable for DDE 'mpl_pfs_client.timing.runs'. */
/begin MEASUREMENT mpl_pfs_client.timing.runs ": pfs_client" ULONG CU_MPL_PFS_CLIENT.TIMING.RUNS 1 100 0.0 4294967295.0 ECU_ADDRESS 0x7001715c BYTE_ORDER MSB_LAST /end MEASUREMENT
/begin COMPU_METHOD CU_MPL_PFS_CLIENT.TIMING.RUNS "Conversion method for mpl_pfs_client.timing.runs" RAT_FUNC "%10.0" "count" COEFFS 0.000000 1.000000 -0.000000 0.000000 0.000000 1.000000 /end COMPU_METHOD
/* Scalar measurable for DDE 'mpl_pfs_client.timing.task_time'. */
/begin MEASUREMENT mpl_pfs_client.timing.task_time "Duration of task: pfs_client" ULONG CU_MPL_PFS_CLIENT.TIMING.TASK_0 1 100 0.0 42949672.0 ECU_ADDRESS 0x7001ca5c BYTE_ORDER MSB_LAST /end MEASUREMENT
/begin COMPU_METHOD CU_MPL_PFS_CLIENT.TIMING.TASK_0 "Conversion method for mpl_pfs_client.timing.task_time" RAT_FUNC "%10.0" "microseconds" COEFFS 0.000000 100.000000 -0.000000 0.000000 0.000000 1.000000 /end COMPU_METHOD
/* Scalar measurable for DDE 'mpl_piso_client.stack.isr.status'. */
/begin MEASUREMENT mpl_piso_client.stack.isr.stat0 "Current status of stack performance measurement for task: piso_client" SLONG CU_MPL_PISO_CLIENT.STACK.ISR.S0 1 100 0.0 255.0 ECU_ADDRESS 0x70017008 BYTE_ORDER MSB_LAST /end MEASUREMENT
/begin COMPU_METHOD CU_MPL_PISO_CLIENT.STACK.ISR.S0 "Conversion method for mpl_piso_client.stack.isr.status" TAB_VERB "%12.0" "(not defined)" COMPU_TAB_REF CT_MPL_PISO_CLIENT.STACK.ISR.S0 /end COMPU_METHOD
/begin COMPU_VTAB CT_MPL_PISO_CLIENT.STACK.ISR.S0 "Conversion method for mpl_piso_client.stack.isr.status" TAB_VERB 5 0 "PKN_TASK_STK_STAT_NR_IN_PROG" 1 "PKN_TASK_STACK_DATA_STATUS_VALID" 2 "PKN_TASK_STK_STAT_NR_GROW_SPEC" 3 "PKN_TASK_STK_STAT_NR_ALLOC_SPEC" 4 "PKN_TASK_STK_STAT_NR_INV_SPEC" /end COMPU_VTAB
/* Scalar measurable for DDE 'mpl_piso_client.stack.isr.used'. */
/begin MEASUREMENT mpl_piso_client.stack.isr.used "Used bytes of interrupt stack for task named: piso_client" ULONG CU_MPL_PISO_CLIENT.STACK.ISR.U0 1 100 0.0 4294967295.0 ECU_ADDRESS 0x70017004 BYTE_ORDER MSB_LAST /end MEASUREMENT
/begin COMPU_METHOD CU_MPL_PISO_CLIENT.STACK.ISR.U0 "Conversion method for mpl_piso_client.stack.isr.used" RAT_FUNC "%10.0" "bytes" COEFFS 0.000000 1.000000 -0.000000 0.000000 0.000000 1.000000 /end COMPU_METHOD
/* Scalar measurable for DDE 'mpl_piso_client.stack.task.status'. */
/begin MEASUREMENT mpl_piso_client.stack.task.sta0 "Current status of stack performance measurement for task: piso_client" SLONG CU_MPL_PISO_CLIENT.STACK.TASK.0 1 100 0.0 255.0 ECU_ADDRESS 0x70017018 BYTE_ORDER MSB_LAST /end MEASUREMENT
/begin COMPU_METHOD CU_MPL_PISO_CLIENT.STACK.TASK.0 "Conversion method for mpl_piso_client.stack.task.status" TAB_VERB "%12.0" "(not defined)" COMPU_TAB_REF CT_MPL_PISO_CLIENT.STACK.TASK.0 /end COMPU_METHOD
/begin COMPU_VTAB CT_MPL_PISO_CLIENT.STACK.TASK.0 "Conversion method for mpl_piso_client.stack.task.status" TAB_VERB 5 0 "PKN_TASK_STK_STAT_NR_IN_PROG" 1 "PKN_TASK_STACK_DATA_STATUS_VALID" 2 "PKN_TASK_STK_STAT_NR_GROW_SPEC" 3 "PKN_TASK_STK_STAT_NR_ALLOC_SPEC" 4 "PKN_TASK_STK_STAT_NR_INV_SPEC" /end COMPU_VTAB
/* Scalar measurable for DDE 'mpl_piso_client.stack.task.used'. */
/begin MEASUREMENT mpl_piso_client.stack.task.used "Used bytes of task stack for task named: piso_client" ULONG CU_MPL_PISO_CLIENT.STACK.TASK.1 1 100 0.0 4294967295.0 ECU_ADDRESS 0x70017014 BYTE_ORDER MSB_LAST /end MEASUREMENT
/begin COMPU_METHOD CU_MPL_PISO_CLIENT.STACK.TASK.1 "Conversion method for mpl_piso_client.stack.task.used" RAT_FUNC "%10.0" "bytes" COEFFS 0.000000 1.000000 -0.000000 0.000000 0.000000 1.000000 /end COMPU_METHOD
/* Scalar measurable for DDE 'mpl_piso_client.timing.max_task_time'. */
/begin MEASUREMENT mpl_piso_client.timing.max_tas0 "Maximum duration of task since reset: piso_client" ULONG CU_MPL_PISO_CLIENT.TIMING.MAX_0 1 100 0.0 42949672.0 ECU_ADDRESS 0x7001cac8 BYTE_ORDER MSB_LAST /end MEASUREMENT
/begin COMPU_METHOD CU_MPL_PISO_CLIENT.TIMING.MAX_0 "Conversion method for mpl_piso_client.timing.max_task_time" RAT_FUNC "%10.0" "microseconds" COEFFS 0.000000 100.000000 -0.000000 0.000000 0.000000 1.000000 /end COMPU_METHOD
/* Scalar measurable for DDE 'mpl_piso_client.timing.overruns'. */
/begin MEASUREMENT mpl_piso_client.timing.overruns ": piso_client" UBYTE CU_MPL_PISO_CLIENT.TIMING.OVER0 1 100 0.0 255.0 ECU_ADDRESS 0x70016ff8 BYTE_ORDER MSB_LAST /end MEASUREMENT
/begin COMPU_METHOD CU_MPL_PISO_CLIENT.TIMING.OVER0 "Conversion method for mpl_piso_client.timing.overruns" RAT_FUNC "%10.0" "count" COEFFS 0.000000 1.000000 -0.000000 0.000000 0.000000 1.000000 /end COMPU_METHOD
/* Scalar measurable for DDE 'mpl_piso_client.timing.runs'. */
/begin MEASUREMENT mpl_piso_client.timing.runs ": piso_client" ULONG CU_MPL_PISO_CLIENT.TIMING.RUNS 1 100 0.0 4294967295.0 ECU_ADDRESS 0x70016ff4 BYTE_ORDER MSB_LAST /end MEASUREMENT
/begin COMPU_METHOD CU_MPL_PISO_CLIENT.TIMING.RUNS "Conversion method for mpl_piso_client.timing.runs" RAT_FUNC "%10.0" "count" COEFFS 0.000000 1.000000 -0.000000 0.000000 0.000000 1.000000 /end COMPU_METHOD
/* Scalar measurable for DDE 'mpl_piso_client.timing.task_time'. */
/begin MEASUREMENT mpl_piso_client.timing.task_ti0 "Duration of task: piso_client" ULONG CU_MPL_PISO_CLIENT.TIMING.TASK0 1 100 0.0 42949672.0 ECU_ADDRESS 0x7001ca6c BYTE_ORDER MSB_LAST /end MEASUREMENT
/begin COMPU_METHOD CU_MPL_PISO_CLIENT.TIMING.TASK0 "Conversion method for mpl_piso_client.timing.task_time" RAT_FUNC "%10.0" "microseconds" COEFFS 0.000000 100.000000 -0.000000 0.000000 0.000000 1.000000 /end COMPU_METHOD
/* Scalar measurable for DDE 'mpl_pj1939_client.stack.isr.status'. */
/begin MEASUREMENT mpl_pj1939_client.stack.isr.st0 "Current status of stack performance measurement for task: pj1939_client" SLONG CU_MPL_PJ1939_CLIENT.STACK.ISR0 1 100 0.0 255.0 ECU_ADDRESS 0x70017050 BYTE_ORDER MSB_LAST /end MEASUREMENT
/begin COMPU_METHOD CU_MPL_PJ1939_CLIENT.STACK.ISR0 "Conversion method for mpl_pj1939_client.stack.isr.status" TAB_VERB "%12.0" "(not defined)" COMPU_TAB_REF CT_MPL_PJ1939_CLIENT.STACK.ISR0 /end COMPU_METHOD
/begin COMPU_VTAB CT_MPL_PJ1939_CLIENT.STACK.ISR0 "Conversion method for mpl_pj1939_client.stack.isr.status" TAB_VERB 5 0 "PKN_TASK_STK_STAT_NR_IN_PROG" 1 "PKN_TASK_STACK_DATA_STATUS_VALID" 2 "PKN_TASK_STK_STAT_NR_GROW_SPEC" 3 "PKN_TASK_STK_STAT_NR_ALLOC_SPEC" 4 "PKN_TASK_STK_STAT_NR_INV_SPEC" /end COMPU_VTAB
/* Scalar measurable for DDE 'mpl_pj1939_client.stack.isr.used'. */
/begin MEASUREMENT mpl_pj1939_client.stack.isr.us0 "Used bytes of interrupt stack for task named: pj1939_client" ULONG CU_MPL_PJ1939_CLIENT.STACK.ISR1 1 100 0.0 4294967295.0 ECU_ADDRESS 0x7001704c BYTE_ORDER MSB_LAST /end MEASUREMENT
/begin COMPU_METHOD CU_MPL_PJ1939_CLIENT.STACK.ISR1 "Conversion method for mpl_pj1939_client.stack.isr.used" RAT_FUNC "%10.0" "bytes" COEFFS 0.000000 1.000000 -0.000000 0.000000 0.000000 1.000000 /end COMPU_METHOD
/* Scalar measurable for DDE 'mpl_pj1939_client.stack.task.status'. */
/begin MEASUREMENT mpl_pj1939_client.stack.task.s0 "Current status of stack performance measurement for task: pj1939_client" SLONG CU_MPL_PJ1939_CLIENT.STACK.TAS1 1 100 0.0 255.0 ECU_ADDRESS 0x70017060 BYTE_ORDER MSB_LAST /end MEASUREMENT
/begin COMPU_METHOD CU_MPL_PJ1939_CLIENT.STACK.TAS1 "Conversion method for mpl_pj1939_client.stack.task.status" TAB_VERB "%12.0" "(not defined)" COMPU_TAB_REF CT_MPL_PJ1939_CLIENT.STACK.TAS1 /end COMPU_METHOD
/begin COMPU_VTAB CT_MPL_PJ1939_CLIENT.STACK.TAS1 "Conversion method for mpl_pj1939_client.stack.task.status" TAB_VERB 5 0 "PKN_TASK_STK_STAT_NR_IN_PROG" 1 "PKN_TASK_STACK_DATA_STATUS_VALID" 2 "PKN_TASK_STK_STAT_NR_GROW_SPEC" 3 "PKN_TASK_STK_STAT_NR_ALLOC_SPEC" 4 "PKN_TASK_STK_STAT_NR_INV_SPEC" /end COMPU_VTAB
/* Scalar measurable for DDE 'mpl_pj1939_client.stack.task.used'. */
/begin MEASUREMENT mpl_pj1939_client.stack.task.u0 "Used bytes of task stack for task named: pj1939_client" ULONG CU_MPL_PJ1939_CLIENT.STACK.TAS0 1 100 0.0 4294967295.0 ECU_ADDRESS 0x7001705c BYTE_ORDER MSB_LAST /end MEASUREMENT
/begin COMPU_METHOD CU_MPL_PJ1939_CLIENT.STACK.TAS0 "Conversion method for mpl_pj1939_client.stack.task.used" RAT_FUNC "%10.0" "bytes" COEFFS 0.000000 1.000000 -0.000000 0.000000 0.000000 1.000000 /end COMPU_METHOD
/* Scalar measurable for DDE 'mpl_pj1939_client.timing.max_task_time'. */
/begin MEASUREMENT mpl_pj1939_client.timing.max_t0 "Maximum duration of task since reset: pj1939_client" ULONG CU_MPL_PJ1939_CLIENT.TIMING.MA0 1 100 0.0 42949672.0 ECU_ADDRESS 0x7001cacc BYTE_ORDER MSB_LAST /end MEASUREMENT
/begin COMPU_METHOD CU_MPL_PJ1939_CLIENT.TIMING.MA0 "Conversion method for mpl_pj1939_client.timing.max_task_time" RAT_FUNC "%10.0" "microseconds" COEFFS 0.000000 100.000000 -0.000000 0.000000 0.000000 1.000000 /end COMPU_METHOD
/* Scalar measurable for DDE 'mpl_pj1939_client.timing.overruns'. */
/begin MEASUREMENT mpl_pj1939_client.timing.overr0 ": pj1939_client" UBYTE CU_MPL_PJ1939_CLIENT.TIMING.OV0 1 100 0.0 255.0 ECU_ADDRESS 0x70017040 BYTE_ORDER MSB_LAST /end MEASUREMENT
/begin COMPU_METHOD CU_MPL_PJ1939_CLIENT.TIMING.OV0 "Conversion method for mpl_pj1939_client.timing.overruns" RAT_FUNC "%10.0" "count" COEFFS 0.000000 1.000000 -0.000000 0.000000 0.000000 1.000000 /end COMPU_METHOD
/* Scalar measurable for DDE 'mpl_pj1939_client.timing.runs'. */
/begin MEASUREMENT mpl_pj1939_client.timing.runs ": pj1939_client" ULONG CU_MPL_PJ1939_CLIENT.TIMING.RU0 1 100 0.0 4294967295.0 ECU_ADDRESS 0x7001703c BYTE_ORDER MSB_LAST /end MEASUREMENT
/begin COMPU_METHOD CU_MPL_PJ1939_CLIENT.TIMING.RU0 "Conversion method for mpl_pj1939_client.timing.runs" RAT_FUNC "%10.0" "count" COEFFS 0.000000 1.000000 -0.000000 0.000000 0.000000 1.000000 /end COMPU_METHOD
/* Scalar measurable for DDE 'mpl_pj1939_client.timing.task_time'. */
/begin MEASUREMENT mpl_pj1939_client.timing.task_0 "Duration of task: pj1939_client" ULONG CU_MPL_PJ1939_CLIENT.TIMING.TA0 1 100 0.0 42949672.0 ECU_ADDRESS 0x7001ca70 BYTE_ORDER MSB_LAST /end MEASUREMENT
/begin COMPU_METHOD CU_MPL_PJ1939_CLIENT.TIMING.TA0 "Conversion method for mpl_pj1939_client.timing.task_time" RAT_FUNC "%10.0" "microseconds" COEFFS 0.000000 100.000000 -0.000000 0.000000 0.000000 1.000000 /end COMPU_METHOD
/begin FUNCTION Automatic "Group /ByType/Automatic"
 /begin LOC_MEASUREMENT mpl_error_log_detailed[3].err16 mpl_error_log_detailed[3].err61 mpl_error_log_detailed[3].err73 mpl_error_log_detailed[3].err93 mpl_error_log_detailed[3].err44 mpl_error_log_detailed[3].err80 mpl_error_log_detailed[3].err60 mpl_error_log_detailed[3].err_1 mpl_error_log_detailed[3].err54 mpl_error_log_detailed[3].err37 mpl_error_log_detailed[3].err08 mpl_error_log_detailed[3].er039 mpl_error_log_detailed[3].er038 mpl_error_log_detailed[3].er037 mpl_error_log_detailed[3].er036 mpl_error_log_detailed[3].er001 mpl_error_log_detailed[3].er016 mpl_error_log_detailed[3].err81 mpl_error_log_detailed[3].err94 mpl_error_log_detailed[3].err29 mpl_error_log_detailed[3].err28 mpl_error_log_detailed[3].err39 mpl_error_log_detailed[3].er020 mpl_error_log_detailed[3].err53 mpl_error_log_detailed[3].er014 mpl_error_log_detailed[3].er013 mpl_error_log_detailed[3].er032 mpl_error_log_detailed[3].err48 mpl_error_log_detailed[3].err19 mpl_error_log_detailed[3].err03 mpl_error_log_detailed[3].er003 mpl_error_log_detailed[3].err11 mpl_error_log_detailed[3].err12 mpl_error_log_detailed[3].err14 mpl_error_log_detailed[3].err15 mpl_error_log_detailed[3].err66 mpl_error_log_detailed[3].err13 mpl_error_log_detailed[3].err69 mpl_error_log_detailed[3].er030 mpl_error_log_detailed[3].er031 mpl_error_log_detailed[3].err64 mpl_error_log_detailed[3].er027 mpl_error_log_detailed[3].er011 mpl_error_log_detailed[3].er029 mpl_error_log_detailed[3].er028 mpl_error_log_detailed[3].err35 mpl_error_log_detailed[3].er000 mpl_error_log_detailed[3].err40 mpl_error_log_detailed[3].err99 mpl_error_log_detailed[3].err98 mpl_error_log_detailed[3].err97 mpl_error_log_detailed[3].err96 mpl_error_log_detailed[3].er012 mpl_error_log_detailed[3].err78 mpl_error_log_detailed[3].err77 mpl_error_log_detailed[3].err91 mpl_error_log_detailed[3].err75 mpl_error_log_detailed[3].err76 mpl_error_log_detailed[3].err58 mpl_error_log_detailed[3].er002 mpl_error_log_detailed[3].err41 mpl_error_log_detailed[3].er035 mpl_error_log_detailed[3].er045 mpl_error_log_detailed[3].err95 mpl_error_log_detailed[3].err65 mpl_error_log_detailed[3].er033 mpl_error_log_detailed[3].er017 mpl_error_log_detailed[3].er007 mpl_error_log_detailed[3].err56 mpl_error_log_detailed[3].er025 mpl_error_log_detailed[3].err67 mpl_error_log_detailed[3].err_9 mpl_error_log_detailed[3].err51 mpl_error_log_detailed[3].err42 mpl_error_log_detailed[3].err74 mpl_error_log_detailed[3].err36 mpl_error_log_detailed[3].err17 mpl_error_log_detailed[3].err88 mpl_error_log_detailed[3].err10 mpl_error_log_detailed[3].er015 mpl_error_log_detailed[3].err26 mpl_error_log_detailed[3].er005 mpl_error_log_detailed[3].err25 mpl_error_log_detailed[3].err04 mpl_error_log_detailed[3].err05 mpl_error_log_detailed[3].err22 mpl_error_log_summary[0].id mpl_error_log_summary[0].mode mpl_error_log_summary[0].react0 mpl_error_log_summary[1].id mpl_error_log_summary[1].mode mpl_error_log_summary[1].react0 mpl_error_log_summary[2].id mpl_error_log_summary[2].mode mpl_error_log_summary[2].react0 mpl_error_log_summary[3].id mpl_error_log_summary[3].mode mpl_error_log_summary[3].react0 mpl_flp_div_by_zero mpl_flp_inexact mpl_flp_invalid mpl_flp_overflow mpl_flp_underflow mpl_init_task_c0.stack.isr.sta0 mpl_init_task_c0.stack.isr.used mpl_init_task_c0.stack.task.st0 mpl_init_task_c0.stack.task.us0 mpl_init_task_c0.timing.overru0 mpl_init_task_c0.timing.runs mpl_max_cpu_loaded_1000ms_c0 mpl_max_cpu_loaded_1000ms_c1 mpl_max_cpu_loaded_50ms_c0 mpl_max_cpu_loaded_50ms_c1 mpl_max_cpu_loaded_c0 mpl_max_cpu_loaded_c1 mpl_mode mpl_mode_run_time mpl_pax_task.stack.isr.status mpl_pax_task.stack.isr.used mpl_pax_task.stack.task.status mpl_pax_task.stack.task.used mpl_pax_task.timing.max_task_t0 mpl_pax_task.timing.overruns mpl_pax_task.timing.runs mpl_pax_task.timing.task_time mpl_pcp_client.stack.isr.status mpl_pcp_client.stack.isr.used mpl_pcp_client.stack.task.stat0 mpl_pcp_client.stack.task.used mpl_pcp_client.timing.max_task0 mpl_pcp_client.timing.overruns mpl_pcp_client.timing.runs mpl_pcp_client.timing.task_time mpl_pcx_can_callback.stack.isr0 mpl_pcx_can_callback.stack.isr1 mpl_pcx_can_callback.stack.tas0 mpl_pcx_can_callback.stack.tas1 mpl_pcx_can_callback.timing.ma0 mpl_pcx_can_callback.timing.ov0 mpl_pcx_can_callback.timing.ru0 mpl_pcx_can_callback.timing.ta0 mpl_pcx_gw_qemptier.stack.isr.0 mpl_pcx_gw_qemptier.stack.isr.1 mpl_pcx_gw_qemptier.stack.task1 mpl_pcx_gw_qemptier.stack.task0 mpl_pcx_gw_qemptier.timing.max0 mpl_pcx_gw_qemptier.timing.ove0 mpl_pcx_gw_qemptier.timing.runs mpl_pcx_gw_qemptier.timing.tas0 mpl_pcx_periodic.stack.isr.sta0 mpl_pcx_periodic.stack.isr.used mpl_pcx_periodic.stack.task.st0 mpl_pcx_periodic.stack.task.us0 mpl_pcx_periodic.timing.max_ta0 mpl_pcx_periodic.timing.overru0 mpl_pcx_periodic.timing.runs mpl_pcx_periodic.timing.task_t0 mpl_pcx_qemptier.stack.isr.sta0 mpl_pcx_qemptier.stack.isr.used mpl_pcx_qemptier.stack.task.st0 mpl_pcx_qemptier.stack.task.us0 mpl_pcx_qemptier.timing.max_ta0 mpl_pcx_qemptier.timing.overru0 mpl_pcx_qemptier.timing.runs mpl_pcx_qemptier.timing.task_t0 mpl_pdg_client.stack.isr.status mpl_pdg_client.stack.isr.used mpl_pdg_client.stack.task.stat0 mpl_pdg_client.stack.task.used mpl_pdg_client.timing.max_task0 mpl_pdg_client.timing.overruns mpl_pdg_client.timing.runs mpl_pdg_client.timing.task_time mpl_pdx_task.stack.isr.status mpl_pdx_task.stack.isr.used mpl_pdx_task.stack.task.status mpl_pdx_task.stack.task.used mpl_pdx_task.timing.max_task_t0 mpl_pdx_task.timing.overruns mpl_pdx_task.timing.runs mpl_pdx_task.timing.task_time mpl_pfc_periodic.stack.isr.sta0 mpl_pfc_periodic.stack.isr.used mpl_pfc_periodic.stack.task.st0 mpl_pfc_periodic.stack.task.us0 mpl_pfc_periodic.timing.max_ta0 mpl_pfc_periodic.timing.overru0 mpl_pfc_periodic.timing.runs mpl_pfc_periodic.timing.task_t0 mpl_pff_client.stack.isr.status mpl_pff_client.stack.isr.used mpl_pff_client.stack.task.stat0 mpl_pff_client.stack.task.used mpl_pff_client.timing.max_task0 mpl_pff_client.timing.overruns mpl_pff_client.timing.runs mpl_pff_client.timing.task_time mpl_pfs_client.stack.isr.status mpl_pfs_client.stack.isr.used mpl_pfs_client.stack.task.stat0 mpl_pfs_client.stack.task.used mpl_pfs_client.timing.max_task0 mpl_pfs_client.timing.overruns mpl_pfs_client.timing.runs mpl_pfs_client.timing.task_time mpl_piso_client.stack.isr.stat0 mpl_piso_client.stack.isr.used mpl_piso_client.stack.task.sta0 mpl_piso_client.stack.task.used mpl_piso_client.timing.max_tas0 mpl_piso_client.timing.overruns mpl_piso_client.timing.runs mpl_piso_client.timing.task_ti0 mpl_pj1939_client.stack.isr.st0 mpl_pj1939_client.stack.isr.us0 mpl_pj1939_client.stack.task.s0 mpl_pj1939_client.stack.task.u0 mpl_pj1939_client.timing.max_t0 mpl_pj1939_client.timing.overr0 mpl_pj1939_client.timing.runs mpl_pj1939_client.timing.task_0 /end LOC_MEASUREMENT
/end FUNCTION
/end MODULE
/end PROJECT
