ASAP2_VERSION 1 31
/begin PROJECT LaForge_CCU_TestApp "Test Application for LaForge TC367"
/begin HEADER "Dana" VERSION "0_3_1" /end HEADER
/begin MODULE OpenECU_TC367_001 ""
/* Scalar measurable for DDE 'V2gRxMsgBptCtrlChgMaxCrnt'. */
/begin MEASUREMENT V2gRxMsgBptCtrlChgMaxCrnt "Maximum current that the EVSE can deliver" FLOAT32_IEEE CU_V2GRXMSGBPTCTRLCHGMAXCRNT 1 100 -32768000.0 32767000.0 ECU_ADDRESS 0x700181d8 BYTE_ORDER MSB_LAST /end MEASUREMENT
/begin COMPU_METHOD CU_V2GRXMSGBPTCTRLCHGMAXCRNT "Conversion method for V2gRxMsgBptCtrlChgMaxCrnt" RAT_FUNC "%10.0" "A" COEFFS 0.000000 1.000000 -0.000000 0.000000 0.000000 1.000000 /end COMPU_METHOD
/* Scalar measurable for DDE 'V2gRxMsgBptCtrlChgMaxCrnt_flg'. */
/begin MEASUREMENT V2gRxMsgBptCtrlChgMaxCrnt_flg "Indicates that the EVSEMaximumCurrentLimit parameter is available." UBYTE CU_V2GRXMSGBPTCTRLCHGMAXCRNT_F0 1 100 0.0 1.0 ECU_ADDRESS 0x70018495 BYTE_ORDER MSB_LAST /end MEASUREMENT
/begin COMPU_METHOD CU_V2GRXMSGBPTCTRLCHGMAXCRNT_F0 "Conversion method for V2gRxMsgBptCtrlChgMaxCrnt_flg" RAT_FUNC "%10.0" "b" COEFFS 0.000000 1.000000 -0.000000 0.000000 0.000000 1.000000 /end COMPU_METHOD
/* Scalar measurable for DDE 'V2gRxMsgBptCtrlChgMaxPwr'. */
/begin MEASUREMENT V2gRxMsgBptCtrlChgMaxPwr "Maximum power the EVSE can deliver" FLOAT32_IEEE CU_V2GRXMSGBPTCTRLCHGMAXPWR 1 100 -32768000.0 32767000.0 ECU_ADDRESS 0x70018300 BYTE_ORDER MSB_LAST /end MEASUREMENT
/begin COMPU_METHOD CU_V2GRXMSGBPTCTRLCHGMAXPWR "Conversion method for V2gRxMsgBptCtrlChgMaxPwr" RAT_FUNC "%10.0" "W" COEFFS 0.000000 1.000000 -0.000000 0.000000 0.000000 1.000000 /end COMPU_METHOD
/* Scalar measurable for DDE 'V2gRxMsgBptCtrlChgMaxPwr_flg'. */
/begin MEASUREMENT V2gRxMsgBptCtrlChgMaxPwr_flg "Indicates that the EVSEMaximumPowerLimit parameter is available." UBYTE CU_V2GRXMSGBPTCTRLCHGMAXPWR_FLG 1 100 0.0 1.0 ECU_ADDRESS 0x70018162 BYTE_ORDER MSB_LAST /end MEASUREMENT
/begin COMPU_METHOD CU_V2GRXMSGBPTCTRLCHGMAXPWR_FLG "Conversion method for V2gRxMsgBptCtrlChgMaxPwr_flg" RAT_FUNC "%10.0" "b" COEFFS 0.000000 1.000000 -0.000000 0.000000 0.000000 1.000000 /end COMPU_METHOD
/* Scalar measurable for DDE 'V2gRxMsgBptCtrlCrntLimReached'. */
/begin MEASUREMENT V2gRxMsgBptCtrlCrntLimReached "If set to TRUE, the EVSE has reached its current limit." UBYTE CU_V2GRXMSGBPTCTRLCRNTLIMREACH0 1 100 0.0 1.0 ECU_ADDRESS 0x70017e34 BYTE_ORDER MSB_LAST /end MEASUREMENT
/begin COMPU_METHOD CU_V2GRXMSGBPTCTRLCRNTLIMREACH0 "Conversion method for V2gRxMsgBptCtrlCrntLimReached" RAT_FUNC "%10.0" "b" COEFFS 0.000000 1.000000 -0.000000 0.000000 0.000000 1.000000 /end COMPU_METHOD
/* Scalar measurable for DDE 'V2gRxMsgBptCtrlDchgMaxCrnt'. */
/begin MEASUREMENT V2gRxMsgBptCtrlDchgMaxCrnt "Maximum current discharge that the EVSE can deliver" FLOAT32_IEEE CU_V2GRXMSGBPTCTRLDCHGMAXCRNT 1 100 -32768000.0 32767000.0 ECU_ADDRESS 0x70018190 BYTE_ORDER MSB_LAST /end MEASUREMENT
/begin COMPU_METHOD CU_V2GRXMSGBPTCTRLDCHGMAXCRNT "Conversion method for V2gRxMsgBptCtrlDchgMaxCrnt" RAT_FUNC "%10.0" "A" COEFFS 0.000000 1.000000 -0.000000 0.000000 0.000000 1.000000 /end COMPU_METHOD
/* Scalar measurable for DDE 'V2gRxMsgBptCtrlDchgMaxCrntFlg'. */
/begin MEASUREMENT V2gRxMsgBptCtrlDchgMaxCrntFlg "Indicates that the EVSEMaximumDischargeCurrentLimit parameter is available." UBYTE CU_V2GRXMSGBPTCTRLDCHGMAXCRNTF0 1 100 0.0 1.0 ECU_ADDRESS 0x70018459 BYTE_ORDER MSB_LAST /end MEASUREMENT
/begin COMPU_METHOD CU_V2GRXMSGBPTCTRLDCHGMAXCRNTF0 "Conversion method for V2gRxMsgBptCtrlDchgMaxCrntFlg" RAT_FUNC "%10.0" "b" COEFFS 0.000000 1.000000 -0.000000 0.000000 0.000000 1.000000 /end COMPU_METHOD
/* Scalar measurable for DDE 'V2gRxMsgBptCtrlDchgMaxPwr'. */
/begin MEASUREMENT V2gRxMsgBptCtrlDchgMaxPwr "Maximum power discharge that the EVSE can deliver" FLOAT32_IEEE CU_V2GRXMSGBPTCTRLDCHGMAXPWR 1 100 -32768000.0 32767000.0 ECU_ADDRESS 0x70017e44 BYTE_ORDER MSB_LAST /end MEASUREMENT
/begin COMPU_METHOD CU_V2GRXMSGBPTCTRLDCHGMAXPWR "Conversion method for V2gRxMsgBptCtrlDchgMaxPwr" RAT_FUNC "%10.0" "W" COEFFS 0.000000 1.000000 -0.000000 0.000000 0.000000 1.000000 /end COMPU_METHOD
/* Scalar measurable for DDE 'V2gRxMsgBptCtrlDchgMaxPwr_flg'. */
/begin MEASUREMENT V2gRxMsgBptCtrlDchgMaxPwr_flg "Indicates that the EVSEMaximumDischargePowerLimit parameter is available." UBYTE CU_V2GRXMSGBPTCTRLDCHGMAXPWR_F0 1 100 0.0 1.0 ECU_ADDRESS 0x70017c85 BYTE_ORDER MSB_LAST /end MEASUREMENT
/begin COMPU_METHOD CU_V2GRXMSGBPTCTRLDCHGMAXPWR_F0 "Conversion method for V2gRxMsgBptCtrlDchgMaxPwr_flg" RAT_FUNC "%10.0" "b" COEFFS 0.000000 1.000000 -0.000000 0.000000 0.000000 1.000000 /end COMPU_METHOD
/* Scalar measurable for DDE 'V2gRxMsgBptCtrlEvseCurrent'. */
/begin MEASUREMENT V2gRxMsgBptCtrlEvseCurrent "Present output current of the EVSE." FLOAT32_IEEE CU_V2GRXMSGBPTCTRLEVSECURRENT 1 100 -32768000.0 32767000.0 ECU_ADDRESS 0x700183a4 BYTE_ORDER MSB_LAST /end MEASUREMENT
/begin COMPU_METHOD CU_V2GRXMSGBPTCTRLEVSECURRENT "Conversion method for V2gRxMsgBptCtrlEvseCurrent" RAT_FUNC "%10.0" "A" COEFFS 0.000000 1.000000 -0.000000 0.000000 0.000000 1.000000 /end COMPU_METHOD
/* Scalar measurable for DDE 'V2gRxMsgBptCtrlEvseIdLen'. */
/begin MEASUREMENT V2gRxMsgBptCtrlEvseIdLen "Number of bytes in EVSE ID" UBYTE CU_V2GRXMSGBPTCTRLEVSEIDLEN 1 100 0.0 37.0 ECU_ADDRESS 0x700183c4 BYTE_ORDER MSB_LAST /end MEASUREMENT
/begin COMPU_METHOD CU_V2GRXMSGBPTCTRLEVSEIDLEN "Conversion method for V2gRxMsgBptCtrlEvseIdLen" RAT_FUNC "%10.0" "1" COEFFS 0.000000 1.000000 -0.000000 0.000000 0.000000 1.000000 /end COMPU_METHOD
/* Scalar measurable for DDE 'V2gRxMsgBptCtrlEvseId[0]'. */
/begin MEASUREMENT V2gRxMsgBptCtrlEvseId[0] "The ID that uniquely identifies the EVSE. Format is defined in DIN SPEC 91286" UBYTE CU_V2GRXMSGBPTCTRLEVSEID[0] 1 100 0.0 255.0 ECU_ADDRESS 0x7001811c BYTE_ORDER MSB_LAST /end MEASUREMENT
/begin COMPU_METHOD CU_V2GRXMSGBPTCTRLEVSEID[0] "Conversion method for V2gRxMsgBptCtrlEvseId[0]" RAT_FUNC "%10.0" "1" COEFFS 0.000000 1.000000 -0.000000 0.000000 0.000000 1.000000 /end COMPU_METHOD
/* Scalar measurable for DDE 'V2gRxMsgBptCtrlEvseId[10]'. */
/begin MEASUREMENT V2gRxMsgBptCtrlEvseId[10] "The ID that uniquely identifies the EVSE. Format is defined in DIN SPEC 91286" UBYTE CU_V2GRXMSGBPTCTRLEVSEID[10] 1 100 0.0 255.0 ECU_ADDRESS 0x70018126 BYTE_ORDER MSB_LAST /end MEASUREMENT
/begin COMPU_METHOD CU_V2GRXMSGBPTCTRLEVSEID[10] "Conversion method for V2gRxMsgBptCtrlEvseId[10]" RAT_FUNC "%10.0" "1" COEFFS 0.000000 1.000000 -0.000000 0.000000 0.000000 1.000000 /end COMPU_METHOD
/* Scalar measurable for DDE 'V2gRxMsgBptCtrlEvseId[11]'. */
/begin MEASUREMENT V2gRxMsgBptCtrlEvseId[11] "The ID that uniquely identifies the EVSE. Format is defined in DIN SPEC 91286" UBYTE CU_V2GRXMSGBPTCTRLEVSEID[11] 1 100 0.0 255.0 ECU_ADDRESS 0x70018127 BYTE_ORDER MSB_LAST /end MEASUREMENT
/begin COMPU_METHOD CU_V2GRXMSGBPTCTRLEVSEID[11] "Conversion method for V2gRxMsgBptCtrlEvseId[11]" RAT_FUNC "%10.0" "1" COEFFS 0.000000 1.000000 -0.000000 0.000000 0.000000 1.000000 /end COMPU_METHOD
/* Scalar measurable for DDE 'V2gRxMsgBptCtrlEvseId[12]'. */
/begin MEASUREMENT V2gRxMsgBptCtrlEvseId[12] "The ID that uniquely identifies the EVSE. Format is defined in DIN SPEC 91286" UBYTE CU_V2GRXMSGBPTCTRLEVSEID[12] 1 100 0.0 255.0 ECU_ADDRESS 0x70018128 BYTE_ORDER MSB_LAST /end MEASUREMENT
/begin COMPU_METHOD CU_V2GRXMSGBPTCTRLEVSEID[12] "Conversion method for V2gRxMsgBptCtrlEvseId[12]" RAT_FUNC "%10.0" "1" COEFFS 0.000000 1.000000 -0.000000 0.000000 0.000000 1.000000 /end COMPU_METHOD
/* Scalar measurable for DDE 'V2gRxMsgBptCtrlEvseId[13]'. */
/begin MEASUREMENT V2gRxMsgBptCtrlEvseId[13] "The ID that uniquely identifies the EVSE. Format is defined in DIN SPEC 91286" UBYTE CU_V2GRXMSGBPTCTRLEVSEID[13] 1 100 0.0 255.0 ECU_ADDRESS 0x70018129 BYTE_ORDER MSB_LAST /end MEASUREMENT
/begin COMPU_METHOD CU_V2GRXMSGBPTCTRLEVSEID[13] "Conversion method for V2gRxMsgBptCtrlEvseId[13]" RAT_FUNC "%10.0" "1" COEFFS 0.000000 1.000000 -0.000000 0.000000 0.000000 1.000000 /end COMPU_METHOD
/* Scalar measurable for DDE 'V2gRxMsgBptCtrlEvseId[14]'. */
/begin MEASUREMENT V2gRxMsgBptCtrlEvseId[14] "The ID that uniquely identifies the EVSE. Format is defined in DIN SPEC 91286" UBYTE CU_V2GRXMSGBPTCTRLEVSEID[14] 1 100 0.0 255.0 ECU_ADDRESS 0x7001812a BYTE_ORDER MSB_LAST /end MEASUREMENT
/begin COMPU_METHOD CU_V2GRXMSGBPTCTRLEVSEID[14] "Conversion method for V2gRxMsgBptCtrlEvseId[14]" RAT_FUNC "%10.0" "1" COEFFS 0.000000 1.000000 -0.000000 0.000000 0.000000 1.000000 /end COMPU_METHOD
/* Scalar measurable for DDE 'V2gRxMsgBptCtrlEvseId[15]'. */
/begin MEASUREMENT V2gRxMsgBptCtrlEvseId[15] "The ID that uniquely identifies the EVSE. Format is defined in DIN SPEC 91286" UBYTE CU_V2GRXMSGBPTCTRLEVSEID[15] 1 100 0.0 255.0 ECU_ADDRESS 0x7001812b BYTE_ORDER MSB_LAST /end MEASUREMENT
/begin COMPU_METHOD CU_V2GRXMSGBPTCTRLEVSEID[15] "Conversion method for V2gRxMsgBptCtrlEvseId[15]" RAT_FUNC "%10.0" "1" COEFFS 0.000000 1.000000 -0.000000 0.000000 0.000000 1.000000 /end COMPU_METHOD
/* Scalar measurable for DDE 'V2gRxMsgBptCtrlEvseId[16]'. */
/begin MEASUREMENT V2gRxMsgBptCtrlEvseId[16] "The ID that uniquely identifies the EVSE. Format is defined in DIN SPEC 91286" UBYTE CU_V2GRXMSGBPTCTRLEVSEID[16] 1 100 0.0 255.0 ECU_ADDRESS 0x7001812c BYTE_ORDER MSB_LAST /end MEASUREMENT
/begin COMPU_METHOD CU_V2GRXMSGBPTCTRLEVSEID[16] "Conversion method for V2gRxMsgBptCtrlEvseId[16]" RAT_FUNC "%10.0" "1" COEFFS 0.000000 1.000000 -0.000000 0.000000 0.000000 1.000000 /end COMPU_METHOD
/* Scalar measurable for DDE 'V2gRxMsgBptCtrlEvseId[17]'. */
/begin MEASUREMENT V2gRxMsgBptCtrlEvseId[17] "The ID that uniquely identifies the EVSE. Format is defined in DIN SPEC 91286" UBYTE CU_V2GRXMSGBPTCTRLEVSEID[17] 1 100 0.0 255.0 ECU_ADDRESS 0x7001812d BYTE_ORDER MSB_LAST /end MEASUREMENT
/begin COMPU_METHOD CU_V2GRXMSGBPTCTRLEVSEID[17] "Conversion method for V2gRxMsgBptCtrlEvseId[17]" RAT_FUNC "%10.0" "1" COEFFS 0.000000 1.000000 -0.000000 0.000000 0.000000 1.000000 /end COMPU_METHOD
/* Scalar measurable for DDE 'V2gRxMsgBptCtrlEvseId[18]'. */
/begin MEASUREMENT V2gRxMsgBptCtrlEvseId[18] "The ID that uniquely identifies the EVSE. Format is defined in DIN SPEC 91286" UBYTE CU_V2GRXMSGBPTCTRLEVSEID[18] 1 100 0.0 255.0 ECU_ADDRESS 0x7001812e BYTE_ORDER MSB_LAST /end MEASUREMENT
/begin COMPU_METHOD CU_V2GRXMSGBPTCTRLEVSEID[18] "Conversion method for V2gRxMsgBptCtrlEvseId[18]" RAT_FUNC "%10.0" "1" COEFFS 0.000000 1.000000 -0.000000 0.000000 0.000000 1.000000 /end COMPU_METHOD
/* Scalar measurable for DDE 'V2gRxMsgBptCtrlEvseId[19]'. */
/begin MEASUREMENT V2gRxMsgBptCtrlEvseId[19] "The ID that uniquely identifies the EVSE. Format is defined in DIN SPEC 91286" UBYTE CU_V2GRXMSGBPTCTRLEVSEID[19] 1 100 0.0 255.0 ECU_ADDRESS 0x7001812f BYTE_ORDER MSB_LAST /end MEASUREMENT
/begin COMPU_METHOD CU_V2GRXMSGBPTCTRLEVSEID[19] "Conversion method for V2gRxMsgBptCtrlEvseId[19]" RAT_FUNC "%10.0" "1" COEFFS 0.000000 1.000000 -0.000000 0.000000 0.000000 1.000000 /end COMPU_METHOD
/* Scalar measurable for DDE 'V2gRxMsgBptCtrlEvseId[1]'. */
/begin MEASUREMENT V2gRxMsgBptCtrlEvseId[1] "The ID that uniquely identifies the EVSE. Format is defined in DIN SPEC 91286" UBYTE CU_V2GRXMSGBPTCTRLEVSEID[1] 1 100 0.0 255.0 ECU_ADDRESS 0x7001811d BYTE_ORDER MSB_LAST /end MEASUREMENT
/begin COMPU_METHOD CU_V2GRXMSGBPTCTRLEVSEID[1] "Conversion method for V2gRxMsgBptCtrlEvseId[1]" RAT_FUNC "%10.0" "1" COEFFS 0.000000 1.000000 -0.000000 0.000000 0.000000 1.000000 /end COMPU_METHOD
/* Scalar measurable for DDE 'V2gRxMsgBptCtrlEvseId[20]'. */
/begin MEASUREMENT V2gRxMsgBptCtrlEvseId[20] "The ID that uniquely identifies the EVSE. Format is defined in DIN SPEC 91286" UBYTE CU_V2GRXMSGBPTCTRLEVSEID[20] 1 100 0.0 255.0 ECU_ADDRESS 0x70018130 BYTE_ORDER MSB_LAST /end MEASUREMENT
/begin COMPU_METHOD CU_V2GRXMSGBPTCTRLEVSEID[20] "Conversion method for V2gRxMsgBptCtrlEvseId[20]" RAT_FUNC "%10.0" "1" COEFFS 0.000000 1.000000 -0.000000 0.000000 0.000000 1.000000 /end COMPU_METHOD
/* Scalar measurable for DDE 'V2gRxMsgBptCtrlEvseId[21]'. */
/begin MEASUREMENT V2gRxMsgBptCtrlEvseId[21] "The ID that uniquely identifies the EVSE. Format is defined in DIN SPEC 91286" UBYTE CU_V2GRXMSGBPTCTRLEVSEID[21] 1 100 0.0 255.0 ECU_ADDRESS 0x70018131 BYTE_ORDER MSB_LAST /end MEASUREMENT
/begin COMPU_METHOD CU_V2GRXMSGBPTCTRLEVSEID[21] "Conversion method for V2gRxMsgBptCtrlEvseId[21]" RAT_FUNC "%10.0" "1" COEFFS 0.000000 1.000000 -0.000000 0.000000 0.000000 1.000000 /end COMPU_METHOD
/* Scalar measurable for DDE 'V2gRxMsgBptCtrlEvseId[22]'. */
/begin MEASUREMENT V2gRxMsgBptCtrlEvseId[22] "The ID that uniquely identifies the EVSE. Format is defined in DIN SPEC 91286" UBYTE CU_V2GRXMSGBPTCTRLEVSEID[22] 1 100 0.0 255.0 ECU_ADDRESS 0x70018132 BYTE_ORDER MSB_LAST /end MEASUREMENT
/begin COMPU_METHOD CU_V2GRXMSGBPTCTRLEVSEID[22] "Conversion method for V2gRxMsgBptCtrlEvseId[22]" RAT_FUNC "%10.0" "1" COEFFS 0.000000 1.000000 -0.000000 0.000000 0.000000 1.000000 /end COMPU_METHOD
/* Scalar measurable for DDE 'V2gRxMsgBptCtrlEvseId[23]'. */
/begin MEASUREMENT V2gRxMsgBptCtrlEvseId[23] "The ID that uniquely identifies the EVSE. Format is defined in DIN SPEC 91286" UBYTE CU_V2GRXMSGBPTCTRLEVSEID[23] 1 100 0.0 255.0 ECU_ADDRESS 0x70018133 BYTE_ORDER MSB_LAST /end MEASUREMENT
/begin COMPU_METHOD CU_V2GRXMSGBPTCTRLEVSEID[23] "Conversion method for V2gRxMsgBptCtrlEvseId[23]" RAT_FUNC "%10.0" "1" COEFFS 0.000000 1.000000 -0.000000 0.000000 0.000000 1.000000 /end COMPU_METHOD
/* Scalar measurable for DDE 'V2gRxMsgBptCtrlEvseId[24]'. */
/begin MEASUREMENT V2gRxMsgBptCtrlEvseId[24] "The ID that uniquely identifies the EVSE. Format is defined in DIN SPEC 91286" UBYTE CU_V2GRXMSGBPTCTRLEVSEID[24] 1 100 0.0 255.0 ECU_ADDRESS 0x70018134 BYTE_ORDER MSB_LAST /end MEASUREMENT
/begin COMPU_METHOD CU_V2GRXMSGBPTCTRLEVSEID[24] "Conversion method for V2gRxMsgBptCtrlEvseId[24]" RAT_FUNC "%10.0" "1" COEFFS 0.000000 1.000000 -0.000000 0.000000 0.000000 1.000000 /end COMPU_METHOD
/* Scalar measurable for DDE 'V2gRxMsgBptCtrlEvseId[25]'. */
/begin MEASUREMENT V2gRxMsgBptCtrlEvseId[25] "The ID that uniquely identifies the EVSE. Format is defined in DIN SPEC 91286" UBYTE CU_V2GRXMSGBPTCTRLEVSEID[25] 1 100 0.0 255.0 ECU_ADDRESS 0x70018135 BYTE_ORDER MSB_LAST /end MEASUREMENT
/begin COMPU_METHOD CU_V2GRXMSGBPTCTRLEVSEID[25] "Conversion method for V2gRxMsgBptCtrlEvseId[25]" RAT_FUNC "%10.0" "1" COEFFS 0.000000 1.000000 -0.000000 0.000000 0.000000 1.000000 /end COMPU_METHOD
/* Scalar measurable for DDE 'V2gRxMsgBptCtrlEvseId[26]'. */
/begin MEASUREMENT V2gRxMsgBptCtrlEvseId[26] "The ID that uniquely identifies the EVSE. Format is defined in DIN SPEC 91286" UBYTE CU_V2GRXMSGBPTCTRLEVSEID[26] 1 100 0.0 255.0 ECU_ADDRESS 0x70018136 BYTE_ORDER MSB_LAST /end MEASUREMENT
/begin COMPU_METHOD CU_V2GRXMSGBPTCTRLEVSEID[26] "Conversion method for V2gRxMsgBptCtrlEvseId[26]" RAT_FUNC "%10.0" "1" COEFFS 0.000000 1.000000 -0.000000 0.000000 0.000000 1.000000 /end COMPU_METHOD
/* Scalar measurable for DDE 'V2gRxMsgBptCtrlEvseId[27]'. */
/begin MEASUREMENT V2gRxMsgBptCtrlEvseId[27] "The ID that uniquely identifies the EVSE. Format is defined in DIN SPEC 91286" UBYTE CU_V2GRXMSGBPTCTRLEVSEID[27] 1 100 0.0 255.0 ECU_ADDRESS 0x70018137 BYTE_ORDER MSB_LAST /end MEASUREMENT
/begin COMPU_METHOD CU_V2GRXMSGBPTCTRLEVSEID[27] "Conversion method for V2gRxMsgBptCtrlEvseId[27]" RAT_FUNC "%10.0" "1" COEFFS 0.000000 1.000000 -0.000000 0.000000 0.000000 1.000000 /end COMPU_METHOD
/* Scalar measurable for DDE 'V2gRxMsgBptCtrlEvseId[28]'. */
/begin MEASUREMENT V2gRxMsgBptCtrlEvseId[28] "The ID that uniquely identifies the EVSE. Format is defined in DIN SPEC 91286" UBYTE CU_V2GRXMSGBPTCTRLEVSEID[28] 1 100 0.0 255.0 ECU_ADDRESS 0x70018138 BYTE_ORDER MSB_LAST /end MEASUREMENT
/begin COMPU_METHOD CU_V2GRXMSGBPTCTRLEVSEID[28] "Conversion method for V2gRxMsgBptCtrlEvseId[28]" RAT_FUNC "%10.0" "1" COEFFS 0.000000 1.000000 -0.000000 0.000000 0.000000 1.000000 /end COMPU_METHOD
/* Scalar measurable for DDE 'V2gRxMsgBptCtrlEvseId[29]'. */
/begin MEASUREMENT V2gRxMsgBptCtrlEvseId[29] "The ID that uniquely identifies the EVSE. Format is defined in DIN SPEC 91286" UBYTE CU_V2GRXMSGBPTCTRLEVSEID[29] 1 100 0.0 255.0 ECU_ADDRESS 0x70018139 BYTE_ORDER MSB_LAST /end MEASUREMENT
/begin COMPU_METHOD CU_V2GRXMSGBPTCTRLEVSEID[29] "Conversion method for V2gRxMsgBptCtrlEvseId[29]" RAT_FUNC "%10.0" "1" COEFFS 0.000000 1.000000 -0.000000 0.000000 0.000000 1.000000 /end COMPU_METHOD
/* Scalar measurable for DDE 'V2gRxMsgBptCtrlEvseId[2]'. */
/begin MEASUREMENT V2gRxMsgBptCtrlEvseId[2] "The ID that uniquely identifies the EVSE. Format is defined in DIN SPEC 91286" UBYTE CU_V2GRXMSGBPTCTRLEVSEID[2] 1 100 0.0 255.0 ECU_ADDRESS 0x7001811e BYTE_ORDER MSB_LAST /end MEASUREMENT
/begin COMPU_METHOD CU_V2GRXMSGBPTCTRLEVSEID[2] "Conversion method for V2gRxMsgBptCtrlEvseId[2]" RAT_FUNC "%10.0" "1" COEFFS 0.000000 1.000000 -0.000000 0.000000 0.000000 1.000000 /end COMPU_METHOD
/* Scalar measurable for DDE 'V2gRxMsgBptCtrlEvseId[30]'. */
/begin MEASUREMENT V2gRxMsgBptCtrlEvseId[30] "The ID that uniquely identifies the EVSE. Format is defined in DIN SPEC 91286" UBYTE CU_V2GRXMSGBPTCTRLEVSEID[30] 1 100 0.0 255.0 ECU_ADDRESS 0x7001813a BYTE_ORDER MSB_LAST /end MEASUREMENT
/begin COMPU_METHOD CU_V2GRXMSGBPTCTRLEVSEID[30] "Conversion method for V2gRxMsgBptCtrlEvseId[30]" RAT_FUNC "%10.0" "1" COEFFS 0.000000 1.000000 -0.000000 0.000000 0.000000 1.000000 /end COMPU_METHOD
/* Scalar measurable for DDE 'V2gRxMsgBptCtrlEvseId[31]'. */
/begin MEASUREMENT V2gRxMsgBptCtrlEvseId[31] "The ID that uniquely identifies the EVSE. Format is defined in DIN SPEC 91286" UBYTE CU_V2GRXMSGBPTCTRLEVSEID[31] 1 100 0.0 255.0 ECU_ADDRESS 0x7001813b BYTE_ORDER MSB_LAST /end MEASUREMENT
/begin COMPU_METHOD CU_V2GRXMSGBPTCTRLEVSEID[31] "Conversion method for V2gRxMsgBptCtrlEvseId[31]" RAT_FUNC "%10.0" "1" COEFFS 0.000000 1.000000 -0.000000 0.000000 0.000000 1.000000 /end COMPU_METHOD
/* Scalar measurable for DDE 'V2gRxMsgBptCtrlEvseId[32]'. */
/begin MEASUREMENT V2gRxMsgBptCtrlEvseId[32] "The ID that uniquely identifies the EVSE. Format is defined in DIN SPEC 91286" UBYTE CU_V2GRXMSGBPTCTRLEVSEID[32] 1 100 0.0 255.0 ECU_ADDRESS 0x7001813c BYTE_ORDER MSB_LAST /end MEASUREMENT
/begin COMPU_METHOD CU_V2GRXMSGBPTCTRLEVSEID[32] "Conversion method for V2gRxMsgBptCtrlEvseId[32]" RAT_FUNC "%10.0" "1" COEFFS 0.000000 1.000000 -0.000000 0.000000 0.000000 1.000000 /end COMPU_METHOD
/* Scalar measurable for DDE 'V2gRxMsgBptCtrlEvseId[33]'. */
/begin MEASUREMENT V2gRxMsgBptCtrlEvseId[33] "The ID that uniquely identifies the EVSE. Format is defined in DIN SPEC 91286" UBYTE CU_V2GRXMSGBPTCTRLEVSEID[33] 1 100 0.0 255.0 ECU_ADDRESS 0x7001813d BYTE_ORDER MSB_LAST /end MEASUREMENT
/begin COMPU_METHOD CU_V2GRXMSGBPTCTRLEVSEID[33] "Conversion method for V2gRxMsgBptCtrlEvseId[33]" RAT_FUNC "%10.0" "1" COEFFS 0.000000 1.000000 -0.000000 0.000000 0.000000 1.000000 /end COMPU_METHOD
/* Scalar measurable for DDE 'V2gRxMsgBptCtrlEvseId[34]'. */
/begin MEASUREMENT V2gRxMsgBptCtrlEvseId[34] "The ID that uniquely identifies the EVSE. Format is defined in DIN SPEC 91286" UBYTE CU_V2GRXMSGBPTCTRLEVSEID[34] 1 100 0.0 255.0 ECU_ADDRESS 0x7001813e BYTE_ORDER MSB_LAST /end MEASUREMENT
/begin COMPU_METHOD CU_V2GRXMSGBPTCTRLEVSEID[34] "Conversion method for V2gRxMsgBptCtrlEvseId[34]" RAT_FUNC "%10.0" "1" COEFFS 0.000000 1.000000 -0.000000 0.000000 0.000000 1.000000 /end COMPU_METHOD
/* Scalar measurable for DDE 'V2gRxMsgBptCtrlEvseId[35]'. */
/begin MEASUREMENT V2gRxMsgBptCtrlEvseId[35] "The ID that uniquely identifies the EVSE. Format is defined in DIN SPEC 91286" UBYTE CU_V2GRXMSGBPTCTRLEVSEID[35] 1 100 0.0 255.0 ECU_ADDRESS 0x7001813f BYTE_ORDER MSB_LAST /end MEASUREMENT
/begin COMPU_METHOD CU_V2GRXMSGBPTCTRLEVSEID[35] "Conversion method for V2gRxMsgBptCtrlEvseId[35]" RAT_FUNC "%10.0" "1" COEFFS 0.000000 1.000000 -0.000000 0.000000 0.000000 1.000000 /end COMPU_METHOD
/* Scalar measurable for DDE 'V2gRxMsgBptCtrlEvseId[36]'. */
/begin MEASUREMENT V2gRxMsgBptCtrlEvseId[36] "The ID that uniquely identifies the EVSE. Format is defined in DIN SPEC 91286" UBYTE CU_V2GRXMSGBPTCTRLEVSEID[36] 1 100 0.0 255.0 ECU_ADDRESS 0x70018140 BYTE_ORDER MSB_LAST /end MEASUREMENT
/begin COMPU_METHOD CU_V2GRXMSGBPTCTRLEVSEID[36] "Conversion method for V2gRxMsgBptCtrlEvseId[36]" RAT_FUNC "%10.0" "1" COEFFS 0.000000 1.000000 -0.000000 0.000000 0.000000 1.000000 /end COMPU_METHOD
/* Scalar measurable for DDE 'V2gRxMsgBptCtrlEvseId[37]'. */
/begin MEASUREMENT V2gRxMsgBptCtrlEvseId[37] "The ID that uniquely identifies the EVSE. Format is defined in DIN SPEC 91286" UBYTE CU_V2GRXMSGBPTCTRLEVSEID[37] 1 100 0.0 255.0 ECU_ADDRESS 0x70018141 BYTE_ORDER MSB_LAST /end MEASUREMENT
/begin COMPU_METHOD CU_V2GRXMSGBPTCTRLEVSEID[37] "Conversion method for V2gRxMsgBptCtrlEvseId[37]" RAT_FUNC "%10.0" "1" COEFFS 0.000000 1.000000 -0.000000 0.000000 0.000000 1.000000 /end COMPU_METHOD
/* Scalar measurable for DDE 'V2gRxMsgBptCtrlEvseId[3]'. */
/begin MEASUREMENT V2gRxMsgBptCtrlEvseId[3] "The ID that uniquely identifies the EVSE. Format is defined in DIN SPEC 91286" UBYTE CU_V2GRXMSGBPTCTRLEVSEID[3] 1 100 0.0 255.0 ECU_ADDRESS 0x7001811f BYTE_ORDER MSB_LAST /end MEASUREMENT
/begin COMPU_METHOD CU_V2GRXMSGBPTCTRLEVSEID[3] "Conversion method for V2gRxMsgBptCtrlEvseId[3]" RAT_FUNC "%10.0" "1" COEFFS 0.000000 1.000000 -0.000000 0.000000 0.000000 1.000000 /end COMPU_METHOD
/* Scalar measurable for DDE 'V2gRxMsgBptCtrlEvseId[4]'. */
/begin MEASUREMENT V2gRxMsgBptCtrlEvseId[4] "The ID that uniquely identifies the EVSE. Format is defined in DIN SPEC 91286" UBYTE CU_V2GRXMSGBPTCTRLEVSEID[4] 1 100 0.0 255.0 ECU_ADDRESS 0x70018120 BYTE_ORDER MSB_LAST /end MEASUREMENT
/begin COMPU_METHOD CU_V2GRXMSGBPTCTRLEVSEID[4] "Conversion method for V2gRxMsgBptCtrlEvseId[4]" RAT_FUNC "%10.0" "1" COEFFS 0.000000 1.000000 -0.000000 0.000000 0.000000 1.000000 /end COMPU_METHOD
/* Scalar measurable for DDE 'V2gRxMsgBptCtrlEvseId[5]'. */
/begin MEASUREMENT V2gRxMsgBptCtrlEvseId[5] "The ID that uniquely identifies the EVSE. Format is defined in DIN SPEC 91286" UBYTE CU_V2GRXMSGBPTCTRLEVSEID[5] 1 100 0.0 255.0 ECU_ADDRESS 0x70018121 BYTE_ORDER MSB_LAST /end MEASUREMENT
/begin COMPU_METHOD CU_V2GRXMSGBPTCTRLEVSEID[5] "Conversion method for V2gRxMsgBptCtrlEvseId[5]" RAT_FUNC "%10.0" "1" COEFFS 0.000000 1.000000 -0.000000 0.000000 0.000000 1.000000 /end COMPU_METHOD
/* Scalar measurable for DDE 'V2gRxMsgBptCtrlEvseId[6]'. */
/begin MEASUREMENT V2gRxMsgBptCtrlEvseId[6] "The ID that uniquely identifies the EVSE. Format is defined in DIN SPEC 91286" UBYTE CU_V2GRXMSGBPTCTRLEVSEID[6] 1 100 0.0 255.0 ECU_ADDRESS 0x70018122 BYTE_ORDER MSB_LAST /end MEASUREMENT
/begin COMPU_METHOD CU_V2GRXMSGBPTCTRLEVSEID[6] "Conversion method for V2gRxMsgBptCtrlEvseId[6]" RAT_FUNC "%10.0" "1" COEFFS 0.000000 1.000000 -0.000000 0.000000 0.000000 1.000000 /end COMPU_METHOD
/* Scalar measurable for DDE 'V2gRxMsgBptCtrlEvseId[7]'. */
/begin MEASUREMENT V2gRxMsgBptCtrlEvseId[7] "The ID that uniquely identifies the EVSE. Format is defined in DIN SPEC 91286" UBYTE CU_V2GRXMSGBPTCTRLEVSEID[7] 1 100 0.0 255.0 ECU_ADDRESS 0x70018123 BYTE_ORDER MSB_LAST /end MEASUREMENT
/begin COMPU_METHOD CU_V2GRXMSGBPTCTRLEVSEID[7] "Conversion method for V2gRxMsgBptCtrlEvseId[7]" RAT_FUNC "%10.0" "1" COEFFS 0.000000 1.000000 -0.000000 0.000000 0.000000 1.000000 /end COMPU_METHOD
/* Scalar measurable for DDE 'V2gRxMsgBptCtrlEvseId[8]'. */
/begin MEASUREMENT V2gRxMsgBptCtrlEvseId[8] "The ID that uniquely identifies the EVSE. Format is defined in DIN SPEC 91286" UBYTE CU_V2GRXMSGBPTCTRLEVSEID[8] 1 100 0.0 255.0 ECU_ADDRESS 0x70018124 BYTE_ORDER MSB_LAST /end MEASUREMENT
/begin COMPU_METHOD CU_V2GRXMSGBPTCTRLEVSEID[8] "Conversion method for V2gRxMsgBptCtrlEvseId[8]" RAT_FUNC "%10.0" "1" COEFFS 0.000000 1.000000 -0.000000 0.000000 0.000000 1.000000 /end COMPU_METHOD
/* Scalar measurable for DDE 'V2gRxMsgBptCtrlEvseId[9]'. */
/begin MEASUREMENT V2gRxMsgBptCtrlEvseId[9] "The ID that uniquely identifies the EVSE. Format is defined in DIN SPEC 91286" UBYTE CU_V2GRXMSGBPTCTRLEVSEID[9] 1 100 0.0 255.0 ECU_ADDRESS 0x70018125 BYTE_ORDER MSB_LAST /end MEASUREMENT
/begin COMPU_METHOD CU_V2GRXMSGBPTCTRLEVSEID[9] "Conversion method for V2gRxMsgBptCtrlEvseId[9]" RAT_FUNC "%10.0" "1" COEFFS 0.000000 1.000000 -0.000000 0.000000 0.000000 1.000000 /end COMPU_METHOD
/* Scalar measurable for DDE 'V2gRxMsgBptCtrlEvseMaxVolt'. */
/begin MEASUREMENT V2gRxMsgBptCtrlEvseMaxVolt "Maximum voltage the EVSE can deliver" FLOAT32_IEEE CU_V2GRXMSGBPTCTRLEVSEMAXVOLT 1 100 -32768000.0 32767000.0 ECU_ADDRESS 0x70017df0 BYTE_ORDER MSB_LAST /end MEASUREMENT
/begin COMPU_METHOD CU_V2GRXMSGBPTCTRLEVSEMAXVOLT "Conversion method for V2gRxMsgBptCtrlEvseMaxVolt" RAT_FUNC "%10.0" "V" COEFFS 0.000000 1.000000 -0.000000 0.000000 0.000000 1.000000 /end COMPU_METHOD
/* Scalar measurable for DDE 'V2gRxMsgBptCtrlEvseMaxVoltFlg'. */
/begin MEASUREMENT V2gRxMsgBptCtrlEvseMaxVoltFlg "Indicates that the EVSEMaximumVoltage parameter is available." UBYTE CU_V2GRXMSGBPTCTRLEVSEMAXVOLTF0 1 100 0.0 1.0 ECU_ADDRESS 0x70017c2e BYTE_ORDER MSB_LAST /end MEASUREMENT
/begin COMPU_METHOD CU_V2GRXMSGBPTCTRLEVSEMAXVOLTF0 "Conversion method for V2gRxMsgBptCtrlEvseMaxVoltFlg" RAT_FUNC "%10.0" "b" COEFFS 0.000000 1.000000 -0.000000 0.000000 0.000000 1.000000 /end COMPU_METHOD
/* Scalar measurable for DDE 'V2gRxMsgBptCtrlEvseMinVolt'. */
/begin MEASUREMENT V2gRxMsgBptCtrlEvseMinVolt "Maximum voltage the EVSE can deliver" FLOAT32_IEEE CU_V2GRXMSGBPTCTRLEVSEMINVOLT 1 100 -32768000.0 32767000.0 ECU_ADDRESS 0x7001835c BYTE_ORDER MSB_LAST /end MEASUREMENT
/begin COMPU_METHOD CU_V2GRXMSGBPTCTRLEVSEMINVOLT "Conversion method for V2gRxMsgBptCtrlEvseMinVolt" RAT_FUNC "%10.0" "V" COEFFS 0.000000 1.000000 -0.000000 0.000000 0.000000 1.000000 /end COMPU_METHOD
/* Scalar measurable for DDE 'V2gRxMsgBptCtrlEvseMinVoltFlg'. */
/begin MEASUREMENT V2gRxMsgBptCtrlEvseMinVoltFlg "Indicates that the EVSEMaximumVoltage parameter is available." UBYTE CU_V2GRXMSGBPTCTRLEVSEMINVOLTF0 1 100 0.0 1.0 ECU_ADDRESS 0x700181aa BYTE_ORDER MSB_LAST /end MEASUREMENT
/begin COMPU_METHOD CU_V2GRXMSGBPTCTRLEVSEMINVOLTF0 "Conversion method for V2gRxMsgBptCtrlEvseMinVoltFlg" RAT_FUNC "%10.0" "b" COEFFS 0.000000 1.000000 -0.000000 0.000000 0.000000 1.000000 /end COMPU_METHOD
/* Scalar measurable for DDE 'V2gRxMsgBptCtrlEvseVoltage'. */
/begin MEASUREMENT V2gRxMsgBptCtrlEvseVoltage "Present voltage of EVSE" FLOAT32_IEEE CU_V2GRXMSGBPTCTRLEVSEVOLTAGE 1 100 -32768000.0 32767000.0 ECU_ADDRESS 0x70017e8c BYTE_ORDER MSB_LAST /end MEASUREMENT
/begin COMPU_METHOD CU_V2GRXMSGBPTCTRLEVSEVOLTAGE "Conversion method for V2gRxMsgBptCtrlEvseVoltage" RAT_FUNC "%10.0" "V" COEFFS 0.000000 1.000000 -0.000000 0.000000 0.000000 1.000000 /end COMPU_METHOD
/* Scalar measurable for DDE 'V2gRxMsgBptCtrlNotif'. */
/begin MEASUREMENT V2gRxMsgBptCtrlNotif "The arbitrated Notification Max Delay parameter in the received message from EVSE" SLONG CU_V2GRXMSGBPTCTRLNOTIF 1 100 -2147483648.0 2147483647.0 ECU_ADDRESS 0x700181d0 BYTE_ORDER MSB_LAST /end MEASUREMENT
/begin COMPU_METHOD CU_V2GRXMSGBPTCTRLNOTIF "Conversion method for V2gRxMsgBptCtrlNotif" TAB_VERB "%12.0" "1" COMPU_TAB_REF CT_V2GRXMSGBPTCTRLNOTIF /end COMPU_METHOD
/begin COMPU_VTAB CT_V2GRXMSGBPTCTRLNOTIF "Conversion method for V2gRxMsgBptCtrlNotif" TAB_VERB 3 0 "NONE" 1 "STOPCHARGING" 2 "RENEGOTIATION" /end COMPU_VTAB
/* Scalar measurable for DDE 'V2gRxMsgBptCtrlNotifFlg'. */
/begin MEASUREMENT V2gRxMsgBptCtrlNotifFlg "The arbitrated Notification parameter in the received message from EVSE" UBYTE CU_V2GRXMSGBPTCTRLNOTIFFLG 1 100 0.0 1.0 ECU_ADDRESS 0x70018493 BYTE_ORDER MSB_LAST /end MEASUREMENT
/begin COMPU_METHOD CU_V2GRXMSGBPTCTRLNOTIFFLG "Conversion method for V2gRxMsgBptCtrlNotifFlg" RAT_FUNC "%10.0" "b" COEFFS 0.000000 1.000000 -0.000000 0.000000 0.000000 1.000000 /end COMPU_METHOD
/* Scalar measurable for DDE 'V2gRxMsgBptCtrlNotifMaxDelay'. */
/begin MEASUREMENT V2gRxMsgBptCtrlNotifMaxDelay "The arbitrated Notification Max Delay parameter in the received message from EVSE" UWORD CU_V2GRXMSGBPTCTRLNOTIFMAXDELAY 1 100 0.0 65535.0 ECU_ADDRESS 0x700182fa BYTE_ORDER MSB_LAST /end MEASUREMENT
/begin COMPU_METHOD CU_V2GRXMSGBPTCTRLNOTIFMAXDELAY "Conversion method for V2gRxMsgBptCtrlNotifMaxDelay" RAT_FUNC "%10.0" "s" COEFFS 0.000000 1.000000 -0.000000 0.000000 0.000000 1.000000 /end COMPU_METHOD
/* Scalar measurable for DDE 'V2gRxMsgBptCtrlPwrLimReached'. */
/begin MEASUREMENT V2gRxMsgBptCtrlPwrLimReached "If set to TRUE, the EVSE has reached its power limit." UBYTE CU_V2GRXMSGBPTCTRLPWRLIMREACHED 1 100 0.0 1.0 ECU_ADDRESS 0x70018160 BYTE_ORDER MSB_LAST /end MEASUREMENT
/begin COMPU_METHOD CU_V2GRXMSGBPTCTRLPWRLIMREACHED "Conversion method for V2gRxMsgBptCtrlPwrLimReached" RAT_FUNC "%10.0" "b" COEFFS 0.000000 1.000000 -0.000000 0.000000 0.000000 1.000000 /end COMPU_METHOD
/* Scalar measurable for DDE 'V2gRxMsgBptCtrlRescode'. */
/begin MEASUREMENT V2gRxMsgBptCtrlRescode "Indicates the acknowledgment status of  this V2G messages received by the SECC." UBYTE CU_V2GRXMSGBPTCTRLRESCODE 1 100 0.0 255.0 ECU_ADDRESS 0x70017ef2 BYTE_ORDER MSB_LAST /end MEASUREMENT
/begin COMPU_METHOD CU_V2GRXMSGBPTCTRLRESCODE "Conversion method for V2gRxMsgBptCtrlRescode" RAT_FUNC "%10.0" "1" COEFFS 0.000000 1.000000 -0.000000 0.000000 0.000000 1.000000 /end COMPU_METHOD
/* Scalar measurable for DDE 'V2gRxMsgBptCtrlSASchTupId'. */
/begin MEASUREMENT V2gRxMsgBptCtrlSASchTupId "The SaSchedule Tuple ID message received from the EVSE" UBYTE CU_V2GRXMSGBPTCTRLSASCHTUPID 1 100 0.0 255.0 ECU_ADDRESS 0x70017c61 BYTE_ORDER MSB_LAST /end MEASUREMENT
/begin COMPU_METHOD CU_V2GRXMSGBPTCTRLSASCHTUPID "Conversion method for V2gRxMsgBptCtrlSASchTupId" RAT_FUNC "%10.0" "1" COEFFS 0.000000 1.000000 -0.000000 0.000000 0.000000 1.000000 /end COMPU_METHOD
/* Scalar measurable for DDE 'V2gRxMsgBptCtrlSASchTupIdFlg'. */
/begin MEASUREMENT V2gRxMsgBptCtrlSASchTupIdFlg "Identifies the presence of the SaSchedule Tuple ID message received from the EVSE" UBYTE CU_V2GRXMSGBPTCTRLSASCHTUPIDFLG 1 100 0.0 1.0 ECU_ADDRESS 0x70017f18 BYTE_ORDER MSB_LAST /end MEASUREMENT
/begin COMPU_METHOD CU_V2GRXMSGBPTCTRLSASCHTUPIDFLG "Conversion method for V2gRxMsgBptCtrlSASchTupIdFlg" RAT_FUNC "%10.0" "b" COEFFS 0.000000 1.000000 -0.000000 0.000000 0.000000 1.000000 /end COMPU_METHOD
/* Scalar measurable for DDE 'V2gRxMsgBptCtrlTrg'. */
/begin MEASUREMENT V2gRxMsgBptCtrlTrg "Trigger flag that on a rising edge indicates the event for receiving the PLC (V2G) message response BidirectionalControlRes from EVSE" UBYTE CU_V2GRXMSGBPTCTRLTRG 1 100 0.0 1.0 ECU_ADDRESS 0x7001829a BYTE_ORDER MSB_LAST /end MEASUREMENT
/begin COMPU_METHOD CU_V2GRXMSGBPTCTRLTRG "Conversion method for V2gRxMsgBptCtrlTrg" RAT_FUNC "%10.0" "b" COEFFS 0.000000 1.000000 -0.000000 0.000000 0.000000 1.000000 /end COMPU_METHOD
/* Scalar measurable for DDE 'V2gRxMsgBptCtrlVoltLimReached'. */
/begin MEASUREMENT V2gRxMsgBptCtrlVoltLimReached "f set to TRUE, the EVSE has reached its voltage limit." UBYTE CU_V2GRXMSGBPTCTRLVOLTLIMREACH0 1 100 0.0 1.0 ECU_ADDRESS 0x7001808c BYTE_ORDER MSB_LAST /end MEASUREMENT
/begin COMPU_METHOD CU_V2GRXMSGBPTCTRLVOLTLIMREACH0 "Conversion method for V2gRxMsgBptCtrlVoltLimReached" RAT_FUNC "%10.0" "b" COEFFS 0.000000 1.000000 -0.000000 0.000000 0.000000 1.000000 /end COMPU_METHOD
/* Scalar measurable for DDE 'V2gRxMsgCblChkEvseProcessing'. */
/begin MEASUREMENT V2gRxMsgCblChkEvseProcessing "Message 4b: Parameter indicating that the EVSE has finished the processing that was initiated after the ContractAuthenticationReq or that the EVSE is still processing at the time the response message was sent." SLONG CU_V2GRXMSGCBLCHKEVSEPROCESSING 1 100 -2147483648.0 2147483647.0 ECU_ADDRESS 0x70017ea8 BYTE_ORDER MSB_LAST /end MEASUREMENT
/begin COMPU_METHOD CU_V2GRXMSGCBLCHKEVSEPROCESSING "Conversion method for V2gRxMsgCblChkEvseProcessing" TAB_VERB "%12.0" "enum" COMPU_TAB_REF CT_V2GRXMSGCBLCHKEVSEPROCESSING /end COMPU_METHOD
/begin COMPU_VTAB CT_V2GRXMSGCBLCHKEVSEPROCESSING "Conversion method for V2gRxMsgCblChkEvseProcessing" TAB_VERB 3 0 "FINISHED" 1 "ONGOING" 2 "ONGOING_WAITINGFORCUSTOMERINTERACTION" /end COMPU_VTAB
/* Scalar measurable for DDE 'V2gRxMsgCblChkEvseStatus'. */
/begin MEASUREMENT V2gRxMsgCblChkEvseStatus "Indicates the internal state of the EVSE." SLONG CU_V2GRXMSGCBLCHKEVSESTATUS 1 100 -2147483648.0 2147483647.0 ECU_ADDRESS 0x70017cf0 BYTE_ORDER MSB_LAST /end MEASUREMENT
/begin COMPU_METHOD CU_V2GRXMSGCBLCHKEVSESTATUS "Conversion method for V2gRxMsgCblChkEvseStatus" TAB_VERB "%12.0" "enum" COMPU_TAB_REF CT_V2GRXMSGCBLCHKEVSESTATUS /end COMPU_METHOD
/begin COMPU_VTAB CT_V2GRXMSGCBLCHKEVSESTATUS "Conversion method for V2gRxMsgCblChkEvseStatus" TAB_VERB 12 0 "EVSE_NOT_READY" 1 "EVSE_READY" 2 "EVSE_SHUTDOWN" 3 "EVSE_UTILITY_INTERRUPT" 4 "EVSE_ISOLATION_MONITOR_ACTV" 5 "EVSE_EMERGENCY_SHUTDOWN" 6 "EVSE_MALFUNCTION" 7 "EVSE_STATUS_RESERVED1" 8 "EVSE_STATUS_RESERVED2" 9 "EVSE_STATUS_RESERVED3" 10 "EVSE_STATUS_RESERVED4" 11 "EVSE_STATUS_RESERVED5" /end COMPU_VTAB
/* Scalar measurable for DDE 'V2gRxMsgCblChkIsolStatus'. */
/begin MEASUREMENT V2gRxMsgCblChkIsolStatus "Indicates the isolation condition" SLONG CU_V2GRXMSGCBLCHKISOLSTATUS 1 100 -2147483648.0 2147483647.0 ECU_ADDRESS 0x7001833c BYTE_ORDER MSB_LAST /end MEASUREMENT
/begin COMPU_METHOD CU_V2GRXMSGCBLCHKISOLSTATUS "Conversion method for V2gRxMsgCblChkIsolStatus" TAB_VERB "%12.0" "enum" COMPU_TAB_REF CT_V2GRXMSGCBLCHKISOLSTATUS /end COMPU_METHOD
/begin COMPU_VTAB CT_V2GRXMSGCBLCHKISOLSTATUS "Conversion method for V2gRxMsgCblChkIsolStatus" TAB_VERB 4 0 "ISOLATION_INVALID" 1 "ISOLATION_VALID" 2 "ISOLATION_WARNING" 3 "ISOLATION_FAULT" /end COMPU_VTAB
/* Scalar measurable for DDE 'V2gRxMsgCblChkIsolStatus_flg'. */
/begin MEASUREMENT V2gRxMsgCblChkIsolStatus_flg "Identifies the presence of the EVSEIsolationStatus parameter." UBYTE CU_V2GRXMSGCBLCHKISOLSTATUS_FLG 1 100 0.0 1.0 ECU_ADDRESS 0x70017d48 BYTE_ORDER MSB_LAST /end MEASUREMENT
/begin COMPU_METHOD CU_V2GRXMSGCBLCHKISOLSTATUS_FLG "Conversion method for V2gRxMsgCblChkIsolStatus_flg" RAT_FUNC "%10.0" "b" COEFFS 0.000000 1.000000 -0.000000 0.000000 0.000000 1.000000 /end COMPU_METHOD
/* Scalar measurable for DDE 'V2gRxMsgCblChkNotif'. */
/begin MEASUREMENT V2gRxMsgCblChkNotif "The arbitrated Notification Max Delay parameter in the received message from EVSE" SLONG CU_V2GRXMSGCBLCHKNOTIF 1 100 -2147483648.0 2147483647.0 ECU_ADDRESS 0x70017fe0 BYTE_ORDER MSB_LAST /end MEASUREMENT
/begin COMPU_METHOD CU_V2GRXMSGCBLCHKNOTIF "Conversion method for V2gRxMsgCblChkNotif" TAB_VERB "%12.0" "1" COMPU_TAB_REF CT_V2GRXMSGCBLCHKNOTIF /end COMPU_METHOD
/begin COMPU_VTAB CT_V2GRXMSGCBLCHKNOTIF "Conversion method for V2gRxMsgCblChkNotif" TAB_VERB 3 0 "NONE" 1 "STOPCHARGING" 2 "RENEGOTIATION" /end COMPU_VTAB
/* Scalar measurable for DDE 'V2gRxMsgCblChkNotifFlg'. */
/begin MEASUREMENT V2gRxMsgCblChkNotifFlg "The arbitrated Notification parameter in the received message from EVSE" UBYTE CU_V2GRXMSGCBLCHKNOTIFFLG 1 100 0.0 1.0 ECU_ADDRESS 0x70017e48 BYTE_ORDER MSB_LAST /end MEASUREMENT
/begin COMPU_METHOD CU_V2GRXMSGCBLCHKNOTIFFLG "Conversion method for V2gRxMsgCblChkNotifFlg" RAT_FUNC "%10.0" "b" COEFFS 0.000000 1.000000 -0.000000 0.000000 0.000000 1.000000 /end COMPU_METHOD
/* Scalar measurable for DDE 'V2gRxMsgCblChkNotifMaxDelay'. */
/begin MEASUREMENT V2gRxMsgCblChkNotifMaxDelay "The arbitrated Notification Max Delay parameter in the received message from EVSE" UWORD CU_V2GRXMSGCBLCHKNOTIFMAXDELAY 1 100 0.0 65535.0 ECU_ADDRESS 0x70017c86 BYTE_ORDER MSB_LAST /end MEASUREMENT
/begin COMPU_METHOD CU_V2GRXMSGCBLCHKNOTIFMAXDELAY "Conversion method for V2gRxMsgCblChkNotifMaxDelay" RAT_FUNC "%10.0" "s" COEFFS 0.000000 1.000000 -0.000000 0.000000 0.000000 1.000000 /end COMPU_METHOD
/* Scalar measurable for DDE 'V2gRxMsgCblChkRescode'. */
/begin MEASUREMENT V2gRxMsgCblChkRescode "for message 4b: indicates the acknowledgment status of  this V2G messages received by the SECC." UBYTE CU_V2GRXMSGCBLCHKRESCODE 1 100 0.0 255.0 ECU_ADDRESS 0x700183a8 BYTE_ORDER MSB_LAST /end MEASUREMENT
/begin COMPU_METHOD CU_V2GRXMSGCBLCHKRESCODE "Conversion method for V2gRxMsgCblChkRescode" RAT_FUNC "%10.0" "1" COEFFS 0.000000 1.000000 -0.000000 0.000000 0.000000 1.000000 /end COMPU_METHOD
/* Scalar measurable for DDE 'V2gRxMsgCblChkTrg'. */
/begin MEASUREMENT V2gRxMsgCblChkTrg "Trigger falg that on a rising edge indicates the event for receiving the PLC (V2G) message response 4b from EVSE" UBYTE CU_V2GRXMSGCBLCHKTRG 1 100 0.0 1.0 ECU_ADDRESS 0x70017ca8 BYTE_ORDER MSB_LAST /end MEASUREMENT
/begin COMPU_METHOD CU_V2GRXMSGCBLCHKTRG "Conversion method for V2gRxMsgCblChkTrg" RAT_FUNC "%10.0" "b" COEFFS 0.000000 1.000000 -0.000000 0.000000 0.000000 1.000000 /end COMPU_METHOD
/* Scalar measurable for DDE 'V2gRxMsgChgParDscCrntRegTol'. */
/begin MEASUREMENT V2gRxMsgChgParDscCrntRegTol "Absolute magnitude of the regulation tolerance of the EVSE." FLOAT32_IEEE CU_V2GRXMSGCHGPARDSCCRNTREGTOL 1 100 0.0 196605.0 ECU_ADDRESS 0x70017f88 BYTE_ORDER MSB_LAST /end MEASUREMENT
/begin COMPU_METHOD CU_V2GRXMSGCHGPARDSCCRNTREGTOL "Conversion method for V2gRxMsgChgParDscCrntRegTol" RAT_FUNC "%10.0" "A" COEFFS 0.000000 1.000000 -0.000000 0.000000 0.000000 1.000000 /end COMPU_METHOD
/* Scalar measurable for DDE 'V2gRxMsgChgParDscCrntRegTol_flg'. */
/begin MEASUREMENT V2gRxMsgChgParDscCrntRegTol_flg "Identifies the presence of the DC_EVSEChargeParameter and its sub-parameters." UBYTE CU_V2GRXMSGCHGPARDSCCRNTREGTOL1 1 100 0.0 1.0 ECU_ADDRESS 0x700182e5 BYTE_ORDER MSB_LAST /end MEASUREMENT
/begin COMPU_METHOD CU_V2GRXMSGCHGPARDSCCRNTREGTOL1 "Conversion method for V2gRxMsgChgParDscCrntRegTol_flg" RAT_FUNC "%10.0" "b" COEFFS 0.000000 1.000000 -0.000000 0.000000 0.000000 1.000000 /end COMPU_METHOD
/* Scalar measurable for DDE 'V2gRxMsgChgParDscDchgMaxCrnt'. */
/begin MEASUREMENT V2gRxMsgChgParDscDchgMaxCrnt "Maximum discharge current that the EVSE can deliver" FLOAT32_IEEE CU_V2GRXMSGCHGPARDSCDCHGMAXCRNT 1 100 -32768000.0 32767000.0 ECU_ADDRESS 0x70018158 BYTE_ORDER MSB_LAST /end MEASUREMENT
/begin COMPU_METHOD CU_V2GRXMSGCHGPARDSCDCHGMAXCRNT "Conversion method for V2gRxMsgChgParDscDchgMaxCrnt" RAT_FUNC "%10.0" "A" COEFFS 0.000000 1.000000 -0.000000 0.000000 0.000000 1.000000 /end COMPU_METHOD
/* Scalar measurable for DDE 'V2gRxMsgChgParDscDchgMaxCrntFlg'. */
/begin MEASUREMENT V2gRxMsgChgParDscDchgMaxCrntFlg "Identifies the presence of the maximum discharge current from the EVSE" UBYTE CU_V2GRXMSGCHGPARDSCDCHGMAXCRN0 1 100 0.0 1.0 ECU_ADDRESS 0x70017ef0 BYTE_ORDER MSB_LAST /end MEASUREMENT
/begin COMPU_METHOD CU_V2GRXMSGCHGPARDSCDCHGMAXCRN0 "Conversion method for V2gRxMsgChgParDscDchgMaxCrntFlg" RAT_FUNC "%10.0" "b" COEFFS 0.000000 1.000000 -0.000000 0.000000 0.000000 1.000000 /end COMPU_METHOD
/* Scalar measurable for DDE 'V2gRxMsgChgParDscDchgMaxPwr'. */
/begin MEASUREMENT V2gRxMsgChgParDscDchgMaxPwr "Maximum discharge power that the EVSE can deliver" FLOAT32_IEEE CU_V2GRXMSGCHGPARDSCDCHGMAXPWR 1 100 -32768000.0 32767000.0 ECU_ADDRESS 0x70017d74 BYTE_ORDER MSB_LAST /end MEASUREMENT
/begin COMPU_METHOD CU_V2GRXMSGCHGPARDSCDCHGMAXPWR "Conversion method for V2gRxMsgChgParDscDchgMaxPwr" RAT_FUNC "%10.0" "W" COEFFS 0.000000 1.000000 -0.000000 0.000000 0.000000 1.000000 /end COMPU_METHOD
/* Scalar measurable for DDE 'V2gRxMsgChgParDscDchgMaxPwr_flg'. */
/begin MEASUREMENT V2gRxMsgChgParDscDchgMaxPwr_flg "Identifies the presence of the maximum discharge power from the EVSE" UBYTE CU_V2GRXMSGCHGPARDSCDCHGMAXPWR1 1 100 0.0 1.0 ECU_ADDRESS 0x70017f16 BYTE_ORDER MSB_LAST /end MEASUREMENT
/begin COMPU_METHOD CU_V2GRXMSGCHGPARDSCDCHGMAXPWR1 "Conversion method for V2gRxMsgChgParDscDchgMaxPwr_flg" RAT_FUNC "%10.0" "b" COEFFS 0.000000 1.000000 -0.000000 0.000000 0.000000 1.000000 /end COMPU_METHOD
/* Scalar measurable for DDE 'V2gRxMsgChgParDscDchgMinCrnt'. */
/begin MEASUREMENT V2gRxMsgChgParDscDchgMinCrnt "Minimum discharge current that the EVSE can deliver" FLOAT32_IEEE CU_V2GRXMSGCHGPARDSCDCHGMINCRNT 1 100 -32768000.0 32767000.0 ECU_ADDRESS 0x70018294 BYTE_ORDER MSB_LAST /end MEASUREMENT
/begin COMPU_METHOD CU_V2GRXMSGCHGPARDSCDCHGMINCRNT "Conversion method for V2gRxMsgChgParDscDchgMinCrnt" RAT_FUNC "%10.0" "A" COEFFS 0.000000 1.000000 -0.000000 0.000000 0.000000 1.000000 /end COMPU_METHOD
/* Scalar measurable for DDE 'V2gRxMsgChgParDscDchgMinCrntFlg'. */
/begin MEASUREMENT V2gRxMsgChgParDscDchgMinCrntFlg "Identifies the presence of the minimum discharge current from the EVSE" UBYTE CU_V2GRXMSGCHGPARDSCDCHGMINCRN0 1 100 0.0 1.0 ECU_ADDRESS 0x70017c7b BYTE_ORDER MSB_LAST /end MEASUREMENT
/begin COMPU_METHOD CU_V2GRXMSGCHGPARDSCDCHGMINCRN0 "Conversion method for V2gRxMsgChgParDscDchgMinCrntFlg" RAT_FUNC "%10.0" "b" COEFFS 0.000000 1.000000 -0.000000 0.000000 0.000000 1.000000 /end COMPU_METHOD
/* Scalar measurable for DDE 'V2gRxMsgChgParDscEgy2Deliv'. */
/begin MEASUREMENT V2gRxMsgChgParDscEgy2Deliv "Amount of energy to be delivered by the EVSE." FLOAT32_IEEE CU_V2GRXMSGCHGPARDSCEGY2DELIV 1 100 0.0 196605.0 ECU_ADDRESS 0x7001839c BYTE_ORDER MSB_LAST /end MEASUREMENT
/begin COMPU_METHOD CU_V2GRXMSGCHGPARDSCEGY2DELIV "Conversion method for V2gRxMsgChgParDscEgy2Deliv" RAT_FUNC "%10.0" "Wh" COEFFS 0.000000 1.000000 -0.000000 0.000000 0.000000 1.000000 /end COMPU_METHOD
/* Scalar measurable for DDE 'V2gRxMsgChgParDscEgy2DelivFlg'. */
/begin MEASUREMENT V2gRxMsgChgParDscEgy2DelivFlg "Indicated the presente of the amount of energy signal to be delivered by the EVSE." UBYTE CU_V2GRXMSGCHGPARDSCEGY2DELIVF0 1 100 0.0 1.0 ECU_ADDRESS 0x700181f1 BYTE_ORDER MSB_LAST /end MEASUREMENT
/begin COMPU_METHOD CU_V2GRXMSGCHGPARDSCEGY2DELIVF0 "Conversion method for V2gRxMsgChgParDscEgy2DelivFlg" RAT_FUNC "%10.0" "b" COEFFS 0.000000 1.000000 -0.000000 0.000000 0.000000 1.000000 /end COMPU_METHOD
/* Scalar measurable for DDE 'V2gRxMsgChgParDscEvseProcessing'. */
/begin MEASUREMENT V2gRxMsgChgParDscEvseProcessing "Message 3b: Parameter indicating that the EVSE has finished the processing that was initiated after the ContractAuthenticationReq or that the EVSE is still processing at the time the response message was sent." SLONG CU_V2GRXMSGCHGPARDSCEVSEPROCES0 1 100 -2147483648.0 2147483647.0 ECU_ADDRESS 0x70017fa4 BYTE_ORDER MSB_LAST /end MEASUREMENT
/begin COMPU_METHOD CU_V2GRXMSGCHGPARDSCEVSEPROCES0 "Conversion method for V2gRxMsgChgParDscEvseProcessing" TAB_VERB "%12.0" "enum" COMPU_TAB_REF CT_V2GRXMSGCHGPARDSCEVSEPROCES0 /end COMPU_METHOD
/begin COMPU_VTAB CT_V2GRXMSGCHGPARDSCEVSEPROCES0 "Conversion method for V2gRxMsgChgParDscEvseProcessing" TAB_VERB 3 0 "FINISHED" 1 "ONGOING" 2 "ONGOING_WAITINGFORCUSTOMERINTERACTION" /end COMPU_VTAB
/* Scalar measurable for DDE 'V2gRxMsgChgParDscEvseStatus'. */
/begin MEASUREMENT V2gRxMsgChgParDscEvseStatus "Indicates the internal state of the EVSE." SLONG CU_V2GRXMSGCHGPARDSCEVSESTATUS 1 100 -2147483648.0 2147483647.0 ECU_ADDRESS 0x7001823c BYTE_ORDER MSB_LAST /end MEASUREMENT
/begin COMPU_METHOD CU_V2GRXMSGCHGPARDSCEVSESTATUS "Conversion method for V2gRxMsgChgParDscEvseStatus" TAB_VERB "%12.0" "enum" COMPU_TAB_REF CT_V2GRXMSGCHGPARDSCEVSESTATUS /end COMPU_METHOD
/begin COMPU_VTAB CT_V2GRXMSGCHGPARDSCEVSESTATUS "Conversion method for V2gRxMsgChgParDscEvseStatus" TAB_VERB 12 0 "EVSE_NOT_READY" 1 "EVSE_READY" 2 "EVSE_SHUTDOWN" 3 "EVSE_UTILITY_INTERRUPT" 4 "EVSE_ISOLATION_MONITOR_ACTV" 5 "EVSE_EMERGENCY_SHUTDOWN" 6 "EVSE_MALFUNCTION" 7 "EVSE_STATUS_RESERVED1" 8 "EVSE_STATUS_RESERVED2" 9 "EVSE_STATUS_RESERVED3" 10 "EVSE_STATUS_RESERVED4" 11 "EVSE_STATUS_RESERVED5" /end COMPU_VTAB
/* Scalar measurable for DDE 'V2gRxMsgChgParDscEvseStatus_flg'. */
/begin MEASUREMENT V2gRxMsgChgParDscEvseStatus_flg "Identifies the presence of the DC_EVSEChargeParameter and its sub-parameters." UBYTE CU_V2GRXMSGCHGPARDSCEVSESTATUS1 1 100 0.0 1.0 ECU_ADDRESS 0x70017c25 BYTE_ORDER MSB_LAST /end MEASUREMENT
/begin COMPU_METHOD CU_V2GRXMSGCHGPARDSCEVSESTATUS1 "Conversion method for V2gRxMsgChgParDscEvseStatus_flg" RAT_FUNC "%10.0" "b" COEFFS 0.000000 1.000000 -0.000000 0.000000 0.000000 1.000000 /end COMPU_METHOD
/* Scalar measurable for DDE 'V2gRxMsgChgParDscIsolStatus'. */
/begin MEASUREMENT V2gRxMsgChgParDscIsolStatus "Indicates the isolation condition" SLONG CU_V2GRXMSGCHGPARDSCISOLSTATUS 1 100 -2147483648.0 2147483647.0 ECU_ADDRESS 0x70017ee4 BYTE_ORDER MSB_LAST /end MEASUREMENT
/begin COMPU_METHOD CU_V2GRXMSGCHGPARDSCISOLSTATUS "Conversion method for V2gRxMsgChgParDscIsolStatus" TAB_VERB "%12.0" "enum" COMPU_TAB_REF CT_V2GRXMSGCHGPARDSCISOLSTATUS /end COMPU_METHOD
/begin COMPU_VTAB CT_V2GRXMSGCHGPARDSCISOLSTATUS "Conversion method for V2gRxMsgChgParDscIsolStatus" TAB_VERB 4 0 "ISOLATION_INVALID" 1 "ISOLATION_VALID" 2 "ISOLATION_WARNING" 3 "ISOLATION_FAULT" /end COMPU_VTAB
/* Scalar measurable for DDE 'V2gRxMsgChgParDscIsolStatus_flg'. */
/begin MEASUREMENT V2gRxMsgChgParDscIsolStatus_flg "Indicates the presence of the isolation condition" UBYTE CU_V2GRXMSGCHGPARDSCISOLSTATUS1 1 100 0.0 1.0 ECU_ADDRESS 0x70017d52 BYTE_ORDER MSB_LAST /end MEASUREMENT
/begin COMPU_METHOD CU_V2GRXMSGCHGPARDSCISOLSTATUS1 "Conversion method for V2gRxMsgChgParDscIsolStatus_flg" RAT_FUNC "%10.0" "b" COEFFS 0.000000 1.000000 -0.000000 0.000000 0.000000 1.000000 /end COMPU_METHOD
/* Scalar measurable for DDE 'V2gRxMsgChgParDscMaxCrnt'. */
/begin MEASUREMENT V2gRxMsgChgParDscMaxCrnt "Maximum current the EVSE can deliver" FLOAT32_IEEE CU_V2GRXMSGCHGPARDSCMAXCRNT 1 100 0.0 196605.0 ECU_ADDRESS 0x70018468 BYTE_ORDER MSB_LAST /end MEASUREMENT
/begin COMPU_METHOD CU_V2GRXMSGCHGPARDSCMAXCRNT "Conversion method for V2gRxMsgChgParDscMaxCrnt" RAT_FUNC "%10.0" "A" COEFFS 0.000000 1.000000 -0.000000 0.000000 0.000000 1.000000 /end COMPU_METHOD
/* Scalar measurable for DDE 'V2gRxMsgChgParDscMaxCrnt_flg'. */
/begin MEASUREMENT V2gRxMsgChgParDscMaxCrnt_flg "Identifies the presence of the DC_EVSEChargeParameter and its sub-parameters." UBYTE CU_V2GRXMSGCHGPARDSCMAXCRNT_FLG 1 100 0.0 1.0 ECU_ADDRESS 0x700182b1 BYTE_ORDER MSB_LAST /end MEASUREMENT
/begin COMPU_METHOD CU_V2GRXMSGCHGPARDSCMAXCRNT_FLG "Conversion method for V2gRxMsgChgParDscMaxCrnt_flg" RAT_FUNC "%10.0" "b" COEFFS 0.000000 1.000000 -0.000000 0.000000 0.000000 1.000000 /end COMPU_METHOD
/* Scalar measurable for DDE 'V2gRxMsgChgParDscMaxPwr'. */
/begin MEASUREMENT V2gRxMsgChgParDscMaxPwr "Maximum power the EVSE can deliver" FLOAT32_IEEE CU_V2GRXMSGCHGPARDSCMAXPWR 1 100 0.0 500000.0 ECU_ADDRESS 0x70018488 BYTE_ORDER MSB_LAST /end MEASUREMENT
/begin COMPU_METHOD CU_V2GRXMSGCHGPARDSCMAXPWR "Conversion method for V2gRxMsgChgParDscMaxPwr" RAT_FUNC "%10.0" "W" COEFFS 0.000000 1.000000 -0.000000 0.000000 0.000000 1.000000 /end COMPU_METHOD
/* Scalar measurable for DDE 'V2gRxMsgChgParDscMaxPwr_flg'. */
/begin MEASUREMENT V2gRxMsgChgParDscMaxPwr_flg "Identifies the presence of the DC_EVSEChargeParameter and its sub-parameters." UBYTE CU_V2GRXMSGCHGPARDSCMAXPWR_FLG 1 100 0.0 1.0 ECU_ADDRESS 0x70017e96 BYTE_ORDER MSB_LAST /end MEASUREMENT
/begin COMPU_METHOD CU_V2GRXMSGCHGPARDSCMAXPWR_FLG "Conversion method for V2gRxMsgChgParDscMaxPwr_flg" RAT_FUNC "%10.0" "b" COEFFS 0.000000 1.000000 -0.000000 0.000000 0.000000 1.000000 /end COMPU_METHOD
/* Scalar measurable for DDE 'V2gRxMsgChgParDscMaxVolt'. */
/begin MEASUREMENT V2gRxMsgChgParDscMaxVolt "Maximum voltage the EVSE can deliver" FLOAT32_IEEE CU_V2GRXMSGCHGPARDSCMAXVOLT 1 100 0.0 196605.0 ECU_ADDRESS 0x700181e0 BYTE_ORDER MSB_LAST /end MEASUREMENT
/begin COMPU_METHOD CU_V2GRXMSGCHGPARDSCMAXVOLT "Conversion method for V2gRxMsgChgParDscMaxVolt" RAT_FUNC "%10.0" "V" COEFFS 0.000000 1.000000 -0.000000 0.000000 0.000000 1.000000 /end COMPU_METHOD
/* Scalar measurable for DDE 'V2gRxMsgChgParDscMaxVolt_flg'. */
/begin MEASUREMENT V2gRxMsgChgParDscMaxVolt_flg "Identifies the presence of the DC_EVSEChargeParameter and its sub-parameters." UBYTE CU_V2GRXMSGCHGPARDSCMAXVOLT_FLG 1 100 0.0 1.0 ECU_ADDRESS 0x70017f92 BYTE_ORDER MSB_LAST /end MEASUREMENT
/begin COMPU_METHOD CU_V2GRXMSGCHGPARDSCMAXVOLT_FLG "Conversion method for V2gRxMsgChgParDscMaxVolt_flg" RAT_FUNC "%10.0" "b" COEFFS 0.000000 1.000000 -0.000000 0.000000 0.000000 1.000000 /end COMPU_METHOD
/* Scalar measurable for DDE 'V2gRxMsgChgParDscMinCrnt'. */
/begin MEASUREMENT V2gRxMsgChgParDscMinCrnt "Minimum current the EVSE can deliver with the expected accuracy" FLOAT32_IEEE CU_V2GRXMSGCHGPARDSCMINCRNT 1 100 0.0 196605.0 ECU_ADDRESS 0x70017e0c BYTE_ORDER MSB_LAST /end MEASUREMENT
/begin COMPU_METHOD CU_V2GRXMSGCHGPARDSCMINCRNT "Conversion method for V2gRxMsgChgParDscMinCrnt" RAT_FUNC "%10.0" "A" COEFFS 0.000000 1.000000 -0.000000 0.000000 0.000000 1.000000 /end COMPU_METHOD
/* Scalar measurable for DDE 'V2gRxMsgChgParDscMinCrnt_flg'. */
/begin MEASUREMENT V2gRxMsgChgParDscMinCrnt_flg "Identifies the presence of the DC_EVSEChargeParameter and its sub-parameters." UBYTE CU_V2GRXMSGCHGPARDSCMINCRNT_FLG 1 100 0.0 1.0 ECU_ADDRESS 0x70017c44 BYTE_ORDER MSB_LAST /end MEASUREMENT
/begin COMPU_METHOD CU_V2GRXMSGCHGPARDSCMINCRNT_FLG "Conversion method for V2gRxMsgChgParDscMinCrnt_flg" RAT_FUNC "%10.0" "b" COEFFS 0.000000 1.000000 -0.000000 0.000000 0.000000 1.000000 /end COMPU_METHOD
/* Scalar measurable for DDE 'V2gRxMsgChgParDscMinVolt'. */
/begin MEASUREMENT V2gRxMsgChgParDscMinVolt "Minimum voltage the EVSE can deliver with the expected accuracy." FLOAT32_IEEE CU_V2GRXMSGCHGPARDSCMINVOLT 1 100 0.0 196605.0 ECU_ADDRESS 0x70017de4 BYTE_ORDER MSB_LAST /end MEASUREMENT
/begin COMPU_METHOD CU_V2GRXMSGCHGPARDSCMINVOLT "Conversion method for V2gRxMsgChgParDscMinVolt" RAT_FUNC "%10.0" "V" COEFFS 0.000000 1.000000 -0.000000 0.000000 0.000000 1.000000 /end COMPU_METHOD
/* Scalar measurable for DDE 'V2gRxMsgChgParDscMinVolt_flg'. */
/begin MEASUREMENT V2gRxMsgChgParDscMinVolt_flg "Identifies the presence of the DC_EVSEChargeParameter and its sub-parameters." UBYTE CU_V2GRXMSGCHGPARDSCMINVOLT_FLG 1 100 0.0 1.0 ECU_ADDRESS 0x70017ce3 BYTE_ORDER MSB_LAST /end MEASUREMENT
/begin COMPU_METHOD CU_V2GRXMSGCHGPARDSCMINVOLT_FLG "Conversion method for V2gRxMsgChgParDscMinVolt_flg" RAT_FUNC "%10.0" "b" COEFFS 0.000000 1.000000 -0.000000 0.000000 0.000000 1.000000 /end COMPU_METHOD
/* Scalar measurable for DDE 'V2gRxMsgChgParDscNotif'. */
/begin MEASUREMENT V2gRxMsgChgParDscNotif "The arbitrated Notification Max Delay parameter in the received message from EVSE" SLONG CU_V2GRXMSGCHGPARDSCNOTIF 1 100 -2147483648.0 2147483647.0 ECU_ADDRESS 0x70017ed4 BYTE_ORDER MSB_LAST /end MEASUREMENT
/begin COMPU_METHOD CU_V2GRXMSGCHGPARDSCNOTIF "Conversion method for V2gRxMsgChgParDscNotif" TAB_VERB "%12.0" "1" COMPU_TAB_REF CT_V2GRXMSGCHGPARDSCNOTIF /end COMPU_METHOD
/begin COMPU_VTAB CT_V2GRXMSGCHGPARDSCNOTIF "Conversion method for V2gRxMsgChgParDscNotif" TAB_VERB 3 0 "NONE" 1 "STOPCHARGING" 2 "RENEGOTIATION" /end COMPU_VTAB
/* Scalar measurable for DDE 'V2gRxMsgChgParDscNotifFlg'. */
/begin MEASUREMENT V2gRxMsgChgParDscNotifFlg "The arbitrated Notification parameter in the received message from EVSE" UBYTE CU_V2GRXMSGCHGPARDSCNOTIFFLG 1 100 0.0 1.0 ECU_ADDRESS 0x70017e9e BYTE_ORDER MSB_LAST /end MEASUREMENT
/begin COMPU_METHOD CU_V2GRXMSGCHGPARDSCNOTIFFLG "Conversion method for V2gRxMsgChgParDscNotifFlg" RAT_FUNC "%10.0" "b" COEFFS 0.000000 1.000000 -0.000000 0.000000 0.000000 1.000000 /end COMPU_METHOD
/* Scalar measurable for DDE 'V2gRxMsgChgParDscNotifMaxDelay'. */
/begin MEASUREMENT V2gRxMsgChgParDscNotifMaxDelay "The arbitrated Notification Max Delay parameter in the received message from EVSE" UWORD CU_V2GRXMSGCHGPARDSCNOTIFMAXDE0 1 100 0.0 65535.0 ECU_ADDRESS 0x70017ca6 BYTE_ORDER MSB_LAST /end MEASUREMENT
/begin COMPU_METHOD CU_V2GRXMSGCHGPARDSCNOTIFMAXDE0 "Conversion method for V2gRxMsgChgParDscNotifMaxDelay" RAT_FUNC "%10.0" "s" COEFFS 0.000000 1.000000 -0.000000 0.000000 0.000000 1.000000 /end COMPU_METHOD
/* Scalar measurable for DDE 'V2gRxMsgChgParDscPkRipple'. */
/begin MEASUREMENT V2gRxMsgChgParDscPkRipple "Peak-to-peak magnitude of the current ripple of the EVSE." FLOAT32_IEEE CU_V2GRXMSGCHGPARDSCPKRIPPLE 1 100 0.0 196605.0 ECU_ADDRESS 0x70018088 BYTE_ORDER MSB_LAST /end MEASUREMENT
/begin COMPU_METHOD CU_V2GRXMSGCHGPARDSCPKRIPPLE "Conversion method for V2gRxMsgChgParDscPkRipple" RAT_FUNC "%10.0" "A" COEFFS 0.000000 1.000000 -0.000000 0.000000 0.000000 1.000000 /end COMPU_METHOD
/* Scalar measurable for DDE 'V2gRxMsgChgParDscPkRipple_flg'. */
/begin MEASUREMENT V2gRxMsgChgParDscPkRipple_flg "Identifies the presence of the DC_EVSEChargeParameter and its sub-parameters." UBYTE CU_V2GRXMSGCHGPARDSCPKRIPPLE_F0 1 100 0.0 1.0 ECU_ADDRESS 0x70017eb4 BYTE_ORDER MSB_LAST /end MEASUREMENT
/begin COMPU_METHOD CU_V2GRXMSGCHGPARDSCPKRIPPLE_F0 "Conversion method for V2gRxMsgChgParDscPkRipple_flg" RAT_FUNC "%10.0" "b" COEFFS 0.000000 1.000000 -0.000000 0.000000 0.000000 1.000000 /end COMPU_METHOD
/* Scalar measurable for DDE 'V2gRxMsgChgParDscRescode'. */
/begin MEASUREMENT V2gRxMsgChgParDscRescode "for message 3b: indicates the acknowledgment status of  this V2G messages received by the SECC." UBYTE CU_V2GRXMSGCHGPARDSCRESCODE 1 100 0.0 255.0 ECU_ADDRESS 0x70017da5 BYTE_ORDER MSB_LAST /end MEASUREMENT
/begin COMPU_METHOD CU_V2GRXMSGCHGPARDSCRESCODE "Conversion method for V2gRxMsgChgParDscRescode" RAT_FUNC "%10.0" "1" COEFFS 0.000000 1.000000 -0.000000 0.000000 0.000000 1.000000 /end COMPU_METHOD
/* Scalar measurable for DDE 'V2gRxMsgChgParDscTrg'. */
/begin MEASUREMENT V2gRxMsgChgParDscTrg "Trigger falg that on a rising edge indicates the event for receiving the PLC (V2G) message response 3b from EVSE" UBYTE CU_V2GRXMSGCHGPARDSCTRG 1 100 0.0 1.0 ECU_ADDRESS 0x70017c89 BYTE_ORDER MSB_LAST /end MEASUREMENT
/begin COMPU_METHOD CU_V2GRXMSGCHGPARDSCTRG "Conversion method for V2gRxMsgChgParDscTrg" RAT_FUNC "%10.0" "b" COEFFS 0.000000 1.000000 -0.000000 0.000000 0.000000 1.000000 /end COMPU_METHOD
/* Scalar measurable for DDE 'V2gRxMsgSesSetupEvseIdLen'. */
/begin MEASUREMENT V2gRxMsgSesSetupEvseIdLen "Number of bytes in EVSE ID" UBYTE CU_V2GRXMSGSESSETUPEVSEIDLEN 1 100 0.0 37.0 ECU_ADDRESS 0x700182b0 BYTE_ORDER MSB_LAST /end MEASUREMENT
/begin COMPU_METHOD CU_V2GRXMSGSESSETUPEVSEIDLEN "Conversion method for V2gRxMsgSesSetupEvseIdLen" RAT_FUNC "%10.0" "1" COEFFS 0.000000 1.000000 -0.000000 0.000000 0.000000 1.000000 /end COMPU_METHOD
/* Scalar measurable for DDE 'V2gRxMsgSesSetupEvseId[0]'. */
/begin MEASUREMENT V2gRxMsgSesSetupEvseId[0] "The ID that uniquely identifies the EVSE. Format is defined in DIN SPEC 91286" UBYTE CU_V2GRXMSGSESSETUPEVSEID[0] 1 100 0.0 255.0 ECU_ADDRESS 0x70017f21 BYTE_ORDER MSB_LAST /end MEASUREMENT
/begin COMPU_METHOD CU_V2GRXMSGSESSETUPEVSEID[0] "Conversion method for V2gRxMsgSesSetupEvseId[0]" RAT_FUNC "%10.0" "1" COEFFS 0.000000 1.000000 -0.000000 0.000000 0.000000 1.000000 /end COMPU_METHOD
/* Scalar measurable for DDE 'V2gRxMsgSesSetupEvseId[10]'. */
/begin MEASUREMENT V2gRxMsgSesSetupEvseId[10] "The ID that uniquely identifies the EVSE. Format is defined in DIN SPEC 91286" UBYTE CU_V2GRXMSGSESSETUPEVSEID[10] 1 100 0.0 255.0 ECU_ADDRESS 0x70017f2b BYTE_ORDER MSB_LAST /end MEASUREMENT
/begin COMPU_METHOD CU_V2GRXMSGSESSETUPEVSEID[10] "Conversion method for V2gRxMsgSesSetupEvseId[10]" RAT_FUNC "%10.0" "1" COEFFS 0.000000 1.000000 -0.000000 0.000000 0.000000 1.000000 /end COMPU_METHOD
/* Scalar measurable for DDE 'V2gRxMsgSesSetupEvseId[11]'. */
/begin MEASUREMENT V2gRxMsgSesSetupEvseId[11] "The ID that uniquely identifies the EVSE. Format is defined in DIN SPEC 91286" UBYTE CU_V2GRXMSGSESSETUPEVSEID[11] 1 100 0.0 255.0 ECU_ADDRESS 0x70017f2c BYTE_ORDER MSB_LAST /end MEASUREMENT
/begin COMPU_METHOD CU_V2GRXMSGSESSETUPEVSEID[11] "Conversion method for V2gRxMsgSesSetupEvseId[11]" RAT_FUNC "%10.0" "1" COEFFS 0.000000 1.000000 -0.000000 0.000000 0.000000 1.000000 /end COMPU_METHOD
/* Scalar measurable for DDE 'V2gRxMsgSesSetupEvseId[12]'. */
/begin MEASUREMENT V2gRxMsgSesSetupEvseId[12] "The ID that uniquely identifies the EVSE. Format is defined in DIN SPEC 91286" UBYTE CU_V2GRXMSGSESSETUPEVSEID[12] 1 100 0.0 255.0 ECU_ADDRESS 0x70017f2d BYTE_ORDER MSB_LAST /end MEASUREMENT
/begin COMPU_METHOD CU_V2GRXMSGSESSETUPEVSEID[12] "Conversion method for V2gRxMsgSesSetupEvseId[12]" RAT_FUNC "%10.0" "1" COEFFS 0.000000 1.000000 -0.000000 0.000000 0.000000 1.000000 /end COMPU_METHOD
/* Scalar measurable for DDE 'V2gRxMsgSesSetupEvseId[13]'. */
/begin MEASUREMENT V2gRxMsgSesSetupEvseId[13] "The ID that uniquely identifies the EVSE. Format is defined in DIN SPEC 91286" UBYTE CU_V2GRXMSGSESSETUPEVSEID[13] 1 100 0.0 255.0 ECU_ADDRESS 0x70017f2e BYTE_ORDER MSB_LAST /end MEASUREMENT
/begin COMPU_METHOD CU_V2GRXMSGSESSETUPEVSEID[13] "Conversion method for V2gRxMsgSesSetupEvseId[13]" RAT_FUNC "%10.0" "1" COEFFS 0.000000 1.000000 -0.000000 0.000000 0.000000 1.000000 /end COMPU_METHOD
/* Scalar measurable for DDE 'V2gRxMsgSesSetupEvseId[14]'. */
/begin MEASUREMENT V2gRxMsgSesSetupEvseId[14] "The ID that uniquely identifies the EVSE. Format is defined in DIN SPEC 91286" UBYTE CU_V2GRXMSGSESSETUPEVSEID[14] 1 100 0.0 255.0 ECU_ADDRESS 0x70017f2f BYTE_ORDER MSB_LAST /end MEASUREMENT
/begin COMPU_METHOD CU_V2GRXMSGSESSETUPEVSEID[14] "Conversion method for V2gRxMsgSesSetupEvseId[14]" RAT_FUNC "%10.0" "1" COEFFS 0.000000 1.000000 -0.000000 0.000000 0.000000 1.000000 /end COMPU_METHOD
/* Scalar measurable for DDE 'V2gRxMsgSesSetupEvseId[15]'. */
/begin MEASUREMENT V2gRxMsgSesSetupEvseId[15] "The ID that uniquely identifies the EVSE. Format is defined in DIN SPEC 91286" UBYTE CU_V2GRXMSGSESSETUPEVSEID[15] 1 100 0.0 255.0 ECU_ADDRESS 0x70017f30 BYTE_ORDER MSB_LAST /end MEASUREMENT
/begin COMPU_METHOD CU_V2GRXMSGSESSETUPEVSEID[15] "Conversion method for V2gRxMsgSesSetupEvseId[15]" RAT_FUNC "%10.0" "1" COEFFS 0.000000 1.000000 -0.000000 0.000000 0.000000 1.000000 /end COMPU_METHOD
/* Scalar measurable for DDE 'V2gRxMsgSesSetupEvseId[16]'. */
/begin MEASUREMENT V2gRxMsgSesSetupEvseId[16] "The ID that uniquely identifies the EVSE. Format is defined in DIN SPEC 91286" UBYTE CU_V2GRXMSGSESSETUPEVSEID[16] 1 100 0.0 255.0 ECU_ADDRESS 0x70017f31 BYTE_ORDER MSB_LAST /end MEASUREMENT
/begin COMPU_METHOD CU_V2GRXMSGSESSETUPEVSEID[16] "Conversion method for V2gRxMsgSesSetupEvseId[16]" RAT_FUNC "%10.0" "1" COEFFS 0.000000 1.000000 -0.000000 0.000000 0.000000 1.000000 /end COMPU_METHOD
/* Scalar measurable for DDE 'V2gRxMsgSesSetupEvseId[17]'. */
/begin MEASUREMENT V2gRxMsgSesSetupEvseId[17] "The ID that uniquely identifies the EVSE. Format is defined in DIN SPEC 91286" UBYTE CU_V2GRXMSGSESSETUPEVSEID[17] 1 100 0.0 255.0 ECU_ADDRESS 0x70017f32 BYTE_ORDER MSB_LAST /end MEASUREMENT
/begin COMPU_METHOD CU_V2GRXMSGSESSETUPEVSEID[17] "Conversion method for V2gRxMsgSesSetupEvseId[17]" RAT_FUNC "%10.0" "1" COEFFS 0.000000 1.000000 -0.000000 0.000000 0.000000 1.000000 /end COMPU_METHOD
/* Scalar measurable for DDE 'V2gRxMsgSesSetupEvseId[18]'. */
/begin MEASUREMENT V2gRxMsgSesSetupEvseId[18] "The ID that uniquely identifies the EVSE. Format is defined in DIN SPEC 91286" UBYTE CU_V2GRXMSGSESSETUPEVSEID[18] 1 100 0.0 255.0 ECU_ADDRESS 0x70017f33 BYTE_ORDER MSB_LAST /end MEASUREMENT
/begin COMPU_METHOD CU_V2GRXMSGSESSETUPEVSEID[18] "Conversion method for V2gRxMsgSesSetupEvseId[18]" RAT_FUNC "%10.0" "1" COEFFS 0.000000 1.000000 -0.000000 0.000000 0.000000 1.000000 /end COMPU_METHOD
/* Scalar measurable for DDE 'V2gRxMsgSesSetupEvseId[19]'. */
/begin MEASUREMENT V2gRxMsgSesSetupEvseId[19] "The ID that uniquely identifies the EVSE. Format is defined in DIN SPEC 91286" UBYTE CU_V2GRXMSGSESSETUPEVSEID[19] 1 100 0.0 255.0 ECU_ADDRESS 0x70017f34 BYTE_ORDER MSB_LAST /end MEASUREMENT
/begin COMPU_METHOD CU_V2GRXMSGSESSETUPEVSEID[19] "Conversion method for V2gRxMsgSesSetupEvseId[19]" RAT_FUNC "%10.0" "1" COEFFS 0.000000 1.000000 -0.000000 0.000000 0.000000 1.000000 /end COMPU_METHOD
/* Scalar measurable for DDE 'V2gRxMsgSesSetupEvseId[1]'. */
/begin MEASUREMENT V2gRxMsgSesSetupEvseId[1] "The ID that uniquely identifies the EVSE. Format is defined in DIN SPEC 91286" UBYTE CU_V2GRXMSGSESSETUPEVSEID[1] 1 100 0.0 255.0 ECU_ADDRESS 0x70017f22 BYTE_ORDER MSB_LAST /end MEASUREMENT
/begin COMPU_METHOD CU_V2GRXMSGSESSETUPEVSEID[1] "Conversion method for V2gRxMsgSesSetupEvseId[1]" RAT_FUNC "%10.0" "1" COEFFS 0.000000 1.000000 -0.000000 0.000000 0.000000 1.000000 /end COMPU_METHOD
/* Scalar measurable for DDE 'V2gRxMsgSesSetupEvseId[20]'. */
/begin MEASUREMENT V2gRxMsgSesSetupEvseId[20] "The ID that uniquely identifies the EVSE. Format is defined in DIN SPEC 91286" UBYTE CU_V2GRXMSGSESSETUPEVSEID[20] 1 100 0.0 255.0 ECU_ADDRESS 0x70017f35 BYTE_ORDER MSB_LAST /end MEASUREMENT
/begin COMPU_METHOD CU_V2GRXMSGSESSETUPEVSEID[20] "Conversion method for V2gRxMsgSesSetupEvseId[20]" RAT_FUNC "%10.0" "1" COEFFS 0.000000 1.000000 -0.000000 0.000000 0.000000 1.000000 /end COMPU_METHOD
/* Scalar measurable for DDE 'V2gRxMsgSesSetupEvseId[21]'. */
/begin MEASUREMENT V2gRxMsgSesSetupEvseId[21] "The ID that uniquely identifies the EVSE. Format is defined in DIN SPEC 91286" UBYTE CU_V2GRXMSGSESSETUPEVSEID[21] 1 100 0.0 255.0 ECU_ADDRESS 0x70017f36 BYTE_ORDER MSB_LAST /end MEASUREMENT
/begin COMPU_METHOD CU_V2GRXMSGSESSETUPEVSEID[21] "Conversion method for V2gRxMsgSesSetupEvseId[21]" RAT_FUNC "%10.0" "1" COEFFS 0.000000 1.000000 -0.000000 0.000000 0.000000 1.000000 /end COMPU_METHOD
/* Scalar measurable for DDE 'V2gRxMsgSesSetupEvseId[22]'. */
/begin MEASUREMENT V2gRxMsgSesSetupEvseId[22] "The ID that uniquely identifies the EVSE. Format is defined in DIN SPEC 91286" UBYTE CU_V2GRXMSGSESSETUPEVSEID[22] 1 100 0.0 255.0 ECU_ADDRESS 0x70017f37 BYTE_ORDER MSB_LAST /end MEASUREMENT
/begin COMPU_METHOD CU_V2GRXMSGSESSETUPEVSEID[22] "Conversion method for V2gRxMsgSesSetupEvseId[22]" RAT_FUNC "%10.0" "1" COEFFS 0.000000 1.000000 -0.000000 0.000000 0.000000 1.000000 /end COMPU_METHOD
/* Scalar measurable for DDE 'V2gRxMsgSesSetupEvseId[23]'. */
/begin MEASUREMENT V2gRxMsgSesSetupEvseId[23] "The ID that uniquely identifies the EVSE. Format is defined in DIN SPEC 91286" UBYTE CU_V2GRXMSGSESSETUPEVSEID[23] 1 100 0.0 255.0 ECU_ADDRESS 0x70017f38 BYTE_ORDER MSB_LAST /end MEASUREMENT
/begin COMPU_METHOD CU_V2GRXMSGSESSETUPEVSEID[23] "Conversion method for V2gRxMsgSesSetupEvseId[23]" RAT_FUNC "%10.0" "1" COEFFS 0.000000 1.000000 -0.000000 0.000000 0.000000 1.000000 /end COMPU_METHOD
/* Scalar measurable for DDE 'V2gRxMsgSesSetupEvseId[24]'. */
/begin MEASUREMENT V2gRxMsgSesSetupEvseId[24] "The ID that uniquely identifies the EVSE. Format is defined in DIN SPEC 91286" UBYTE CU_V2GRXMSGSESSETUPEVSEID[24] 1 100 0.0 255.0 ECU_ADDRESS 0x70017f39 BYTE_ORDER MSB_LAST /end MEASUREMENT
/begin COMPU_METHOD CU_V2GRXMSGSESSETUPEVSEID[24] "Conversion method for V2gRxMsgSesSetupEvseId[24]" RAT_FUNC "%10.0" "1" COEFFS 0.000000 1.000000 -0.000000 0.000000 0.000000 1.000000 /end COMPU_METHOD
/* Scalar measurable for DDE 'V2gRxMsgSesSetupEvseId[25]'. */
/begin MEASUREMENT V2gRxMsgSesSetupEvseId[25] "The ID that uniquely identifies the EVSE. Format is defined in DIN SPEC 91286" UBYTE CU_V2GRXMSGSESSETUPEVSEID[25] 1 100 0.0 255.0 ECU_ADDRESS 0x70017f3a BYTE_ORDER MSB_LAST /end MEASUREMENT
/begin COMPU_METHOD CU_V2GRXMSGSESSETUPEVSEID[25] "Conversion method for V2gRxMsgSesSetupEvseId[25]" RAT_FUNC "%10.0" "1" COEFFS 0.000000 1.000000 -0.000000 0.000000 0.000000 1.000000 /end COMPU_METHOD
/* Scalar measurable for DDE 'V2gRxMsgSesSetupEvseId[26]'. */
/begin MEASUREMENT V2gRxMsgSesSetupEvseId[26] "The ID that uniquely identifies the EVSE. Format is defined in DIN SPEC 91286" UBYTE CU_V2GRXMSGSESSETUPEVSEID[26] 1 100 0.0 255.0 ECU_ADDRESS 0x70017f3b BYTE_ORDER MSB_LAST /end MEASUREMENT
/begin COMPU_METHOD CU_V2GRXMSGSESSETUPEVSEID[26] "Conversion method for V2gRxMsgSesSetupEvseId[26]" RAT_FUNC "%10.0" "1" COEFFS 0.000000 1.000000 -0.000000 0.000000 0.000000 1.000000 /end COMPU_METHOD
/* Scalar measurable for DDE 'V2gRxMsgSesSetupEvseId[27]'. */
/begin MEASUREMENT V2gRxMsgSesSetupEvseId[27] "The ID that uniquely identifies the EVSE. Format is defined in DIN SPEC 91286" UBYTE CU_V2GRXMSGSESSETUPEVSEID[27] 1 100 0.0 255.0 ECU_ADDRESS 0x70017f3c BYTE_ORDER MSB_LAST /end MEASUREMENT
/begin COMPU_METHOD CU_V2GRXMSGSESSETUPEVSEID[27] "Conversion method for V2gRxMsgSesSetupEvseId[27]" RAT_FUNC "%10.0" "1" COEFFS 0.000000 1.000000 -0.000000 0.000000 0.000000 1.000000 /end COMPU_METHOD
/* Scalar measurable for DDE 'V2gRxMsgSesSetupEvseId[28]'. */
/begin MEASUREMENT V2gRxMsgSesSetupEvseId[28] "The ID that uniquely identifies the EVSE. Format is defined in DIN SPEC 91286" UBYTE CU_V2GRXMSGSESSETUPEVSEID[28] 1 100 0.0 255.0 ECU_ADDRESS 0x70017f3d BYTE_ORDER MSB_LAST /end MEASUREMENT
/begin COMPU_METHOD CU_V2GRXMSGSESSETUPEVSEID[28] "Conversion method for V2gRxMsgSesSetupEvseId[28]" RAT_FUNC "%10.0" "1" COEFFS 0.000000 1.000000 -0.000000 0.000000 0.000000 1.000000 /end COMPU_METHOD
/* Scalar measurable for DDE 'V2gRxMsgSesSetupEvseId[29]'. */
/begin MEASUREMENT V2gRxMsgSesSetupEvseId[29] "The ID that uniquely identifies the EVSE. Format is defined in DIN SPEC 91286" UBYTE CU_V2GRXMSGSESSETUPEVSEID[29] 1 100 0.0 255.0 ECU_ADDRESS 0x70017f3e BYTE_ORDER MSB_LAST /end MEASUREMENT
/begin COMPU_METHOD CU_V2GRXMSGSESSETUPEVSEID[29] "Conversion method for V2gRxMsgSesSetupEvseId[29]" RAT_FUNC "%10.0" "1" COEFFS 0.000000 1.000000 -0.000000 0.000000 0.000000 1.000000 /end COMPU_METHOD
/* Scalar measurable for DDE 'V2gRxMsgSesSetupEvseId[2]'. */
/begin MEASUREMENT V2gRxMsgSesSetupEvseId[2] "The ID that uniquely identifies the EVSE. Format is defined in DIN SPEC 91286" UBYTE CU_V2GRXMSGSESSETUPEVSEID[2] 1 100 0.0 255.0 ECU_ADDRESS 0x70017f23 BYTE_ORDER MSB_LAST /end MEASUREMENT
/begin COMPU_METHOD CU_V2GRXMSGSESSETUPEVSEID[2] "Conversion method for V2gRxMsgSesSetupEvseId[2]" RAT_FUNC "%10.0" "1" COEFFS 0.000000 1.000000 -0.000000 0.000000 0.000000 1.000000 /end COMPU_METHOD
/* Scalar measurable for DDE 'V2gRxMsgSesSetupEvseId[30]'. */
/begin MEASUREMENT V2gRxMsgSesSetupEvseId[30] "The ID that uniquely identifies the EVSE. Format is defined in DIN SPEC 91286" UBYTE CU_V2GRXMSGSESSETUPEVSEID[30] 1 100 0.0 255.0 ECU_ADDRESS 0x70017f3f BYTE_ORDER MSB_LAST /end MEASUREMENT
/begin COMPU_METHOD CU_V2GRXMSGSESSETUPEVSEID[30] "Conversion method for V2gRxMsgSesSetupEvseId[30]" RAT_FUNC "%10.0" "1" COEFFS 0.000000 1.000000 -0.000000 0.000000 0.000000 1.000000 /end COMPU_METHOD
/* Scalar measurable for DDE 'V2gRxMsgSesSetupEvseId[31]'. */
/begin MEASUREMENT V2gRxMsgSesSetupEvseId[31] "The ID that uniquely identifies the EVSE. Format is defined in DIN SPEC 91286" UBYTE CU_V2GRXMSGSESSETUPEVSEID[31] 1 100 0.0 255.0 ECU_ADDRESS 0x70017f40 BYTE_ORDER MSB_LAST /end MEASUREMENT
/begin COMPU_METHOD CU_V2GRXMSGSESSETUPEVSEID[31] "Conversion method for V2gRxMsgSesSetupEvseId[31]" RAT_FUNC "%10.0" "1" COEFFS 0.000000 1.000000 -0.000000 0.000000 0.000000 1.000000 /end COMPU_METHOD
/* Scalar measurable for DDE 'V2gRxMsgSesSetupEvseId[32]'. */
/begin MEASUREMENT V2gRxMsgSesSetupEvseId[32] "The ID that uniquely identifies the EVSE. Format is defined in DIN SPEC 91286" UBYTE CU_V2GRXMSGSESSETUPEVSEID[32] 1 100 0.0 255.0 ECU_ADDRESS 0x70017f41 BYTE_ORDER MSB_LAST /end MEASUREMENT
/begin COMPU_METHOD CU_V2GRXMSGSESSETUPEVSEID[32] "Conversion method for V2gRxMsgSesSetupEvseId[32]" RAT_FUNC "%10.0" "1" COEFFS 0.000000 1.000000 -0.000000 0.000000 0.000000 1.000000 /end COMPU_METHOD
/* Scalar measurable for DDE 'V2gRxMsgSesSetupEvseId[33]'. */
/begin MEASUREMENT V2gRxMsgSesSetupEvseId[33] "The ID that uniquely identifies the EVSE. Format is defined in DIN SPEC 91286" UBYTE CU_V2GRXMSGSESSETUPEVSEID[33] 1 100 0.0 255.0 ECU_ADDRESS 0x70017f42 BYTE_ORDER MSB_LAST /end MEASUREMENT
/begin COMPU_METHOD CU_V2GRXMSGSESSETUPEVSEID[33] "Conversion method for V2gRxMsgSesSetupEvseId[33]" RAT_FUNC "%10.0" "1" COEFFS 0.000000 1.000000 -0.000000 0.000000 0.000000 1.000000 /end COMPU_METHOD
/* Scalar measurable for DDE 'V2gRxMsgSesSetupEvseId[34]'. */
/begin MEASUREMENT V2gRxMsgSesSetupEvseId[34] "The ID that uniquely identifies the EVSE. Format is defined in DIN SPEC 91286" UBYTE CU_V2GRXMSGSESSETUPEVSEID[34] 1 100 0.0 255.0 ECU_ADDRESS 0x70017f43 BYTE_ORDER MSB_LAST /end MEASUREMENT
/begin COMPU_METHOD CU_V2GRXMSGSESSETUPEVSEID[34] "Conversion method for V2gRxMsgSesSetupEvseId[34]" RAT_FUNC "%10.0" "1" COEFFS 0.000000 1.000000 -0.000000 0.000000 0.000000 1.000000 /end COMPU_METHOD
/* Scalar measurable for DDE 'V2gRxMsgSesSetupEvseId[35]'. */
/begin MEASUREMENT V2gRxMsgSesSetupEvseId[35] "The ID that uniquely identifies the EVSE. Format is defined in DIN SPEC 91286" UBYTE CU_V2GRXMSGSESSETUPEVSEID[35] 1 100 0.0 255.0 ECU_ADDRESS 0x70017f44 BYTE_ORDER MSB_LAST /end MEASUREMENT
/begin COMPU_METHOD CU_V2GRXMSGSESSETUPEVSEID[35] "Conversion method for V2gRxMsgSesSetupEvseId[35]" RAT_FUNC "%10.0" "1" COEFFS 0.000000 1.000000 -0.000000 0.000000 0.000000 1.000000 /end COMPU_METHOD
/* Scalar measurable for DDE 'V2gRxMsgSesSetupEvseId[36]'. */
/begin MEASUREMENT V2gRxMsgSesSetupEvseId[36] "The ID that uniquely identifies the EVSE. Format is defined in DIN SPEC 91286" UBYTE CU_V2GRXMSGSESSETUPEVSEID[36] 1 100 0.0 255.0 ECU_ADDRESS 0x70017f45 BYTE_ORDER MSB_LAST /end MEASUREMENT
/begin COMPU_METHOD CU_V2GRXMSGSESSETUPEVSEID[36] "Conversion method for V2gRxMsgSesSetupEvseId[36]" RAT_FUNC "%10.0" "1" COEFFS 0.000000 1.000000 -0.000000 0.000000 0.000000 1.000000 /end COMPU_METHOD
/* Scalar measurable for DDE 'V2gRxMsgSesSetupEvseId[37]'. */
/begin MEASUREMENT V2gRxMsgSesSetupEvseId[37] "The ID that uniquely identifies the EVSE. Format is defined in DIN SPEC 91286" UBYTE CU_V2GRXMSGSESSETUPEVSEID[37] 1 100 0.0 255.0 ECU_ADDRESS 0x70017f46 BYTE_ORDER MSB_LAST /end MEASUREMENT
/begin COMPU_METHOD CU_V2GRXMSGSESSETUPEVSEID[37] "Conversion method for V2gRxMsgSesSetupEvseId[37]" RAT_FUNC "%10.0" "1" COEFFS 0.000000 1.000000 -0.000000 0.000000 0.000000 1.000000 /end COMPU_METHOD
/* Scalar measurable for DDE 'V2gRxMsgSesSetupEvseId[3]'. */
/begin MEASUREMENT V2gRxMsgSesSetupEvseId[3] "The ID that uniquely identifies the EVSE. Format is defined in DIN SPEC 91286" UBYTE CU_V2GRXMSGSESSETUPEVSEID[3] 1 100 0.0 255.0 ECU_ADDRESS 0x70017f24 BYTE_ORDER MSB_LAST /end MEASUREMENT
/begin COMPU_METHOD CU_V2GRXMSGSESSETUPEVSEID[3] "Conversion method for V2gRxMsgSesSetupEvseId[3]" RAT_FUNC "%10.0" "1" COEFFS 0.000000 1.000000 -0.000000 0.000000 0.000000 1.000000 /end COMPU_METHOD
/* Scalar measurable for DDE 'V2gRxMsgSesSetupEvseId[4]'. */
/begin MEASUREMENT V2gRxMsgSesSetupEvseId[4] "The ID that uniquely identifies the EVSE. Format is defined in DIN SPEC 91286" UBYTE CU_V2GRXMSGSESSETUPEVSEID[4] 1 100 0.0 255.0 ECU_ADDRESS 0x70017f25 BYTE_ORDER MSB_LAST /end MEASUREMENT
/begin COMPU_METHOD CU_V2GRXMSGSESSETUPEVSEID[4] "Conversion method for V2gRxMsgSesSetupEvseId[4]" RAT_FUNC "%10.0" "1" COEFFS 0.000000 1.000000 -0.000000 0.000000 0.000000 1.000000 /end COMPU_METHOD
/* Scalar measurable for DDE 'V2gRxMsgSesSetupEvseId[5]'. */
/begin MEASUREMENT V2gRxMsgSesSetupEvseId[5] "The ID that uniquely identifies the EVSE. Format is defined in DIN SPEC 91286" UBYTE CU_V2GRXMSGSESSETUPEVSEID[5] 1 100 0.0 255.0 ECU_ADDRESS 0x70017f26 BYTE_ORDER MSB_LAST /end MEASUREMENT
/begin COMPU_METHOD CU_V2GRXMSGSESSETUPEVSEID[5] "Conversion method for V2gRxMsgSesSetupEvseId[5]" RAT_FUNC "%10.0" "1" COEFFS 0.000000 1.000000 -0.000000 0.000000 0.000000 1.000000 /end COMPU_METHOD
/* Scalar measurable for DDE 'V2gRxMsgSesSetupEvseId[6]'. */
/begin MEASUREMENT V2gRxMsgSesSetupEvseId[6] "The ID that uniquely identifies the EVSE. Format is defined in DIN SPEC 91286" UBYTE CU_V2GRXMSGSESSETUPEVSEID[6] 1 100 0.0 255.0 ECU_ADDRESS 0x70017f27 BYTE_ORDER MSB_LAST /end MEASUREMENT
/begin COMPU_METHOD CU_V2GRXMSGSESSETUPEVSEID[6] "Conversion method for V2gRxMsgSesSetupEvseId[6]" RAT_FUNC "%10.0" "1" COEFFS 0.000000 1.000000 -0.000000 0.000000 0.000000 1.000000 /end COMPU_METHOD
/* Scalar measurable for DDE 'V2gRxMsgSesSetupEvseId[7]'. */
/begin MEASUREMENT V2gRxMsgSesSetupEvseId[7] "The ID that uniquely identifies the EVSE. Format is defined in DIN SPEC 91286" UBYTE CU_V2GRXMSGSESSETUPEVSEID[7] 1 100 0.0 255.0 ECU_ADDRESS 0x70017f28 BYTE_ORDER MSB_LAST /end MEASUREMENT
/begin COMPU_METHOD CU_V2GRXMSGSESSETUPEVSEID[7] "Conversion method for V2gRxMsgSesSetupEvseId[7]" RAT_FUNC "%10.0" "1" COEFFS 0.000000 1.000000 -0.000000 0.000000 0.000000 1.000000 /end COMPU_METHOD
/* Scalar measurable for DDE 'V2gRxMsgSesSetupEvseId[8]'. */
/begin MEASUREMENT V2gRxMsgSesSetupEvseId[8] "The ID that uniquely identifies the EVSE. Format is defined in DIN SPEC 91286" UBYTE CU_V2GRXMSGSESSETUPEVSEID[8] 1 100 0.0 255.0 ECU_ADDRESS 0x70017f29 BYTE_ORDER MSB_LAST /end MEASUREMENT
/begin COMPU_METHOD CU_V2GRXMSGSESSETUPEVSEID[8] "Conversion method for V2gRxMsgSesSetupEvseId[8]" RAT_FUNC "%10.0" "1" COEFFS 0.000000 1.000000 -0.000000 0.000000 0.000000 1.000000 /end COMPU_METHOD
/* Scalar measurable for DDE 'V2gRxMsgSesSetupEvseId[9]'. */
/begin MEASUREMENT V2gRxMsgSesSetupEvseId[9] "The ID that uniquely identifies the EVSE. Format is defined in DIN SPEC 91286" UBYTE CU_V2GRXMSGSESSETUPEVSEID[9] 1 100 0.0 255.0 ECU_ADDRESS 0x70017f2a BYTE_ORDER MSB_LAST /end MEASUREMENT
/begin COMPU_METHOD CU_V2GRXMSGSESSETUPEVSEID[9] "Conversion method for V2gRxMsgSesSetupEvseId[9]" RAT_FUNC "%10.0" "1" COEFFS 0.000000 1.000000 -0.000000 0.000000 0.000000 1.000000 /end COMPU_METHOD
/* Scalar measurable for DDE 'V2gRxMsgSesSetupNotif'. */
/begin MEASUREMENT V2gRxMsgSesSetupNotif "The arbitrated Notification Max Delay parameter in the received message from EVSE" SLONG CU_V2GRXMSGSESSETUPNOTIF 1 100 -2147483648.0 2147483647.0 ECU_ADDRESS 0x70018198 BYTE_ORDER MSB_LAST /end MEASUREMENT
/begin COMPU_METHOD CU_V2GRXMSGSESSETUPNOTIF "Conversion method for V2gRxMsgSesSetupNotif" TAB_VERB "%12.0" "1" COMPU_TAB_REF CT_V2GRXMSGSESSETUPNOTIF /end COMPU_METHOD
/begin COMPU_VTAB CT_V2GRXMSGSESSETUPNOTIF "Conversion method for V2gRxMsgSesSetupNotif" TAB_VERB 3 0 "NONE" 1 "STOPCHARGING" 2 "RENEGOTIATION" /end COMPU_VTAB
/* Scalar measurable for DDE 'V2gRxMsgSesSetupNotifFlg'. */
/begin MEASUREMENT V2gRxMsgSesSetupNotifFlg "The arbitrated Notification parameter in the received message from EVSE" UBYTE CU_V2GRXMSGSESSETUPNOTIFFLG 1 100 0.0 1.0 ECU_ADDRESS 0x7001846c BYTE_ORDER MSB_LAST /end MEASUREMENT
/begin COMPU_METHOD CU_V2GRXMSGSESSETUPNOTIFFLG "Conversion method for V2gRxMsgSesSetupNotifFlg" RAT_FUNC "%10.0" "b" COEFFS 0.000000 1.000000 -0.000000 0.000000 0.000000 1.000000 /end COMPU_METHOD
/* Scalar measurable for DDE 'V2gRxMsgSesSetupNotifMaxDelay'. */
/begin MEASUREMENT V2gRxMsgSesSetupNotifMaxDelay "The arbitrated Notification Max Delay parameter in the received message from EVSE" UWORD CU_V2GRXMSGSESSETUPNOTIFMAXDEL0 1 100 0.0 65535.0 ECU_ADDRESS 0x70018298 BYTE_ORDER MSB_LAST /end MEASUREMENT
/begin COMPU_METHOD CU_V2GRXMSGSESSETUPNOTIFMAXDEL0 "Conversion method for V2gRxMsgSesSetupNotifMaxDelay" RAT_FUNC "%10.0" "s" COEFFS 0.000000 1.000000 -0.000000 0.000000 0.000000 1.000000 /end COMPU_METHOD
/* Scalar measurable for DDE 'V2gRxMsgSesSetupRescode'. */
/begin MEASUREMENT V2gRxMsgSesSetupRescode "for message 1b: indicates the acknowledgment status of  this V2G messages received by the SECC." UBYTE CU_V2GRXMSGSESSETUPRESCODE 1 100 0.0 255.0 ECU_ADDRESS 0x70017c88 BYTE_ORDER MSB_LAST /end MEASUREMENT
/begin COMPU_METHOD CU_V2GRXMSGSESSETUPRESCODE "Conversion method for V2gRxMsgSesSetupRescode" RAT_FUNC "%10.0" "1" COEFFS 0.000000 1.000000 -0.000000 0.000000 0.000000 1.000000 /end COMPU_METHOD
/* Scalar measurable for DDE 'V2gRxMsgSesSetupTimestamp'. */
/begin MEASUREMENT V2gRxMsgSesSetupTimestamp "Timestamp of the current SECC time using the Unix Time Stamp format." SLONG CU_V2GRXMSGSESSETUPTIMESTAMP 1 100 -2147480000.0 2147480000.0 ECU_ADDRESS 0x7001838c BYTE_ORDER MSB_LAST /end MEASUREMENT
/begin COMPU_METHOD CU_V2GRXMSGSESSETUPTIMESTAMP "Conversion method for V2gRxMsgSesSetupTimestamp" RAT_FUNC "%10.0" "s" COEFFS 0.000000 1.000000 -0.000000 0.000000 0.000000 1.000000 /end COMPU_METHOD
/* Scalar measurable for DDE 'V2gRxMsgSesSetupTimestamp_flg'. */
/begin MEASUREMENT V2gRxMsgSesSetupTimestamp_flg "Identifies the presence of the DateTimeNow parameter in the received message from EVSE" UBYTE CU_V2GRXMSGSESSETUPTIMESTAMP_F0 1 100 0.0 1.0 ECU_ADDRESS 0x70017f54 BYTE_ORDER MSB_LAST /end MEASUREMENT
/begin COMPU_METHOD CU_V2GRXMSGSESSETUPTIMESTAMP_F0 "Conversion method for V2gRxMsgSesSetupTimestamp_flg" RAT_FUNC "%10.0" "b" COEFFS 0.000000 1.000000 -0.000000 0.000000 0.000000 1.000000 /end COMPU_METHOD
/* Scalar measurable for DDE 'V2gRxMsgSesSetupTrg'. */
/begin MEASUREMENT V2gRxMsgSesSetupTrg "Trigger falg that on a rising edge indicates the event for receiving the PLC (V2G) message response 1b from EVSE" UBYTE CU_V2GRXMSGSESSETUPTRG 1 100 0.0 1.0 ECU_ADDRESS 0x700181c8 BYTE_ORDER MSB_LAST /end MEASUREMENT
/begin COMPU_METHOD CU_V2GRXMSGSESSETUPTRG "Conversion method for V2gRxMsgSesSetupTrg" RAT_FUNC "%10.0" "b" COEFFS 0.000000 1.000000 -0.000000 0.000000 0.000000 1.000000 /end COMPU_METHOD
/* Scalar measurable for DDE 'V2gRxMsgSesStopNotif'. */
/begin MEASUREMENT V2gRxMsgSesStopNotif "The arbitrated Notification Max Delay parameter in the received message from EVSE" SLONG CU_V2GRXMSGSESSTOPNOTIF 1 100 -2147483648.0 2147483647.0 ECU_ADDRESS 0x70017c80 BYTE_ORDER MSB_LAST /end MEASUREMENT
/begin COMPU_METHOD CU_V2GRXMSGSESSTOPNOTIF "Conversion method for V2gRxMsgSesStopNotif" TAB_VERB "%12.0" "1" COMPU_TAB_REF CT_V2GRXMSGSESSTOPNOTIF /end COMPU_METHOD
/begin COMPU_VTAB CT_V2GRXMSGSESSTOPNOTIF "Conversion method for V2gRxMsgSesStopNotif" TAB_VERB 3 0 "NONE" 1 "STOPCHARGING" 2 "RENEGOTIATION" /end COMPU_VTAB
/* Scalar measurable for DDE 'V2gRxMsgSesStopNotifFlg'. */
/begin MEASUREMENT V2gRxMsgSesStopNotifFlg "The arbitrated Notification parameter in the received message from EVSE" UBYTE CU_V2GRXMSGSESSTOPNOTIFFLG 1 100 0.0 1.0 ECU_ADDRESS 0x70018383 BYTE_ORDER MSB_LAST /end MEASUREMENT
/begin COMPU_METHOD CU_V2GRXMSGSESSTOPNOTIFFLG "Conversion method for V2gRxMsgSesStopNotifFlg" RAT_FUNC "%10.0" "b" COEFFS 0.000000 1.000000 -0.000000 0.000000 0.000000 1.000000 /end COMPU_METHOD
/* Scalar measurable for DDE 'V2gRxMsgSesStopNotifMaxDelay'. */
/begin MEASUREMENT V2gRxMsgSesStopNotifMaxDelay "The arbitrated Notification Max Delay parameter in the received message from EVSE" UWORD CU_V2GRXMSGSESSTOPNOTIFMAXDELAY 1 100 0.0 65535.0 ECU_ADDRESS 0x70018350 BYTE_ORDER MSB_LAST /end MEASUREMENT
/begin COMPU_METHOD CU_V2GRXMSGSESSTOPNOTIFMAXDELAY "Conversion method for V2gRxMsgSesStopNotifMaxDelay" RAT_FUNC "%10.0" "s" COEFFS 0.000000 1.000000 -0.000000 0.000000 0.000000 1.000000 /end COMPU_METHOD
/* Scalar measurable for DDE 'V2gRxMsgSesStopRescode'. */
/begin MEASUREMENT V2gRxMsgSesStopRescode "for message 10b: indicates the acknowledgment status of  this V2G messages received by the SECC." UBYTE CU_V2GRXMSGSESSTOPRESCODE 1 100 0.0 255.0 ECU_ADDRESS 0x700181ac BYTE_ORDER MSB_LAST /end MEASUREMENT
/begin COMPU_METHOD CU_V2GRXMSGSESSTOPRESCODE "Conversion method for V2gRxMsgSesStopRescode" RAT_FUNC "%10.0" "1" COEFFS 0.000000 1.000000 -0.000000 0.000000 0.000000 1.000000 /end COMPU_METHOD
/* Scalar measurable for DDE 'V2gRxMsgSesStopTrg'. */
/begin MEASUREMENT V2gRxMsgSesStopTrg "Trigger falg that on a rising edge indicates the event for receiving the PLC (V2G) message response 10b from EVSE" UBYTE CU_V2GRXMSGSESSTOPTRG 1 100 0.0 1.0 ECU_ADDRESS 0x7001845c BYTE_ORDER MSB_LAST /end MEASUREMENT
/begin COMPU_METHOD CU_V2GRXMSGSESSTOPTRG "Conversion method for V2gRxMsgSesStopTrg" RAT_FUNC "%10.0" "b" COEFFS 0.000000 1.000000 -0.000000 0.000000 0.000000 1.000000 /end COMPU_METHOD
/* Scalar measurable for DDE 'V2gRxMsgSvcDiscEgyTransferModeSize'. */
/begin MEASUREMENT V2gRxMsgSvcDiscEgyTransferMode1 "The arbitrated Transfer Mode Size parameter in the received message from EVSE" UBYTE CU_V2GRXMSGSVCDISCEGYTRANSFERM1 1 100 0.0 255.0 ECU_ADDRESS 0x70017f17 BYTE_ORDER MSB_LAST /end MEASUREMENT
/begin COMPU_METHOD CU_V2GRXMSGSVCDISCEGYTRANSFERM1 "Conversion method for V2gRxMsgSvcDiscEgyTransferModeSize" RAT_FUNC "%10.0" "1" COEFFS 0.000000 1.000000 -0.000000 0.000000 0.000000 1.000000 /end COMPU_METHOD
/* Scalar measurable for DDE 'V2gRxMsgSvcDiscEgyTransferMode[0]'. */
/begin MEASUREMENT V2gRxMsgSvcDiscEgyTransferMode4 "The arbitrated Transfer Mode parameter in the received message from EVSE" SLONG CU_V2GRXMSGSVCDISCEGYTRANSFERM4 1 100 -2147483648.0 2147483647.0 ECU_ADDRESS 0x70017d54 BYTE_ORDER MSB_LAST /end MEASUREMENT
/begin COMPU_METHOD CU_V2GRXMSGSVCDISCEGYTRANSFERM4 "Conversion method for V2gRxMsgSvcDiscEgyTransferMode[0]" TAB_VERB "%12.0" "enum" COMPU_TAB_REF CT_V2GRXMSGSVCDISCEGYTRANSFERM4 /end COMPU_METHOD
/begin COMPU_VTAB CT_V2GRXMSGSVCDISCEGYTRANSFERM4 "Conversion method for V2gRxMsgSvcDiscEgyTransferMode[0]" TAB_VERB 8 0 "AC_SINGLE_PHASE" 1 "AC_THREE_PHASE" 2 "DC_CORE" 3 "DC_EXTENDED" 4 "DC_COMBO" 5 "DC_UNIQUE" 6 "DUAL_2" 7 "DUAL_4" /end COMPU_VTAB
/* Scalar measurable for DDE 'V2gRxMsgSvcDiscEgyTransferMode[1]'. */
/begin MEASUREMENT V2gRxMsgSvcDiscEgyTransferMode3 "The arbitrated Transfer Mode parameter in the received message from EVSE" SLONG CU_V2GRXMSGSVCDISCEGYTRANSFERM3 1 100 -2147483648.0 2147483647.0 ECU_ADDRESS 0x70017d58 BYTE_ORDER MSB_LAST /end MEASUREMENT
/begin COMPU_METHOD CU_V2GRXMSGSVCDISCEGYTRANSFERM3 "Conversion method for V2gRxMsgSvcDiscEgyTransferMode[1]" TAB_VERB "%12.0" "enum" COMPU_TAB_REF CT_V2GRXMSGSVCDISCEGYTRANSFERM3 /end COMPU_METHOD
/begin COMPU_VTAB CT_V2GRXMSGSVCDISCEGYTRANSFERM3 "Conversion method for V2gRxMsgSvcDiscEgyTransferMode[1]" TAB_VERB 8 0 "AC_SINGLE_PHASE" 1 "AC_THREE_PHASE" 2 "DC_CORE" 3 "DC_EXTENDED" 4 "DC_COMBO" 5 "DC_UNIQUE" 6 "DUAL_2" 7 "DUAL_4" /end COMPU_VTAB
/* Scalar measurable for DDE 'V2gRxMsgSvcDiscEgyTransferMode[2]'. */
/begin MEASUREMENT V2gRxMsgSvcDiscEgyTransferMode2 "The arbitrated Transfer Mode parameter in the received message from EVSE" SLONG CU_V2GRXMSGSVCDISCEGYTRANSFERM2 1 100 -2147483648.0 2147483647.0 ECU_ADDRESS 0x70017d5c BYTE_ORDER MSB_LAST /end MEASUREMENT
/begin COMPU_METHOD CU_V2GRXMSGSVCDISCEGYTRANSFERM2 "Conversion method for V2gRxMsgSvcDiscEgyTransferMode[2]" TAB_VERB "%12.0" "enum" COMPU_TAB_REF CT_V2GRXMSGSVCDISCEGYTRANSFERM2 /end COMPU_METHOD
/begin COMPU_VTAB CT_V2GRXMSGSVCDISCEGYTRANSFERM2 "Conversion method for V2gRxMsgSvcDiscEgyTransferMode[2]" TAB_VERB 8 0 "AC_SINGLE_PHASE" 1 "AC_THREE_PHASE" 2 "DC_CORE" 3 "DC_EXTENDED" 4 "DC_COMBO" 5 "DC_UNIQUE" 6 "DUAL_2" 7 "DUAL_4" /end COMPU_VTAB
/* Scalar measurable for DDE 'V2gRxMsgSvcDiscEgyTransferMode[3]'. */
/begin MEASUREMENT V2gRxMsgSvcDiscEgyTransferMode0 "The arbitrated Transfer Mode parameter in the received message from EVSE" SLONG CU_V2GRXMSGSVCDISCEGYTRANSFERM0 1 100 -2147483648.0 2147483647.0 ECU_ADDRESS 0x70017d60 BYTE_ORDER MSB_LAST /end MEASUREMENT
/begin COMPU_METHOD CU_V2GRXMSGSVCDISCEGYTRANSFERM0 "Conversion method for V2gRxMsgSvcDiscEgyTransferMode[3]" TAB_VERB "%12.0" "enum" COMPU_TAB_REF CT_V2GRXMSGSVCDISCEGYTRANSFERM0 /end COMPU_METHOD
/begin COMPU_VTAB CT_V2GRXMSGSVCDISCEGYTRANSFERM0 "Conversion method for V2gRxMsgSvcDiscEgyTransferMode[3]" TAB_VERB 8 0 "AC_SINGLE_PHASE" 1 "AC_THREE_PHASE" 2 "DC_CORE" 3 "DC_EXTENDED" 4 "DC_COMBO" 5 "DC_UNIQUE" 6 "DUAL_2" 7 "DUAL_4" /end COMPU_VTAB
/* Scalar measurable for DDE 'V2gRxMsgSvcDiscEgyTransferMode[4]'. */
/begin MEASUREMENT V2gRxMsgSvcDiscEgyTransferMode6 "The arbitrated Transfer Mode parameter in the received message from EVSE" SLONG CU_V2GRXMSGSVCDISCEGYTRANSFERM6 1 100 -2147483648.0 2147483647.0 ECU_ADDRESS 0x70017d64 BYTE_ORDER MSB_LAST /end MEASUREMENT
/begin COMPU_METHOD CU_V2GRXMSGSVCDISCEGYTRANSFERM6 "Conversion method for V2gRxMsgSvcDiscEgyTransferMode[4]" TAB_VERB "%12.0" "enum" COMPU_TAB_REF CT_V2GRXMSGSVCDISCEGYTRANSFERM6 /end COMPU_METHOD
/begin COMPU_VTAB CT_V2GRXMSGSVCDISCEGYTRANSFERM6 "Conversion method for V2gRxMsgSvcDiscEgyTransferMode[4]" TAB_VERB 8 0 "AC_SINGLE_PHASE" 1 "AC_THREE_PHASE" 2 "DC_CORE" 3 "DC_EXTENDED" 4 "DC_COMBO" 5 "DC_UNIQUE" 6 "DUAL_2" 7 "DUAL_4" /end COMPU_VTAB
/* Scalar measurable for DDE 'V2gRxMsgSvcDiscEgyTransferMode[5]'. */
/begin MEASUREMENT V2gRxMsgSvcDiscEgyTransferMode5 "The arbitrated Transfer Mode parameter in the received message from EVSE" SLONG CU_V2GRXMSGSVCDISCEGYTRANSFERM5 1 100 -2147483648.0 2147483647.0 ECU_ADDRESS 0x70017d68 BYTE_ORDER MSB_LAST /end MEASUREMENT
/begin COMPU_METHOD CU_V2GRXMSGSVCDISCEGYTRANSFERM5 "Conversion method for V2gRxMsgSvcDiscEgyTransferMode[5]" TAB_VERB "%12.0" "enum" COMPU_TAB_REF CT_V2GRXMSGSVCDISCEGYTRANSFERM5 /end COMPU_METHOD
/begin COMPU_VTAB CT_V2GRXMSGSVCDISCEGYTRANSFERM5 "Conversion method for V2gRxMsgSvcDiscEgyTransferMode[5]" TAB_VERB 8 0 "AC_SINGLE_PHASE" 1 "AC_THREE_PHASE" 2 "DC_CORE" 3 "DC_EXTENDED" 4 "DC_COMBO" 5 "DC_UNIQUE" 6 "DUAL_2" 7 "DUAL_4" /end COMPU_VTAB
/* Scalar measurable for DDE 'V2gRxMsgSvcDiscEgyTransferSvcIdsLen'. */
/begin MEASUREMENT V2gRxMsgSvcDiscEgyTransferSvcI1 "The arbitrated Transfer Service IDs Length parameter in the received message from EVSE" UBYTE CU_V2GRXMSGSVCDISCEGYTRANSFERS1 1 100 0.0 255.0 ECU_ADDRESS 0x70018054 BYTE_ORDER MSB_LAST /end MEASUREMENT
/begin COMPU_METHOD CU_V2GRXMSGSVCDISCEGYTRANSFERS1 "Conversion method for V2gRxMsgSvcDiscEgyTransferSvcIdsLen" RAT_FUNC "%10.0" "1" COEFFS 0.000000 1.000000 -0.000000 0.000000 0.000000 1.000000 /end COMPU_METHOD
/* Scalar measurable for DDE 'V2gRxMsgSvcDiscEgyTransferSvcIds[0]'. */
/begin MEASUREMENT V2gRxMsgSvcDiscEgyTransferSvcI8 "The arbitrated Transfer Service IDs parameter in the received message from EVSE" UWORD CU_V2GRXMSGSVCDISCEGYTRANSFERS8 1 100 0.0 65535.0 ECU_ADDRESS 0x70017e4a BYTE_ORDER MSB_LAST /end MEASUREMENT
/begin COMPU_METHOD CU_V2GRXMSGSVCDISCEGYTRANSFERS8 "Conversion method for V2gRxMsgSvcDiscEgyTransferSvcIds[0]" RAT_FUNC "%10.0" "1" COEFFS 0.000000 1.000000 -0.000000 0.000000 0.000000 1.000000 /end COMPU_METHOD
/* Scalar measurable for DDE 'V2gRxMsgSvcDiscEgyTransferSvcIds[1]'. */
/begin MEASUREMENT V2gRxMsgSvcDiscEgyTransferSvcI4 "The arbitrated Transfer Service IDs parameter in the received message from EVSE" UWORD CU_V2GRXMSGSVCDISCEGYTRANSFERS4 1 100 0.0 65535.0 ECU_ADDRESS 0x70017e4c BYTE_ORDER MSB_LAST /end MEASUREMENT
/begin COMPU_METHOD CU_V2GRXMSGSVCDISCEGYTRANSFERS4 "Conversion method for V2gRxMsgSvcDiscEgyTransferSvcIds[1]" RAT_FUNC "%10.0" "1" COEFFS 0.000000 1.000000 -0.000000 0.000000 0.000000 1.000000 /end COMPU_METHOD
/* Scalar measurable for DDE 'V2gRxMsgSvcDiscEgyTransferSvcIds[2]'. */
/begin MEASUREMENT V2gRxMsgSvcDiscEgyTransferSvcI0 "The arbitrated Transfer Service IDs parameter in the received message from EVSE" UWORD CU_V2GRXMSGSVCDISCEGYTRANSFERS0 1 100 0.0 65535.0 ECU_ADDRESS 0x70017e4e BYTE_ORDER MSB_LAST /end MEASUREMENT
/begin COMPU_METHOD CU_V2GRXMSGSVCDISCEGYTRANSFERS0 "Conversion method for V2gRxMsgSvcDiscEgyTransferSvcIds[2]" RAT_FUNC "%10.0" "1" COEFFS 0.000000 1.000000 -0.000000 0.000000 0.000000 1.000000 /end COMPU_METHOD
/* Scalar measurable for DDE 'V2gRxMsgSvcDiscEgyTransferSvcIds[3]'. */
/begin MEASUREMENT V2gRxMsgSvcDiscEgyTransferSvcI7 "The arbitrated Transfer Service IDs parameter in the received message from EVSE" UWORD CU_V2GRXMSGSVCDISCEGYTRANSFERS7 1 100 0.0 65535.0 ECU_ADDRESS 0x70017e50 BYTE_ORDER MSB_LAST /end MEASUREMENT
/begin COMPU_METHOD CU_V2GRXMSGSVCDISCEGYTRANSFERS7 "Conversion method for V2gRxMsgSvcDiscEgyTransferSvcIds[3]" RAT_FUNC "%10.0" "1" COEFFS 0.000000 1.000000 -0.000000 0.000000 0.000000 1.000000 /end COMPU_METHOD
/* Scalar measurable for DDE 'V2gRxMsgSvcDiscEgyTransferSvcIds[4]'. */
/begin MEASUREMENT V2gRxMsgSvcDiscEgyTransferSvcI5 "The arbitrated Transfer Service IDs parameter in the received message from EVSE" UWORD CU_V2GRXMSGSVCDISCEGYTRANSFERS5 1 100 0.0 65535.0 ECU_ADDRESS 0x70017e52 BYTE_ORDER MSB_LAST /end MEASUREMENT
/begin COMPU_METHOD CU_V2GRXMSGSVCDISCEGYTRANSFERS5 "Conversion method for V2gRxMsgSvcDiscEgyTransferSvcIds[4]" RAT_FUNC "%10.0" "1" COEFFS 0.000000 1.000000 -0.000000 0.000000 0.000000 1.000000 /end COMPU_METHOD
/* Scalar measurable for DDE 'V2gRxMsgSvcDiscEgyTransferSvcIds[5]'. */
/begin MEASUREMENT V2gRxMsgSvcDiscEgyTransferSvcI6 "The arbitrated Transfer Service IDs parameter in the received message from EVSE" UWORD CU_V2GRXMSGSVCDISCEGYTRANSFERS6 1 100 0.0 65535.0 ECU_ADDRESS 0x70017e54 BYTE_ORDER MSB_LAST /end MEASUREMENT
/begin COMPU_METHOD CU_V2GRXMSGSVCDISCEGYTRANSFERS6 "Conversion method for V2gRxMsgSvcDiscEgyTransferSvcIds[5]" RAT_FUNC "%10.0" "1" COEFFS 0.000000 1.000000 -0.000000 0.000000 0.000000 1.000000 /end COMPU_METHOD
/* Scalar measurable for DDE 'V2gRxMsgSvcDiscEgyTransferSvcIds[6]'. */
/begin MEASUREMENT V2gRxMsgSvcDiscEgyTransferSvcI2 "The arbitrated Transfer Service IDs parameter in the received message from EVSE" UWORD CU_V2GRXMSGSVCDISCEGYTRANSFERS2 1 100 0.0 65535.0 ECU_ADDRESS 0x70017e56 BYTE_ORDER MSB_LAST /end MEASUREMENT
/begin COMPU_METHOD CU_V2GRXMSGSVCDISCEGYTRANSFERS2 "Conversion method for V2gRxMsgSvcDiscEgyTransferSvcIds[6]" RAT_FUNC "%10.0" "1" COEFFS 0.000000 1.000000 -0.000000 0.000000 0.000000 1.000000 /end COMPU_METHOD
/* Scalar measurable for DDE 'V2gRxMsgSvcDiscEgyTransferSvcIds[7]'. */
/begin MEASUREMENT V2gRxMsgSvcDiscEgyTransferSvcI3 "The arbitrated Transfer Service IDs parameter in the received message from EVSE" UWORD CU_V2GRXMSGSVCDISCEGYTRANSFERS3 1 100 0.0 65535.0 ECU_ADDRESS 0x70017e58 BYTE_ORDER MSB_LAST /end MEASUREMENT
/begin COMPU_METHOD CU_V2GRXMSGSVCDISCEGYTRANSFERS3 "Conversion method for V2gRxMsgSvcDiscEgyTransferSvcIds[7]" RAT_FUNC "%10.0" "1" COEFFS 0.000000 1.000000 -0.000000 0.000000 0.000000 1.000000 /end COMPU_METHOD
/* Scalar measurable for DDE 'V2gRxMsgSvcDiscEgyTxfrType'. */
/begin MEASUREMENT V2gRxMsgSvcDiscEgyTxfrType "Identifies the energy transfer type for charging." SLONG CU_V2GRXMSGSVCDISCEGYTXFRTYPE 1 100 -2147483648.0 2147483647.0 ECU_ADDRESS 0x7001819c BYTE_ORDER MSB_LAST /end MEASUREMENT
/begin COMPU_METHOD CU_V2GRXMSGSVCDISCEGYTXFRTYPE "Conversion method for V2gRxMsgSvcDiscEgyTxfrType" TAB_VERB "%12.0" "enum" COMPU_TAB_REF CT_V2GRXMSGSVCDISCEGYTXFRTYPE /end COMPU_METHOD
/begin COMPU_VTAB CT_V2GRXMSGSVCDISCEGYTXFRTYPE "Conversion method for V2gRxMsgSvcDiscEgyTxfrType" TAB_VERB 8 0 "AC_SINGLE_PHASE" 1 "AC_THREE_PHASE" 2 "DC_CORE" 3 "DC_EXTENDED" 4 "DC_COMBO" 5 "DC_UNIQUE" 6 "DUAL_2" 7 "DUAL_4" /end COMPU_VTAB
/* Scalar measurable for DDE 'V2gRxMsgSvcDiscFreeService[0]'. */
/begin MEASUREMENT V2gRxMsgSvcDiscFreeService[0] "If true, indicates that the service can be used free of charge." UBYTE CU_V2GRXMSGSVCDISCFREESERVICE[5 1 100 0.0 1.0 ECU_ADDRESS 0x70017f5c BYTE_ORDER MSB_LAST /end MEASUREMENT
/begin COMPU_METHOD CU_V2GRXMSGSVCDISCFREESERVICE[5 "Conversion method for V2gRxMsgSvcDiscFreeService[0]" RAT_FUNC "%10.0" "b" COEFFS 0.000000 1.000000 -0.000000 0.000000 0.000000 1.000000 /end COMPU_METHOD
/* Scalar measurable for DDE 'V2gRxMsgSvcDiscFreeService[1]'. */
/begin MEASUREMENT V2gRxMsgSvcDiscFreeService[1] "If true, indicates that the service can be used free of charge." UBYTE CU_V2GRXMSGSVCDISCFREESERVICE[4 1 100 0.0 1.0 ECU_ADDRESS 0x70017f5d BYTE_ORDER MSB_LAST /end MEASUREMENT
/begin COMPU_METHOD CU_V2GRXMSGSVCDISCFREESERVICE[4 "Conversion method for V2gRxMsgSvcDiscFreeService[1]" RAT_FUNC "%10.0" "b" COEFFS 0.000000 1.000000 -0.000000 0.000000 0.000000 1.000000 /end COMPU_METHOD
/* Scalar measurable for DDE 'V2gRxMsgSvcDiscFreeService[2]'. */
/begin MEASUREMENT V2gRxMsgSvcDiscFreeService[2] "If true, indicates that the service can be used free of charge." UBYTE CU_V2GRXMSGSVCDISCFREESERVICE[7 1 100 0.0 1.0 ECU_ADDRESS 0x70017f5e BYTE_ORDER MSB_LAST /end MEASUREMENT
/begin COMPU_METHOD CU_V2GRXMSGSVCDISCFREESERVICE[7 "Conversion method for V2gRxMsgSvcDiscFreeService[2]" RAT_FUNC "%10.0" "b" COEFFS 0.000000 1.000000 -0.000000 0.000000 0.000000 1.000000 /end COMPU_METHOD
/* Scalar measurable for DDE 'V2gRxMsgSvcDiscFreeService[3]'. */
/begin MEASUREMENT V2gRxMsgSvcDiscFreeService[3] "If true, indicates that the service can be used free of charge." UBYTE CU_V2GRXMSGSVCDISCFREESERVICE[6 1 100 0.0 1.0 ECU_ADDRESS 0x70017f5f BYTE_ORDER MSB_LAST /end MEASUREMENT
/begin COMPU_METHOD CU_V2GRXMSGSVCDISCFREESERVICE[6 "Conversion method for V2gRxMsgSvcDiscFreeService[3]" RAT_FUNC "%10.0" "b" COEFFS 0.000000 1.000000 -0.000000 0.000000 0.000000 1.000000 /end COMPU_METHOD
/* Scalar measurable for DDE 'V2gRxMsgSvcDiscFreeService[4]'. */
/begin MEASUREMENT V2gRxMsgSvcDiscFreeService[4] "If true, indicates that the service can be used free of charge." UBYTE CU_V2GRXMSGSVCDISCFREESERVICE[1 1 100 0.0 1.0 ECU_ADDRESS 0x70017f60 BYTE_ORDER MSB_LAST /end MEASUREMENT
/begin COMPU_METHOD CU_V2GRXMSGSVCDISCFREESERVICE[1 "Conversion method for V2gRxMsgSvcDiscFreeService[4]" RAT_FUNC "%10.0" "b" COEFFS 0.000000 1.000000 -0.000000 0.000000 0.000000 1.000000 /end COMPU_METHOD
/* Scalar measurable for DDE 'V2gRxMsgSvcDiscFreeService[5]'. */
/begin MEASUREMENT V2gRxMsgSvcDiscFreeService[5] "If true, indicates that the service can be used free of charge." UBYTE CU_V2GRXMSGSVCDISCFREESERVICE[0 1 100 0.0 1.0 ECU_ADDRESS 0x70017f61 BYTE_ORDER MSB_LAST /end MEASUREMENT
/begin COMPU_METHOD CU_V2GRXMSGSVCDISCFREESERVICE[0 "Conversion method for V2gRxMsgSvcDiscFreeService[5]" RAT_FUNC "%10.0" "b" COEFFS 0.000000 1.000000 -0.000000 0.000000 0.000000 1.000000 /end COMPU_METHOD
/* Scalar measurable for DDE 'V2gRxMsgSvcDiscFreeService[6]'. */
/begin MEASUREMENT V2gRxMsgSvcDiscFreeService[6] "If true, indicates that the service can be used free of charge." UBYTE CU_V2GRXMSGSVCDISCFREESERVICE[3 1 100 0.0 1.0 ECU_ADDRESS 0x70017f62 BYTE_ORDER MSB_LAST /end MEASUREMENT
/begin COMPU_METHOD CU_V2GRXMSGSVCDISCFREESERVICE[3 "Conversion method for V2gRxMsgSvcDiscFreeService[6]" RAT_FUNC "%10.0" "b" COEFFS 0.000000 1.000000 -0.000000 0.000000 0.000000 1.000000 /end COMPU_METHOD
/* Scalar measurable for DDE 'V2gRxMsgSvcDiscFreeService[7]'. */
/begin MEASUREMENT V2gRxMsgSvcDiscFreeService[7] "If true, indicates that the service can be used free of charge." UBYTE CU_V2GRXMSGSVCDISCFREESERVICE[2 1 100 0.0 1.0 ECU_ADDRESS 0x70017f63 BYTE_ORDER MSB_LAST /end MEASUREMENT
/begin COMPU_METHOD CU_V2GRXMSGSVCDISCFREESERVICE[2 "Conversion method for V2gRxMsgSvcDiscFreeService[7]" RAT_FUNC "%10.0" "b" COEFFS 0.000000 1.000000 -0.000000 0.000000 0.000000 1.000000 /end COMPU_METHOD
/* Scalar measurable for DDE 'V2gRxMsgSvcDiscNotif'. */
/begin MEASUREMENT V2gRxMsgSvcDiscNotif "The arbitrated Notification Max Delay parameter in the received message from EVSE" SLONG CU_V2GRXMSGSVCDISCNOTIF 1 100 -2147483648.0 2147483647.0 ECU_ADDRESS 0x70017e3c BYTE_ORDER MSB_LAST /end MEASUREMENT
/begin COMPU_METHOD CU_V2GRXMSGSVCDISCNOTIF "Conversion method for V2gRxMsgSvcDiscNotif" TAB_VERB "%12.0" "1" COMPU_TAB_REF CT_V2GRXMSGSVCDISCNOTIF /end COMPU_METHOD
/begin COMPU_VTAB CT_V2GRXMSGSVCDISCNOTIF "Conversion method for V2gRxMsgSvcDiscNotif" TAB_VERB 3 0 "NONE" 1 "STOPCHARGING" 2 "RENEGOTIATION" /end COMPU_VTAB
/* Scalar measurable for DDE 'V2gRxMsgSvcDiscNotifFlg'. */
/begin MEASUREMENT V2gRxMsgSvcDiscNotifFlg "The arbitrated Notification parameter in the received message from EVSE" UBYTE CU_V2GRXMSGSVCDISCNOTIFFLG 1 100 0.0 1.0 ECU_ADDRESS 0x70017d72 BYTE_ORDER MSB_LAST /end MEASUREMENT
/begin COMPU_METHOD CU_V2GRXMSGSVCDISCNOTIFFLG "Conversion method for V2gRxMsgSvcDiscNotifFlg" RAT_FUNC "%10.0" "b" COEFFS 0.000000 1.000000 -0.000000 0.000000 0.000000 1.000000 /end COMPU_METHOD
/* Scalar measurable for DDE 'V2gRxMsgSvcDiscNotifMaxDelay'. */
/begin MEASUREMENT V2gRxMsgSvcDiscNotifMaxDelay "The arbitrated Notification Max Delay parameter in the received message from EVSE" UWORD CU_V2GRXMSGSVCDISCNOTIFMAXDELAY 1 100 0.0 65535.0 ECU_ADDRESS 0x70017fdc BYTE_ORDER MSB_LAST /end MEASUREMENT
/begin COMPU_METHOD CU_V2GRXMSGSVCDISCNOTIFMAXDELAY "Conversion method for V2gRxMsgSvcDiscNotifMaxDelay" RAT_FUNC "%10.0" "s" COEFFS 0.000000 1.000000 -0.000000 0.000000 0.000000 1.000000 /end COMPU_METHOD
/* Scalar measurable for DDE 'V2gRxMsgSvcDiscRescode'. */
/begin MEASUREMENT V2gRxMsgSvcDiscRescode "for message 2b: indicates the acknowledgment status of  this V2G messages received by the SECC." UBYTE CU_V2GRXMSGSVCDISCRESCODE 1 100 0.0 255.0 ECU_ADDRESS 0x70018364 BYTE_ORDER MSB_LAST /end MEASUREMENT
/begin COMPU_METHOD CU_V2GRXMSGSVCDISCRESCODE "Conversion method for V2gRxMsgSvcDiscRescode" RAT_FUNC "%10.0" "1" COEFFS 0.000000 1.000000 -0.000000 0.000000 0.000000 1.000000 /end COMPU_METHOD
/* Scalar measurable for DDE 'V2gRxMsgSvcDiscServiceId'. */
/begin MEASUREMENT V2gRxMsgSvcDiscServiceId "Unique identifier of the service from EVSE" UWORD CU_V2GRXMSGSVCDISCSERVICEID 1 100 0.0 65535.0 ECU_ADDRESS 0x70018196 BYTE_ORDER MSB_LAST /end MEASUREMENT
/begin COMPU_METHOD CU_V2GRXMSGSVCDISCSERVICEID "Conversion method for V2gRxMsgSvcDiscServiceId" RAT_FUNC "%10.0" "1" COEFFS 0.000000 1.000000 -0.000000 0.000000 0.000000 1.000000 /end COMPU_METHOD
/* Scalar measurable for DDE 'V2gRxMsgSvcDiscSvcCategory'. */
/begin MEASUREMENT V2gRxMsgSvcDiscSvcCategory "The arbitrated Service Category parameter in the received message from EVSE" UBYTE CU_V2GRXMSGSVCDISCSVCCATEGORY 1 100 0.0 4.0 ECU_ADDRESS 0x70017c38 BYTE_ORDER MSB_LAST /end MEASUREMENT
/begin COMPU_METHOD CU_V2GRXMSGSVCDISCSVCCATEGORY "Conversion method for V2gRxMsgSvcDiscSvcCategory" RAT_FUNC "%10.0" "1" COEFFS 0.000000 1.000000 -0.000000 0.000000 0.000000 1.000000 /end COMPU_METHOD
/* Scalar measurable for DDE 'V2gRxMsgSvcDiscSvcListSize'. */
/begin MEASUREMENT V2gRxMsgSvcDiscSvcListSize "The arbitrated Service List Size parameter in the received message from EVSE" UBYTE CU_V2GRXMSGSVCDISCSVCLISTSIZE 1 100 0.0 255.0 ECU_ADDRESS 0x70017ed9 BYTE_ORDER MSB_LAST /end MEASUREMENT
/begin COMPU_METHOD CU_V2GRXMSGSVCDISCSVCLISTSIZE "Conversion method for V2gRxMsgSvcDiscSvcListSize" RAT_FUNC "%10.0" "1" COEFFS 0.000000 1.000000 -0.000000 0.000000 0.000000 1.000000 /end COMPU_METHOD
/* Scalar measurable for DDE 'V2gRxMsgSvcDiscSvcNameLen'. */
/begin MEASUREMENT V2gRxMsgSvcDiscSvcNameLen "The arbitrated Service Name Length parameter in the received message from EVSE" UBYTE CU_V2GRXMSGSVCDISCSVCNAMELEN 1 100 0.0 255.0 ECU_ADDRESS 0x70018151 BYTE_ORDER MSB_LAST /end MEASUREMENT
/begin COMPU_METHOD CU_V2GRXMSGSVCDISCSVCNAMELEN "Conversion method for V2gRxMsgSvcDiscSvcNameLen" RAT_FUNC "%10.0" "1" COEFFS 0.000000 1.000000 -0.000000 0.000000 0.000000 1.000000 /end COMPU_METHOD
/* Scalar measurable for DDE 'V2gRxMsgSvcDiscSvcName[0]'. */
/begin MEASUREMENT V2gRxMsgSvcDiscSvcName[0] "The arbitrated Service Name parameter in the received message from EVSE" UBYTE CU_V2GRXMSGSVCDISCSVCNAME[0] 1 100 0.0 255.0 ECU_ADDRESS 0x700183cc BYTE_ORDER MSB_LAST /end MEASUREMENT
/begin COMPU_METHOD CU_V2GRXMSGSVCDISCSVCNAME[0] "Conversion method for V2gRxMsgSvcDiscSvcName[0]" RAT_FUNC "%10.0" "1" COEFFS 0.000000 1.000000 -0.000000 0.000000 0.000000 1.000000 /end COMPU_METHOD
/* Scalar measurable for DDE 'V2gRxMsgSvcDiscSvcName[10]'. */
/begin MEASUREMENT V2gRxMsgSvcDiscSvcName[10] "The arbitrated Service Name parameter in the received message from EVSE" UBYTE CU_V2GRXMSGSVCDISCSVCNAME[10] 1 100 0.0 255.0 ECU_ADDRESS 0x700183d6 BYTE_ORDER MSB_LAST /end MEASUREMENT
/begin COMPU_METHOD CU_V2GRXMSGSVCDISCSVCNAME[10] "Conversion method for V2gRxMsgSvcDiscSvcName[10]" RAT_FUNC "%10.0" "1" COEFFS 0.000000 1.000000 -0.000000 0.000000 0.000000 1.000000 /end COMPU_METHOD
/* Scalar measurable for DDE 'V2gRxMsgSvcDiscSvcName[11]'. */
/begin MEASUREMENT V2gRxMsgSvcDiscSvcName[11] "The arbitrated Service Name parameter in the received message from EVSE" UBYTE CU_V2GRXMSGSVCDISCSVCNAME[11] 1 100 0.0 255.0 ECU_ADDRESS 0x700183d7 BYTE_ORDER MSB_LAST /end MEASUREMENT
/begin COMPU_METHOD CU_V2GRXMSGSVCDISCSVCNAME[11] "Conversion method for V2gRxMsgSvcDiscSvcName[11]" RAT_FUNC "%10.0" "1" COEFFS 0.000000 1.000000 -0.000000 0.000000 0.000000 1.000000 /end COMPU_METHOD
/* Scalar measurable for DDE 'V2gRxMsgSvcDiscSvcName[12]'. */
/begin MEASUREMENT V2gRxMsgSvcDiscSvcName[12] "The arbitrated Service Name parameter in the received message from EVSE" UBYTE CU_V2GRXMSGSVCDISCSVCNAME[12] 1 100 0.0 255.0 ECU_ADDRESS 0x700183d8 BYTE_ORDER MSB_LAST /end MEASUREMENT
/begin COMPU_METHOD CU_V2GRXMSGSVCDISCSVCNAME[12] "Conversion method for V2gRxMsgSvcDiscSvcName[12]" RAT_FUNC "%10.0" "1" COEFFS 0.000000 1.000000 -0.000000 0.000000 0.000000 1.000000 /end COMPU_METHOD
/* Scalar measurable for DDE 'V2gRxMsgSvcDiscSvcName[13]'. */
/begin MEASUREMENT V2gRxMsgSvcDiscSvcName[13] "The arbitrated Service Name parameter in the received message from EVSE" UBYTE CU_V2GRXMSGSVCDISCSVCNAME[13] 1 100 0.0 255.0 ECU_ADDRESS 0x700183d9 BYTE_ORDER MSB_LAST /end MEASUREMENT
/begin COMPU_METHOD CU_V2GRXMSGSVCDISCSVCNAME[13] "Conversion method for V2gRxMsgSvcDiscSvcName[13]" RAT_FUNC "%10.0" "1" COEFFS 0.000000 1.000000 -0.000000 0.000000 0.000000 1.000000 /end COMPU_METHOD
/* Scalar measurable for DDE 'V2gRxMsgSvcDiscSvcName[14]'. */
/begin MEASUREMENT V2gRxMsgSvcDiscSvcName[14] "The arbitrated Service Name parameter in the received message from EVSE" UBYTE CU_V2GRXMSGSVCDISCSVCNAME[14] 1 100 0.0 255.0 ECU_ADDRESS 0x700183da BYTE_ORDER MSB_LAST /end MEASUREMENT
/begin COMPU_METHOD CU_V2GRXMSGSVCDISCSVCNAME[14] "Conversion method for V2gRxMsgSvcDiscSvcName[14]" RAT_FUNC "%10.0" "1" COEFFS 0.000000 1.000000 -0.000000 0.000000 0.000000 1.000000 /end COMPU_METHOD
/* Scalar measurable for DDE 'V2gRxMsgSvcDiscSvcName[15]'. */
/begin MEASUREMENT V2gRxMsgSvcDiscSvcName[15] "The arbitrated Service Name parameter in the received message from EVSE" UBYTE CU_V2GRXMSGSVCDISCSVCNAME[15] 1 100 0.0 255.0 ECU_ADDRESS 0x700183db BYTE_ORDER MSB_LAST /end MEASUREMENT
/begin COMPU_METHOD CU_V2GRXMSGSVCDISCSVCNAME[15] "Conversion method for V2gRxMsgSvcDiscSvcName[15]" RAT_FUNC "%10.0" "1" COEFFS 0.000000 1.000000 -0.000000 0.000000 0.000000 1.000000 /end COMPU_METHOD
/* Scalar measurable for DDE 'V2gRxMsgSvcDiscSvcName[16]'. */
/begin MEASUREMENT V2gRxMsgSvcDiscSvcName[16] "The arbitrated Service Name parameter in the received message from EVSE" UBYTE CU_V2GRXMSGSVCDISCSVCNAME[16] 1 100 0.0 255.0 ECU_ADDRESS 0x700183dc BYTE_ORDER MSB_LAST /end MEASUREMENT
/begin COMPU_METHOD CU_V2GRXMSGSVCDISCSVCNAME[16] "Conversion method for V2gRxMsgSvcDiscSvcName[16]" RAT_FUNC "%10.0" "1" COEFFS 0.000000 1.000000 -0.000000 0.000000 0.000000 1.000000 /end COMPU_METHOD
/* Scalar measurable for DDE 'V2gRxMsgSvcDiscSvcName[17]'. */
/begin MEASUREMENT V2gRxMsgSvcDiscSvcName[17] "The arbitrated Service Name parameter in the received message from EVSE" UBYTE CU_V2GRXMSGSVCDISCSVCNAME[17] 1 100 0.0 255.0 ECU_ADDRESS 0x700183dd BYTE_ORDER MSB_LAST /end MEASUREMENT
/begin COMPU_METHOD CU_V2GRXMSGSVCDISCSVCNAME[17] "Conversion method for V2gRxMsgSvcDiscSvcName[17]" RAT_FUNC "%10.0" "1" COEFFS 0.000000 1.000000 -0.000000 0.000000 0.000000 1.000000 /end COMPU_METHOD
/* Scalar measurable for DDE 'V2gRxMsgSvcDiscSvcName[18]'. */
/begin MEASUREMENT V2gRxMsgSvcDiscSvcName[18] "The arbitrated Service Name parameter in the received message from EVSE" UBYTE CU_V2GRXMSGSVCDISCSVCNAME[18] 1 100 0.0 255.0 ECU_ADDRESS 0x700183de BYTE_ORDER MSB_LAST /end MEASUREMENT
/begin COMPU_METHOD CU_V2GRXMSGSVCDISCSVCNAME[18] "Conversion method for V2gRxMsgSvcDiscSvcName[18]" RAT_FUNC "%10.0" "1" COEFFS 0.000000 1.000000 -0.000000 0.000000 0.000000 1.000000 /end COMPU_METHOD
/* Scalar measurable for DDE 'V2gRxMsgSvcDiscSvcName[19]'. */
/begin MEASUREMENT V2gRxMsgSvcDiscSvcName[19] "The arbitrated Service Name parameter in the received message from EVSE" UBYTE CU_V2GRXMSGSVCDISCSVCNAME[19] 1 100 0.0 255.0 ECU_ADDRESS 0x700183df BYTE_ORDER MSB_LAST /end MEASUREMENT
/begin COMPU_METHOD CU_V2GRXMSGSVCDISCSVCNAME[19] "Conversion method for V2gRxMsgSvcDiscSvcName[19]" RAT_FUNC "%10.0" "1" COEFFS 0.000000 1.000000 -0.000000 0.000000 0.000000 1.000000 /end COMPU_METHOD
/* Scalar measurable for DDE 'V2gRxMsgSvcDiscSvcName[1]'. */
/begin MEASUREMENT V2gRxMsgSvcDiscSvcName[1] "The arbitrated Service Name parameter in the received message from EVSE" UBYTE CU_V2GRXMSGSVCDISCSVCNAME[1] 1 100 0.0 255.0 ECU_ADDRESS 0x700183cd BYTE_ORDER MSB_LAST /end MEASUREMENT
/begin COMPU_METHOD CU_V2GRXMSGSVCDISCSVCNAME[1] "Conversion method for V2gRxMsgSvcDiscSvcName[1]" RAT_FUNC "%10.0" "1" COEFFS 0.000000 1.000000 -0.000000 0.000000 0.000000 1.000000 /end COMPU_METHOD
/* Scalar measurable for DDE 'V2gRxMsgSvcDiscSvcName[20]'. */
/begin MEASUREMENT V2gRxMsgSvcDiscSvcName[20] "The arbitrated Service Name parameter in the received message from EVSE" UBYTE CU_V2GRXMSGSVCDISCSVCNAME[20] 1 100 0.0 255.0 ECU_ADDRESS 0x700183e0 BYTE_ORDER MSB_LAST /end MEASUREMENT
/begin COMPU_METHOD CU_V2GRXMSGSVCDISCSVCNAME[20] "Conversion method for V2gRxMsgSvcDiscSvcName[20]" RAT_FUNC "%10.0" "1" COEFFS 0.000000 1.000000 -0.000000 0.000000 0.000000 1.000000 /end COMPU_METHOD
/* Scalar measurable for DDE 'V2gRxMsgSvcDiscSvcName[21]'. */
/begin MEASUREMENT V2gRxMsgSvcDiscSvcName[21] "The arbitrated Service Name parameter in the received message from EVSE" UBYTE CU_V2GRXMSGSVCDISCSVCNAME[21] 1 100 0.0 255.0 ECU_ADDRESS 0x700183e1 BYTE_ORDER MSB_LAST /end MEASUREMENT
/begin COMPU_METHOD CU_V2GRXMSGSVCDISCSVCNAME[21] "Conversion method for V2gRxMsgSvcDiscSvcName[21]" RAT_FUNC "%10.0" "1" COEFFS 0.000000 1.000000 -0.000000 0.000000 0.000000 1.000000 /end COMPU_METHOD
/* Scalar measurable for DDE 'V2gRxMsgSvcDiscSvcName[22]'. */
/begin MEASUREMENT V2gRxMsgSvcDiscSvcName[22] "The arbitrated Service Name parameter in the received message from EVSE" UBYTE CU_V2GRXMSGSVCDISCSVCNAME[22] 1 100 0.0 255.0 ECU_ADDRESS 0x700183e2 BYTE_ORDER MSB_LAST /end MEASUREMENT
/begin COMPU_METHOD CU_V2GRXMSGSVCDISCSVCNAME[22] "Conversion method for V2gRxMsgSvcDiscSvcName[22]" RAT_FUNC "%10.0" "1" COEFFS 0.000000 1.000000 -0.000000 0.000000 0.000000 1.000000 /end COMPU_METHOD
/* Scalar measurable for DDE 'V2gRxMsgSvcDiscSvcName[23]'. */
/begin MEASUREMENT V2gRxMsgSvcDiscSvcName[23] "The arbitrated Service Name parameter in the received message from EVSE" UBYTE CU_V2GRXMSGSVCDISCSVCNAME[23] 1 100 0.0 255.0 ECU_ADDRESS 0x700183e3 BYTE_ORDER MSB_LAST /end MEASUREMENT
/begin COMPU_METHOD CU_V2GRXMSGSVCDISCSVCNAME[23] "Conversion method for V2gRxMsgSvcDiscSvcName[23]" RAT_FUNC "%10.0" "1" COEFFS 0.000000 1.000000 -0.000000 0.000000 0.000000 1.000000 /end COMPU_METHOD
/* Scalar measurable for DDE 'V2gRxMsgSvcDiscSvcName[24]'. */
/begin MEASUREMENT V2gRxMsgSvcDiscSvcName[24] "The arbitrated Service Name parameter in the received message from EVSE" UBYTE CU_V2GRXMSGSVCDISCSVCNAME[24] 1 100 0.0 255.0 ECU_ADDRESS 0x700183e4 BYTE_ORDER MSB_LAST /end MEASUREMENT
/begin COMPU_METHOD CU_V2GRXMSGSVCDISCSVCNAME[24] "Conversion method for V2gRxMsgSvcDiscSvcName[24]" RAT_FUNC "%10.0" "1" COEFFS 0.000000 1.000000 -0.000000 0.000000 0.000000 1.000000 /end COMPU_METHOD
/* Scalar measurable for DDE 'V2gRxMsgSvcDiscSvcName[25]'. */
/begin MEASUREMENT V2gRxMsgSvcDiscSvcName[25] "The arbitrated Service Name parameter in the received message from EVSE" UBYTE CU_V2GRXMSGSVCDISCSVCNAME[25] 1 100 0.0 255.0 ECU_ADDRESS 0x700183e5 BYTE_ORDER MSB_LAST /end MEASUREMENT
/begin COMPU_METHOD CU_V2GRXMSGSVCDISCSVCNAME[25] "Conversion method for V2gRxMsgSvcDiscSvcName[25]" RAT_FUNC "%10.0" "1" COEFFS 0.000000 1.000000 -0.000000 0.000000 0.000000 1.000000 /end COMPU_METHOD
/* Scalar measurable for DDE 'V2gRxMsgSvcDiscSvcName[26]'. */
/begin MEASUREMENT V2gRxMsgSvcDiscSvcName[26] "The arbitrated Service Name parameter in the received message from EVSE" UBYTE CU_V2GRXMSGSVCDISCSVCNAME[26] 1 100 0.0 255.0 ECU_ADDRESS 0x700183e6 BYTE_ORDER MSB_LAST /end MEASUREMENT
/begin COMPU_METHOD CU_V2GRXMSGSVCDISCSVCNAME[26] "Conversion method for V2gRxMsgSvcDiscSvcName[26]" RAT_FUNC "%10.0" "1" COEFFS 0.000000 1.000000 -0.000000 0.000000 0.000000 1.000000 /end COMPU_METHOD
/* Scalar measurable for DDE 'V2gRxMsgSvcDiscSvcName[27]'. */
/begin MEASUREMENT V2gRxMsgSvcDiscSvcName[27] "The arbitrated Service Name parameter in the received message from EVSE" UBYTE CU_V2GRXMSGSVCDISCSVCNAME[27] 1 100 0.0 255.0 ECU_ADDRESS 0x700183e7 BYTE_ORDER MSB_LAST /end MEASUREMENT
/begin COMPU_METHOD CU_V2GRXMSGSVCDISCSVCNAME[27] "Conversion method for V2gRxMsgSvcDiscSvcName[27]" RAT_FUNC "%10.0" "1" COEFFS 0.000000 1.000000 -0.000000 0.000000 0.000000 1.000000 /end COMPU_METHOD
/* Scalar measurable for DDE 'V2gRxMsgSvcDiscSvcName[28]'. */
/begin MEASUREMENT V2gRxMsgSvcDiscSvcName[28] "The arbitrated Service Name parameter in the received message from EVSE" UBYTE CU_V2GRXMSGSVCDISCSVCNAME[28] 1 100 0.0 255.0 ECU_ADDRESS 0x700183e8 BYTE_ORDER MSB_LAST /end MEASUREMENT
/begin COMPU_METHOD CU_V2GRXMSGSVCDISCSVCNAME[28] "Conversion method for V2gRxMsgSvcDiscSvcName[28]" RAT_FUNC "%10.0" "1" COEFFS 0.000000 1.000000 -0.000000 0.000000 0.000000 1.000000 /end COMPU_METHOD
/* Scalar measurable for DDE 'V2gRxMsgSvcDiscSvcName[29]'. */
/begin MEASUREMENT V2gRxMsgSvcDiscSvcName[29] "The arbitrated Service Name parameter in the received message from EVSE" UBYTE CU_V2GRXMSGSVCDISCSVCNAME[29] 1 100 0.0 255.0 ECU_ADDRESS 0x700183e9 BYTE_ORDER MSB_LAST /end MEASUREMENT
/begin COMPU_METHOD CU_V2GRXMSGSVCDISCSVCNAME[29] "Conversion method for V2gRxMsgSvcDiscSvcName[29]" RAT_FUNC "%10.0" "1" COEFFS 0.000000 1.000000 -0.000000 0.000000 0.000000 1.000000 /end COMPU_METHOD
/* Scalar measurable for DDE 'V2gRxMsgSvcDiscSvcName[2]'. */
/begin MEASUREMENT V2gRxMsgSvcDiscSvcName[2] "The arbitrated Service Name parameter in the received message from EVSE" UBYTE CU_V2GRXMSGSVCDISCSVCNAME[2] 1 100 0.0 255.0 ECU_ADDRESS 0x700183ce BYTE_ORDER MSB_LAST /end MEASUREMENT
/begin COMPU_METHOD CU_V2GRXMSGSVCDISCSVCNAME[2] "Conversion method for V2gRxMsgSvcDiscSvcName[2]" RAT_FUNC "%10.0" "1" COEFFS 0.000000 1.000000 -0.000000 0.000000 0.000000 1.000000 /end COMPU_METHOD
/* Scalar measurable for DDE 'V2gRxMsgSvcDiscSvcName[30]'. */
/begin MEASUREMENT V2gRxMsgSvcDiscSvcName[30] "The arbitrated Service Name parameter in the received message from EVSE" UBYTE CU_V2GRXMSGSVCDISCSVCNAME[30] 1 100 0.0 255.0 ECU_ADDRESS 0x700183ea BYTE_ORDER MSB_LAST /end MEASUREMENT
/begin COMPU_METHOD CU_V2GRXMSGSVCDISCSVCNAME[30] "Conversion method for V2gRxMsgSvcDiscSvcName[30]" RAT_FUNC "%10.0" "1" COEFFS 0.000000 1.000000 -0.000000 0.000000 0.000000 1.000000 /end COMPU_METHOD
/* Scalar measurable for DDE 'V2gRxMsgSvcDiscSvcName[31]'. */
/begin MEASUREMENT V2gRxMsgSvcDiscSvcName[31] "The arbitrated Service Name parameter in the received message from EVSE" UBYTE CU_V2GRXMSGSVCDISCSVCNAME[31] 1 100 0.0 255.0 ECU_ADDRESS 0x700183eb BYTE_ORDER MSB_LAST /end MEASUREMENT
/begin COMPU_METHOD CU_V2GRXMSGSVCDISCSVCNAME[31] "Conversion method for V2gRxMsgSvcDiscSvcName[31]" RAT_FUNC "%10.0" "1" COEFFS 0.000000 1.000000 -0.000000 0.000000 0.000000 1.000000 /end COMPU_METHOD
/* Scalar measurable for DDE 'V2gRxMsgSvcDiscSvcName[32]'. */
/begin MEASUREMENT V2gRxMsgSvcDiscSvcName[32] "The arbitrated Service Name parameter in the received message from EVSE" UBYTE CU_V2GRXMSGSVCDISCSVCNAME[32] 1 100 0.0 255.0 ECU_ADDRESS 0x700183ec BYTE_ORDER MSB_LAST /end MEASUREMENT
/begin COMPU_METHOD CU_V2GRXMSGSVCDISCSVCNAME[32] "Conversion method for V2gRxMsgSvcDiscSvcName[32]" RAT_FUNC "%10.0" "1" COEFFS 0.000000 1.000000 -0.000000 0.000000 0.000000 1.000000 /end COMPU_METHOD
/* Scalar measurable for DDE 'V2gRxMsgSvcDiscSvcName[3]'. */
/begin MEASUREMENT V2gRxMsgSvcDiscSvcName[3] "The arbitrated Service Name parameter in the received message from EVSE" UBYTE CU_V2GRXMSGSVCDISCSVCNAME[3] 1 100 0.0 255.0 ECU_ADDRESS 0x700183cf BYTE_ORDER MSB_LAST /end MEASUREMENT
/begin COMPU_METHOD CU_V2GRXMSGSVCDISCSVCNAME[3] "Conversion method for V2gRxMsgSvcDiscSvcName[3]" RAT_FUNC "%10.0" "1" COEFFS 0.000000 1.000000 -0.000000 0.000000 0.000000 1.000000 /end COMPU_METHOD
/* Scalar measurable for DDE 'V2gRxMsgSvcDiscSvcName[4]'. */
/begin MEASUREMENT V2gRxMsgSvcDiscSvcName[4] "The arbitrated Service Name parameter in the received message from EVSE" UBYTE CU_V2GRXMSGSVCDISCSVCNAME[4] 1 100 0.0 255.0 ECU_ADDRESS 0x700183d0 BYTE_ORDER MSB_LAST /end MEASUREMENT
/begin COMPU_METHOD CU_V2GRXMSGSVCDISCSVCNAME[4] "Conversion method for V2gRxMsgSvcDiscSvcName[4]" RAT_FUNC "%10.0" "1" COEFFS 0.000000 1.000000 -0.000000 0.000000 0.000000 1.000000 /end COMPU_METHOD
/* Scalar measurable for DDE 'V2gRxMsgSvcDiscSvcName[5]'. */
/begin MEASUREMENT V2gRxMsgSvcDiscSvcName[5] "The arbitrated Service Name parameter in the received message from EVSE" UBYTE CU_V2GRXMSGSVCDISCSVCNAME[5] 1 100 0.0 255.0 ECU_ADDRESS 0x700183d1 BYTE_ORDER MSB_LAST /end MEASUREMENT
/begin COMPU_METHOD CU_V2GRXMSGSVCDISCSVCNAME[5] "Conversion method for V2gRxMsgSvcDiscSvcName[5]" RAT_FUNC "%10.0" "1" COEFFS 0.000000 1.000000 -0.000000 0.000000 0.000000 1.000000 /end COMPU_METHOD
/* Scalar measurable for DDE 'V2gRxMsgSvcDiscSvcName[6]'. */
/begin MEASUREMENT V2gRxMsgSvcDiscSvcName[6] "The arbitrated Service Name parameter in the received message from EVSE" UBYTE CU_V2GRXMSGSVCDISCSVCNAME[6] 1 100 0.0 255.0 ECU_ADDRESS 0x700183d2 BYTE_ORDER MSB_LAST /end MEASUREMENT
/begin COMPU_METHOD CU_V2GRXMSGSVCDISCSVCNAME[6] "Conversion method for V2gRxMsgSvcDiscSvcName[6]" RAT_FUNC "%10.0" "1" COEFFS 0.000000 1.000000 -0.000000 0.000000 0.000000 1.000000 /end COMPU_METHOD
/* Scalar measurable for DDE 'V2gRxMsgSvcDiscSvcName[7]'. */
/begin MEASUREMENT V2gRxMsgSvcDiscSvcName[7] "The arbitrated Service Name parameter in the received message from EVSE" UBYTE CU_V2GRXMSGSVCDISCSVCNAME[7] 1 100 0.0 255.0 ECU_ADDRESS 0x700183d3 BYTE_ORDER MSB_LAST /end MEASUREMENT
/begin COMPU_METHOD CU_V2GRXMSGSVCDISCSVCNAME[7] "Conversion method for V2gRxMsgSvcDiscSvcName[7]" RAT_FUNC "%10.0" "1" COEFFS 0.000000 1.000000 -0.000000 0.000000 0.000000 1.000000 /end COMPU_METHOD
/* Scalar measurable for DDE 'V2gRxMsgSvcDiscSvcName[8]'. */
/begin MEASUREMENT V2gRxMsgSvcDiscSvcName[8] "The arbitrated Service Name parameter in the received message from EVSE" UBYTE CU_V2GRXMSGSVCDISCSVCNAME[8] 1 100 0.0 255.0 ECU_ADDRESS 0x700183d4 BYTE_ORDER MSB_LAST /end MEASUREMENT
/begin COMPU_METHOD CU_V2GRXMSGSVCDISCSVCNAME[8] "Conversion method for V2gRxMsgSvcDiscSvcName[8]" RAT_FUNC "%10.0" "1" COEFFS 0.000000 1.000000 -0.000000 0.000000 0.000000 1.000000 /end COMPU_METHOD
/* Scalar measurable for DDE 'V2gRxMsgSvcDiscSvcName[9]'. */
/begin MEASUREMENT V2gRxMsgSvcDiscSvcName[9] "The arbitrated Service Name parameter in the received message from EVSE" UBYTE CU_V2GRXMSGSVCDISCSVCNAME[9] 1 100 0.0 255.0 ECU_ADDRESS 0x700183d5 BYTE_ORDER MSB_LAST /end MEASUREMENT
/begin COMPU_METHOD CU_V2GRXMSGSVCDISCSVCNAME[9] "Conversion method for V2gRxMsgSvcDiscSvcName[9]" RAT_FUNC "%10.0" "1" COEFFS 0.000000 1.000000 -0.000000 0.000000 0.000000 1.000000 /end COMPU_METHOD
/* Scalar measurable for DDE 'V2gRxMsgSvcDiscSvcScopeLen'. */
/begin MEASUREMENT V2gRxMsgSvcDiscSvcScopeLen "The arbitrated Service Scope Length parameter in the received message from EVSE" UBYTE CU_V2GRXMSGSVCDISCSVCSCOPELEN 1 100 0.0 255.0 ECU_ADDRESS 0x70017c24 BYTE_ORDER MSB_LAST /end MEASUREMENT
/begin COMPU_METHOD CU_V2GRXMSGSVCDISCSVCSCOPELEN "Conversion method for V2gRxMsgSvcDiscSvcScopeLen" RAT_FUNC "%10.0" "1" COEFFS 0.000000 1.000000 -0.000000 0.000000 0.000000 1.000000 /end COMPU_METHOD
/* Scalar measurable for DDE 'V2gRxMsgSvcDiscSvcScope[0]'. */
/begin MEASUREMENT V2gRxMsgSvcDiscSvcScope[0] "The arbitrated Service Scope parameter in the received message from EVSE" UBYTE CU_V2GRXMSGSVCDISCSVCSCOPE[0] 1 100 0.0 255.0 ECU_ADDRESS 0x700180a0 BYTE_ORDER MSB_LAST /end MEASUREMENT
/begin COMPU_METHOD CU_V2GRXMSGSVCDISCSVCSCOPE[0] "Conversion method for V2gRxMsgSvcDiscSvcScope[0]" RAT_FUNC "%10.0" "1" COEFFS 0.000000 1.000000 -0.000000 0.000000 0.000000 1.000000 /end COMPU_METHOD
/* Scalar measurable for DDE 'V2gRxMsgSvcDiscSvcScope[10]'. */
/begin MEASUREMENT V2gRxMsgSvcDiscSvcScope[10] "The arbitrated Service Scope parameter in the received message from EVSE" UBYTE CU_V2GRXMSGSVCDISCSVCSCOPE[10] 1 100 0.0 255.0 ECU_ADDRESS 0x700180aa BYTE_ORDER MSB_LAST /end MEASUREMENT
/begin COMPU_METHOD CU_V2GRXMSGSVCDISCSVCSCOPE[10] "Conversion method for V2gRxMsgSvcDiscSvcScope[10]" RAT_FUNC "%10.0" "1" COEFFS 0.000000 1.000000 -0.000000 0.000000 0.000000 1.000000 /end COMPU_METHOD
/* Scalar measurable for DDE 'V2gRxMsgSvcDiscSvcScope[11]'. */
/begin MEASUREMENT V2gRxMsgSvcDiscSvcScope[11] "The arbitrated Service Scope parameter in the received message from EVSE" UBYTE CU_V2GRXMSGSVCDISCSVCSCOPE[11] 1 100 0.0 255.0 ECU_ADDRESS 0x700180ab BYTE_ORDER MSB_LAST /end MEASUREMENT
/begin COMPU_METHOD CU_V2GRXMSGSVCDISCSVCSCOPE[11] "Conversion method for V2gRxMsgSvcDiscSvcScope[11]" RAT_FUNC "%10.0" "1" COEFFS 0.000000 1.000000 -0.000000 0.000000 0.000000 1.000000 /end COMPU_METHOD
/* Scalar measurable for DDE 'V2gRxMsgSvcDiscSvcScope[12]'. */
/begin MEASUREMENT V2gRxMsgSvcDiscSvcScope[12] "The arbitrated Service Scope parameter in the received message from EVSE" UBYTE CU_V2GRXMSGSVCDISCSVCSCOPE[12] 1 100 0.0 255.0 ECU_ADDRESS 0x700180ac BYTE_ORDER MSB_LAST /end MEASUREMENT
/begin COMPU_METHOD CU_V2GRXMSGSVCDISCSVCSCOPE[12] "Conversion method for V2gRxMsgSvcDiscSvcScope[12]" RAT_FUNC "%10.0" "1" COEFFS 0.000000 1.000000 -0.000000 0.000000 0.000000 1.000000 /end COMPU_METHOD
/* Scalar measurable for DDE 'V2gRxMsgSvcDiscSvcScope[13]'. */
/begin MEASUREMENT V2gRxMsgSvcDiscSvcScope[13] "The arbitrated Service Scope parameter in the received message from EVSE" UBYTE CU_V2GRXMSGSVCDISCSVCSCOPE[13] 1 100 0.0 255.0 ECU_ADDRESS 0x700180ad BYTE_ORDER MSB_LAST /end MEASUREMENT
/begin COMPU_METHOD CU_V2GRXMSGSVCDISCSVCSCOPE[13] "Conversion method for V2gRxMsgSvcDiscSvcScope[13]" RAT_FUNC "%10.0" "1" COEFFS 0.000000 1.000000 -0.000000 0.000000 0.000000 1.000000 /end COMPU_METHOD
/* Scalar measurable for DDE 'V2gRxMsgSvcDiscSvcScope[14]'. */
/begin MEASUREMENT V2gRxMsgSvcDiscSvcScope[14] "The arbitrated Service Scope parameter in the received message from EVSE" UBYTE CU_V2GRXMSGSVCDISCSVCSCOPE[14] 1 100 0.0 255.0 ECU_ADDRESS 0x700180ae BYTE_ORDER MSB_LAST /end MEASUREMENT
/begin COMPU_METHOD CU_V2GRXMSGSVCDISCSVCSCOPE[14] "Conversion method for V2gRxMsgSvcDiscSvcScope[14]" RAT_FUNC "%10.0" "1" COEFFS 0.000000 1.000000 -0.000000 0.000000 0.000000 1.000000 /end COMPU_METHOD
/* Scalar measurable for DDE 'V2gRxMsgSvcDiscSvcScope[15]'. */
/begin MEASUREMENT V2gRxMsgSvcDiscSvcScope[15] "The arbitrated Service Scope parameter in the received message from EVSE" UBYTE CU_V2GRXMSGSVCDISCSVCSCOPE[15] 1 100 0.0 255.0 ECU_ADDRESS 0x700180af BYTE_ORDER MSB_LAST /end MEASUREMENT
/begin COMPU_METHOD CU_V2GRXMSGSVCDISCSVCSCOPE[15] "Conversion method for V2gRxMsgSvcDiscSvcScope[15]" RAT_FUNC "%10.0" "1" COEFFS 0.000000 1.000000 -0.000000 0.000000 0.000000 1.000000 /end COMPU_METHOD
/* Scalar measurable for DDE 'V2gRxMsgSvcDiscSvcScope[16]'. */
/begin MEASUREMENT V2gRxMsgSvcDiscSvcScope[16] "The arbitrated Service Scope parameter in the received message from EVSE" UBYTE CU_V2GRXMSGSVCDISCSVCSCOPE[16] 1 100 0.0 255.0 ECU_ADDRESS 0x700180b0 BYTE_ORDER MSB_LAST /end MEASUREMENT
/begin COMPU_METHOD CU_V2GRXMSGSVCDISCSVCSCOPE[16] "Conversion method for V2gRxMsgSvcDiscSvcScope[16]" RAT_FUNC "%10.0" "1" COEFFS 0.000000 1.000000 -0.000000 0.000000 0.000000 1.000000 /end COMPU_METHOD
/* Scalar measurable for DDE 'V2gRxMsgSvcDiscSvcScope[17]'. */
/begin MEASUREMENT V2gRxMsgSvcDiscSvcScope[17] "The arbitrated Service Scope parameter in the received message from EVSE" UBYTE CU_V2GRXMSGSVCDISCSVCSCOPE[17] 1 100 0.0 255.0 ECU_ADDRESS 0x700180b1 BYTE_ORDER MSB_LAST /end MEASUREMENT
/begin COMPU_METHOD CU_V2GRXMSGSVCDISCSVCSCOPE[17] "Conversion method for V2gRxMsgSvcDiscSvcScope[17]" RAT_FUNC "%10.0" "1" COEFFS 0.000000 1.000000 -0.000000 0.000000 0.000000 1.000000 /end COMPU_METHOD
/* Scalar measurable for DDE 'V2gRxMsgSvcDiscSvcScope[18]'. */
/begin MEASUREMENT V2gRxMsgSvcDiscSvcScope[18] "The arbitrated Service Scope parameter in the received message from EVSE" UBYTE CU_V2GRXMSGSVCDISCSVCSCOPE[18] 1 100 0.0 255.0 ECU_ADDRESS 0x700180b2 BYTE_ORDER MSB_LAST /end MEASUREMENT
/begin COMPU_METHOD CU_V2GRXMSGSVCDISCSVCSCOPE[18] "Conversion method for V2gRxMsgSvcDiscSvcScope[18]" RAT_FUNC "%10.0" "1" COEFFS 0.000000 1.000000 -0.000000 0.000000 0.000000 1.000000 /end COMPU_METHOD
/* Scalar measurable for DDE 'V2gRxMsgSvcDiscSvcScope[19]'. */
/begin MEASUREMENT V2gRxMsgSvcDiscSvcScope[19] "The arbitrated Service Scope parameter in the received message from EVSE" UBYTE CU_V2GRXMSGSVCDISCSVCSCOPE[19] 1 100 0.0 255.0 ECU_ADDRESS 0x700180b3 BYTE_ORDER MSB_LAST /end MEASUREMENT
/begin COMPU_METHOD CU_V2GRXMSGSVCDISCSVCSCOPE[19] "Conversion method for V2gRxMsgSvcDiscSvcScope[19]" RAT_FUNC "%10.0" "1" COEFFS 0.000000 1.000000 -0.000000 0.000000 0.000000 1.000000 /end COMPU_METHOD
/* Scalar measurable for DDE 'V2gRxMsgSvcDiscSvcScope[1]'. */
/begin MEASUREMENT V2gRxMsgSvcDiscSvcScope[1] "The arbitrated Service Scope parameter in the received message from EVSE" UBYTE CU_V2GRXMSGSVCDISCSVCSCOPE[1] 1 100 0.0 255.0 ECU_ADDRESS 0x700180a1 BYTE_ORDER MSB_LAST /end MEASUREMENT
/begin COMPU_METHOD CU_V2GRXMSGSVCDISCSVCSCOPE[1] "Conversion method for V2gRxMsgSvcDiscSvcScope[1]" RAT_FUNC "%10.0" "1" COEFFS 0.000000 1.000000 -0.000000 0.000000 0.000000 1.000000 /end COMPU_METHOD
/* Scalar measurable for DDE 'V2gRxMsgSvcDiscSvcScope[20]'. */
/begin MEASUREMENT V2gRxMsgSvcDiscSvcScope[20] "The arbitrated Service Scope parameter in the received message from EVSE" UBYTE CU_V2GRXMSGSVCDISCSVCSCOPE[20] 1 100 0.0 255.0 ECU_ADDRESS 0x700180b4 BYTE_ORDER MSB_LAST /end MEASUREMENT
/begin COMPU_METHOD CU_V2GRXMSGSVCDISCSVCSCOPE[20] "Conversion method for V2gRxMsgSvcDiscSvcScope[20]" RAT_FUNC "%10.0" "1" COEFFS 0.000000 1.000000 -0.000000 0.000000 0.000000 1.000000 /end COMPU_METHOD
/* Scalar measurable for DDE 'V2gRxMsgSvcDiscSvcScope[21]'. */
/begin MEASUREMENT V2gRxMsgSvcDiscSvcScope[21] "The arbitrated Service Scope parameter in the received message from EVSE" UBYTE CU_V2GRXMSGSVCDISCSVCSCOPE[21] 1 100 0.0 255.0 ECU_ADDRESS 0x700180b5 BYTE_ORDER MSB_LAST /end MEASUREMENT
/begin COMPU_METHOD CU_V2GRXMSGSVCDISCSVCSCOPE[21] "Conversion method for V2gRxMsgSvcDiscSvcScope[21]" RAT_FUNC "%10.0" "1" COEFFS 0.000000 1.000000 -0.000000 0.000000 0.000000 1.000000 /end COMPU_METHOD
/* Scalar measurable for DDE 'V2gRxMsgSvcDiscSvcScope[22]'. */
/begin MEASUREMENT V2gRxMsgSvcDiscSvcScope[22] "The arbitrated Service Scope parameter in the received message from EVSE" UBYTE CU_V2GRXMSGSVCDISCSVCSCOPE[22] 1 100 0.0 255.0 ECU_ADDRESS 0x700180b6 BYTE_ORDER MSB_LAST /end MEASUREMENT
/begin COMPU_METHOD CU_V2GRXMSGSVCDISCSVCSCOPE[22] "Conversion method for V2gRxMsgSvcDiscSvcScope[22]" RAT_FUNC "%10.0" "1" COEFFS 0.000000 1.000000 -0.000000 0.000000 0.000000 1.000000 /end COMPU_METHOD
/* Scalar measurable for DDE 'V2gRxMsgSvcDiscSvcScope[23]'. */
/begin MEASUREMENT V2gRxMsgSvcDiscSvcScope[23] "The arbitrated Service Scope parameter in the received message from EVSE" UBYTE CU_V2GRXMSGSVCDISCSVCSCOPE[23] 1 100 0.0 255.0 ECU_ADDRESS 0x700180b7 BYTE_ORDER MSB_LAST /end MEASUREMENT
/begin COMPU_METHOD CU_V2GRXMSGSVCDISCSVCSCOPE[23] "Conversion method for V2gRxMsgSvcDiscSvcScope[23]" RAT_FUNC "%10.0" "1" COEFFS 0.000000 1.000000 -0.000000 0.000000 0.000000 1.000000 /end COMPU_METHOD
/* Scalar measurable for DDE 'V2gRxMsgSvcDiscSvcScope[24]'. */
/begin MEASUREMENT V2gRxMsgSvcDiscSvcScope[24] "The arbitrated Service Scope parameter in the received message from EVSE" UBYTE CU_V2GRXMSGSVCDISCSVCSCOPE[24] 1 100 0.0 255.0 ECU_ADDRESS 0x700180b8 BYTE_ORDER MSB_LAST /end MEASUREMENT
/begin COMPU_METHOD CU_V2GRXMSGSVCDISCSVCSCOPE[24] "Conversion method for V2gRxMsgSvcDiscSvcScope[24]" RAT_FUNC "%10.0" "1" COEFFS 0.000000 1.000000 -0.000000 0.000000 0.000000 1.000000 /end COMPU_METHOD
/* Scalar measurable for DDE 'V2gRxMsgSvcDiscSvcScope[25]'. */
/begin MEASUREMENT V2gRxMsgSvcDiscSvcScope[25] "The arbitrated Service Scope parameter in the received message from EVSE" UBYTE CU_V2GRXMSGSVCDISCSVCSCOPE[25] 1 100 0.0 255.0 ECU_ADDRESS 0x700180b9 BYTE_ORDER MSB_LAST /end MEASUREMENT
/begin COMPU_METHOD CU_V2GRXMSGSVCDISCSVCSCOPE[25] "Conversion method for V2gRxMsgSvcDiscSvcScope[25]" RAT_FUNC "%10.0" "1" COEFFS 0.000000 1.000000 -0.000000 0.000000 0.000000 1.000000 /end COMPU_METHOD
/* Scalar measurable for DDE 'V2gRxMsgSvcDiscSvcScope[26]'. */
/begin MEASUREMENT V2gRxMsgSvcDiscSvcScope[26] "The arbitrated Service Scope parameter in the received message from EVSE" UBYTE CU_V2GRXMSGSVCDISCSVCSCOPE[26] 1 100 0.0 255.0 ECU_ADDRESS 0x700180ba BYTE_ORDER MSB_LAST /end MEASUREMENT
/begin COMPU_METHOD CU_V2GRXMSGSVCDISCSVCSCOPE[26] "Conversion method for V2gRxMsgSvcDiscSvcScope[26]" RAT_FUNC "%10.0" "1" COEFFS 0.000000 1.000000 -0.000000 0.000000 0.000000 1.000000 /end COMPU_METHOD
/* Scalar measurable for DDE 'V2gRxMsgSvcDiscSvcScope[27]'. */
/begin MEASUREMENT V2gRxMsgSvcDiscSvcScope[27] "The arbitrated Service Scope parameter in the received message from EVSE" UBYTE CU_V2GRXMSGSVCDISCSVCSCOPE[27] 1 100 0.0 255.0 ECU_ADDRESS 0x700180bb BYTE_ORDER MSB_LAST /end MEASUREMENT
/begin COMPU_METHOD CU_V2GRXMSGSVCDISCSVCSCOPE[27] "Conversion method for V2gRxMsgSvcDiscSvcScope[27]" RAT_FUNC "%10.0" "1" COEFFS 0.000000 1.000000 -0.000000 0.000000 0.000000 1.000000 /end COMPU_METHOD
/* Scalar measurable for DDE 'V2gRxMsgSvcDiscSvcScope[28]'. */
/begin MEASUREMENT V2gRxMsgSvcDiscSvcScope[28] "The arbitrated Service Scope parameter in the received message from EVSE" UBYTE CU_V2GRXMSGSVCDISCSVCSCOPE[28] 1 100 0.0 255.0 ECU_ADDRESS 0x700180bc BYTE_ORDER MSB_LAST /end MEASUREMENT
/begin COMPU_METHOD CU_V2GRXMSGSVCDISCSVCSCOPE[28] "Conversion method for V2gRxMsgSvcDiscSvcScope[28]" RAT_FUNC "%10.0" "1" COEFFS 0.000000 1.000000 -0.000000 0.000000 0.000000 1.000000 /end COMPU_METHOD
/* Scalar measurable for DDE 'V2gRxMsgSvcDiscSvcScope[29]'. */
/begin MEASUREMENT V2gRxMsgSvcDiscSvcScope[29] "The arbitrated Service Scope parameter in the received message from EVSE" UBYTE CU_V2GRXMSGSVCDISCSVCSCOPE[29] 1 100 0.0 255.0 ECU_ADDRESS 0x700180bd BYTE_ORDER MSB_LAST /end MEASUREMENT
/begin COMPU_METHOD CU_V2GRXMSGSVCDISCSVCSCOPE[29] "Conversion method for V2gRxMsgSvcDiscSvcScope[29]" RAT_FUNC "%10.0" "1" COEFFS 0.000000 1.000000 -0.000000 0.000000 0.000000 1.000000 /end COMPU_METHOD
/* Scalar measurable for DDE 'V2gRxMsgSvcDiscSvcScope[2]'. */
/begin MEASUREMENT V2gRxMsgSvcDiscSvcScope[2] "The arbitrated Service Scope parameter in the received message from EVSE" UBYTE CU_V2GRXMSGSVCDISCSVCSCOPE[2] 1 100 0.0 255.0 ECU_ADDRESS 0x700180a2 BYTE_ORDER MSB_LAST /end MEASUREMENT
/begin COMPU_METHOD CU_V2GRXMSGSVCDISCSVCSCOPE[2] "Conversion method for V2gRxMsgSvcDiscSvcScope[2]" RAT_FUNC "%10.0" "1" COEFFS 0.000000 1.000000 -0.000000 0.000000 0.000000 1.000000 /end COMPU_METHOD
/* Scalar measurable for DDE 'V2gRxMsgSvcDiscSvcScope[30]'. */
/begin MEASUREMENT V2gRxMsgSvcDiscSvcScope[30] "The arbitrated Service Scope parameter in the received message from EVSE" UBYTE CU_V2GRXMSGSVCDISCSVCSCOPE[30] 1 100 0.0 255.0 ECU_ADDRESS 0x700180be BYTE_ORDER MSB_LAST /end MEASUREMENT
/begin COMPU_METHOD CU_V2GRXMSGSVCDISCSVCSCOPE[30] "Conversion method for V2gRxMsgSvcDiscSvcScope[30]" RAT_FUNC "%10.0" "1" COEFFS 0.000000 1.000000 -0.000000 0.000000 0.000000 1.000000 /end COMPU_METHOD
/* Scalar measurable for DDE 'V2gRxMsgSvcDiscSvcScope[31]'. */
/begin MEASUREMENT V2gRxMsgSvcDiscSvcScope[31] "The arbitrated Service Scope parameter in the received message from EVSE" UBYTE CU_V2GRXMSGSVCDISCSVCSCOPE[31] 1 100 0.0 255.0 ECU_ADDRESS 0x700180bf BYTE_ORDER MSB_LAST /end MEASUREMENT
/begin COMPU_METHOD CU_V2GRXMSGSVCDISCSVCSCOPE[31] "Conversion method for V2gRxMsgSvcDiscSvcScope[31]" RAT_FUNC "%10.0" "1" COEFFS 0.000000 1.000000 -0.000000 0.000000 0.000000 1.000000 /end COMPU_METHOD
/* Scalar measurable for DDE 'V2gRxMsgSvcDiscSvcScope[32]'. */
/begin MEASUREMENT V2gRxMsgSvcDiscSvcScope[32] "The arbitrated Service Scope parameter in the received message from EVSE" UBYTE CU_V2GRXMSGSVCDISCSVCSCOPE[32] 1 100 0.0 255.0 ECU_ADDRESS 0x700180c0 BYTE_ORDER MSB_LAST /end MEASUREMENT
/begin COMPU_METHOD CU_V2GRXMSGSVCDISCSVCSCOPE[32] "Conversion method for V2gRxMsgSvcDiscSvcScope[32]" RAT_FUNC "%10.0" "1" COEFFS 0.000000 1.000000 -0.000000 0.000000 0.000000 1.000000 /end COMPU_METHOD
/* Scalar measurable for DDE 'V2gRxMsgSvcDiscSvcScope[33]'. */
/begin MEASUREMENT V2gRxMsgSvcDiscSvcScope[33] "The arbitrated Service Scope parameter in the received message from EVSE" UBYTE CU_V2GRXMSGSVCDISCSVCSCOPE[33] 1 100 0.0 255.0 ECU_ADDRESS 0x700180c1 BYTE_ORDER MSB_LAST /end MEASUREMENT
/begin COMPU_METHOD CU_V2GRXMSGSVCDISCSVCSCOPE[33] "Conversion method for V2gRxMsgSvcDiscSvcScope[33]" RAT_FUNC "%10.0" "1" COEFFS 0.000000 1.000000 -0.000000 0.000000 0.000000 1.000000 /end COMPU_METHOD
/* Scalar measurable for DDE 'V2gRxMsgSvcDiscSvcScope[34]'. */
/begin MEASUREMENT V2gRxMsgSvcDiscSvcScope[34] "The arbitrated Service Scope parameter in the received message from EVSE" UBYTE CU_V2GRXMSGSVCDISCSVCSCOPE[34] 1 100 0.0 255.0 ECU_ADDRESS 0x700180c2 BYTE_ORDER MSB_LAST /end MEASUREMENT
/begin COMPU_METHOD CU_V2GRXMSGSVCDISCSVCSCOPE[34] "Conversion method for V2gRxMsgSvcDiscSvcScope[34]" RAT_FUNC "%10.0" "1" COEFFS 0.000000 1.000000 -0.000000 0.000000 0.000000 1.000000 /end COMPU_METHOD
/* Scalar measurable for DDE 'V2gRxMsgSvcDiscSvcScope[35]'. */
/begin MEASUREMENT V2gRxMsgSvcDiscSvcScope[35] "The arbitrated Service Scope parameter in the received message from EVSE" UBYTE CU_V2GRXMSGSVCDISCSVCSCOPE[35] 1 100 0.0 255.0 ECU_ADDRESS 0x700180c3 BYTE_ORDER MSB_LAST /end MEASUREMENT
/begin COMPU_METHOD CU_V2GRXMSGSVCDISCSVCSCOPE[35] "Conversion method for V2gRxMsgSvcDiscSvcScope[35]" RAT_FUNC "%10.0" "1" COEFFS 0.000000 1.000000 -0.000000 0.000000 0.000000 1.000000 /end COMPU_METHOD
/* Scalar measurable for DDE 'V2gRxMsgSvcDiscSvcScope[36]'. */
/begin MEASUREMENT V2gRxMsgSvcDiscSvcScope[36] "The arbitrated Service Scope parameter in the received message from EVSE" UBYTE CU_V2GRXMSGSVCDISCSVCSCOPE[36] 1 100 0.0 255.0 ECU_ADDRESS 0x700180c4 BYTE_ORDER MSB_LAST /end MEASUREMENT
/begin COMPU_METHOD CU_V2GRXMSGSVCDISCSVCSCOPE[36] "Conversion method for V2gRxMsgSvcDiscSvcScope[36]" RAT_FUNC "%10.0" "1" COEFFS 0.000000 1.000000 -0.000000 0.000000 0.000000 1.000000 /end COMPU_METHOD
/* Scalar measurable for DDE 'V2gRxMsgSvcDiscSvcScope[37]'. */
/begin MEASUREMENT V2gRxMsgSvcDiscSvcScope[37] "The arbitrated Service Scope parameter in the received message from EVSE" UBYTE CU_V2GRXMSGSVCDISCSVCSCOPE[37] 1 100 0.0 255.0 ECU_ADDRESS 0x700180c5 BYTE_ORDER MSB_LAST /end MEASUREMENT
/begin COMPU_METHOD CU_V2GRXMSGSVCDISCSVCSCOPE[37] "Conversion method for V2gRxMsgSvcDiscSvcScope[37]" RAT_FUNC "%10.0" "1" COEFFS 0.000000 1.000000 -0.000000 0.000000 0.000000 1.000000 /end COMPU_METHOD
/* Scalar measurable for DDE 'V2gRxMsgSvcDiscSvcScope[38]'. */
/begin MEASUREMENT V2gRxMsgSvcDiscSvcScope[38] "The arbitrated Service Scope parameter in the received message from EVSE" UBYTE CU_V2GRXMSGSVCDISCSVCSCOPE[38] 1 100 0.0 255.0 ECU_ADDRESS 0x700180c6 BYTE_ORDER MSB_LAST /end MEASUREMENT
/begin COMPU_METHOD CU_V2GRXMSGSVCDISCSVCSCOPE[38] "Conversion method for V2gRxMsgSvcDiscSvcScope[38]" RAT_FUNC "%10.0" "1" COEFFS 0.000000 1.000000 -0.000000 0.000000 0.000000 1.000000 /end COMPU_METHOD
/* Scalar measurable for DDE 'V2gRxMsgSvcDiscSvcScope[39]'. */
/begin MEASUREMENT V2gRxMsgSvcDiscSvcScope[39] "The arbitrated Service Scope parameter in the received message from EVSE" UBYTE CU_V2GRXMSGSVCDISCSVCSCOPE[39] 1 100 0.0 255.0 ECU_ADDRESS 0x700180c7 BYTE_ORDER MSB_LAST /end MEASUREMENT
/begin COMPU_METHOD CU_V2GRXMSGSVCDISCSVCSCOPE[39] "Conversion method for V2gRxMsgSvcDiscSvcScope[39]" RAT_FUNC "%10.0" "1" COEFFS 0.000000 1.000000 -0.000000 0.000000 0.000000 1.000000 /end COMPU_METHOD
/* Scalar measurable for DDE 'V2gRxMsgSvcDiscSvcScope[3]'. */
/begin MEASUREMENT V2gRxMsgSvcDiscSvcScope[3] "The arbitrated Service Scope parameter in the received message from EVSE" UBYTE CU_V2GRXMSGSVCDISCSVCSCOPE[3] 1 100 0.0 255.0 ECU_ADDRESS 0x700180a3 BYTE_ORDER MSB_LAST /end MEASUREMENT
/begin COMPU_METHOD CU_V2GRXMSGSVCDISCSVCSCOPE[3] "Conversion method for V2gRxMsgSvcDiscSvcScope[3]" RAT_FUNC "%10.0" "1" COEFFS 0.000000 1.000000 -0.000000 0.000000 0.000000 1.000000 /end COMPU_METHOD
/* Scalar measurable for DDE 'V2gRxMsgSvcDiscSvcScope[40]'. */
/begin MEASUREMENT V2gRxMsgSvcDiscSvcScope[40] "The arbitrated Service Scope parameter in the received message from EVSE" UBYTE CU_V2GRXMSGSVCDISCSVCSCOPE[40] 1 100 0.0 255.0 ECU_ADDRESS 0x700180c8 BYTE_ORDER MSB_LAST /end MEASUREMENT
/begin COMPU_METHOD CU_V2GRXMSGSVCDISCSVCSCOPE[40] "Conversion method for V2gRxMsgSvcDiscSvcScope[40]" RAT_FUNC "%10.0" "1" COEFFS 0.000000 1.000000 -0.000000 0.000000 0.000000 1.000000 /end COMPU_METHOD
/* Scalar measurable for DDE 'V2gRxMsgSvcDiscSvcScope[41]'. */
/begin MEASUREMENT V2gRxMsgSvcDiscSvcScope[41] "The arbitrated Service Scope parameter in the received message from EVSE" UBYTE CU_V2GRXMSGSVCDISCSVCSCOPE[41] 1 100 0.0 255.0 ECU_ADDRESS 0x700180c9 BYTE_ORDER MSB_LAST /end MEASUREMENT
/begin COMPU_METHOD CU_V2GRXMSGSVCDISCSVCSCOPE[41] "Conversion method for V2gRxMsgSvcDiscSvcScope[41]" RAT_FUNC "%10.0" "1" COEFFS 0.000000 1.000000 -0.000000 0.000000 0.000000 1.000000 /end COMPU_METHOD
/* Scalar measurable for DDE 'V2gRxMsgSvcDiscSvcScope[42]'. */
/begin MEASUREMENT V2gRxMsgSvcDiscSvcScope[42] "The arbitrated Service Scope parameter in the received message from EVSE" UBYTE CU_V2GRXMSGSVCDISCSVCSCOPE[42] 1 100 0.0 255.0 ECU_ADDRESS 0x700180ca BYTE_ORDER MSB_LAST /end MEASUREMENT
/begin COMPU_METHOD CU_V2GRXMSGSVCDISCSVCSCOPE[42] "Conversion method for V2gRxMsgSvcDiscSvcScope[42]" RAT_FUNC "%10.0" "1" COEFFS 0.000000 1.000000 -0.000000 0.000000 0.000000 1.000000 /end COMPU_METHOD
/* Scalar measurable for DDE 'V2gRxMsgSvcDiscSvcScope[43]'. */
/begin MEASUREMENT V2gRxMsgSvcDiscSvcScope[43] "The arbitrated Service Scope parameter in the received message from EVSE" UBYTE CU_V2GRXMSGSVCDISCSVCSCOPE[43] 1 100 0.0 255.0 ECU_ADDRESS 0x700180cb BYTE_ORDER MSB_LAST /end MEASUREMENT
/begin COMPU_METHOD CU_V2GRXMSGSVCDISCSVCSCOPE[43] "Conversion method for V2gRxMsgSvcDiscSvcScope[43]" RAT_FUNC "%10.0" "1" COEFFS 0.000000 1.000000 -0.000000 0.000000 0.000000 1.000000 /end COMPU_METHOD
/* Scalar measurable for DDE 'V2gRxMsgSvcDiscSvcScope[44]'. */
/begin MEASUREMENT V2gRxMsgSvcDiscSvcScope[44] "The arbitrated Service Scope parameter in the received message from EVSE" UBYTE CU_V2GRXMSGSVCDISCSVCSCOPE[44] 1 100 0.0 255.0 ECU_ADDRESS 0x700180cc BYTE_ORDER MSB_LAST /end MEASUREMENT
/begin COMPU_METHOD CU_V2GRXMSGSVCDISCSVCSCOPE[44] "Conversion method for V2gRxMsgSvcDiscSvcScope[44]" RAT_FUNC "%10.0" "1" COEFFS 0.000000 1.000000 -0.000000 0.000000 0.000000 1.000000 /end COMPU_METHOD
/* Scalar measurable for DDE 'V2gRxMsgSvcDiscSvcScope[45]'. */
/begin MEASUREMENT V2gRxMsgSvcDiscSvcScope[45] "The arbitrated Service Scope parameter in the received message from EVSE" UBYTE CU_V2GRXMSGSVCDISCSVCSCOPE[45] 1 100 0.0 255.0 ECU_ADDRESS 0x700180cd BYTE_ORDER MSB_LAST /end MEASUREMENT
/begin COMPU_METHOD CU_V2GRXMSGSVCDISCSVCSCOPE[45] "Conversion method for V2gRxMsgSvcDiscSvcScope[45]" RAT_FUNC "%10.0" "1" COEFFS 0.000000 1.000000 -0.000000 0.000000 0.000000 1.000000 /end COMPU_METHOD
/* Scalar measurable for DDE 'V2gRxMsgSvcDiscSvcScope[46]'. */
/begin MEASUREMENT V2gRxMsgSvcDiscSvcScope[46] "The arbitrated Service Scope parameter in the received message from EVSE" UBYTE CU_V2GRXMSGSVCDISCSVCSCOPE[46] 1 100 0.0 255.0 ECU_ADDRESS 0x700180ce BYTE_ORDER MSB_LAST /end MEASUREMENT
/begin COMPU_METHOD CU_V2GRXMSGSVCDISCSVCSCOPE[46] "Conversion method for V2gRxMsgSvcDiscSvcScope[46]" RAT_FUNC "%10.0" "1" COEFFS 0.000000 1.000000 -0.000000 0.000000 0.000000 1.000000 /end COMPU_METHOD
/* Scalar measurable for DDE 'V2gRxMsgSvcDiscSvcScope[47]'. */
/begin MEASUREMENT V2gRxMsgSvcDiscSvcScope[47] "The arbitrated Service Scope parameter in the received message from EVSE" UBYTE CU_V2GRXMSGSVCDISCSVCSCOPE[47] 1 100 0.0 255.0 ECU_ADDRESS 0x700180cf BYTE_ORDER MSB_LAST /end MEASUREMENT
/begin COMPU_METHOD CU_V2GRXMSGSVCDISCSVCSCOPE[47] "Conversion method for V2gRxMsgSvcDiscSvcScope[47]" RAT_FUNC "%10.0" "1" COEFFS 0.000000 1.000000 -0.000000 0.000000 0.000000 1.000000 /end COMPU_METHOD
/* Scalar measurable for DDE 'V2gRxMsgSvcDiscSvcScope[48]'. */
/begin MEASUREMENT V2gRxMsgSvcDiscSvcScope[48] "The arbitrated Service Scope parameter in the received message from EVSE" UBYTE CU_V2GRXMSGSVCDISCSVCSCOPE[48] 1 100 0.0 255.0 ECU_ADDRESS 0x700180d0 BYTE_ORDER MSB_LAST /end MEASUREMENT
/begin COMPU_METHOD CU_V2GRXMSGSVCDISCSVCSCOPE[48] "Conversion method for V2gRxMsgSvcDiscSvcScope[48]" RAT_FUNC "%10.0" "1" COEFFS 0.000000 1.000000 -0.000000 0.000000 0.000000 1.000000 /end COMPU_METHOD
/* Scalar measurable for DDE 'V2gRxMsgSvcDiscSvcScope[49]'. */
/begin MEASUREMENT V2gRxMsgSvcDiscSvcScope[49] "The arbitrated Service Scope parameter in the received message from EVSE" UBYTE CU_V2GRXMSGSVCDISCSVCSCOPE[49] 1 100 0.0 255.0 ECU_ADDRESS 0x700180d1 BYTE_ORDER MSB_LAST /end MEASUREMENT
/begin COMPU_METHOD CU_V2GRXMSGSVCDISCSVCSCOPE[49] "Conversion method for V2gRxMsgSvcDiscSvcScope[49]" RAT_FUNC "%10.0" "1" COEFFS 0.000000 1.000000 -0.000000 0.000000 0.000000 1.000000 /end COMPU_METHOD
/* Scalar measurable for DDE 'V2gRxMsgSvcDiscSvcScope[4]'. */
/begin MEASUREMENT V2gRxMsgSvcDiscSvcScope[4] "The arbitrated Service Scope parameter in the received message from EVSE" UBYTE CU_V2GRXMSGSVCDISCSVCSCOPE[4] 1 100 0.0 255.0 ECU_ADDRESS 0x700180a4 BYTE_ORDER MSB_LAST /end MEASUREMENT
/begin COMPU_METHOD CU_V2GRXMSGSVCDISCSVCSCOPE[4] "Conversion method for V2gRxMsgSvcDiscSvcScope[4]" RAT_FUNC "%10.0" "1" COEFFS 0.000000 1.000000 -0.000000 0.000000 0.000000 1.000000 /end COMPU_METHOD
/* Scalar measurable for DDE 'V2gRxMsgSvcDiscSvcScope[50]'. */
/begin MEASUREMENT V2gRxMsgSvcDiscSvcScope[50] "The arbitrated Service Scope parameter in the received message from EVSE" UBYTE CU_V2GRXMSGSVCDISCSVCSCOPE[50] 1 100 0.0 255.0 ECU_ADDRESS 0x700180d2 BYTE_ORDER MSB_LAST /end MEASUREMENT
/begin COMPU_METHOD CU_V2GRXMSGSVCDISCSVCSCOPE[50] "Conversion method for V2gRxMsgSvcDiscSvcScope[50]" RAT_FUNC "%10.0" "1" COEFFS 0.000000 1.000000 -0.000000 0.000000 0.000000 1.000000 /end COMPU_METHOD
/* Scalar measurable for DDE 'V2gRxMsgSvcDiscSvcScope[51]'. */
/begin MEASUREMENT V2gRxMsgSvcDiscSvcScope[51] "The arbitrated Service Scope parameter in the received message from EVSE" UBYTE CU_V2GRXMSGSVCDISCSVCSCOPE[51] 1 100 0.0 255.0 ECU_ADDRESS 0x700180d3 BYTE_ORDER MSB_LAST /end MEASUREMENT
/begin COMPU_METHOD CU_V2GRXMSGSVCDISCSVCSCOPE[51] "Conversion method for V2gRxMsgSvcDiscSvcScope[51]" RAT_FUNC "%10.0" "1" COEFFS 0.000000 1.000000 -0.000000 0.000000 0.000000 1.000000 /end COMPU_METHOD
/* Scalar measurable for DDE 'V2gRxMsgSvcDiscSvcScope[52]'. */
/begin MEASUREMENT V2gRxMsgSvcDiscSvcScope[52] "The arbitrated Service Scope parameter in the received message from EVSE" UBYTE CU_V2GRXMSGSVCDISCSVCSCOPE[52] 1 100 0.0 255.0 ECU_ADDRESS 0x700180d4 BYTE_ORDER MSB_LAST /end MEASUREMENT
/begin COMPU_METHOD CU_V2GRXMSGSVCDISCSVCSCOPE[52] "Conversion method for V2gRxMsgSvcDiscSvcScope[52]" RAT_FUNC "%10.0" "1" COEFFS 0.000000 1.000000 -0.000000 0.000000 0.000000 1.000000 /end COMPU_METHOD
/* Scalar measurable for DDE 'V2gRxMsgSvcDiscSvcScope[53]'. */
/begin MEASUREMENT V2gRxMsgSvcDiscSvcScope[53] "The arbitrated Service Scope parameter in the received message from EVSE" UBYTE CU_V2GRXMSGSVCDISCSVCSCOPE[53] 1 100 0.0 255.0 ECU_ADDRESS 0x700180d5 BYTE_ORDER MSB_LAST /end MEASUREMENT
/begin COMPU_METHOD CU_V2GRXMSGSVCDISCSVCSCOPE[53] "Conversion method for V2gRxMsgSvcDiscSvcScope[53]" RAT_FUNC "%10.0" "1" COEFFS 0.000000 1.000000 -0.000000 0.000000 0.000000 1.000000 /end COMPU_METHOD
/* Scalar measurable for DDE 'V2gRxMsgSvcDiscSvcScope[54]'. */
/begin MEASUREMENT V2gRxMsgSvcDiscSvcScope[54] "The arbitrated Service Scope parameter in the received message from EVSE" UBYTE CU_V2GRXMSGSVCDISCSVCSCOPE[54] 1 100 0.0 255.0 ECU_ADDRESS 0x700180d6 BYTE_ORDER MSB_LAST /end MEASUREMENT
/begin COMPU_METHOD CU_V2GRXMSGSVCDISCSVCSCOPE[54] "Conversion method for V2gRxMsgSvcDiscSvcScope[54]" RAT_FUNC "%10.0" "1" COEFFS 0.000000 1.000000 -0.000000 0.000000 0.000000 1.000000 /end COMPU_METHOD
/* Scalar measurable for DDE 'V2gRxMsgSvcDiscSvcScope[55]'. */
/begin MEASUREMENT V2gRxMsgSvcDiscSvcScope[55] "The arbitrated Service Scope parameter in the received message from EVSE" UBYTE CU_V2GRXMSGSVCDISCSVCSCOPE[55] 1 100 0.0 255.0 ECU_ADDRESS 0x700180d7 BYTE_ORDER MSB_LAST /end MEASUREMENT
/begin COMPU_METHOD CU_V2GRXMSGSVCDISCSVCSCOPE[55] "Conversion method for V2gRxMsgSvcDiscSvcScope[55]" RAT_FUNC "%10.0" "1" COEFFS 0.000000 1.000000 -0.000000 0.000000 0.000000 1.000000 /end COMPU_METHOD
/* Scalar measurable for DDE 'V2gRxMsgSvcDiscSvcScope[56]'. */
/begin MEASUREMENT V2gRxMsgSvcDiscSvcScope[56] "The arbitrated Service Scope parameter in the received message from EVSE" UBYTE CU_V2GRXMSGSVCDISCSVCSCOPE[56] 1 100 0.0 255.0 ECU_ADDRESS 0x700180d8 BYTE_ORDER MSB_LAST /end MEASUREMENT
/begin COMPU_METHOD CU_V2GRXMSGSVCDISCSVCSCOPE[56] "Conversion method for V2gRxMsgSvcDiscSvcScope[56]" RAT_FUNC "%10.0" "1" COEFFS 0.000000 1.000000 -0.000000 0.000000 0.000000 1.000000 /end COMPU_METHOD
/* Scalar measurable for DDE 'V2gRxMsgSvcDiscSvcScope[57]'. */
/begin MEASUREMENT V2gRxMsgSvcDiscSvcScope[57] "The arbitrated Service Scope parameter in the received message from EVSE" UBYTE CU_V2GRXMSGSVCDISCSVCSCOPE[57] 1 100 0.0 255.0 ECU_ADDRESS 0x700180d9 BYTE_ORDER MSB_LAST /end MEASUREMENT
/begin COMPU_METHOD CU_V2GRXMSGSVCDISCSVCSCOPE[57] "Conversion method for V2gRxMsgSvcDiscSvcScope[57]" RAT_FUNC "%10.0" "1" COEFFS 0.000000 1.000000 -0.000000 0.000000 0.000000 1.000000 /end COMPU_METHOD
/* Scalar measurable for DDE 'V2gRxMsgSvcDiscSvcScope[58]'. */
/begin MEASUREMENT V2gRxMsgSvcDiscSvcScope[58] "The arbitrated Service Scope parameter in the received message from EVSE" UBYTE CU_V2GRXMSGSVCDISCSVCSCOPE[58] 1 100 0.0 255.0 ECU_ADDRESS 0x700180da BYTE_ORDER MSB_LAST /end MEASUREMENT
/begin COMPU_METHOD CU_V2GRXMSGSVCDISCSVCSCOPE[58] "Conversion method for V2gRxMsgSvcDiscSvcScope[58]" RAT_FUNC "%10.0" "1" COEFFS 0.000000 1.000000 -0.000000 0.000000 0.000000 1.000000 /end COMPU_METHOD
/* Scalar measurable for DDE 'V2gRxMsgSvcDiscSvcScope[59]'. */
/begin MEASUREMENT V2gRxMsgSvcDiscSvcScope[59] "The arbitrated Service Scope parameter in the received message from EVSE" UBYTE CU_V2GRXMSGSVCDISCSVCSCOPE[59] 1 100 0.0 255.0 ECU_ADDRESS 0x700180db BYTE_ORDER MSB_LAST /end MEASUREMENT
/begin COMPU_METHOD CU_V2GRXMSGSVCDISCSVCSCOPE[59] "Conversion method for V2gRxMsgSvcDiscSvcScope[59]" RAT_FUNC "%10.0" "1" COEFFS 0.000000 1.000000 -0.000000 0.000000 0.000000 1.000000 /end COMPU_METHOD
/* Scalar measurable for DDE 'V2gRxMsgSvcDiscSvcScope[5]'. */
/begin MEASUREMENT V2gRxMsgSvcDiscSvcScope[5] "The arbitrated Service Scope parameter in the received message from EVSE" UBYTE CU_V2GRXMSGSVCDISCSVCSCOPE[5] 1 100 0.0 255.0 ECU_ADDRESS 0x700180a5 BYTE_ORDER MSB_LAST /end MEASUREMENT
/begin COMPU_METHOD CU_V2GRXMSGSVCDISCSVCSCOPE[5] "Conversion method for V2gRxMsgSvcDiscSvcScope[5]" RAT_FUNC "%10.0" "1" COEFFS 0.000000 1.000000 -0.000000 0.000000 0.000000 1.000000 /end COMPU_METHOD
/* Scalar measurable for DDE 'V2gRxMsgSvcDiscSvcScope[60]'. */
/begin MEASUREMENT V2gRxMsgSvcDiscSvcScope[60] "The arbitrated Service Scope parameter in the received message from EVSE" UBYTE CU_V2GRXMSGSVCDISCSVCSCOPE[60] 1 100 0.0 255.0 ECU_ADDRESS 0x700180dc BYTE_ORDER MSB_LAST /end MEASUREMENT
/begin COMPU_METHOD CU_V2GRXMSGSVCDISCSVCSCOPE[60] "Conversion method for V2gRxMsgSvcDiscSvcScope[60]" RAT_FUNC "%10.0" "1" COEFFS 0.000000 1.000000 -0.000000 0.000000 0.000000 1.000000 /end COMPU_METHOD
/* Scalar measurable for DDE 'V2gRxMsgSvcDiscSvcScope[61]'. */
/begin MEASUREMENT V2gRxMsgSvcDiscSvcScope[61] "The arbitrated Service Scope parameter in the received message from EVSE" UBYTE CU_V2GRXMSGSVCDISCSVCSCOPE[61] 1 100 0.0 255.0 ECU_ADDRESS 0x700180dd BYTE_ORDER MSB_LAST /end MEASUREMENT
/begin COMPU_METHOD CU_V2GRXMSGSVCDISCSVCSCOPE[61] "Conversion method for V2gRxMsgSvcDiscSvcScope[61]" RAT_FUNC "%10.0" "1" COEFFS 0.000000 1.000000 -0.000000 0.000000 0.000000 1.000000 /end COMPU_METHOD
/* Scalar measurable for DDE 'V2gRxMsgSvcDiscSvcScope[62]'. */
/begin MEASUREMENT V2gRxMsgSvcDiscSvcScope[62] "The arbitrated Service Scope parameter in the received message from EVSE" UBYTE CU_V2GRXMSGSVCDISCSVCSCOPE[62] 1 100 0.0 255.0 ECU_ADDRESS 0x700180de BYTE_ORDER MSB_LAST /end MEASUREMENT
/begin COMPU_METHOD CU_V2GRXMSGSVCDISCSVCSCOPE[62] "Conversion method for V2gRxMsgSvcDiscSvcScope[62]" RAT_FUNC "%10.0" "1" COEFFS 0.000000 1.000000 -0.000000 0.000000 0.000000 1.000000 /end COMPU_METHOD
/* Scalar measurable for DDE 'V2gRxMsgSvcDiscSvcScope[63]'. */
/begin MEASUREMENT V2gRxMsgSvcDiscSvcScope[63] "The arbitrated Service Scope parameter in the received message from EVSE" UBYTE CU_V2GRXMSGSVCDISCSVCSCOPE[63] 1 100 0.0 255.0 ECU_ADDRESS 0x700180df BYTE_ORDER MSB_LAST /end MEASUREMENT
/begin COMPU_METHOD CU_V2GRXMSGSVCDISCSVCSCOPE[63] "Conversion method for V2gRxMsgSvcDiscSvcScope[63]" RAT_FUNC "%10.0" "1" COEFFS 0.000000 1.000000 -0.000000 0.000000 0.000000 1.000000 /end COMPU_METHOD
/* Scalar measurable for DDE 'V2gRxMsgSvcDiscSvcScope[64]'. */
/begin MEASUREMENT V2gRxMsgSvcDiscSvcScope[64] "The arbitrated Service Scope parameter in the received message from EVSE" UBYTE CU_V2GRXMSGSVCDISCSVCSCOPE[64] 1 100 0.0 255.0 ECU_ADDRESS 0x700180e0 BYTE_ORDER MSB_LAST /end MEASUREMENT
/begin COMPU_METHOD CU_V2GRXMSGSVCDISCSVCSCOPE[64] "Conversion method for V2gRxMsgSvcDiscSvcScope[64]" RAT_FUNC "%10.0" "1" COEFFS 0.000000 1.000000 -0.000000 0.000000 0.000000 1.000000 /end COMPU_METHOD
/* Scalar measurable for DDE 'V2gRxMsgSvcDiscSvcScope[6]'. */
/begin MEASUREMENT V2gRxMsgSvcDiscSvcScope[6] "The arbitrated Service Scope parameter in the received message from EVSE" UBYTE CU_V2GRXMSGSVCDISCSVCSCOPE[6] 1 100 0.0 255.0 ECU_ADDRESS 0x700180a6 BYTE_ORDER MSB_LAST /end MEASUREMENT
/begin COMPU_METHOD CU_V2GRXMSGSVCDISCSVCSCOPE[6] "Conversion method for V2gRxMsgSvcDiscSvcScope[6]" RAT_FUNC "%10.0" "1" COEFFS 0.000000 1.000000 -0.000000 0.000000 0.000000 1.000000 /end COMPU_METHOD
/* Scalar measurable for DDE 'V2gRxMsgSvcDiscSvcScope[7]'. */
/begin MEASUREMENT V2gRxMsgSvcDiscSvcScope[7] "The arbitrated Service Scope parameter in the received message from EVSE" UBYTE CU_V2GRXMSGSVCDISCSVCSCOPE[7] 1 100 0.0 255.0 ECU_ADDRESS 0x700180a7 BYTE_ORDER MSB_LAST /end MEASUREMENT
/begin COMPU_METHOD CU_V2GRXMSGSVCDISCSVCSCOPE[7] "Conversion method for V2gRxMsgSvcDiscSvcScope[7]" RAT_FUNC "%10.0" "1" COEFFS 0.000000 1.000000 -0.000000 0.000000 0.000000 1.000000 /end COMPU_METHOD
/* Scalar measurable for DDE 'V2gRxMsgSvcDiscSvcScope[8]'. */
/begin MEASUREMENT V2gRxMsgSvcDiscSvcScope[8] "The arbitrated Service Scope parameter in the received message from EVSE" UBYTE CU_V2GRXMSGSVCDISCSVCSCOPE[8] 1 100 0.0 255.0 ECU_ADDRESS 0x700180a8 BYTE_ORDER MSB_LAST /end MEASUREMENT
/begin COMPU_METHOD CU_V2GRXMSGSVCDISCSVCSCOPE[8] "Conversion method for V2gRxMsgSvcDiscSvcScope[8]" RAT_FUNC "%10.0" "1" COEFFS 0.000000 1.000000 -0.000000 0.000000 0.000000 1.000000 /end COMPU_METHOD
/* Scalar measurable for DDE 'V2gRxMsgSvcDiscSvcScope[9]'. */
/begin MEASUREMENT V2gRxMsgSvcDiscSvcScope[9] "The arbitrated Service Scope parameter in the received message from EVSE" UBYTE CU_V2GRXMSGSVCDISCSVCSCOPE[9] 1 100 0.0 255.0 ECU_ADDRESS 0x700180a9 BYTE_ORDER MSB_LAST /end MEASUREMENT
/begin COMPU_METHOD CU_V2GRXMSGSVCDISCSVCSCOPE[9] "Conversion method for V2gRxMsgSvcDiscSvcScope[9]" RAT_FUNC "%10.0" "1" COEFFS 0.000000 1.000000 -0.000000 0.000000 0.000000 1.000000 /end COMPU_METHOD
/* Scalar measurable for DDE 'V2gRxMsgSvcDiscTrg'. */
/begin MEASUREMENT V2gRxMsgSvcDiscTrg "Trigger falg that on a rising edge indicates the event for receiving the PLC (V2G) message response 2b from EVSE" UBYTE CU_V2GRXMSGSVCDISCTRG 1 100 0.0 1.0 ECU_ADDRESS 0x70017e38 BYTE_ORDER MSB_LAST /end MEASUREMENT
/begin COMPU_METHOD CU_V2GRXMSGSVCDISCTRG "Conversion method for V2gRxMsgSvcDiscTrg" RAT_FUNC "%10.0" "b" COEFFS 0.000000 1.000000 -0.000000 0.000000 0.000000 1.000000 /end COMPU_METHOD
/* Scalar measurable for DDE 'V2gRxMsgSvcDiscVasListFreeSvc[0]'. */
/begin MEASUREMENT V2gRxMsgSvcDiscVasListFreeSvc[0 "The arbitrated VAS List IDs Free Service parameter in the received message from EVSE" UBYTE CU_V2GRXMSGSVCDISCVASLISTFREES0 1 100 0.0 1.0 ECU_ADDRESS 0x70018168 BYTE_ORDER MSB_LAST /end MEASUREMENT
/begin COMPU_METHOD CU_V2GRXMSGSVCDISCVASLISTFREES0 "Conversion method for V2gRxMsgSvcDiscVasListFreeSvc[0]" RAT_FUNC "%10.0" "b" COEFFS 0.000000 1.000000 -0.000000 0.000000 0.000000 1.000000 /end COMPU_METHOD
/* Scalar measurable for DDE 'V2gRxMsgSvcDiscVasListFreeSvc[1]'. */
/begin MEASUREMENT V2gRxMsgSvcDiscVasListFreeSvc[1 "The arbitrated VAS List IDs Free Service parameter in the received message from EVSE" UBYTE CU_V2GRXMSGSVCDISCVASLISTFREES1 1 100 0.0 1.0 ECU_ADDRESS 0x70018169 BYTE_ORDER MSB_LAST /end MEASUREMENT
/begin COMPU_METHOD CU_V2GRXMSGSVCDISCVASLISTFREES1 "Conversion method for V2gRxMsgSvcDiscVasListFreeSvc[1]" RAT_FUNC "%10.0" "b" COEFFS 0.000000 1.000000 -0.000000 0.000000 0.000000 1.000000 /end COMPU_METHOD
/* Scalar measurable for DDE 'V2gRxMsgSvcDiscVasListFreeSvc[2]'. */
/begin MEASUREMENT V2gRxMsgSvcDiscVasListFreeSvc[6 "The arbitrated VAS List IDs Free Service parameter in the received message from EVSE" UBYTE CU_V2GRXMSGSVCDISCVASLISTFREES6 1 100 0.0 1.0 ECU_ADDRESS 0x7001816a BYTE_ORDER MSB_LAST /end MEASUREMENT
/begin COMPU_METHOD CU_V2GRXMSGSVCDISCVASLISTFREES6 "Conversion method for V2gRxMsgSvcDiscVasListFreeSvc[2]" RAT_FUNC "%10.0" "b" COEFFS 0.000000 1.000000 -0.000000 0.000000 0.000000 1.000000 /end COMPU_METHOD
/* Scalar measurable for DDE 'V2gRxMsgSvcDiscVasListFreeSvc[3]'. */
/begin MEASUREMENT V2gRxMsgSvcDiscVasListFreeSvc[7 "The arbitrated VAS List IDs Free Service parameter in the received message from EVSE" UBYTE CU_V2GRXMSGSVCDISCVASLISTFREES7 1 100 0.0 1.0 ECU_ADDRESS 0x7001816b BYTE_ORDER MSB_LAST /end MEASUREMENT
/begin COMPU_METHOD CU_V2GRXMSGSVCDISCVASLISTFREES7 "Conversion method for V2gRxMsgSvcDiscVasListFreeSvc[3]" RAT_FUNC "%10.0" "b" COEFFS 0.000000 1.000000 -0.000000 0.000000 0.000000 1.000000 /end COMPU_METHOD
/* Scalar measurable for DDE 'V2gRxMsgSvcDiscVasListFreeSvc[4]'. */
/begin MEASUREMENT V2gRxMsgSvcDiscVasListFreeSvc[4 "The arbitrated VAS List IDs Free Service parameter in the received message from EVSE" UBYTE CU_V2GRXMSGSVCDISCVASLISTFREES4 1 100 0.0 1.0 ECU_ADDRESS 0x7001816c BYTE_ORDER MSB_LAST /end MEASUREMENT
/begin COMPU_METHOD CU_V2GRXMSGSVCDISCVASLISTFREES4 "Conversion method for V2gRxMsgSvcDiscVasListFreeSvc[4]" RAT_FUNC "%10.0" "b" COEFFS 0.000000 1.000000 -0.000000 0.000000 0.000000 1.000000 /end COMPU_METHOD
/* Scalar measurable for DDE 'V2gRxMsgSvcDiscVasListFreeSvc[5]'. */
/begin MEASUREMENT V2gRxMsgSvcDiscVasListFreeSvc[5 "The arbitrated VAS List IDs Free Service parameter in the received message from EVSE" UBYTE CU_V2GRXMSGSVCDISCVASLISTFREES5 1 100 0.0 1.0 ECU_ADDRESS 0x7001816d BYTE_ORDER MSB_LAST /end MEASUREMENT
/begin COMPU_METHOD CU_V2GRXMSGSVCDISCVASLISTFREES5 "Conversion method for V2gRxMsgSvcDiscVasListFreeSvc[5]" RAT_FUNC "%10.0" "b" COEFFS 0.000000 1.000000 -0.000000 0.000000 0.000000 1.000000 /end COMPU_METHOD
/* Scalar measurable for DDE 'V2gRxMsgSvcDiscVasListFreeSvc[6]'. */
/begin MEASUREMENT V2gRxMsgSvcDiscVasListFreeSvc[2 "The arbitrated VAS List IDs Free Service parameter in the received message from EVSE" UBYTE CU_V2GRXMSGSVCDISCVASLISTFREES2 1 100 0.0 1.0 ECU_ADDRESS 0x7001816e BYTE_ORDER MSB_LAST /end MEASUREMENT
/begin COMPU_METHOD CU_V2GRXMSGSVCDISCVASLISTFREES2 "Conversion method for V2gRxMsgSvcDiscVasListFreeSvc[6]" RAT_FUNC "%10.0" "b" COEFFS 0.000000 1.000000 -0.000000 0.000000 0.000000 1.000000 /end COMPU_METHOD
/* Scalar measurable for DDE 'V2gRxMsgSvcDiscVasListFreeSvc[7]'. */
/begin MEASUREMENT V2gRxMsgSvcDiscVasListFreeSvc[3 "The arbitrated VAS List IDs Free Service parameter in the received message from EVSE" UBYTE CU_V2GRXMSGSVCDISCVASLISTFREES3 1 100 0.0 1.0 ECU_ADDRESS 0x7001816f BYTE_ORDER MSB_LAST /end MEASUREMENT
/begin COMPU_METHOD CU_V2GRXMSGSVCDISCVASLISTFREES3 "Conversion method for V2gRxMsgSvcDiscVasListFreeSvc[7]" RAT_FUNC "%10.0" "b" COEFFS 0.000000 1.000000 -0.000000 0.000000 0.000000 1.000000 /end COMPU_METHOD
/* Scalar measurable for DDE 'V2gRxMsgSvcDiscVasListIds[0]'. */
/begin MEASUREMENT V2gRxMsgSvcDiscVasListIds[0] "The arbitrated VAS List IDs parameter in the received message from EVSE" UWORD CU_V2GRXMSGSVCDISCVASLISTIDS[0] 1 100 0.0 65535.0 ECU_ADDRESS 0x7001832a BYTE_ORDER MSB_LAST /end MEASUREMENT
/begin COMPU_METHOD CU_V2GRXMSGSVCDISCVASLISTIDS[0] "Conversion method for V2gRxMsgSvcDiscVasListIds[0]" RAT_FUNC "%10.0" "1" COEFFS 0.000000 1.000000 -0.000000 0.000000 0.000000 1.000000 /end COMPU_METHOD
/* Scalar measurable for DDE 'V2gRxMsgSvcDiscVasListIds[1]'. */
/begin MEASUREMENT V2gRxMsgSvcDiscVasListIds[1] "The arbitrated VAS List IDs parameter in the received message from EVSE" UWORD CU_V2GRXMSGSVCDISCVASLISTIDS[1] 1 100 0.0 65535.0 ECU_ADDRESS 0x7001832c BYTE_ORDER MSB_LAST /end MEASUREMENT
/begin COMPU_METHOD CU_V2GRXMSGSVCDISCVASLISTIDS[1] "Conversion method for V2gRxMsgSvcDiscVasListIds[1]" RAT_FUNC "%10.0" "1" COEFFS 0.000000 1.000000 -0.000000 0.000000 0.000000 1.000000 /end COMPU_METHOD
/* Scalar measurable for DDE 'V2gRxMsgSvcDiscVasListIds[2]'. */
/begin MEASUREMENT V2gRxMsgSvcDiscVasListIds[2] "The arbitrated VAS List IDs parameter in the received message from EVSE" UWORD CU_V2GRXMSGSVCDISCVASLISTIDS[2] 1 100 0.0 65535.0 ECU_ADDRESS 0x7001832e BYTE_ORDER MSB_LAST /end MEASUREMENT
/begin COMPU_METHOD CU_V2GRXMSGSVCDISCVASLISTIDS[2] "Conversion method for V2gRxMsgSvcDiscVasListIds[2]" RAT_FUNC "%10.0" "1" COEFFS 0.000000 1.000000 -0.000000 0.000000 0.000000 1.000000 /end COMPU_METHOD
/* Scalar measurable for DDE 'V2gRxMsgSvcDiscVasListIds[3]'. */
/begin MEASUREMENT V2gRxMsgSvcDiscVasListIds[3] "The arbitrated VAS List IDs parameter in the received message from EVSE" UWORD CU_V2GRXMSGSVCDISCVASLISTIDS[3] 1 100 0.0 65535.0 ECU_ADDRESS 0x70018330 BYTE_ORDER MSB_LAST /end MEASUREMENT
/begin COMPU_METHOD CU_V2GRXMSGSVCDISCVASLISTIDS[3] "Conversion method for V2gRxMsgSvcDiscVasListIds[3]" RAT_FUNC "%10.0" "1" COEFFS 0.000000 1.000000 -0.000000 0.000000 0.000000 1.000000 /end COMPU_METHOD
/* Scalar measurable for DDE 'V2gRxMsgSvcDiscVasListIds[4]'. */
/begin MEASUREMENT V2gRxMsgSvcDiscVasListIds[4] "The arbitrated VAS List IDs parameter in the received message from EVSE" UWORD CU_V2GRXMSGSVCDISCVASLISTIDS[4] 1 100 0.0 65535.0 ECU_ADDRESS 0x70018332 BYTE_ORDER MSB_LAST /end MEASUREMENT
/begin COMPU_METHOD CU_V2GRXMSGSVCDISCVASLISTIDS[4] "Conversion method for V2gRxMsgSvcDiscVasListIds[4]" RAT_FUNC "%10.0" "1" COEFFS 0.000000 1.000000 -0.000000 0.000000 0.000000 1.000000 /end COMPU_METHOD
/* Scalar measurable for DDE 'V2gRxMsgSvcDiscVasListIds[5]'. */
/begin MEASUREMENT V2gRxMsgSvcDiscVasListIds[5] "The arbitrated VAS List IDs parameter in the received message from EVSE" UWORD CU_V2GRXMSGSVCDISCVASLISTIDS[5] 1 100 0.0 65535.0 ECU_ADDRESS 0x70018334 BYTE_ORDER MSB_LAST /end MEASUREMENT
/begin COMPU_METHOD CU_V2GRXMSGSVCDISCVASLISTIDS[5] "Conversion method for V2gRxMsgSvcDiscVasListIds[5]" RAT_FUNC "%10.0" "1" COEFFS 0.000000 1.000000 -0.000000 0.000000 0.000000 1.000000 /end COMPU_METHOD
/* Scalar measurable for DDE 'V2gRxMsgSvcDiscVasListIds[6]'. */
/begin MEASUREMENT V2gRxMsgSvcDiscVasListIds[6] "The arbitrated VAS List IDs parameter in the received message from EVSE" UWORD CU_V2GRXMSGSVCDISCVASLISTIDS[6] 1 100 0.0 65535.0 ECU_ADDRESS 0x70018336 BYTE_ORDER MSB_LAST /end MEASUREMENT
/begin COMPU_METHOD CU_V2GRXMSGSVCDISCVASLISTIDS[6] "Conversion method for V2gRxMsgSvcDiscVasListIds[6]" RAT_FUNC "%10.0" "1" COEFFS 0.000000 1.000000 -0.000000 0.000000 0.000000 1.000000 /end COMPU_METHOD
/* Scalar measurable for DDE 'V2gRxMsgSvcDiscVasListIds[7]'. */
/begin MEASUREMENT V2gRxMsgSvcDiscVasListIds[7] "The arbitrated VAS List IDs parameter in the received message from EVSE" UWORD CU_V2GRXMSGSVCDISCVASLISTIDS[7] 1 100 0.0 65535.0 ECU_ADDRESS 0x70018338 BYTE_ORDER MSB_LAST /end MEASUREMENT
/begin COMPU_METHOD CU_V2GRXMSGSVCDISCVASLISTIDS[7] "Conversion method for V2gRxMsgSvcDiscVasListIds[7]" RAT_FUNC "%10.0" "1" COEFFS 0.000000 1.000000 -0.000000 0.000000 0.000000 1.000000 /end COMPU_METHOD
/* Scalar measurable for DDE 'V2gRxMsgSvcDiscVasListLen'. */
/begin MEASUREMENT V2gRxMsgSvcDiscVasListLen "The arbitrated Transfer Service IDs Length parameter in the received message from EVSE" UBYTE CU_V2GRXMSGSVCDISCVASLISTLEN 1 100 0.0 255.0 ECU_ADDRESS 0x70017eea BYTE_ORDER MSB_LAST /end MEASUREMENT
/begin COMPU_METHOD CU_V2GRXMSGSVCDISCVASLISTLEN "Conversion method for V2gRxMsgSvcDiscVasListLen" RAT_FUNC "%10.0" "1" COEFFS 0.000000 1.000000 -0.000000 0.000000 0.000000 1.000000 /end COMPU_METHOD
/begin FUNCTION PayloadArbitration3 "Group /ByModelHeirarchy/LaforgeTestApp_CCU/Core0-TestApp/V2G/OE_CCS/Arbitration/Arbit_V2gRxMsg_ServiceDiscovery/PayloadArbitration"
 /begin LOC_MEASUREMENT V2gRxMsgSvcDiscEgyTransferMode1 V2gRxMsgSvcDiscEgyTransferMode4 V2gRxMsgSvcDiscEgyTransferMode3 V2gRxMsgSvcDiscEgyTransferMode2 V2gRxMsgSvcDiscEgyTransferMode0 V2gRxMsgSvcDiscEgyTransferMode6 V2gRxMsgSvcDiscEgyTransferMode5 V2gRxMsgSvcDiscEgyTransferSvcI1 V2gRxMsgSvcDiscEgyTransferSvcI8 V2gRxMsgSvcDiscEgyTransferSvcI4 V2gRxMsgSvcDiscEgyTransferSvcI0 V2gRxMsgSvcDiscEgyTransferSvcI7 V2gRxMsgSvcDiscEgyTransferSvcI5 V2gRxMsgSvcDiscEgyTransferSvcI6 V2gRxMsgSvcDiscEgyTransferSvcI2 V2gRxMsgSvcDiscEgyTransferSvcI3 V2gRxMsgSvcDiscEgyTxfrType V2gRxMsgSvcDiscFreeService[0] V2gRxMsgSvcDiscFreeService[1] V2gRxMsgSvcDiscFreeService[2] V2gRxMsgSvcDiscFreeService[3] V2gRxMsgSvcDiscFreeService[4] V2gRxMsgSvcDiscFreeService[5] V2gRxMsgSvcDiscFreeService[6] V2gRxMsgSvcDiscFreeService[7] V2gRxMsgSvcDiscNotif V2gRxMsgSvcDiscNotifFlg V2gRxMsgSvcDiscNotifMaxDelay V2gRxMsgSvcDiscRescode V2gRxMsgSvcDiscServiceId V2gRxMsgSvcDiscSvcCategory V2gRxMsgSvcDiscSvcListSize V2gRxMsgSvcDiscSvcNameLen V2gRxMsgSvcDiscSvcName[0] V2gRxMsgSvcDiscSvcName[10] V2gRxMsgSvcDiscSvcName[11] V2gRxMsgSvcDiscSvcName[12] V2gRxMsgSvcDiscSvcName[13] V2gRxMsgSvcDiscSvcName[14] V2gRxMsgSvcDiscSvcName[15] V2gRxMsgSvcDiscSvcName[16] V2gRxMsgSvcDiscSvcName[17] V2gRxMsgSvcDiscSvcName[18] V2gRxMsgSvcDiscSvcName[19] V2gRxMsgSvcDiscSvcName[1] V2gRxMsgSvcDiscSvcName[20] V2gRxMsgSvcDiscSvcName[21] V2gRxMsgSvcDiscSvcName[22] V2gRxMsgSvcDiscSvcName[23] V2gRxMsgSvcDiscSvcName[24] V2gRxMsgSvcDiscSvcName[25] V2gRxMsgSvcDiscSvcName[26] V2gRxMsgSvcDiscSvcName[27] V2gRxMsgSvcDiscSvcName[28] V2gRxMsgSvcDiscSvcName[29] V2gRxMsgSvcDiscSvcName[2] V2gRxMsgSvcDiscSvcName[30] V2gRxMsgSvcDiscSvcName[31] V2gRxMsgSvcDiscSvcName[32] V2gRxMsgSvcDiscSvcName[3] V2gRxMsgSvcDiscSvcName[4] V2gRxMsgSvcDiscSvcName[5] V2gRxMsgSvcDiscSvcName[6] V2gRxMsgSvcDiscSvcName[7] V2gRxMsgSvcDiscSvcName[8] V2gRxMsgSvcDiscSvcName[9] V2gRxMsgSvcDiscSvcScopeLen V2gRxMsgSvcDiscSvcScope[0] V2gRxMsgSvcDiscSvcScope[10] V2gRxMsgSvcDiscSvcScope[11] V2gRxMsgSvcDiscSvcScope[12] V2gRxMsgSvcDiscSvcScope[13] V2gRxMsgSvcDiscSvcScope[14] V2gRxMsgSvcDiscSvcScope[15] V2gRxMsgSvcDiscSvcScope[16] V2gRxMsgSvcDiscSvcScope[17] V2gRxMsgSvcDiscSvcScope[18] V2gRxMsgSvcDiscSvcScope[19] V2gRxMsgSvcDiscSvcScope[1] V2gRxMsgSvcDiscSvcScope[20] V2gRxMsgSvcDiscSvcScope[21] V2gRxMsgSvcDiscSvcScope[22] V2gRxMsgSvcDiscSvcScope[23] V2gRxMsgSvcDiscSvcScope[24] V2gRxMsgSvcDiscSvcScope[25] V2gRxMsgSvcDiscSvcScope[26] V2gRxMsgSvcDiscSvcScope[27] V2gRxMsgSvcDiscSvcScope[28] V2gRxMsgSvcDiscSvcScope[29] V2gRxMsgSvcDiscSvcScope[2] V2gRxMsgSvcDiscSvcScope[30] V2gRxMsgSvcDiscSvcScope[31] V2gRxMsgSvcDiscSvcScope[32] V2gRxMsgSvcDiscSvcScope[33] V2gRxMsgSvcDiscSvcScope[34] V2gRxMsgSvcDiscSvcScope[35] V2gRxMsgSvcDiscSvcScope[36] V2gRxMsgSvcDiscSvcScope[37] V2gRxMsgSvcDiscSvcScope[38] V2gRxMsgSvcDiscSvcScope[39] V2gRxMsgSvcDiscSvcScope[3] V2gRxMsgSvcDiscSvcScope[40] V2gRxMsgSvcDiscSvcScope[41] V2gRxMsgSvcDiscSvcScope[42] V2gRxMsgSvcDiscSvcScope[43] V2gRxMsgSvcDiscSvcScope[44] V2gRxMsgSvcDiscSvcScope[45] V2gRxMsgSvcDiscSvcScope[46] V2gRxMsgSvcDiscSvcScope[47] V2gRxMsgSvcDiscSvcScope[48] V2gRxMsgSvcDiscSvcScope[49] V2gRxMsgSvcDiscSvcScope[4] V2gRxMsgSvcDiscSvcScope[50] V2gRxMsgSvcDiscSvcScope[51] V2gRxMsgSvcDiscSvcScope[52] V2gRxMsgSvcDiscSvcScope[53] V2gRxMsgSvcDiscSvcScope[54] V2gRxMsgSvcDiscSvcScope[55] V2gRxMsgSvcDiscSvcScope[56] V2gRxMsgSvcDiscSvcScope[57] V2gRxMsgSvcDiscSvcScope[58] V2gRxMsgSvcDiscSvcScope[59] V2gRxMsgSvcDiscSvcScope[5] V2gRxMsgSvcDiscSvcScope[60] V2gRxMsgSvcDiscSvcScope[61] V2gRxMsgSvcDiscSvcScope[62] V2gRxMsgSvcDiscSvcScope[63] V2gRxMsgSvcDiscSvcScope[64] V2gRxMsgSvcDiscSvcScope[6] V2gRxMsgSvcDiscSvcScope[7] V2gRxMsgSvcDiscSvcScope[8] V2gRxMsgSvcDiscSvcScope[9] V2gRxMsgSvcDiscVasListFreeSvc[0 V2gRxMsgSvcDiscVasListFreeSvc[1 V2gRxMsgSvcDiscVasListFreeSvc[6 V2gRxMsgSvcDiscVasListFreeSvc[7 V2gRxMsgSvcDiscVasListFreeSvc[4 V2gRxMsgSvcDiscVasListFreeSvc[5 V2gRxMsgSvcDiscVasListFreeSvc[2 V2gRxMsgSvcDiscVasListFreeSvc[3 V2gRxMsgSvcDiscVasListIds[0] V2gRxMsgSvcDiscVasListIds[1] V2gRxMsgSvcDiscVasListIds[2] V2gRxMsgSvcDiscVasListIds[3] V2gRxMsgSvcDiscVasListIds[4] V2gRxMsgSvcDiscVasListIds[5] V2gRxMsgSvcDiscVasListIds[6] V2gRxMsgSvcDiscVasListIds[7] V2gRxMsgSvcDiscVasListLen /end LOC_MEASUREMENT
/end FUNCTION
/begin FUNCTION Arbit_V2gRxMsg_ServiceDiscovery "Group /ByModelHeirarchy/LaforgeTestApp_CCU/Core0-TestApp/V2G/OE_CCS/Arbitration/Arbit_V2gRxMsg_ServiceDiscovery" /begin SUB_FUNCTION PayloadArbitration3 /end SUB_FUNCTION /begin LOC_MEASUREMENT V2gRxMsgSvcDiscTrg /end LOC_MEASUREMENT /end FUNCTION
/begin FUNCTION PayloadArbitration4 "Group /ByModelHeirarchy/LaforgeTestApp_CCU/Core0-TestApp/V2G/OE_CCS/Arbitration/Arbit_V2gRxMsg_SessionSetup/PayloadArbitration"
 /begin LOC_MEASUREMENT V2gRxMsgSesSetupEvseIdLen V2gRxMsgSesSetupEvseId[0] V2gRxMsgSesSetupEvseId[10] V2gRxMsgSesSetupEvseId[11] V2gRxMsgSesSetupEvseId[12] V2gRxMsgSesSetupEvseId[13] V2gRxMsgSesSetupEvseId[14] V2gRxMsgSesSetupEvseId[15] V2gRxMsgSesSetupEvseId[16] V2gRxMsgSesSetupEvseId[17] V2gRxMsgSesSetupEvseId[18] V2gRxMsgSesSetupEvseId[19] V2gRxMsgSesSetupEvseId[1] V2gRxMsgSesSetupEvseId[20] V2gRxMsgSesSetupEvseId[21] V2gRxMsgSesSetupEvseId[22] V2gRxMsgSesSetupEvseId[23] V2gRxMsgSesSetupEvseId[24] V2gRxMsgSesSetupEvseId[25] V2gRxMsgSesSetupEvseId[26] V2gRxMsgSesSetupEvseId[27] V2gRxMsgSesSetupEvseId[28] V2gRxMsgSesSetupEvseId[29] V2gRxMsgSesSetupEvseId[2] V2gRxMsgSesSetupEvseId[30] V2gRxMsgSesSetupEvseId[31] V2gRxMsgSesSetupEvseId[32] V2gRxMsgSesSetupEvseId[33] V2gRxMsgSesSetupEvseId[34] V2gRxMsgSesSetupEvseId[35] V2gRxMsgSesSetupEvseId[36] V2gRxMsgSesSetupEvseId[37] V2gRxMsgSesSetupEvseId[3] V2gRxMsgSesSetupEvseId[4] V2gRxMsgSesSetupEvseId[5] V2gRxMsgSesSetupEvseId[6] V2gRxMsgSesSetupEvseId[7] V2gRxMsgSesSetupEvseId[8] V2gRxMsgSesSetupEvseId[9] V2gRxMsgSesSetupNotif V2gRxMsgSesSetupNotifFlg V2gRxMsgSesSetupNotifMaxDelay V2gRxMsgSesSetupRescode V2gRxMsgSesSetupTimestamp V2gRxMsgSesSetupTimestamp_flg /end LOC_MEASUREMENT
/end FUNCTION
/begin FUNCTION Arbit_V2gRxMsg_SessionSetup "Group /ByModelHeirarchy/LaforgeTestApp_CCU/Core0-TestApp/V2G/OE_CCS/Arbitration/Arbit_V2gRxMsg_SessionSetup" /begin SUB_FUNCTION PayloadArbitration4 /end SUB_FUNCTION /begin LOC_MEASUREMENT V2gRxMsgSesSetupTrg /end LOC_MEASUREMENT /end FUNCTION
/begin FUNCTION PayloadArbitration5 "Group /ByModelHeirarchy/LaforgeTestApp_CCU/Core0-TestApp/V2G/OE_CCS/Arbitration/Arbit_V2gRxMsg_SessionStop/PayloadArbitration"
 /begin LOC_MEASUREMENT V2gRxMsgSesStopNotif V2gRxMsgSesStopNotifFlg V2gRxMsgSesStopNotifMaxDelay V2gRxMsgSesStopRescode /end LOC_MEASUREMENT
/end FUNCTION
/begin FUNCTION Arbit_V2gRxMsg_SessionStop "Group /ByModelHeirarchy/LaforgeTestApp_CCU/Core0-TestApp/V2G/OE_CCS/Arbitration/Arbit_V2gRxMsg_SessionStop" /begin SUB_FUNCTION PayloadArbitration5 /end SUB_FUNCTION /begin LOC_MEASUREMENT V2gRxMsgSesStopTrg /end LOC_MEASUREMENT /end FUNCTION
/begin FUNCTION PayloadArbitration6 "Group /ByModelHeirarchy/LaforgeTestApp_CCU/Core0-TestApp/V2G/OE_CCS/Arbitration/Arbit_V2gRxMsg_V2gRxMsgBptCtrl/PayloadArbitration"
 /begin LOC_MEASUREMENT V2gRxMsgBptCtrlChgMaxCrnt V2gRxMsgBptCtrlChgMaxCrnt_flg V2gRxMsgBptCtrlChgMaxPwr V2gRxMsgBptCtrlChgMaxPwr_flg V2gRxMsgBptCtrlCrntLimReached V2gRxMsgBptCtrlDchgMaxCrnt V2gRxMsgBptCtrlDchgMaxCrntFlg V2gRxMsgBptCtrlDchgMaxPwr V2gRxMsgBptCtrlDchgMaxPwr_flg V2gRxMsgBptCtrlEvseCurrent V2gRxMsgBptCtrlEvseIdLen V2gRxMsgBptCtrlEvseId[0] V2gRxMsgBptCtrlEvseId[10] V2gRxMsgBptCtrlEvseId[11] V2gRxMsgBptCtrlEvseId[12] V2gRxMsgBptCtrlEvseId[13] V2gRxMsgBptCtrlEvseId[14] V2gRxMsgBptCtrlEvseId[15] V2gRxMsgBptCtrlEvseId[16] V2gRxMsgBptCtrlEvseId[17] V2gRxMsgBptCtrlEvseId[18] V2gRxMsgBptCtrlEvseId[19] V2gRxMsgBptCtrlEvseId[1] V2gRxMsgBptCtrlEvseId[20] V2gRxMsgBptCtrlEvseId[21] V2gRxMsgBptCtrlEvseId[22] V2gRxMsgBptCtrlEvseId[23] V2gRxMsgBptCtrlEvseId[24] V2gRxMsgBptCtrlEvseId[25] V2gRxMsgBptCtrlEvseId[26] V2gRxMsgBptCtrlEvseId[27] V2gRxMsgBptCtrlEvseId[28] V2gRxMsgBptCtrlEvseId[29] V2gRxMsgBptCtrlEvseId[2] V2gRxMsgBptCtrlEvseId[30] V2gRxMsgBptCtrlEvseId[31] V2gRxMsgBptCtrlEvseId[32] V2gRxMsgBptCtrlEvseId[33] V2gRxMsgBptCtrlEvseId[34] V2gRxMsgBptCtrlEvseId[35] V2gRxMsgBptCtrlEvseId[36] V2gRxMsgBptCtrlEvseId[37] V2gRxMsgBptCtrlEvseId[3] V2gRxMsgBptCtrlEvseId[4] V2gRxMsgBptCtrlEvseId[5] V2gRxMsgBptCtrlEvseId[6] V2gRxMsgBptCtrlEvseId[7] V2gRxMsgBptCtrlEvseId[8] V2gRxMsgBptCtrlEvseId[9] V2gRxMsgBptCtrlEvseMaxVolt V2gRxMsgBptCtrlEvseMaxVoltFlg V2gRxMsgBptCtrlEvseMinVolt V2gRxMsgBptCtrlEvseMinVoltFlg V2gRxMsgBptCtrlEvseVoltage V2gRxMsgBptCtrlNotif V2gRxMsgBptCtrlNotifFlg V2gRxMsgBptCtrlNotifMaxDelay V2gRxMsgBptCtrlPwrLimReached V2gRxMsgBptCtrlRescode V2gRxMsgBptCtrlSASchTupId V2gRxMsgBptCtrlSASchTupIdFlg V2gRxMsgBptCtrlVoltLimReached /end LOC_MEASUREMENT
/end FUNCTION
/begin FUNCTION Arbit_V2gRxMsg_V2gRxMsgBptCtrl "Group /ByModelHeirarchy/LaforgeTestApp_CCU/Core0-TestApp/V2G/OE_CCS/Arbitration/Arbit_V2gRxMsg_V2gRxMsgBptCtrl" /begin SUB_FUNCTION PayloadArbitration6 /end SUB_FUNCTION /begin LOC_MEASUREMENT V2gRxMsgBptCtrlTrg /end LOC_MEASUREMENT /end FUNCTION
/begin FUNCTION PayloadArbitration7 "Group /ByModelHeirarchy/LaforgeTestApp_CCU/Core0-TestApp/V2G/OE_CCS/Arbitration/Arbit_V2gRxMsg_V2gRxMsgCblChk/PayloadArbitration"
 /begin LOC_MEASUREMENT V2gRxMsgCblChkEvseProcessing V2gRxMsgCblChkEvseStatus V2gRxMsgCblChkIsolStatus V2gRxMsgCblChkIsolStatus_flg V2gRxMsgCblChkNotif V2gRxMsgCblChkNotifFlg V2gRxMsgCblChkNotifMaxDelay V2gRxMsgCblChkRescode /end LOC_MEASUREMENT
/end FUNCTION
/begin FUNCTION Arbit_V2gRxMsg_V2gRxMsgCblChk "Group /ByModelHeirarchy/LaforgeTestApp_CCU/Core0-TestApp/V2G/OE_CCS/Arbitration/Arbit_V2gRxMsg_V2gRxMsgCblChk" /begin SUB_FUNCTION PayloadArbitration7 /end SUB_FUNCTION /begin LOC_MEASUREMENT V2gRxMsgCblChkTrg /end LOC_MEASUREMENT /end FUNCTION
/begin FUNCTION PayloadArbitration8 "Group /ByModelHeirarchy/LaforgeTestApp_CCU/Core0-TestApp/V2G/OE_CCS/Arbitration/Arbit_V2gRxMsg_V2gRxMsgChgParDsc/PayloadArbitration"
 /begin LOC_MEASUREMENT V2gRxMsgChgParDscCrntRegTol V2gRxMsgChgParDscCrntRegTol_flg V2gRxMsgChgParDscDchgMaxCrnt V2gRxMsgChgParDscDchgMaxCrntFlg V2gRxMsgChgParDscDchgMaxPwr V2gRxMsgChgParDscDchgMaxPwr_flg V2gRxMsgChgParDscDchgMinCrnt V2gRxMsgChgParDscDchgMinCrntFlg V2gRxMsgChgParDscEgy2Deliv V2gRxMsgChgParDscEgy2DelivFlg V2gRxMsgChgParDscEvseProcessing V2gRxMsgChgParDscEvseStatus V2gRxMsgChgParDscEvseStatus_flg V2gRxMsgChgParDscIsolStatus V2gRxMsgChgParDscIsolStatus_flg V2gRxMsgChgParDscMaxCrnt V2gRxMsgChgParDscMaxCrnt_flg V2gRxMsgChgParDscMaxPwr V2gRxMsgChgParDscMaxPwr_flg V2gRxMsgChgParDscMaxVolt V2gRxMsgChgParDscMaxVolt_flg V2gRxMsgChgParDscMinCrnt V2gRxMsgChgParDscMinCrnt_flg V2gRxMsgChgParDscMinVolt V2gRxMsgChgParDscMinVolt_flg V2gRxMsgChgParDscNotif V2gRxMsgChgParDscNotifFlg V2gRxMsgChgParDscNotifMaxDelay V2gRxMsgChgParDscPkRipple V2gRxMsgChgParDscPkRipple_flg V2gRxMsgChgParDscRescode /end LOC_MEASUREMENT
/end FUNCTION
/begin FUNCTION Arbit_V2gRxMsg_V2gRxMsgChgParD0 "Group /ByModelHeirarchy/LaforgeTestApp_CCU/Core0-TestApp/V2G/OE_CCS/Arbitration/Arbit_V2gRxMsg_V2gRxMsgChgParDsc" /begin SUB_FUNCTION PayloadArbitration8 /end SUB_FUNCTION /begin LOC_MEASUREMENT V2gRxMsgChgParDscTrg /end LOC_MEASUREMENT /end FUNCTION
/end MODULE
/end PROJECT
