ASAP2_VERSION 1 31
/begin PROJECT LaForge_CCU_TestApp "Test Application for LaForge TC367"
/begin HEADER "Dana" VERSION "0_3_1" /end HEADER
/begin MODULE OpenECU_TC367_001 ""
/* Scalar measurable for DDE 'mpl_bspi_task.timing.overruns'. */
/begin MEASUREMENT mpl_bspi_task.timing.overruns ": bspi_task" UBYTE CU_MPL_BSPI_TASK.TIMING.OVERRU0 1 100 0.0 255.0 ECU_ADDRESS 0x70017280 BYTE_ORDER MSB_LAST /end MEASUREMENT
/begin COMPU_METHOD CU_MPL_BSPI_TASK.TIMING.OVERRU0 "Conversion method for mpl_bspi_task.timing.overruns" RAT_FUNC "%10.0" "count" COEFFS 0.000000 1.000000 -0.000000 0.000000 0.000000 1.000000 /end COMPU_METHOD
/* Scalar measurable for DDE 'mpl_bspi_task.timing.runs'. */
/begin MEASUREMENT mpl_bspi_task.timing.runs ": bspi_task" ULONG CU_MPL_BSPI_TASK.TIMING.RUNS 1 100 0.0 4294967295.0 ECU_ADDRESS 0x7001727c BYTE_ORDER MSB_LAST /end MEASUREMENT
/begin COMPU_METHOD CU_MPL_BSPI_TASK.TIMING.RUNS "Conversion method for mpl_bspi_task.timing.runs" RAT_FUNC "%10.0" "count" COEFFS 0.000000 1.000000 -0.000000 0.000000 0.000000 1.000000 /end COMPU_METHOD
/* Scalar measurable for DDE 'mpl_bspi_task.timing.task_time'. */
/begin MEASUREMENT mpl_bspi_task.timing.task_time "Duration of task: bspi_task" ULONG CU_MPL_BSPI_TASK.TIMING.TASK_T0 1 100 0.0 42949672.0 ECU_ADDRESS 0x7001ca4c BYTE_ORDER MSB_LAST /end MEASUREMENT
/begin COMPU_METHOD CU_MPL_BSPI_TASK.TIMING.TASK_T0 "Conversion method for mpl_bspi_task.timing.task_time" RAT_FUNC "%10.0" "microseconds" COEFFS 0.000000 100.000000 -0.000000 0.000000 0.000000 1.000000 /end COMPU_METHOD
/* Scalar measurable for DDE 'mpl_cpu_loaded_1000ms_c0'. */
/begin MEASUREMENT mpl_cpu_loaded_1000ms_c0 "CPU0 loading each second" UBYTE CU_MPL_CPU_LOADED_1000MS_C0 1 100 0.0 255.0 ECU_ADDRESS 0x70013c4d BYTE_ORDER MSB_LAST /end MEASUREMENT
/begin COMPU_METHOD CU_MPL_CPU_LOADED_1000MS_C0 "Conversion method for mpl_cpu_loaded_1000ms_c0" RAT_FUNC "%10.0" "%" COEFFS 0.000000 1.000000 -0.000000 0.000000 0.000000 1.000000 /end COMPU_METHOD
/* Scalar measurable for DDE 'mpl_cpu_loaded_1000ms_c1'. */
/begin MEASUREMENT mpl_cpu_loaded_1000ms_c1 "CPU1 loading each second" UBYTE CU_MPL_CPU_LOADED_1000MS_C1 1 100 0.0 255.0 ECU_ADDRESS 0x70013c4f BYTE_ORDER MSB_LAST /end MEASUREMENT
/begin COMPU_METHOD CU_MPL_CPU_LOADED_1000MS_C1 "Conversion method for mpl_cpu_loaded_1000ms_c1" RAT_FUNC "%10.0" "%" COEFFS 0.000000 1.000000 -0.000000 0.000000 0.000000 1.000000 /end COMPU_METHOD
/* Scalar measurable for DDE 'mpl_cpu_loaded_50ms_c0'. */
/begin MEASUREMENT mpl_cpu_loaded_50ms_c0 "CPU0 loading each 50ms" UBYTE CU_MPL_CPU_LOADED_50MS_C0 1 100 0.0 255.0 ECU_ADDRESS 0x70013c4c BYTE_ORDER MSB_LAST /end MEASUREMENT
/begin COMPU_METHOD CU_MPL_CPU_LOADED_50MS_C0 "Conversion method for mpl_cpu_loaded_50ms_c0" RAT_FUNC "%10.0" "%" COEFFS 0.000000 1.000000 -0.000000 0.000000 0.000000 1.000000 /end COMPU_METHOD
/* Scalar measurable for DDE 'mpl_cpu_loaded_50ms_c1'. */
/begin MEASUREMENT mpl_cpu_loaded_50ms_c1 "CPU1 loading each 50ms" UBYTE CU_MPL_CPU_LOADED_50MS_C1 1 100 0.0 255.0 ECU_ADDRESS 0x70013c4e BYTE_ORDER MSB_LAST /end MEASUREMENT
/begin COMPU_METHOD CU_MPL_CPU_LOADED_50MS_C1 "Conversion method for mpl_cpu_loaded_50ms_c1" RAT_FUNC "%10.0" "%" COEFFS 0.000000 1.000000 -0.000000 0.000000 0.000000 1.000000 /end COMPU_METHOD
/* Scalar measurable for DDE 'mpl_cpu_loaded_c0'. */
/begin MEASUREMENT mpl_cpu_loaded_c0 "CPU0 loading each 50ms" UBYTE CU_MPL_CPU_LOADED_C0 1 100 0.0 255.0 ECU_ADDRESS 0x70013c4c BYTE_ORDER MSB_LAST /end MEASUREMENT
/begin COMPU_METHOD CU_MPL_CPU_LOADED_C0 "Conversion method for mpl_cpu_loaded_c0" RAT_FUNC "%10.0" "%" COEFFS 0.000000 1.000000 -0.000000 0.000000 0.000000 1.000000 /end COMPU_METHOD
/* Scalar measurable for DDE 'mpl_cpu_loaded_c1'. */
/begin MEASUREMENT mpl_cpu_loaded_c1 "CPU1 loading each 50ms" UBYTE CU_MPL_CPU_LOADED_C1 1 100 0.0 255.0 ECU_ADDRESS 0x70013c4e BYTE_ORDER MSB_LAST /end MEASUREMENT
/begin COMPU_METHOD CU_MPL_CPU_LOADED_C1 "Conversion method for mpl_cpu_loaded_c1" RAT_FUNC "%10.0" "%" COEFFS 0.000000 1.000000 -0.000000 0.000000 0.000000 1.000000 /end COMPU_METHOD
/* Scalar measurable for DDE 'mpl_ecc_flash_address'. */
/begin MEASUREMENT mpl_ecc_flash_address "Address of last Flash non-correctable ECC error, zero if no error has occurred." ULONG CU_MPL_ECC_FLASH_ADDRESS 1 100 0.0 4294967295.0 ECU_ADDRESS 0x7001db5c BYTE_ORDER MSB_LAST /end MEASUREMENT
/begin COMPU_METHOD CU_MPL_ECC_FLASH_ADDRESS "Conversion method for mpl_ecc_flash_address" RAT_FUNC "%10.0" "addr" COEFFS 0.000000 1.000000 -0.000000 0.000000 0.000000 1.000000 /end COMPU_METHOD
/* Scalar measurable for DDE 'mpl_ecc_ram_address'. */
/begin MEASUREMENT mpl_ecc_ram_address "Address of last RAM non-correctable ECC error, zero if no error has occurred." ULONG CU_MPL_ECC_RAM_ADDRESS 1 100 0.0 4294967295.0 ECU_ADDRESS 0x7001db64 BYTE_ORDER MSB_LAST /end MEASUREMENT
/begin COMPU_METHOD CU_MPL_ECC_RAM_ADDRESS "Conversion method for mpl_ecc_ram_address" RAT_FUNC "%10.0" "addr" COEFFS 0.000000 1.000000 -0.000000 0.000000 0.000000 1.000000 /end COMPU_METHOD
/* Scalar measurable for DDE 'mpl_error_log_detailed[0].err.id'. */
/begin MEASUREMENT mpl_error_log_detailed[0].err.1 "Error code of fault raised" SWORD CU_MPL_ERROR_LOG_DETAILED[0].26 1 100 0.0 32767.0 ECU_ADDRESS 0xf02401e0 BYTE_ORDER MSB_LAST /end MEASUREMENT
/begin COMPU_METHOD CU_MPL_ERROR_LOG_DETAILED[0].26 "Conversion method for mpl_error_log_detailed[0].err.id" TAB_VERB "%12.0" "code" COMPU_TAB_REF CT_MPL_ERROR_LOG_DETAILED[0].26 /end COMPU_METHOD
/begin COMPU_VTAB CT_MPL_ERROR_LOG_DETAILED[0].26 "Conversion method for mpl_error_log_detailed[0].err.id" TAB_VERB 464 0 "PIO_PSY_NO_ERROR" 1 "PIO_TRAP_0_TIN_0_VAF" 2 "PIO_TRAP_0_TIN_1_VAP" 3 "PIO_TRAP_0_TIN_UNKNOWN" 4 "PIO_TRAP_1_TIN_1_PRIV" 5 "PIO_TRAP_1_TIN_2_MPR" 6 "PIO_TRAP_1_TIN_3_MPW" 7 "PIO_TRAP_1_TIN_4_MPX" 8 "PIO_TRAP_1_TIN_5_MPP" 9 "PIO_TRAP_1_TIN_6_MPN" 10 "PIO_TRAP_1_TIN_7_GRWP" 11 "PIO_TRAP_1_TIN_UNKNOWN" 12 "PIO_TRAP_2_TIN_1_IOPC" 13 "PIO_TRAP_2_TIN_2_UOPC" 14 "PIO_TRAP_2_TIN_3_OPD" 15 "PIO_TRAP_2_TIN_4_ALN" 16 "PIO_TRAP_2_TIN_5_MEM" 17 "PIO_TRAP_2_TIN_UNKNOWN" 18 "PIO_TRAP_3_TIN_1_FCD" 19 "PIO_TRAP_3_TIN_2_FCD" 20 "PIO_TRAP_3_TIN_3_CDU" 21 "PIO_TRAP_3_TIN_4_FCU" 22 "PIO_TRAP_3_TIN_5_CSU" 23 "PIO_TRAP_3_TIN_6_CTYP" 24 "PIO_TRAP_3_TIN_7_NEST" 25 "PIO_TRAP_3_TIN_UNKNOWN" 26 "PIO_TRAP_4_TIN_1_PSE" 27 "PIO_TRAP_4_TIN_2_DSE" 28 "PIO_TRAP_4_TIN_3_DAE" 29 "PIO_TRAP_4_TIN_4_CAE" 30 "PIO_TRAP_4_TIN_4_CAE_UNEXPECTED" 31 "PIO_TRAP_4_TIN_4_CAE_UNEXPECTED_FW" 32 "PIO_TRAP_4_TIN_5_PIE" 33 "PIO_TRAP_4_TIN_6_DIE" 34 "PIO_TRAP_4_TIN_7_DIE" 35 "PIO_TRAP_4_TIN_5_6_UNEXPECTED" 36 "PIO_TRAP_4_TIN_UNKNOWN" 37 "PIO_TRAP_5_TIN_1_OVF" 38 "PIO_TRAP_5_TIN_2_SOVF" 39 "PIO_TRAP_5_TIN_UNKNOWN" 40 "PIO_TRAP_6_SYS_UNKNOWN" 41 "PIO_TRAP_7_TIN_0_NMI" 42 "PIO_TRAP_7_TIN_UNKNOWN" 43 "PIO_ISR_0_RESET" 44 "PIO_BSPI_FIRST" 45 "PIO_BSPI_TRANSFER_TIMEOUT" 46 "PIO_BSPI_TX_DMA_ERROR" 47 "PIO_BSPI_RX_DMA_ERROR" 48 "PIO_BSPI_DSPI_ERROR" 49 "PIO_BSPI_RX_FIFO_OVERFLOW" 50 "PIO_BSPI_TX_FIFO_UNDERFLOW" 51 "PIO_BSPI_TRANSFER_TERMINATED" 52 "PIO_BSPI_TRANSAC_FAILED" 53 "PIO_BSPI_INTERNAL_SOFTWARE_ERROR" 54 "PIO_BSPI_ISR_MINIMUM_DELAY_TIME_NOT_MET" 55 "PIO_BSPI_ISR_FALSE_INT" 56 "PIO_BSPI_DMA_SAFETY_ERROR" 57 "PIO_BSPI_LAST" 58 "PIO_P1WR_ISR_MINIMUM_DELAY_TIME_NOT_MET" 59 "PIO_PADC_BUFFER_INIT_FAILED" 60 "PIO_PAX_ADC_INPUT_INVALID_ARG" 61 "PIO_PAX_CHANNEL_INVALID" 62 "PIO_PAX_ADC_INPUT_CHANNEL_UNSUPPORTED" 63 "PIO_PAX_CC_OUTPUT_CHANNEL_UNSUPPORTED" 64 "PIO_PAX_AOT_OUTPUT_CHANNEL_UNSUPPORTED" 65 "PIO_PAX_ISR_MINIMUM_DELAY_TIME_NOT_MET" 66 "PIO_PCANOPEN_RESET" 67 "PIO_PCANOPEN_BUFFER_OUT_OF_RANGE" 68 "PIO_PCANOPEN_NULL_POINTER" 69 "PIO_PCCP_RESET" 70 "PIO_PCCU6_ISR_MINIMUM_DELAY_TIME_NOT_MET" 71 "PIO_PCFG_INTERNAL_SW_ERROR" 72 "PIO_PCX_ERR_BUS_ID_OUT_OF_RANGE" 73 "PIO_PCX_ERR_DATA_LENGTH_OUT_OF_RANGE" 74 "PIO_PCX_ERR_STD_ID_OUT_OF_RANGE" 75 "PIO_PCX_ERR_EXT_ID_OUT_OF_RANGE" 76 "PIO_PCX_ERR_SAME_TX_MSG_DIFFERING_ATTRIBS" 77 "PIO_PCX_ERR_TOO_MANY_TX_MSGS" 78 "PIO_PCX_ERR_DUPLICATE_RX_MSG" 79 "PIO_PCX_ERR_TOO_MANY_RX_MSGS" 80 "PIO_PCX_ERR_BIT_RATE_IN_CONFIG_DIFFERS" 81 "PIO_PCX_ERR_UNSUPPORTED_BIT_RATE" 82 "PIO_PCX_ERR_BUS_ID_IN_CONFIG" 83 "PIO_PCX_ERR_NO_BITRATE_TABLE_MATCH" 84 "PIO_PCX_ERR_PACK_MSG_INVALID_PARAM" 85 "PIO_PCX_ERR_PACK_MSG_FIELD_PARAM" 86 "PIO_PCX_ERR_UNPACK_MSG_INVALID_PARAM" 87 "PIO_PCX_ERR_UNPACK_MSG_FIELD_PARAM" 88 "PIO_PCX_ERR_PACK_VDB_MSG_INVALID_PARAM" 89 "PIO_PCX_ERR_UNPACK_VDB_MSG_INVALID_PARAM" 90 "PIO_PCX_ERR_SWITCHED_RATE_FOR_NONFD_BUS" 91 "PIO_PCX_ERR_RX_MSG_FOR_UNCONFIG_BUS_0" 92 "PIO_PCX_ERR_UNSUPPORTED_BUS_MODE" 93 "PIO_PCX_ERR_BUS_MODE_IN_CONFIG_DIFFERS" 94 "PIO_PCX_ERR_SAME_RX_MSG_DIFFERING_ATTRIBS" 95 "PIO_PCX_ERR_TX_MSG_FOR_UNCONFIG_BUS_0" 96 "PIO_PCX_ISR_MINIMUM_DELAY_TIME_NOT_MET" 97 "PIO_PDD_CHANNEL_INVALID" 98 "PIO_PDD_DIG_DATA_IN_CHANNEL_UNSUPPORTED" 99 "PIO_PDD_DIG_DATA_OUT_CHANNEL_UNSUPPORTED" 100 "PIO_PDG_ERR_FORCED_RESET" 101 "PIO_PDTC_UPDATE_INVALID_ARG" 102 "PIO_PDTC_CLEAR_ALL_INVALID_ARG" 103 "PIO_PDTC_CLEAR_ALL_IF_ACT_INVALID_ARG" 104 "PIO_PDTC_CLEAR_ALL_IF_INACT_INVALID_ARG" 105 "PIO_PDTC_GET_DTC_STATUS_INVALID_ARG" 106 "PIO_PDTC_MATCH_EXISTS_INVALID_ARG" 107 "PIO_PDTC_CLEAR_DTCS_INVALID_ARG" 108 "PIO_PDTC_BAD_LICENSE" 109 "PIO_PDX_DO_CHANNEL_UNSUPPORTED" 110 "PIO_PDX_DIG_IN_CHANNEL_UNSUPPORTED" 111 "PIO_PDX_FREQ_IN_CHANNEL_UNSUPPORTED" 112 "PIO_PDX_PERIOD_IN_CHANNEL_UNSUPPORTED" 113 "PIO_PDX_QDEC_FREQ_IN_INVALID_ARG" 114 "PIO_PDX_QDEC_FREQ_IN_CHANNEL_UNSUPPORTED" 115 "PIO_PDX_TPU_QFI_CHANNEL_DEVICE_ERROR" 116 "PIO_PDX_QDEC_IN_CHANNEL_UNSUPPORTED" 117 "PIO_PDX_TPU_QI_CHANNEL_DEVICE_ERROR" 118 "PIO_PDX_PWM_OUT_CHANNEL_UNSUPPORTED" 119 "PIO_PDX_PWM_IN_CHANNEL_UNSUPPORTED" 120 "PIO_PDX_CHANNEL_INVALID" 121 "PIO_PDX_HBRIDGE_INVALID_MODE" 122 "PIO_PDX_HBRIDGE_DECODE_ERROR" 123 "PIO_PDX_HBRIDGE_CHANNEL_GROUP_UNSUPPORTED" 124 "PIO_PEM_EXTERNAL_RAM_REQUIRED" 125 "PIO_PEM_MEM_CONFIG_UNKNOWN" 126 "PIO_PETH_ERR_DRIVER_INITIALIZATION_ERROR" 127 "PIO_PETH_ERR_NULL_CONFIGURATION_POINTER" 128 "PIO_PETH_ERR_DATA_LENGTH_OUT_OF_RANGE" 129 "PIO_PETH_ERR_TOO_MANY_TX_MSGS" 130 "PIO_PETH_ERR_NOT_SUPPORTED" 131 "PIO_PFF_HOLDING_ARRAY_INDEX_INVALID" 132 "PIO_PFF_HOLDING_ARRAY_STRT_END_INVALID" 133 "PIO_PFF_HOLDING_ARRAY_REC_DATA_INVALID" 134 "PIO_PFF_STORED_FF_DTC_INVALID" 135 "PIO_PFF_STORED_DTC_READ_FAILURE" 136 "PIO_PFF_CAPTURE_PID_DATA_FAILURE" 137 "PIO_PFF_STARTUP_FFNO_ERROR" 138 "PIO_PFF_NVM_ALLOCATION_EXCEEDED" 139 "PIO_PFS_ECC_ERROR_DURING_FLASH_OP" 140 "PIO_PFS_RUNTIME_CORRUPT_FILE_FOUND" 141 "PIO_PKN_ERR_KERNEL_STARTED_BELOW_KERNEL_LEVEL" 142 "PIO_PKN_ERR_INVALID_RESOURCE_HANDLE" 143 "PIO_PKN_ERR_TASK_NOT_DECLARED_AS_ACQUIRING_RESOURCE" 144 "PIO_PKN_ERR_INVALID_TASK_HANDLE" 145 "PIO_PKN_ERR_INVALID_PERIODIC_TASK_HANDLE" 146 "PIO_PKN_ERR_UNEXPECTED_EXCEPTION" 147 "PIO_PKN_ERR_TASK_RESOURCE_CORE_DIFFER" 148 "PIO_PKN_ERR_TASK_RELEASE_RESOURCE_FAIL" 149 "PIO_PKN_ERR_ACQUIRING_RESOURCE_PRIORITY_CHANGE_FAIL" 150 "PIO_PKN_ERR_RELEASING_RESOURCE_PRIORITY_CHANGE_FAIL" 151 "PIO_PKN_ERR_TASK_RELEASE_RESOURCE_NEVER_ACQ" 152 "PIO_PKN_ERR_CLEAR_RESOURCE_SET_TASK_PRIO" 153 "PIO_PKN_ERR_ACQUIRING_RESOURCE_ALREADY_ACQUIRED" 154 "PIO_PJ1939_INVALID_CHANNEL" 155 "PIO_PJ1939_PG_TRANSMIT_RING_DEQUEUE_FAIL" 156 "PIO_PJ1939_DM6_TRANSMIT_INVALID_ARG" 157 "PIO_PJ1939_DM12_TRANSMIT_INVALID_ARG" 158 "PIO_PJ1939_DM14_DECODE_INVALID_ARG" 159 "PIO_PJ1939_DM15_TRANSMIT_INVALID_ARG" 160 "PIO_PJ1939_DM16_DECODE_INVALID_ARG" 161 "PIO_PJ1939_DM23_TRANSMIT_INVALID_ARG" 162 "PIO_PJ1939_DM27_TRANSMIT_INVALID_ARG" 163 "PIO_PJ1939_DM28_TRANSMIT_INVALID_ARG" 164 "PIO_PJ1939_DM29_TRANSMIT_INVALID_ARG" 165 "PIO_PJ1939_DM31_TRANSMIT_INVALID_ARG" 166 "PIO_PJ1939_DM41_TRANSMIT_INVALID_ARG" 167 "PIO_PJ1939_DM42_TRANSMIT_INVALID_ARG" 168 "PIO_PJ1939_DM43_TRANSMIT_INVALID_ARG" 169 "PIO_PJ1939_DM44_TRANSMIT_INVALID_ARG" 170 "PIO_PJ1939_DM45_TRANSMIT_INVALID_ARG" 171 "PIO_PJ1939_DM46_TRANSMIT_INVALID_ARG" 172 "PIO_PJ1939_DM47_TRANSMIT_INVALID_ARG" 173 "PIO_PJ1939_DM48_TRANSMIT_INVALID_ARG" 174 "PIO_PJ1939_DM49_TRANSMIT_INVALID_ARG" 175 "PIO_PJ1939_DM50_TRANSMIT_INVALID_ARG" 176 "PIO_PJ1939_DM51_TRANSMIT_INVALID_ARG" 177 "PIO_PJ1939_DM52_TRANSMIT_INVALID_ARG" 178 "PIO_PJ1939_INVALID_RING_BUFFER_ARG" 179 "PIO_PJ1939_DM1_RECEIVE_INVALID_ARG" 180 "PIO_PJ1939_DM2_RECEIVE_INVALID_ARG" 181 "PIO_PMCAL_ADC_INIT_CHECK_ERROR" 182 "PIO_PSAF_ERROR_STANDBY_INIT" 183 "PIO_PSAF_ISR_MINIMUM_DELAY_TIME_NOT_MET" 184 "PIO_PSAF_ERROR_CLOCK_PLAUSIBILITY" 185 "PIO_PSC_DECODE_RESET_INVALID_ARG" 186 "PIO_PSC_ERR_FORCED_RESET" 187 "PIO_PSC_ERR_STANDY_ENTRY" 188 "PIO_PSC_ERR_VERSION_INVALID_PARAM" 189 "PIO_PSC_ERR_BUILD_DATE_INVALID_PARAM" 190 "PIO_PSC_ERR_PART_NUMBER_INVALID_PARAM" 191 "PIO_PSC_UNEXPECTED_CVN_CHANGE" 192 "PIO_PSC_ERR_HW_VERSION_UNKNOWN" 193 "PIO_PSENT_IN_CHANNEL_UNSUPPORTED" 194 "PIO_PSMC_INVALID_DATA" 195 "PIO_PSMC_INTERNAL_SW_ERROR" 196 "PIO_PSTP_SAFETPACK_INIT_FAILURE" 197 "PIO_PSTP_SMU_MODE_INVALID_DURING_INIT" 198 "PIO_PSTP_SMU_MODE_RUN_DURING_INIT" 199 "PIO_PSTP_SMU_FAIL_INIT" 200 "PIO_PSTP_SMU_FAIL_ALARM_CONFIG" 201 "PIO_PSTP_SMU_SW_ALARM_GROUP_0" 202 "PIO_PSTP_SMU_SW_ALARM_GROUP_1" 203 "PIO_PSTP_SMU_SW_ALARM_GROUP_2" 204 "PIO_PSTP_SMU_SW_ALARM_GROUP_3" 205 "PIO_PSTP_SMU_SW_ALARM_GROUP_4" 206 "PIO_PSTP_SMU_SW_ALARM_GROUP_5" 207 "PIO_PSTP_SMU_SW_ALARM_GROUP_6" 208 "PIO_PSTP_SMU_SW_ALARM_GROUP_7" 209 "PIO_PSTP_SMU_SW_ALARM_GROUP_8" 210 "PIO_PSTP_SMU_SW_ALARM_GROUP_9" 211 "PIO_PSTP_SMU_SW_ALARM_GROUP_10" 212 "PIO_PSTP_SMU_SW_ALARM_GROUP_11" 213 "PIO_PSTP_SMU_SW_ALARM_GROUP_12" 214 "PIO_PSTP_SMU_SW_ALARM_GROUP_13" 215 "PIO_PSTP_SMU_SW_ALARM_GROUP_14" 216 "PIO_PSTP_SMU_SW_ALARM_GROUP_15" 217 "PIO_PSTP_SWDGM_UNEXPECTED" 218 "PIO_PSTP_SWDGM_INIT_FAIL" 219 "PIO_PSTP_SWDGM_ACTIVATE_FAIL" 220 "PIO_PSTP_SWDGM_DEINIT_FAIL" 221 "PIO_PSTP_SWDGM_GETERRCNTR_FAIL" 222 "PIO_PSTP_SWDGM_GETINFO_FAIL" 223 "PIO_PSTP_SWDGM_GETSEED_FAIL" 224 "PIO_PSTP_SWDGM_USERREQ_FAIL" 225 "PIO_PSTP_SWDGM_SERVICE_FAIL" 226 "PIO_PSTP_TSTM_STARTUP_TEST_FAIL" 227 "PIO_PSTP_TSTM_RUNTIME_TEST_FAIL" 228 "PIO_PSTP_TSTM_INIT_FAIL" 229 "PIO_PSTP_TSTM_SWITCH_TO_RUN_FAIL" 230 "PIO_PSTP_TLF_TEST_FAIL" 231 "PIO_PSTP_TLF_MAXJOBS_FAIL" 232 "PIO_PSTP_SEID_INCORRECT" 233 "PIO_PSTP_CHECKPOINT_INCORRECT" 234 "PIO_PSTP_ERR_TASK_BUDGET_OVRRUN" 235 "PIO_PSTP_HTXTESTHND_INVALID_RESULT" 236 "PIO_PSTP_HTXTESTHND_TEST_NOT_EXECUTED" 237 "PIO_PSTP_HTXLBIST_CALLER_ADDR_ERR" 238 "PIO_PSTP_HTXLBIST_PORST_ERR" 239 "PIO_PSTP_HTXLBIST_TERMINATION_ERR" 240 "PIO_PSTP_HTXLBIST_DEFAULT_SIGNATURE_ERR" 241 "PIO_PSTP_HTXLBIST_CRC_ERR" 242 "PIO_PSTP_HTXLBIST_UNDEFINED_ERR" 243 "PIO_PSTP_HTXLBIST_INV_PARAM_ERR" 244 "PIO_PSTP_HTXSFRTST_CMP_INV_PARAM_ERR" 245 "PIO_PSTP_HTXSFRTST_CMP_OVERLOAD" 246 "PIO_PSTP_HTXSFRTST_CMP_VAL_ERR" 247 "PIO_PSTP_HTXSFRTST_CRC_INV_PARAM_ERR" 248 "PIO_PSTP_HTXSFRTST_CRC_DATAMISMATCH" 249 "PIO_PSTP_HTXREGMON_SMU_TIMEOUT" 250 "PIO_PSTP_HTXREGMON_ERR_UNDEFINED" 251 "PIO_PSTP_HTXREGMON_ERR_MTU_TIMEOUT_UND" 252 "PIO_PSTP_HTXREGMON_INV_PARAM_ERR" 253 "PIO_PSTP_HTXREGMON_ERR_MTU_FAILED" 254 "PIO_PSTP_HTXMONBIST_ERR_SMU_FLAG" 255 "PIO_PSTP_HTXMONBIST_ERR_PMS_FLAG" 256 "PIO_PSTP_HTXMONBIST_ERR_PMS_SMU_FLAG" 257 "PIO_PSTP_HTXMONBIST_ERR_TIMEOUT" 258 "PIO_PSTP_HTXMONBIST_ERR_UNSPECIFIED" 259 "PIO_PSTP_HTXMONBIST_ERR_SFR_CONFIG" 260 "PIO_PSTP_HTXDTSRESULT_A_FAILED_ERR_DIFF" 261 "PIO_PSTP_HTXDTSRESULT_B_FAILED_ERR_DIFF" 262 "PIO_PSTP_HTXSMUALIVEALARM_ERR_ALM_STS" 263 "PIO_PSTP_HTXSMUALIVEALARM_ERR_TRIG" 264 "PIO_PSTP_HTXSMUALIVEALARM_PREV_ALM_STS" 265 "PIO_PSTP_HTXSMUALIVEALARM_ERR_SMU_RUN" 266 "PIO_PSTP_HTXVMTMBIST_ERR_MTU_UNDEFINED" 267 "PIO_PSTP_HTXVMTMBIST_ERR_MTU_TIMEOUT_UND" 268 "PIO_PSTP_HTXVMTMBIST_INV_PARAM_ERR" 269 "PIO_PSTP_HTXFWCHECK_FAILED" 270 "PIO_PSTP_HTXFWCHECK_INV_PARAM_ERR" 271 "PIO_PSTP_HTXFWCHECK_RST_UNKNOWN" 272 "PIO_PSTP_HTXFWCHECK_SFR_NOT_CLEARED" 273 "PIO_PSTP_HTXFWCHECK_DATA_ERR" 274 "PIO_PSTP_HTXPFM_UNEXPECTED_ERROR" 275 "PIO_PSTP_HTXPFM_RAM_CORRUPTION" 276 "PIO_PSTP_HTXPFM_ILLEGAL_FUNCTION_ARGUMENT" 277 "PIO_PSTP_HTXPFM_SYSTEM_TIMER_READ_FAULT" 278 "PIO_PSTP_HTXPFM_ILLEGAL_REINIT" 279 "PIO_PSTP_HTXPFM_UNEXPECTED_SEID" 280 "PIO_PSTP_HTXPFM_LOGICAL_FAULT_DETECTED" 281 "PIO_PSTP_HTXPFM_DEADLINE_FAULT_DETECTED" 282 "PIO_PSTP_HTXPFM_TIMING_FAULT_DETECTED" 283 "PIO_PSTP_HTXPFM_ALIVENESS_FAULT_DETECTED" 284 "PIO_PSY_ERR_SMU_ASSERT" 285 "PIO_PTM_TIMER_ERROR" 286 "PIO_PUT_DEBOUNCE_BY_CYCLES_INVALID_ARG" 287 "PIO_PUT_LEAKY_BUCKET_INVALID_ARG" 288 "PIO_PUT_DEBOUNCE_BY_TIME_INVALID_ARG" 289 "PIO_PUT_DUTYCYCLE_PROCESSING_INVALID_ARG" 290 "PIO_PUT_STATE_PROCESSING_INVALID_ARG" 291 "PIO_PUT_ARRAY_SEARCH_INVALID_ARG" 292 "PIO_PUT_ERR_PACK_INVALID_PARAM" 293 "PIO_PUT_ERR_UNPACK_INVALID_PARAM" 294 "PIO_PXCP_RESET" 295 "PIO_PUART_MCAL_INIT_CHECK_ERROR" 296 "PIO_ALARM_0_TYPE_0_CPU" 297 "PIO_ALARM_0_TYPE_1_CPU" 298 "PIO_ALARM_0_TYPE_2_CPU" 299 "PIO_ALARM_0_TYPE_4_MTU" 300 "PIO_ALARM_0_TYPE_5_MTU" 301 "PIO_ALARM_0_TYPE_6_MTU" 302 "PIO_ALARM_0_TYPE_7_MTU" 303 "PIO_ALARM_0_TYPE_8_MTU" 304 "PIO_ALARM_0_TYPE_9_MTU" 305 "PIO_ALARM_0_TYPE_10_MTU" 306 "PIO_ALARM_0_TYPE_11_MTU" 307 "PIO_ALARM_0_TYPE_12_MTU" 308 "PIO_ALARM_0_TYPE_13_MTU" 309 "PIO_ALARM_0_TYPE_14_MTU" 310 "PIO_ALARM_0_TYPE_22_CPU" 311 "PIO_ALARM_0_TYPE_23_CPU" 312 "PIO_ALARM_0_TYPE_24_CPU" 313 "PIO_ALARM_1_TYPE_0_CPU" 314 "PIO_ALARM_1_TYPE_1_CPU" 315 "PIO_ALARM_1_TYPE_2_CPU" 316 "PIO_ALARM_1_TYPE_4_MTU" 317 "PIO_ALARM_1_TYPE_5_MTU" 318 "PIO_ALARM_1_TYPE_6_MTU" 319 "PIO_ALARM_1_TYPE_7_MTU" 320 "PIO_ALARM_1_TYPE_8_MTU" 321 "PIO_ALARM_1_TYPE_9_MTU" 322 "PIO_ALARM_1_TYPE_10_MTU" 323 "PIO_ALARM_1_TYPE_11_MTU" 324 "PIO_ALARM_1_TYPE_12_MTU" 325 "PIO_ALARM_1_TYPE_13_MTU" 326 "PIO_ALARM_1_TYPE_14_MTU" 327 "PIO_ALARM_1_TYPE_22_MTU" 328 "PIO_ALARM_1_TYPE_23_CPU" 329 "PIO_ALARM_1_TYPE_24_CPU" 330 "PIO_ALARM_6_TYPE_0_MTU" 331 "PIO_ALARM_6_TYPE_1_IOM" 332 "PIO_ALARM_6_TYPE_2_IR" 333 "PIO_ALARM_6_TYPE_4_SCU" 334 "PIO_ALARM_6_TYPE_5_PMS" 335 "PIO_ALARM_6_TYPE_6_DMA" 336 "PIO_ALARM_6_TYPE_7_SMU_CORE" 337 "PIO_ALARM_6_TYPE_8_CCU" 338 "PIO_ALARM_6_TYPE_10_GTM" 339 "PIO_ALARM_6_TYPE_11_GTM" 340 "PIO_ALARM_6_TYPE_12_GTM" 341 "PIO_ALARM_6_TYPE_13_ERAY" 342 "PIO_ALARM_6_TYPE_14_ERAY" 343 "PIO_ALARM_6_TYPE_15_SRAM" 344 "PIO_ALARM_6_TYPE_16_CAN" 345 "PIO_ALARM_6_TYPE_17_CAN" 346 "PIO_ALARM_6_TYPE_18_CAN" 347 "PIO_ALARM_6_TYPE_19_MISC" 348 "PIO_ALARM_6_TYPE_20_MISC" 349 "PIO_ALARM_6_TYPE_21_MISC" 350 "PIO_ALARM_6_TYPE_23_CBS" 351 "PIO_ALARM_6_TYPE_24_CCU" 352 "PIO_ALARM_6_TYPE_25_CCU" 353 "PIO_ALARM_7_TYPE_0_DAM0" 354 "PIO_ALARM_7_TYPE_1_LMU" 355 "PIO_ALARM_7_TYPE_2_LMU" 356 "PIO_ALARM_7_TYPE_17_XBAR0" 357 "PIO_ALARM_7_TYPE_20_SPB" 358 "PIO_ALARM_7_TYPE_22_FSI" 359 "PIO_ALARM_7_TYPE_23_FSI" 360 "PIO_ALARM_7_TYPE_24_FSI" 361 "PIO_ALARM_7_TYPE_25_FSI" 362 "PIO_ALARM_7_TYPE_26_FSI" 363 "PIO_ALARM_7_TYPE_27_FSI" 364 "PIO_ALARM_7_TYPE_28_FSI" 365 "PIO_ALARM_7_TYPE_29_FSI" 366 "PIO_ALARM_7_TYPE_30_FSI" 367 "PIO_ALARM_7_TYPE_31_FSI" 368 "PIO_ALARM_8_TYPE_0_SCU" 369 "PIO_ALARM_8_TYPE_1_CCU" 370 "PIO_ALARM_8_TYPE_2_CCU" 371 "PIO_ALARM_8_TYPE_3_SCU" 372 "PIO_ALARM_8_TYPE_4_SCU" 373 "PIO_ALARM_8_TYPE_5_SCU" 374 "PIO_ALARM_8_TYPE_6_SCU" 375 "PIO_ALARM_8_TYPE_7_SCU" 376 "PIO_ALARM_8_TYPE_8_SCU" 377 "PIO_ALARM_8_TYPE_9_SCU" 378 "PIO_ALARM_8_TYPE_10_SCU" 379 "PIO_ALARM_8_TYPE_11_SCU" 380 "PIO_ALARM_8_TYPE_16_SCU" 381 "PIO_ALARM_8_TYPE_17_SCU" 382 "PIO_ALARM_8_TYPE_18_SCU" 383 "PIO_ALARM_8_TYPE_19_SCU" 384 "PIO_ALARM_8_TYPE_20_SCU" 385 "PIO_ALARM_8_TYPE_21_SCU" 386 "PIO_ALARM_8_TYPE_22_IR" 387 "PIO_ALARM_8_TYPE_23_DMA" 388 "PIO_ALARM_8_TYPE_25_IOM" 389 "PIO_ALARM_8_TYPE_26_SCU" 390 "PIO_ALARM_8_TYPE_27_SCU" 391 "PIO_ALARM_8_TYPE_28_SCU" 392 "PIO_ALARM_8_TYPE_29_SCU" 393 "PIO_ALARM_8_TYPE_30_SCU" 394 "PIO_ALARM_8_TYPE_31_SCU" 395 "PIO_ALARM_9_TYPE_0_DTS" 396 "PIO_ALARM_9_TYPE_1_DTS" 397 "PIO_ALARM_9_TYPE_3_PMS" 398 "PIO_ALARM_9_TYPE_5_PMS" 399 "PIO_ALARM_9_TYPE_15_PMS" 400 "PIO_ALARM_9_TYPE_16_PMS" 401 "PIO_ALARM_9_TYPE_17_PMS" 402 "PIO_ALARM_10_TYPE_0_SW" 403 "PIO_ALARM_10_TYPE_1_SW" 404 "PIO_ALARM_10_TYPE_2_SW" 405 "PIO_ALARM_10_TYPE_3_SW" 406 "PIO_ALARM_10_TYPE_4_SW" 407 "PIO_ALARM_10_TYPE_5_SW" 408 "PIO_ALARM_10_TYPE_6_SW" 409 "PIO_ALARM_10_TYPE_7_SW" 410 "PIO_ALARM_10_TYPE_8_SW" 411 "PIO_ALARM_10_TYPE_9_SW" 412 "PIO_ALARM_10_TYPE_10_SW" 413 "PIO_ALARM_10_TYPE_11_SW" 414 "PIO_ALARM_10_TYPE_12_SW" 415 "PIO_ALARM_10_TYPE_13_SW" 416 "PIO_ALARM_10_TYPE_14_SW" 417 "PIO_ALARM_10_TYPE_15_SW" 418 "PIO_ALARM_10_TYPE_16_SMU_CORE" 419 "PIO_ALARM_10_TYPE_17_SMU_CORE" 420 "PIO_ALARM_10_TYPE_18_FSP" 421 "PIO_ALARM_10_TYPE_20_CCU" 422 "PIO_ALARM_10_TYPE_21_SFF" 423 "PIO_ALARM_10_TYPE_22_SFF" 424 "PIO_ALARM_11_TYPE_2_XBAR" 425 "PIO_ALARM_11_TYPE_3_XBAR" 426 "PIO_ALARM_11_TYPE_4_DMU" 427 "PIO_ALARM_11_TYPE_5_DMU" 428 "PIO_ALARM_11_TYPE_9_SFIBRIDGE1" 429 "PIO_ALARM_11_TYPE_10_HSSL" 430 "PIO_ALARM_11_TYPE_12_CONVERTER" 431 "PIO_ALARM_11_TYPE_13_XBAR" 432 "PIO_ALARM_20_TYPE_4_EVR" 433 "PIO_ALARM_20_TYPE_5_EVR" 434 "PIO_ALARM_20_TYPE_6_EVR" 435 "PIO_ALARM_20_TYPE_7_EVR" 436 "PIO_ALARM_20_TYPE_8_EVR" 437 "PIO_ALARM_20_TYPE_9_EVR" 438 "PIO_ALARM_20_TYPE_10_EVR" 439 "PIO_ALARM_20_TYPE_11_EVR" 440 "PIO_ALARM_20_TYPE_12_EVR" 441 "PIO_ALARM_20_TYPE_13_EVR" 442 "PIO_ALARM_20_TYPE_14_EVR" 443 "PIO_ALARM_20_TYPE_15_EVR" 444 "PIO_ALARM_21_TYPE_0_HSM" 445 "PIO_ALARM_21_TYPE_1_HSM" 446 "PIO_ALARM_21_TYPE_2_HSM" 447 "PIO_ALARM_21_TYPE_3_HSM" 448 "PIO_ALARM_21_TYPE_4_HSM" 449 "PIO_ALARM_21_TYPE_5_HSM" 450 "PIO_ALARM_21_TYPE_7_SMU" 451 "PIO_ALARM_21_TYPE_8_PMS" 452 "PIO_ALARM_21_TYPE_9_PMS" 453 "PIO_ALARM_21_TYPE_10_PMS" 454 "PIO_ALARM_21_TYPE_11_PMS" 455 "PIO_ALARM_21_TYPE_12_PMS" 456 "PIO_ALARM_21_TYPE_13_PMS" 457 "PIO_ALARM_21_TYPE_14_PMS" 458 "PIO_ALARM_21_TYPE_15_CCU" 459 "PIO_ALARM_21_TYPE_16_SMU_CORE" 460 "PIO_ALARM_MULTIPLE" 461 "PIO_ALARM_RESERVED" 462 "PIO_ALARM_UNEXPECTED" 463 "PIO_ERROR_ID_LAST" /end COMPU_VTAB
/* Scalar measurable for DDE 'mpl_error_log_detailed[0].err.mode'. */
/begin MEASUREMENT mpl_error_log_detailed[0].err.0 "Mode of the software when fault raised" SBYTE CU_MPL_ERROR_LOG_DETAILED[0].08 1 100 0.0 127.0 ECU_ADDRESS 0xf02401e2 BYTE_ORDER MSB_LAST /end MEASUREMENT
/begin COMPU_METHOD CU_MPL_ERROR_LOG_DETAILED[0].08 "Conversion method for mpl_error_log_detailed[0].err.mode" TAB_VERB "%12.0" "code" COMPU_TAB_REF CT_MPL_ERROR_LOG_DETAILED[0].08 /end COMPU_METHOD
/begin COMPU_VTAB CT_MPL_ERROR_LOG_DETAILED[0].08 "Conversion method for mpl_error_log_detailed[0].err.mode" TAB_VERB 4 0 "PIO_EXEC_MODE_UNKNOWN" 1 "PIO_EXEC_MODE_PRG" 2 "PIO_EXEC_MODE_APP" 3 "PIO_EXEC_MODE_LAST" /end COMPU_VTAB
/* Scalar measurable for DDE 'mpl_error_log_detailed[0].err.reaction'. */
/begin MEASUREMENT mpl_error_log_detailed[0].err.2 "Reaction to the fault raised" SBYTE CU_MPL_ERROR_LOG_DETAILED[0].56 1 100 0.0 127.0 ECU_ADDRESS 0xf02401e3 BYTE_ORDER MSB_LAST /end MEASUREMENT
/begin COMPU_METHOD CU_MPL_ERROR_LOG_DETAILED[0].56 "Conversion method for mpl_error_log_detailed[0].err.reaction" TAB_VERB "%12.0" "code" COMPU_TAB_REF CT_MPL_ERROR_LOG_DETAILED[0].56 /end COMPU_METHOD
/begin COMPU_VTAB CT_MPL_ERROR_LOG_DETAILED[0].56 "Conversion method for mpl_error_log_detailed[0].err.reaction" TAB_VERB 6 0 "PIO_CONTINUE" 1 "PIO_RESET" 2 "PIO_RECORD_AND_CONTINUE" 3 "PIO_RECORD_AND_RESET" 4 "PIO_RESET_AND_RECORD" 5 "PIO_FAULT_REACTION_LAST" /end COMPU_VTAB
/* Scalar measurable for DDE 'mpl_error_log_detailed[0].err_log.cpu_log.biv'. */
/begin MEASUREMENT mpl_error_log_detailed[0].err74 "CPU base address of interrupt vector table register" ULONG CU_MPL_ERROR_LOG_DETAILED[0].77 1 100 0.0 4294967295.0 ECU_ADDRESS 0xf02403a4 BYTE_ORDER MSB_LAST /end MEASUREMENT
/begin COMPU_METHOD CU_MPL_ERROR_LOG_DETAILED[0].77 "Conversion method for mpl_error_log_detailed[0].err_log.cpu_log.biv" RAT_FUNC "%10.0" "(not defined)" COEFFS 0.000000 1.000000 -0.000000 0.000000 0.000000 1.000000 /end COMPU_METHOD
/* Scalar measurable for DDE 'mpl_error_log_detailed[0].err_log.cpu_log.btv'. */
/begin MEASUREMENT mpl_error_log_detailed[0].err70 "CPU base address of trap vector table register" ULONG CU_MPL_ERROR_LOG_DETAILED[0].73 1 100 0.0 4294967295.0 ECU_ADDRESS 0xf02403a8 BYTE_ORDER MSB_LAST /end MEASUREMENT
/begin COMPU_METHOD CU_MPL_ERROR_LOG_DETAILED[0].73 "Conversion method for mpl_error_log_detailed[0].err_log.cpu_log.btv" RAT_FUNC "%10.0" "(not defined)" COEFFS 0.000000 1.000000 -0.000000 0.000000 0.000000 1.000000 /end COMPU_METHOD
/* Scalar measurable for DDE 'mpl_error_log_detailed[0].err_log.cpu_log.cpr_low[0]'. */
/begin MEASUREMENT mpl_error_log_detailed[0].err76 "CPU/MPU code segment protection register, lower" ULONG CU_MPL_ERROR_LOG_DETAILED[0].79 1 100 0.0 4294967295.0 ECU_ADDRESS 0xf02402f8 BYTE_ORDER MSB_LAST /end MEASUREMENT
/begin COMPU_METHOD CU_MPL_ERROR_LOG_DETAILED[0].79 "Conversion method for mpl_error_log_detailed[0].err_log.cpu_log.cpr_low[0]" RAT_FUNC "%10.0" "(not defined)" COEFFS 0.000000 1.000000 -0.000000 0.000000 0.000000 1.000000 /end COMPU_METHOD
/* Scalar measurable for DDE 'mpl_error_log_detailed[0].err_log.cpu_log.cpr_low[1]'. */
/begin MEASUREMENT mpl_error_log_detailed[0].err43 "CPU/MPU code segment protection register, lower" ULONG CU_MPL_ERROR_LOG_DETAILED[0].45 1 100 0.0 4294967295.0 ECU_ADDRESS 0xf02402fc BYTE_ORDER MSB_LAST /end MEASUREMENT
/begin COMPU_METHOD CU_MPL_ERROR_LOG_DETAILED[0].45 "Conversion method for mpl_error_log_detailed[0].err_log.cpu_log.cpr_low[1]" RAT_FUNC "%10.0" "(not defined)" COEFFS 0.000000 1.000000 -0.000000 0.000000 0.000000 1.000000 /end COMPU_METHOD
/* Scalar measurable for DDE 'mpl_error_log_detailed[0].err_log.cpu_log.cpr_low[2]'. */
/begin MEASUREMENT mpl_error_log_detailed[0].er045 "CPU/MPU code segment protection register, lower" ULONG CU_MPL_ERROR_LOG_DETAILED[0]048 1 100 0.0 4294967295.0 ECU_ADDRESS 0xf0240300 BYTE_ORDER MSB_LAST /end MEASUREMENT
/begin COMPU_METHOD CU_MPL_ERROR_LOG_DETAILED[0]048 "Conversion method for mpl_error_log_detailed[0].err_log.cpu_log.cpr_low[2]" RAT_FUNC "%10.0" "(not defined)" COEFFS 0.000000 1.000000 -0.000000 0.000000 0.000000 1.000000 /end COMPU_METHOD
/* Scalar measurable for DDE 'mpl_error_log_detailed[0].err_log.cpu_log.cpr_low[3]'. */
/begin MEASUREMENT mpl_error_log_detailed[0].err21 "CPU/MPU code segment protection register, lower" ULONG CU_MPL_ERROR_LOG_DETAILED[0].22 1 100 0.0 4294967295.0 ECU_ADDRESS 0xf0240304 BYTE_ORDER MSB_LAST /end MEASUREMENT
/begin COMPU_METHOD CU_MPL_ERROR_LOG_DETAILED[0].22 "Conversion method for mpl_error_log_detailed[0].err_log.cpu_log.cpr_low[3]" RAT_FUNC "%10.0" "(not defined)" COEFFS 0.000000 1.000000 -0.000000 0.000000 0.000000 1.000000 /end COMPU_METHOD
/* Scalar measurable for DDE 'mpl_error_log_detailed[0].err_log.cpu_log.cpr_low[4]'. */
/begin MEASUREMENT mpl_error_log_detailed[0].err75 "CPU/MPU code segment protection register, lower" ULONG CU_MPL_ERROR_LOG_DETAILED[0].78 1 100 0.0 4294967295.0 ECU_ADDRESS 0xf0240308 BYTE_ORDER MSB_LAST /end MEASUREMENT
/begin COMPU_METHOD CU_MPL_ERROR_LOG_DETAILED[0].78 "Conversion method for mpl_error_log_detailed[0].err_log.cpu_log.cpr_low[4]" RAT_FUNC "%10.0" "(not defined)" COEFFS 0.000000 1.000000 -0.000000 0.000000 0.000000 1.000000 /end COMPU_METHOD
/* Scalar measurable for DDE 'mpl_error_log_detailed[0].err_log.cpu_log.cpr_low[5]'. */
/begin MEASUREMENT mpl_error_log_detailed[0].err78 "CPU/MPU code segment protection register, lower" ULONG CU_MPL_ERROR_LOG_DETAILED[0].81 1 100 0.0 4294967295.0 ECU_ADDRESS 0xf024030c BYTE_ORDER MSB_LAST /end MEASUREMENT
/begin COMPU_METHOD CU_MPL_ERROR_LOG_DETAILED[0].81 "Conversion method for mpl_error_log_detailed[0].err_log.cpu_log.cpr_low[5]" RAT_FUNC "%10.0" "(not defined)" COEFFS 0.000000 1.000000 -0.000000 0.000000 0.000000 1.000000 /end COMPU_METHOD
/* Scalar measurable for DDE 'mpl_error_log_detailed[0].err_log.cpu_log.cpr_low[6]'. */
/begin MEASUREMENT mpl_error_log_detailed[0].err_5 "CPU/MPU code segment protection register, lower" ULONG CU_MPL_ERROR_LOG_DETAILED[0].E5 1 100 0.0 4294967295.0 ECU_ADDRESS 0xf0240310 BYTE_ORDER MSB_LAST /end MEASUREMENT
/begin COMPU_METHOD CU_MPL_ERROR_LOG_DETAILED[0].E5 "Conversion method for mpl_error_log_detailed[0].err_log.cpu_log.cpr_low[6]" RAT_FUNC "%10.0" "(not defined)" COEFFS 0.000000 1.000000 -0.000000 0.000000 0.000000 1.000000 /end COMPU_METHOD
/* Scalar measurable for DDE 'mpl_error_log_detailed[0].err_log.cpu_log.cpr_low[7]'. */
/begin MEASUREMENT mpl_error_log_detailed[0].er023 "CPU/MPU code segment protection register, lower" ULONG CU_MPL_ERROR_LOG_DETAILED[0]026 1 100 0.0 4294967295.0 ECU_ADDRESS 0xf0240314 BYTE_ORDER MSB_LAST /end MEASUREMENT
/begin COMPU_METHOD CU_MPL_ERROR_LOG_DETAILED[0]026 "Conversion method for mpl_error_log_detailed[0].err_log.cpu_log.cpr_low[7]" RAT_FUNC "%10.0" "(not defined)" COEFFS 0.000000 1.000000 -0.000000 0.000000 0.000000 1.000000 /end COMPU_METHOD
/* Scalar measurable for DDE 'mpl_error_log_detailed[0].err_log.cpu_log.cpr_low[8]'. */
/begin MEASUREMENT mpl_error_log_detailed[0].er009 "CPU/MPU code segment protection register, lower" ULONG CU_MPL_ERROR_LOG_DETAILED[0]012 1 100 0.0 4294967295.0 ECU_ADDRESS 0xf0240318 BYTE_ORDER MSB_LAST /end MEASUREMENT
/begin COMPU_METHOD CU_MPL_ERROR_LOG_DETAILED[0]012 "Conversion method for mpl_error_log_detailed[0].err_log.cpu_log.cpr_low[8]" RAT_FUNC "%10.0" "(not defined)" COEFFS 0.000000 1.000000 -0.000000 0.000000 0.000000 1.000000 /end COMPU_METHOD
/* Scalar measurable for DDE 'mpl_error_log_detailed[0].err_log.cpu_log.cpr_low[9]'. */
/begin MEASUREMENT mpl_error_log_detailed[0].er024 "CPU/MPU code segment protection register, lower" ULONG CU_MPL_ERROR_LOG_DETAILED[0]027 1 100 0.0 4294967295.0 ECU_ADDRESS 0xf024031c BYTE_ORDER MSB_LAST /end MEASUREMENT
/begin COMPU_METHOD CU_MPL_ERROR_LOG_DETAILED[0]027 "Conversion method for mpl_error_log_detailed[0].err_log.cpu_log.cpr_low[9]" RAT_FUNC "%10.0" "(not defined)" COEFFS 0.000000 1.000000 -0.000000 0.000000 0.000000 1.000000 /end COMPU_METHOD
/* Scalar measurable for DDE 'mpl_error_log_detailed[0].err_log.cpu_log.cpr_upr[0]'. */
/begin MEASUREMENT mpl_error_log_detailed[0].err42 "CPU/MPU code segment protection register, upper" ULONG CU_MPL_ERROR_LOG_DETAILED[0].44 1 100 0.0 4294967295.0 ECU_ADDRESS 0xf0240320 BYTE_ORDER MSB_LAST /end MEASUREMENT
/begin COMPU_METHOD CU_MPL_ERROR_LOG_DETAILED[0].44 "Conversion method for mpl_error_log_detailed[0].err_log.cpu_log.cpr_upr[0]" RAT_FUNC "%10.0" "(not defined)" COEFFS 0.000000 1.000000 -0.000000 0.000000 0.000000 1.000000 /end COMPU_METHOD
/* Scalar measurable for DDE 'mpl_error_log_detailed[0].err_log.cpu_log.cpr_upr[1]'. */
/begin MEASUREMENT mpl_error_log_detailed[0].err28 "CPU/MPU code segment protection register, upper" ULONG CU_MPL_ERROR_LOG_DETAILED[0].30 1 100 0.0 4294967295.0 ECU_ADDRESS 0xf0240324 BYTE_ORDER MSB_LAST /end MEASUREMENT
/begin COMPU_METHOD CU_MPL_ERROR_LOG_DETAILED[0].30 "Conversion method for mpl_error_log_detailed[0].err_log.cpu_log.cpr_upr[1]" RAT_FUNC "%10.0" "(not defined)" COEFFS 0.000000 1.000000 -0.000000 0.000000 0.000000 1.000000 /end COMPU_METHOD
/* Scalar measurable for DDE 'mpl_error_log_detailed[0].err_log.cpu_log.cpr_upr[2]'. */
/begin MEASUREMENT mpl_error_log_detailed[0].err60 "CPU/MPU code segment protection register, upper" ULONG CU_MPL_ERROR_LOG_DETAILED[0].63 1 100 0.0 4294967295.0 ECU_ADDRESS 0xf0240328 BYTE_ORDER MSB_LAST /end MEASUREMENT
/begin COMPU_METHOD CU_MPL_ERROR_LOG_DETAILED[0].63 "Conversion method for mpl_error_log_detailed[0].err_log.cpu_log.cpr_upr[2]" RAT_FUNC "%10.0" "(not defined)" COEFFS 0.000000 1.000000 -0.000000 0.000000 0.000000 1.000000 /end COMPU_METHOD
/* Scalar measurable for DDE 'mpl_error_log_detailed[0].err_log.cpu_log.cpr_upr[3]'. */
/begin MEASUREMENT mpl_error_log_detailed[0].err32 "CPU/MPU code segment protection register, upper" ULONG CU_MPL_ERROR_LOG_DETAILED[0].34 1 100 0.0 4294967295.0 ECU_ADDRESS 0xf024032c BYTE_ORDER MSB_LAST /end MEASUREMENT
/begin COMPU_METHOD CU_MPL_ERROR_LOG_DETAILED[0].34 "Conversion method for mpl_error_log_detailed[0].err_log.cpu_log.cpr_upr[3]" RAT_FUNC "%10.0" "(not defined)" COEFFS 0.000000 1.000000 -0.000000 0.000000 0.000000 1.000000 /end COMPU_METHOD
/* Scalar measurable for DDE 'mpl_error_log_detailed[0].err_log.cpu_log.cpr_upr[4]'. */
/begin MEASUREMENT mpl_error_log_detailed[0].err_7 "CPU/MPU code segment protection register, upper" ULONG CU_MPL_ERROR_LOG_DETAILED[0].E7 1 100 0.0 4294967295.0 ECU_ADDRESS 0xf0240330 BYTE_ORDER MSB_LAST /end MEASUREMENT
/begin COMPU_METHOD CU_MPL_ERROR_LOG_DETAILED[0].E7 "Conversion method for mpl_error_log_detailed[0].err_log.cpu_log.cpr_upr[4]" RAT_FUNC "%10.0" "(not defined)" COEFFS 0.000000 1.000000 -0.000000 0.000000 0.000000 1.000000 /end COMPU_METHOD
/* Scalar measurable for DDE 'mpl_error_log_detailed[0].err_log.cpu_log.cpr_upr[5]'. */
/begin MEASUREMENT mpl_error_log_detailed[0].err27 "CPU/MPU code segment protection register, upper" ULONG CU_MPL_ERROR_LOG_DETAILED[0].29 1 100 0.0 4294967295.0 ECU_ADDRESS 0xf0240334 BYTE_ORDER MSB_LAST /end MEASUREMENT
/begin COMPU_METHOD CU_MPL_ERROR_LOG_DETAILED[0].29 "Conversion method for mpl_error_log_detailed[0].err_log.cpu_log.cpr_upr[5]" RAT_FUNC "%10.0" "(not defined)" COEFFS 0.000000 1.000000 -0.000000 0.000000 0.000000 1.000000 /end COMPU_METHOD
/* Scalar measurable for DDE 'mpl_error_log_detailed[0].err_log.cpu_log.cpr_upr[6]'. */
/begin MEASUREMENT mpl_error_log_detailed[0].err23 "CPU/MPU code segment protection register, upper" ULONG CU_MPL_ERROR_LOG_DETAILED[0].24 1 100 0.0 4294967295.0 ECU_ADDRESS 0xf0240338 BYTE_ORDER MSB_LAST /end MEASUREMENT
/begin COMPU_METHOD CU_MPL_ERROR_LOG_DETAILED[0].24 "Conversion method for mpl_error_log_detailed[0].err_log.cpu_log.cpr_upr[6]" RAT_FUNC "%10.0" "(not defined)" COEFFS 0.000000 1.000000 -0.000000 0.000000 0.000000 1.000000 /end COMPU_METHOD
/* Scalar measurable for DDE 'mpl_error_log_detailed[0].err_log.cpu_log.cpr_upr[7]'. */
/begin MEASUREMENT mpl_error_log_detailed[0].err06 "CPU/MPU code segment protection register, upper" ULONG CU_MPL_ERROR_LOG_DETAILED[0].06 1 100 0.0 4294967295.0 ECU_ADDRESS 0xf024033c BYTE_ORDER MSB_LAST /end MEASUREMENT
/begin COMPU_METHOD CU_MPL_ERROR_LOG_DETAILED[0].06 "Conversion method for mpl_error_log_detailed[0].err_log.cpu_log.cpr_upr[7]" RAT_FUNC "%10.0" "(not defined)" COEFFS 0.000000 1.000000 -0.000000 0.000000 0.000000 1.000000 /end COMPU_METHOD
/* Scalar measurable for DDE 'mpl_error_log_detailed[0].err_log.cpu_log.cpr_upr[8]'. */
/begin MEASUREMENT mpl_error_log_detailed[0].er039 "CPU/MPU code segment protection register, upper" ULONG CU_MPL_ERROR_LOG_DETAILED[0]042 1 100 0.0 4294967295.0 ECU_ADDRESS 0xf0240340 BYTE_ORDER MSB_LAST /end MEASUREMENT
/begin COMPU_METHOD CU_MPL_ERROR_LOG_DETAILED[0]042 "Conversion method for mpl_error_log_detailed[0].err_log.cpu_log.cpr_upr[8]" RAT_FUNC "%10.0" "(not defined)" COEFFS 0.000000 1.000000 -0.000000 0.000000 0.000000 1.000000 /end COMPU_METHOD
/* Scalar measurable for DDE 'mpl_error_log_detailed[0].err_log.cpu_log.cpr_upr[9]'. */
/begin MEASUREMENT mpl_error_log_detailed[0].er026 "CPU/MPU code segment protection register, upper" ULONG CU_MPL_ERROR_LOG_DETAILED[0]029 1 100 0.0 4294967295.0 ECU_ADDRESS 0xf0240344 BYTE_ORDER MSB_LAST /end MEASUREMENT
/begin COMPU_METHOD CU_MPL_ERROR_LOG_DETAILED[0]029 "Conversion method for mpl_error_log_detailed[0].err_log.cpu_log.cpr_upr[9]" RAT_FUNC "%10.0" "(not defined)" COEFFS 0.000000 1.000000 -0.000000 0.000000 0.000000 1.000000 /end COMPU_METHOD
/* Scalar measurable for DDE 'mpl_error_log_detailed[0].err_log.cpu_log.cpxe[0]'. */
/begin MEASUREMENT mpl_error_log_detailed[0].er008 "CPU/MPU code protection execution enable configuration register" ULONG CU_MPL_ERROR_LOG_DETAILED[0]011 1 100 0.0 4294967295.0 ECU_ADDRESS 0xf0240348 BYTE_ORDER MSB_LAST /end MEASUREMENT
/begin COMPU_METHOD CU_MPL_ERROR_LOG_DETAILED[0]011 "Conversion method for mpl_error_log_detailed[0].err_log.cpu_log.cpxe[0]" RAT_FUNC "%10.0" "(not defined)" COEFFS 0.000000 1.000000 -0.000000 0.000000 0.000000 1.000000 /end COMPU_METHOD
/* Scalar measurable for DDE 'mpl_error_log_detailed[0].err_log.cpu_log.cpxe[1]'. */
/begin MEASUREMENT mpl_error_log_detailed[0].err54 "CPU/MPU code protection execution enable configuration register" ULONG CU_MPL_ERROR_LOG_DETAILED[0].57 1 100 0.0 4294967295.0 ECU_ADDRESS 0xf024034c BYTE_ORDER MSB_LAST /end MEASUREMENT
/begin COMPU_METHOD CU_MPL_ERROR_LOG_DETAILED[0].57 "Conversion method for mpl_error_log_detailed[0].err_log.cpu_log.cpxe[1]" RAT_FUNC "%10.0" "(not defined)" COEFFS 0.000000 1.000000 -0.000000 0.000000 0.000000 1.000000 /end COMPU_METHOD
/* Scalar measurable for DDE 'mpl_error_log_detailed[0].err_log.cpu_log.cpxe[2]'. */
/begin MEASUREMENT mpl_error_log_detailed[0].er030 "CPU/MPU code protection execution enable configuration register" ULONG CU_MPL_ERROR_LOG_DETAILED[0]033 1 100 0.0 4294967295.0 ECU_ADDRESS 0xf0240350 BYTE_ORDER MSB_LAST /end MEASUREMENT
/begin COMPU_METHOD CU_MPL_ERROR_LOG_DETAILED[0]033 "Conversion method for mpl_error_log_detailed[0].err_log.cpu_log.cpxe[2]" RAT_FUNC "%10.0" "(not defined)" COEFFS 0.000000 1.000000 -0.000000 0.000000 0.000000 1.000000 /end COMPU_METHOD
/* Scalar measurable for DDE 'mpl_error_log_detailed[0].err_log.cpu_log.cpxe[3]'. */
/begin MEASUREMENT mpl_error_log_detailed[0].er042 "CPU/MPU code protection execution enable configuration register" ULONG CU_MPL_ERROR_LOG_DETAILED[0]045 1 100 0.0 4294967295.0 ECU_ADDRESS 0xf0240354 BYTE_ORDER MSB_LAST /end MEASUREMENT
/begin COMPU_METHOD CU_MPL_ERROR_LOG_DETAILED[0]045 "Conversion method for mpl_error_log_detailed[0].err_log.cpu_log.cpxe[3]" RAT_FUNC "%10.0" "(not defined)" COEFFS 0.000000 1.000000 -0.000000 0.000000 0.000000 1.000000 /end COMPU_METHOD
/* Scalar measurable for DDE 'mpl_error_log_detailed[0].err_log.cpu_log.cpxe[4]'. */
/begin MEASUREMENT mpl_error_log_detailed[0].err37 "CPU/MPU code protection execution enable configuration register" ULONG CU_MPL_ERROR_LOG_DETAILED[0].39 1 100 0.0 4294967295.0 ECU_ADDRESS 0xf0240358 BYTE_ORDER MSB_LAST /end MEASUREMENT
/begin COMPU_METHOD CU_MPL_ERROR_LOG_DETAILED[0].39 "Conversion method for mpl_error_log_detailed[0].err_log.cpu_log.cpxe[4]" RAT_FUNC "%10.0" "(not defined)" COEFFS 0.000000 1.000000 -0.000000 0.000000 0.000000 1.000000 /end COMPU_METHOD
/* Scalar measurable for DDE 'mpl_error_log_detailed[0].err_log.cpu_log.cpxe[5]'. */
/begin MEASUREMENT mpl_error_log_detailed[0].err62 "CPU/MPU code protection execution enable configuration register" ULONG CU_MPL_ERROR_LOG_DETAILED[0].65 1 100 0.0 4294967295.0 ECU_ADDRESS 0xf024035c BYTE_ORDER MSB_LAST /end MEASUREMENT
/begin COMPU_METHOD CU_MPL_ERROR_LOG_DETAILED[0].65 "Conversion method for mpl_error_log_detailed[0].err_log.cpu_log.cpxe[5]" RAT_FUNC "%10.0" "(not defined)" COEFFS 0.000000 1.000000 -0.000000 0.000000 0.000000 1.000000 /end COMPU_METHOD
/* Scalar measurable for DDE 'mpl_error_log_detailed[0].err_log.cpu_log.datr'. */
/begin MEASUREMENT mpl_error_log_detailed[0].err35 "CPU data asynchronous error trap register" ULONG CU_MPL_ERROR_LOG_DETAILED[0].37 1 100 0.0 4294967295.0 ECU_ADDRESS 0xf024022c BYTE_ORDER MSB_LAST /end MEASUREMENT
/begin COMPU_METHOD CU_MPL_ERROR_LOG_DETAILED[0].37 "Conversion method for mpl_error_log_detailed[0].err_log.cpu_log.datr" RAT_FUNC "%10.0" "(not defined)" COEFFS 0.000000 1.000000 -0.000000 0.000000 0.000000 1.000000 /end COMPU_METHOD
/* Scalar measurable for DDE 'mpl_error_log_detailed[0].err_log.cpu_log.deadd'. */
/begin MEASUREMENT mpl_error_log_detailed[0].err96 "CPU data error address register" ULONG CU_MPL_ERROR_LOG_DETAILED[0].99 1 100 0.0 4294967295.0 ECU_ADDRESS 0xf0240230 BYTE_ORDER MSB_LAST /end MEASUREMENT
/begin COMPU_METHOD CU_MPL_ERROR_LOG_DETAILED[0].99 "Conversion method for mpl_error_log_detailed[0].err_log.cpu_log.deadd" RAT_FUNC "%10.0" "(not defined)" COEFFS 0.000000 1.000000 -0.000000 0.000000 0.000000 1.000000 /end COMPU_METHOD
/* Scalar measurable for DDE 'mpl_error_log_detailed[0].err_log.cpu_log.diear'. */
/begin MEASUREMENT mpl_error_log_detailed[0].er040 "CPU data integrity error address register" ULONG CU_MPL_ERROR_LOG_DETAILED[0]043 1 100 0.0 4294967295.0 ECU_ADDRESS 0xf0240234 BYTE_ORDER MSB_LAST /end MEASUREMENT
/begin COMPU_METHOD CU_MPL_ERROR_LOG_DETAILED[0]043 "Conversion method for mpl_error_log_detailed[0].err_log.cpu_log.diear" RAT_FUNC "%10.0" "(not defined)" COEFFS 0.000000 1.000000 -0.000000 0.000000 0.000000 1.000000 /end COMPU_METHOD
/* Scalar measurable for DDE 'mpl_error_log_detailed[0].err_log.cpu_log.dietr'. */
/begin MEASUREMENT mpl_error_log_detailed[0].err14 "CPU data integrity error trap register" ULONG CU_MPL_ERROR_LOG_DETAILED[0].15 1 100 0.0 4294967295.0 ECU_ADDRESS 0xf0240238 BYTE_ORDER MSB_LAST /end MEASUREMENT
/begin COMPU_METHOD CU_MPL_ERROR_LOG_DETAILED[0].15 "Conversion method for mpl_error_log_detailed[0].err_log.cpu_log.dietr" RAT_FUNC "%10.0" "(not defined)" COEFFS 0.000000 1.000000 -0.000000 0.000000 0.000000 1.000000 /end COMPU_METHOD
/* Scalar measurable for DDE 'mpl_error_log_detailed[0].err_log.cpu_log.dpr_low[0]'. */
/begin MEASUREMENT mpl_error_log_detailed[0].er037 "CPU/MPU data segment protection register, lower" ULONG CU_MPL_ERROR_LOG_DETAILED[0]040 1 100 0.0 4294967295.0 ECU_ADDRESS 0xf0240268 BYTE_ORDER MSB_LAST /end MEASUREMENT
/begin COMPU_METHOD CU_MPL_ERROR_LOG_DETAILED[0]040 "Conversion method for mpl_error_log_detailed[0].err_log.cpu_log.dpr_low[0]" RAT_FUNC "%10.0" "(not defined)" COEFFS 0.000000 1.000000 -0.000000 0.000000 0.000000 1.000000 /end COMPU_METHOD
/* Scalar measurable for DDE 'mpl_error_log_detailed[0].err_log.cpu_log.dpr_low[10]'. */
/begin MEASUREMENT mpl_error_log_detailed[0].err08 "CPU/MPU data segment protection register, lower" ULONG CU_MPL_ERROR_LOG_DETAILED[0].09 1 100 0.0 4294967295.0 ECU_ADDRESS 0xf0240290 BYTE_ORDER MSB_LAST /end MEASUREMENT
/begin COMPU_METHOD CU_MPL_ERROR_LOG_DETAILED[0].09 "Conversion method for mpl_error_log_detailed[0].err_log.cpu_log.dpr_low[10]" RAT_FUNC "%10.0" "(not defined)" COEFFS 0.000000 1.000000 -0.000000 0.000000 0.000000 1.000000 /end COMPU_METHOD
/* Scalar measurable for DDE 'mpl_error_log_detailed[0].err_log.cpu_log.dpr_low[11]'. */
/begin MEASUREMENT mpl_error_log_detailed[0].err25 "CPU/MPU data segment protection register, lower" ULONG CU_MPL_ERROR_LOG_DETAILED[0].27 1 100 0.0 4294967295.0 ECU_ADDRESS 0xf0240294 BYTE_ORDER MSB_LAST /end MEASUREMENT
/begin COMPU_METHOD CU_MPL_ERROR_LOG_DETAILED[0].27 "Conversion method for mpl_error_log_detailed[0].err_log.cpu_log.dpr_low[11]" RAT_FUNC "%10.0" "(not defined)" COEFFS 0.000000 1.000000 -0.000000 0.000000 0.000000 1.000000 /end COMPU_METHOD
/* Scalar measurable for DDE 'mpl_error_log_detailed[0].err_log.cpu_log.dpr_low[12]'. */
/begin MEASUREMENT mpl_error_log_detailed[0].er032 "CPU/MPU data segment protection register, lower" ULONG CU_MPL_ERROR_LOG_DETAILED[0]035 1 100 0.0 4294967295.0 ECU_ADDRESS 0xf0240298 BYTE_ORDER MSB_LAST /end MEASUREMENT
/begin COMPU_METHOD CU_MPL_ERROR_LOG_DETAILED[0]035 "Conversion method for mpl_error_log_detailed[0].err_log.cpu_log.dpr_low[12]" RAT_FUNC "%10.0" "(not defined)" COEFFS 0.000000 1.000000 -0.000000 0.000000 0.000000 1.000000 /end COMPU_METHOD
/* Scalar measurable for DDE 'mpl_error_log_detailed[0].err_log.cpu_log.dpr_low[13]'. */
/begin MEASUREMENT mpl_error_log_detailed[0].err01 "CPU/MPU data segment protection register, lower" ULONG CU_MPL_ERROR_LOG_DETAILED[0].01 1 100 0.0 4294967295.0 ECU_ADDRESS 0xf024029c BYTE_ORDER MSB_LAST /end MEASUREMENT
/begin COMPU_METHOD CU_MPL_ERROR_LOG_DETAILED[0].01 "Conversion method for mpl_error_log_detailed[0].err_log.cpu_log.dpr_low[13]" RAT_FUNC "%10.0" "(not defined)" COEFFS 0.000000 1.000000 -0.000000 0.000000 0.000000 1.000000 /end COMPU_METHOD
/* Scalar measurable for DDE 'mpl_error_log_detailed[0].err_log.cpu_log.dpr_low[14]'. */
/begin MEASUREMENT mpl_error_log_detailed[0].err_4 "CPU/MPU data segment protection register, lower" ULONG CU_MPL_ERROR_LOG_DETAILED[0].E4 1 100 0.0 4294967295.0 ECU_ADDRESS 0xf02402a0 BYTE_ORDER MSB_LAST /end MEASUREMENT
/begin COMPU_METHOD CU_MPL_ERROR_LOG_DETAILED[0].E4 "Conversion method for mpl_error_log_detailed[0].err_log.cpu_log.dpr_low[14]" RAT_FUNC "%10.0" "(not defined)" COEFFS 0.000000 1.000000 -0.000000 0.000000 0.000000 1.000000 /end COMPU_METHOD
/* Scalar measurable for DDE 'mpl_error_log_detailed[0].err_log.cpu_log.dpr_low[15]'. */
/begin MEASUREMENT mpl_error_log_detailed[0].er043 "CPU/MPU data segment protection register, lower" ULONG CU_MPL_ERROR_LOG_DETAILED[0]046 1 100 0.0 4294967295.0 ECU_ADDRESS 0xf02402a4 BYTE_ORDER MSB_LAST /end MEASUREMENT
/begin COMPU_METHOD CU_MPL_ERROR_LOG_DETAILED[0]046 "Conversion method for mpl_error_log_detailed[0].err_log.cpu_log.dpr_low[15]" RAT_FUNC "%10.0" "(not defined)" COEFFS 0.000000 1.000000 -0.000000 0.000000 0.000000 1.000000 /end COMPU_METHOD
/* Scalar measurable for DDE 'mpl_error_log_detailed[0].err_log.cpu_log.dpr_low[16]'. */
/begin MEASUREMENT mpl_error_log_detailed[0].er011 "CPU/MPU data segment protection register, lower" ULONG CU_MPL_ERROR_LOG_DETAILED[0]014 1 100 0.0 4294967295.0 ECU_ADDRESS 0xf02402a8 BYTE_ORDER MSB_LAST /end MEASUREMENT
/begin COMPU_METHOD CU_MPL_ERROR_LOG_DETAILED[0]014 "Conversion method for mpl_error_log_detailed[0].err_log.cpu_log.dpr_low[16]" RAT_FUNC "%10.0" "(not defined)" COEFFS 0.000000 1.000000 -0.000000 0.000000 0.000000 1.000000 /end COMPU_METHOD
/* Scalar measurable for DDE 'mpl_error_log_detailed[0].err_log.cpu_log.dpr_low[17]'. */
/begin MEASUREMENT mpl_error_log_detailed[0].err18 "CPU/MPU data segment protection register, lower" ULONG CU_MPL_ERROR_LOG_DETAILED[0].19 1 100 0.0 4294967295.0 ECU_ADDRESS 0xf02402ac BYTE_ORDER MSB_LAST /end MEASUREMENT
/begin COMPU_METHOD CU_MPL_ERROR_LOG_DETAILED[0].19 "Conversion method for mpl_error_log_detailed[0].err_log.cpu_log.dpr_low[17]" RAT_FUNC "%10.0" "(not defined)" COEFFS 0.000000 1.000000 -0.000000 0.000000 0.000000 1.000000 /end COMPU_METHOD
/* Scalar measurable for DDE 'mpl_error_log_detailed[0].err_log.cpu_log.dpr_low[1]'. */
/begin MEASUREMENT mpl_error_log_detailed[0].er014 "CPU/MPU data segment protection register, lower" ULONG CU_MPL_ERROR_LOG_DETAILED[0]017 1 100 0.0 4294967295.0 ECU_ADDRESS 0xf024026c BYTE_ORDER MSB_LAST /end MEASUREMENT
/begin COMPU_METHOD CU_MPL_ERROR_LOG_DETAILED[0]017 "Conversion method for mpl_error_log_detailed[0].err_log.cpu_log.dpr_low[1]" RAT_FUNC "%10.0" "(not defined)" COEFFS 0.000000 1.000000 -0.000000 0.000000 0.000000 1.000000 /end COMPU_METHOD
/* Scalar measurable for DDE 'mpl_error_log_detailed[0].err_log.cpu_log.dpr_low[2]'. */
/begin MEASUREMENT mpl_error_log_detailed[0].er015 "CPU/MPU data segment protection register, lower" ULONG CU_MPL_ERROR_LOG_DETAILED[0]018 1 100 0.0 4294967295.0 ECU_ADDRESS 0xf0240270 BYTE_ORDER MSB_LAST /end MEASUREMENT
/begin COMPU_METHOD CU_MPL_ERROR_LOG_DETAILED[0]018 "Conversion method for mpl_error_log_detailed[0].err_log.cpu_log.dpr_low[2]" RAT_FUNC "%10.0" "(not defined)" COEFFS 0.000000 1.000000 -0.000000 0.000000 0.000000 1.000000 /end COMPU_METHOD
/* Scalar measurable for DDE 'mpl_error_log_detailed[0].err_log.cpu_log.dpr_low[3]'. */
/begin MEASUREMENT mpl_error_log_detailed[0].er038 "CPU/MPU data segment protection register, lower" ULONG CU_MPL_ERROR_LOG_DETAILED[0]041 1 100 0.0 4294967295.0 ECU_ADDRESS 0xf0240274 BYTE_ORDER MSB_LAST /end MEASUREMENT
/begin COMPU_METHOD CU_MPL_ERROR_LOG_DETAILED[0]041 "Conversion method for mpl_error_log_detailed[0].err_log.cpu_log.dpr_low[3]" RAT_FUNC "%10.0" "(not defined)" COEFFS 0.000000 1.000000 -0.000000 0.000000 0.000000 1.000000 /end COMPU_METHOD
/* Scalar measurable for DDE 'mpl_error_log_detailed[0].err_log.cpu_log.dpr_low[4]'. */
/begin MEASUREMENT mpl_error_log_detailed[0].er034 "CPU/MPU data segment protection register, lower" ULONG CU_MPL_ERROR_LOG_DETAILED[0]037 1 100 0.0 4294967295.0 ECU_ADDRESS 0xf0240278 BYTE_ORDER MSB_LAST /end MEASUREMENT
/begin COMPU_METHOD CU_MPL_ERROR_LOG_DETAILED[0]037 "Conversion method for mpl_error_log_detailed[0].err_log.cpu_log.dpr_low[4]" RAT_FUNC "%10.0" "(not defined)" COEFFS 0.000000 1.000000 -0.000000 0.000000 0.000000 1.000000 /end COMPU_METHOD
/* Scalar measurable for DDE 'mpl_error_log_detailed[0].err_log.cpu_log.dpr_low[5]'. */
/begin MEASUREMENT mpl_error_log_detailed[0].err02 "CPU/MPU data segment protection register, lower" ULONG CU_MPL_ERROR_LOG_DETAILED[0].02 1 100 0.0 4294967295.0 ECU_ADDRESS 0xf024027c BYTE_ORDER MSB_LAST /end MEASUREMENT
/begin COMPU_METHOD CU_MPL_ERROR_LOG_DETAILED[0].02 "Conversion method for mpl_error_log_detailed[0].err_log.cpu_log.dpr_low[5]" RAT_FUNC "%10.0" "(not defined)" COEFFS 0.000000 1.000000 -0.000000 0.000000 0.000000 1.000000 /end COMPU_METHOD
/* Scalar measurable for DDE 'mpl_error_log_detailed[0].err_log.cpu_log.dpr_low[6]'. */
/begin MEASUREMENT mpl_error_log_detailed[0].err_0 "CPU/MPU data segment protection register, lower" ULONG CU_MPL_ERROR_LOG_DETAILED[0].E0 1 100 0.0 4294967295.0 ECU_ADDRESS 0xf0240280 BYTE_ORDER MSB_LAST /end MEASUREMENT
/begin COMPU_METHOD CU_MPL_ERROR_LOG_DETAILED[0].E0 "Conversion method for mpl_error_log_detailed[0].err_log.cpu_log.dpr_low[6]" RAT_FUNC "%10.0" "(not defined)" COEFFS 0.000000 1.000000 -0.000000 0.000000 0.000000 1.000000 /end COMPU_METHOD
/* Scalar measurable for DDE 'mpl_error_log_detailed[0].err_log.cpu_log.dpr_low[7]'. */
/begin MEASUREMENT mpl_error_log_detailed[0].er044 "CPU/MPU data segment protection register, lower" ULONG CU_MPL_ERROR_LOG_DETAILED[0]047 1 100 0.0 4294967295.0 ECU_ADDRESS 0xf0240284 BYTE_ORDER MSB_LAST /end MEASUREMENT
/begin COMPU_METHOD CU_MPL_ERROR_LOG_DETAILED[0]047 "Conversion method for mpl_error_log_detailed[0].err_log.cpu_log.dpr_low[7]" RAT_FUNC "%10.0" "(not defined)" COEFFS 0.000000 1.000000 -0.000000 0.000000 0.000000 1.000000 /end COMPU_METHOD
/* Scalar measurable for DDE 'mpl_error_log_detailed[0].err_log.cpu_log.dpr_low[8]'. */
/begin MEASUREMENT mpl_error_log_detailed[0].err40 "CPU/MPU data segment protection register, lower" ULONG CU_MPL_ERROR_LOG_DETAILED[0].42 1 100 0.0 4294967295.0 ECU_ADDRESS 0xf0240288 BYTE_ORDER MSB_LAST /end MEASUREMENT
/begin COMPU_METHOD CU_MPL_ERROR_LOG_DETAILED[0].42 "Conversion method for mpl_error_log_detailed[0].err_log.cpu_log.dpr_low[8]" RAT_FUNC "%10.0" "(not defined)" COEFFS 0.000000 1.000000 -0.000000 0.000000 0.000000 1.000000 /end COMPU_METHOD
/* Scalar measurable for DDE 'mpl_error_log_detailed[0].err_log.cpu_log.dpr_low[9]'. */
/begin MEASUREMENT mpl_error_log_detailed[0].err26 "CPU/MPU data segment protection register, lower" ULONG CU_MPL_ERROR_LOG_DETAILED[0].28 1 100 0.0 4294967295.0 ECU_ADDRESS 0xf024028c BYTE_ORDER MSB_LAST /end MEASUREMENT
/begin COMPU_METHOD CU_MPL_ERROR_LOG_DETAILED[0].28 "Conversion method for mpl_error_log_detailed[0].err_log.cpu_log.dpr_low[9]" RAT_FUNC "%10.0" "(not defined)" COEFFS 0.000000 1.000000 -0.000000 0.000000 0.000000 1.000000 /end COMPU_METHOD
/* Scalar measurable for DDE 'mpl_error_log_detailed[0].err_log.cpu_log.dpr_upr[0]'. */
/begin MEASUREMENT mpl_error_log_detailed[0].er036 "CPU/MPU data segment protection register, upper" ULONG CU_MPL_ERROR_LOG_DETAILED[0]039 1 100 0.0 4294967295.0 ECU_ADDRESS 0xf02402b0 BYTE_ORDER MSB_LAST /end MEASUREMENT
/begin COMPU_METHOD CU_MPL_ERROR_LOG_DETAILED[0]039 "Conversion method for mpl_error_log_detailed[0].err_log.cpu_log.dpr_upr[0]" RAT_FUNC "%10.0" "(not defined)" COEFFS 0.000000 1.000000 -0.000000 0.000000 0.000000 1.000000 /end COMPU_METHOD
/* Scalar measurable for DDE 'mpl_error_log_detailed[0].err_log.cpu_log.dpr_upr[10]'. */
/begin MEASUREMENT mpl_error_log_detailed[0].err10 "CPU/MPU data segment protection register, upper" ULONG CU_MPL_ERROR_LOG_DETAILED[0].11 1 100 0.0 4294967295.0 ECU_ADDRESS 0xf02402d8 BYTE_ORDER MSB_LAST /end MEASUREMENT
/begin COMPU_METHOD CU_MPL_ERROR_LOG_DETAILED[0].11 "Conversion method for mpl_error_log_detailed[0].err_log.cpu_log.dpr_upr[10]" RAT_FUNC "%10.0" "(not defined)" COEFFS 0.000000 1.000000 -0.000000 0.000000 0.000000 1.000000 /end COMPU_METHOD
/* Scalar measurable for DDE 'mpl_error_log_detailed[0].err_log.cpu_log.dpr_upr[11]'. */
/begin MEASUREMENT mpl_error_log_detailed[0].err_6 "CPU/MPU data segment protection register, upper" ULONG CU_MPL_ERROR_LOG_DETAILED[0].E6 1 100 0.0 4294967295.0 ECU_ADDRESS 0xf02402dc BYTE_ORDER MSB_LAST /end MEASUREMENT
/begin COMPU_METHOD CU_MPL_ERROR_LOG_DETAILED[0].E6 "Conversion method for mpl_error_log_detailed[0].err_log.cpu_log.dpr_upr[11]" RAT_FUNC "%10.0" "(not defined)" COEFFS 0.000000 1.000000 -0.000000 0.000000 0.000000 1.000000 /end COMPU_METHOD
/* Scalar measurable for DDE 'mpl_error_log_detailed[0].err_log.cpu_log.dpr_upr[12]'. */
/begin MEASUREMENT mpl_error_log_detailed[0].err38 "CPU/MPU data segment protection register, upper" ULONG CU_MPL_ERROR_LOG_DETAILED[0].40 1 100 0.0 4294967295.0 ECU_ADDRESS 0xf02402e0 BYTE_ORDER MSB_LAST /end MEASUREMENT
/begin COMPU_METHOD CU_MPL_ERROR_LOG_DETAILED[0].40 "Conversion method for mpl_error_log_detailed[0].err_log.cpu_log.dpr_upr[12]" RAT_FUNC "%10.0" "(not defined)" COEFFS 0.000000 1.000000 -0.000000 0.000000 0.000000 1.000000 /end COMPU_METHOD
/* Scalar measurable for DDE 'mpl_error_log_detailed[0].err_log.cpu_log.dpr_upr[13]'. */
/begin MEASUREMENT mpl_error_log_detailed[0].err34 "CPU/MPU data segment protection register, upper" ULONG CU_MPL_ERROR_LOG_DETAILED[0].36 1 100 0.0 4294967295.0 ECU_ADDRESS 0xf02402e4 BYTE_ORDER MSB_LAST /end MEASUREMENT
/begin COMPU_METHOD CU_MPL_ERROR_LOG_DETAILED[0].36 "Conversion method for mpl_error_log_detailed[0].err_log.cpu_log.dpr_upr[13]" RAT_FUNC "%10.0" "(not defined)" COEFFS 0.000000 1.000000 -0.000000 0.000000 0.000000 1.000000 /end COMPU_METHOD
/* Scalar measurable for DDE 'mpl_error_log_detailed[0].err_log.cpu_log.dpr_upr[14]'. */
/begin MEASUREMENT mpl_error_log_detailed[0].err_1 "CPU/MPU data segment protection register, upper" ULONG CU_MPL_ERROR_LOG_DETAILED[0].E1 1 100 0.0 4294967295.0 ECU_ADDRESS 0xf02402e8 BYTE_ORDER MSB_LAST /end MEASUREMENT
/begin COMPU_METHOD CU_MPL_ERROR_LOG_DETAILED[0].E1 "Conversion method for mpl_error_log_detailed[0].err_log.cpu_log.dpr_upr[14]" RAT_FUNC "%10.0" "(not defined)" COEFFS 0.000000 1.000000 -0.000000 0.000000 0.000000 1.000000 /end COMPU_METHOD
/* Scalar measurable for DDE 'mpl_error_log_detailed[0].err_log.cpu_log.dpr_upr[15]'. */
/begin MEASUREMENT mpl_error_log_detailed[0].err93 "CPU/MPU data segment protection register, upper" ULONG CU_MPL_ERROR_LOG_DETAILED[0].96 1 100 0.0 4294967295.0 ECU_ADDRESS 0xf02402ec BYTE_ORDER MSB_LAST /end MEASUREMENT
/begin COMPU_METHOD CU_MPL_ERROR_LOG_DETAILED[0].96 "Conversion method for mpl_error_log_detailed[0].err_log.cpu_log.dpr_upr[15]" RAT_FUNC "%10.0" "(not defined)" COEFFS 0.000000 1.000000 -0.000000 0.000000 0.000000 1.000000 /end COMPU_METHOD
/* Scalar measurable for DDE 'mpl_error_log_detailed[0].err_log.cpu_log.dpr_upr[16]'. */
/begin MEASUREMENT mpl_error_log_detailed[0].err87 "CPU/MPU data segment protection register, upper" ULONG CU_MPL_ERROR_LOG_DETAILED[0].90 1 100 0.0 4294967295.0 ECU_ADDRESS 0xf02402f0 BYTE_ORDER MSB_LAST /end MEASUREMENT
/begin COMPU_METHOD CU_MPL_ERROR_LOG_DETAILED[0].90 "Conversion method for mpl_error_log_detailed[0].err_log.cpu_log.dpr_upr[16]" RAT_FUNC "%10.0" "(not defined)" COEFFS 0.000000 1.000000 -0.000000 0.000000 0.000000 1.000000 /end COMPU_METHOD
/* Scalar measurable for DDE 'mpl_error_log_detailed[0].err_log.cpu_log.dpr_upr[17]'. */
/begin MEASUREMENT mpl_error_log_detailed[0].err55 "CPU/MPU data segment protection register, upper" ULONG CU_MPL_ERROR_LOG_DETAILED[0].58 1 100 0.0 4294967295.0 ECU_ADDRESS 0xf02402f4 BYTE_ORDER MSB_LAST /end MEASUREMENT
/begin COMPU_METHOD CU_MPL_ERROR_LOG_DETAILED[0].58 "Conversion method for mpl_error_log_detailed[0].err_log.cpu_log.dpr_upr[17]" RAT_FUNC "%10.0" "(not defined)" COEFFS 0.000000 1.000000 -0.000000 0.000000 0.000000 1.000000 /end COMPU_METHOD
/* Scalar measurable for DDE 'mpl_error_log_detailed[0].err_log.cpu_log.dpr_upr[1]'. */
/begin MEASUREMENT mpl_error_log_detailed[0].er025 "CPU/MPU data segment protection register, upper" ULONG CU_MPL_ERROR_LOG_DETAILED[0]028 1 100 0.0 4294967295.0 ECU_ADDRESS 0xf02402b4 BYTE_ORDER MSB_LAST /end MEASUREMENT
/begin COMPU_METHOD CU_MPL_ERROR_LOG_DETAILED[0]028 "Conversion method for mpl_error_log_detailed[0].err_log.cpu_log.dpr_upr[1]" RAT_FUNC "%10.0" "(not defined)" COEFFS 0.000000 1.000000 -0.000000 0.000000 0.000000 1.000000 /end COMPU_METHOD
/* Scalar measurable for DDE 'mpl_error_log_detailed[0].err_log.cpu_log.dpr_upr[2]'. */
/begin MEASUREMENT mpl_error_log_detailed[0].er013 "CPU/MPU data segment protection register, upper" ULONG CU_MPL_ERROR_LOG_DETAILED[0]016 1 100 0.0 4294967295.0 ECU_ADDRESS 0xf02402b8 BYTE_ORDER MSB_LAST /end MEASUREMENT
/begin COMPU_METHOD CU_MPL_ERROR_LOG_DETAILED[0]016 "Conversion method for mpl_error_log_detailed[0].err_log.cpu_log.dpr_upr[2]" RAT_FUNC "%10.0" "(not defined)" COEFFS 0.000000 1.000000 -0.000000 0.000000 0.000000 1.000000 /end COMPU_METHOD
/* Scalar measurable for DDE 'mpl_error_log_detailed[0].err_log.cpu_log.dpr_upr[3]'. */
/begin MEASUREMENT mpl_error_log_detailed[0].er029 "CPU/MPU data segment protection register, upper" ULONG CU_MPL_ERROR_LOG_DETAILED[0]032 1 100 0.0 4294967295.0 ECU_ADDRESS 0xf02402bc BYTE_ORDER MSB_LAST /end MEASUREMENT
/begin COMPU_METHOD CU_MPL_ERROR_LOG_DETAILED[0]032 "Conversion method for mpl_error_log_detailed[0].err_log.cpu_log.dpr_upr[3]" RAT_FUNC "%10.0" "(not defined)" COEFFS 0.000000 1.000000 -0.000000 0.000000 0.000000 1.000000 /end COMPU_METHOD
/* Scalar measurable for DDE 'mpl_error_log_detailed[0].err_log.cpu_log.dpr_upr[4]'. */
/begin MEASUREMENT mpl_error_log_detailed[0].err16 "CPU/MPU data segment protection register, upper" ULONG CU_MPL_ERROR_LOG_DETAILED[0].17 1 100 0.0 4294967295.0 ECU_ADDRESS 0xf02402c0 BYTE_ORDER MSB_LAST /end MEASUREMENT
/begin COMPU_METHOD CU_MPL_ERROR_LOG_DETAILED[0].17 "Conversion method for mpl_error_log_detailed[0].err_log.cpu_log.dpr_upr[4]" RAT_FUNC "%10.0" "(not defined)" COEFFS 0.000000 1.000000 -0.000000 0.000000 0.000000 1.000000 /end COMPU_METHOD
/* Scalar measurable for DDE 'mpl_error_log_detailed[0].err_log.cpu_log.dpr_upr[5]'. */
/begin MEASUREMENT mpl_error_log_detailed[0].err24 "CPU/MPU data segment protection register, upper" ULONG CU_MPL_ERROR_LOG_DETAILED[0].25 1 100 0.0 4294967295.0 ECU_ADDRESS 0xf02402c4 BYTE_ORDER MSB_LAST /end MEASUREMENT
/begin COMPU_METHOD CU_MPL_ERROR_LOG_DETAILED[0].25 "Conversion method for mpl_error_log_detailed[0].err_log.cpu_log.dpr_upr[5]" RAT_FUNC "%10.0" "(not defined)" COEFFS 0.000000 1.000000 -0.000000 0.000000 0.000000 1.000000 /end COMPU_METHOD
/* Scalar measurable for DDE 'mpl_error_log_detailed[0].err_log.cpu_log.dpr_upr[6]'. */
/begin MEASUREMENT mpl_error_log_detailed[0].er046 "CPU/MPU data segment protection register, upper" ULONG CU_MPL_ERROR_LOG_DETAILED[0]049 1 100 0.0 4294967295.0 ECU_ADDRESS 0xf02402c8 BYTE_ORDER MSB_LAST /end MEASUREMENT
/begin COMPU_METHOD CU_MPL_ERROR_LOG_DETAILED[0]049 "Conversion method for mpl_error_log_detailed[0].err_log.cpu_log.dpr_upr[6]" RAT_FUNC "%10.0" "(not defined)" COEFFS 0.000000 1.000000 -0.000000 0.000000 0.000000 1.000000 /end COMPU_METHOD
/* Scalar measurable for DDE 'mpl_error_log_detailed[0].err_log.cpu_log.dpr_upr[7]'. */
/begin MEASUREMENT mpl_error_log_detailed[0].err_9 "CPU/MPU data segment protection register, upper" ULONG CU_MPL_ERROR_LOG_DETAILED[0].E9 1 100 0.0 4294967295.0 ECU_ADDRESS 0xf02402cc BYTE_ORDER MSB_LAST /end MEASUREMENT
/begin COMPU_METHOD CU_MPL_ERROR_LOG_DETAILED[0].E9 "Conversion method for mpl_error_log_detailed[0].err_log.cpu_log.dpr_upr[7]" RAT_FUNC "%10.0" "(not defined)" COEFFS 0.000000 1.000000 -0.000000 0.000000 0.000000 1.000000 /end COMPU_METHOD
/* Scalar measurable for DDE 'mpl_error_log_detailed[0].err_log.cpu_log.dpr_upr[8]'. */
/begin MEASUREMENT mpl_error_log_detailed[0].err57 "CPU/MPU data segment protection register, upper" ULONG CU_MPL_ERROR_LOG_DETAILED[0].60 1 100 0.0 4294967295.0 ECU_ADDRESS 0xf02402d0 BYTE_ORDER MSB_LAST /end MEASUREMENT
/begin COMPU_METHOD CU_MPL_ERROR_LOG_DETAILED[0].60 "Conversion method for mpl_error_log_detailed[0].err_log.cpu_log.dpr_upr[8]" RAT_FUNC "%10.0" "(not defined)" COEFFS 0.000000 1.000000 -0.000000 0.000000 0.000000 1.000000 /end COMPU_METHOD
/* Scalar measurable for DDE 'mpl_error_log_detailed[0].err_log.cpu_log.dpr_upr[9]'. */
/begin MEASUREMENT mpl_error_log_detailed[0].err63 "CPU/MPU data segment protection register, upper" ULONG CU_MPL_ERROR_LOG_DETAILED[0].66 1 100 0.0 4294967295.0 ECU_ADDRESS 0xf02402d4 BYTE_ORDER MSB_LAST /end MEASUREMENT
/begin COMPU_METHOD CU_MPL_ERROR_LOG_DETAILED[0].66 "Conversion method for mpl_error_log_detailed[0].err_log.cpu_log.dpr_upr[9]" RAT_FUNC "%10.0" "(not defined)" COEFFS 0.000000 1.000000 -0.000000 0.000000 0.000000 1.000000 /end COMPU_METHOD
/* Scalar measurable for DDE 'mpl_error_log_detailed[0].err_log.cpu_log.dpre[0]'. */
/begin MEASUREMENT mpl_error_log_detailed[0].err72 "CPU/MPU data protection read enable configuration register" ULONG CU_MPL_ERROR_LOG_DETAILED[0].75 1 100 0.0 4294967295.0 ECU_ADDRESS 0xf0240360 BYTE_ORDER MSB_LAST /end MEASUREMENT
/begin COMPU_METHOD CU_MPL_ERROR_LOG_DETAILED[0].75 "Conversion method for mpl_error_log_detailed[0].err_log.cpu_log.dpre[0]" RAT_FUNC "%10.0" "(not defined)" COEFFS 0.000000 1.000000 -0.000000 0.000000 0.000000 1.000000 /end COMPU_METHOD
/* Scalar measurable for DDE 'mpl_error_log_detailed[0].err_log.cpu_log.dpre[1]'. */
/begin MEASUREMENT mpl_error_log_detailed[0].err61 "CPU/MPU data protection read enable configuration register" ULONG CU_MPL_ERROR_LOG_DETAILED[0].64 1 100 0.0 4294967295.0 ECU_ADDRESS 0xf0240364 BYTE_ORDER MSB_LAST /end MEASUREMENT
/begin COMPU_METHOD CU_MPL_ERROR_LOG_DETAILED[0].64 "Conversion method for mpl_error_log_detailed[0].err_log.cpu_log.dpre[1]" RAT_FUNC "%10.0" "(not defined)" COEFFS 0.000000 1.000000 -0.000000 0.000000 0.000000 1.000000 /end COMPU_METHOD
/* Scalar measurable for DDE 'mpl_error_log_detailed[0].err_log.cpu_log.dpre[2]'. */
/begin MEASUREMENT mpl_error_log_detailed[0].err52 "CPU/MPU data protection read enable configuration register" ULONG CU_MPL_ERROR_LOG_DETAILED[0].54 1 100 0.0 4294967295.0 ECU_ADDRESS 0xf0240368 BYTE_ORDER MSB_LAST /end MEASUREMENT
/begin COMPU_METHOD CU_MPL_ERROR_LOG_DETAILED[0].54 "Conversion method for mpl_error_log_detailed[0].err_log.cpu_log.dpre[2]" RAT_FUNC "%10.0" "(not defined)" COEFFS 0.000000 1.000000 -0.000000 0.000000 0.000000 1.000000 /end COMPU_METHOD
/* Scalar measurable for DDE 'mpl_error_log_detailed[0].err_log.cpu_log.dpre[3]'. */
/begin MEASUREMENT mpl_error_log_detailed[0].err41 "CPU/MPU data protection read enable configuration register" ULONG CU_MPL_ERROR_LOG_DETAILED[0].43 1 100 0.0 4294967295.0 ECU_ADDRESS 0xf024036c BYTE_ORDER MSB_LAST /end MEASUREMENT
/begin COMPU_METHOD CU_MPL_ERROR_LOG_DETAILED[0].43 "Conversion method for mpl_error_log_detailed[0].err_log.cpu_log.dpre[3]" RAT_FUNC "%10.0" "(not defined)" COEFFS 0.000000 1.000000 -0.000000 0.000000 0.000000 1.000000 /end COMPU_METHOD
/* Scalar measurable for DDE 'mpl_error_log_detailed[0].err_log.cpu_log.dpre[4]'. */
/begin MEASUREMENT mpl_error_log_detailed[0].err49 "CPU/MPU data protection read enable configuration register" ULONG CU_MPL_ERROR_LOG_DETAILED[0].51 1 100 0.0 4294967295.0 ECU_ADDRESS 0xf0240370 BYTE_ORDER MSB_LAST /end MEASUREMENT
/begin COMPU_METHOD CU_MPL_ERROR_LOG_DETAILED[0].51 "Conversion method for mpl_error_log_detailed[0].err_log.cpu_log.dpre[4]" RAT_FUNC "%10.0" "(not defined)" COEFFS 0.000000 1.000000 -0.000000 0.000000 0.000000 1.000000 /end COMPU_METHOD
/* Scalar measurable for DDE 'mpl_error_log_detailed[0].err_log.cpu_log.dpre[5]'. */
/begin MEASUREMENT mpl_error_log_detailed[0].err22 "CPU/MPU data protection read enable configuration register" ULONG CU_MPL_ERROR_LOG_DETAILED[0].23 1 100 0.0 4294967295.0 ECU_ADDRESS 0xf0240374 BYTE_ORDER MSB_LAST /end MEASUREMENT
/begin COMPU_METHOD CU_MPL_ERROR_LOG_DETAILED[0].23 "Conversion method for mpl_error_log_detailed[0].err_log.cpu_log.dpre[5]" RAT_FUNC "%10.0" "(not defined)" COEFFS 0.000000 1.000000 -0.000000 0.000000 0.000000 1.000000 /end COMPU_METHOD
/* Scalar measurable for DDE 'mpl_error_log_detailed[0].err_log.cpu_log.dpwe[0]'. */
/begin MEASUREMENT mpl_error_log_detailed[0].err03 "CPU/MPU data protection write enable configuration register" ULONG CU_MPL_ERROR_LOG_DETAILED[0].03 1 100 0.0 4294967295.0 ECU_ADDRESS 0xf0240378 BYTE_ORDER MSB_LAST /end MEASUREMENT
/begin COMPU_METHOD CU_MPL_ERROR_LOG_DETAILED[0].03 "Conversion method for mpl_error_log_detailed[0].err_log.cpu_log.dpwe[0]" RAT_FUNC "%10.0" "(not defined)" COEFFS 0.000000 1.000000 -0.000000 0.000000 0.000000 1.000000 /end COMPU_METHOD
/* Scalar measurable for DDE 'mpl_error_log_detailed[0].err_log.cpu_log.dpwe[1]'. */
/begin MEASUREMENT mpl_error_log_detailed[0].err95 "CPU/MPU data protection write enable configuration register" ULONG CU_MPL_ERROR_LOG_DETAILED[0].98 1 100 0.0 4294967295.0 ECU_ADDRESS 0xf024037c BYTE_ORDER MSB_LAST /end MEASUREMENT
/begin COMPU_METHOD CU_MPL_ERROR_LOG_DETAILED[0].98 "Conversion method for mpl_error_log_detailed[0].err_log.cpu_log.dpwe[1]" RAT_FUNC "%10.0" "(not defined)" COEFFS 0.000000 1.000000 -0.000000 0.000000 0.000000 1.000000 /end COMPU_METHOD
/* Scalar measurable for DDE 'mpl_error_log_detailed[0].err_log.cpu_log.dpwe[2]'. */
/begin MEASUREMENT mpl_error_log_detailed[0].err82 "CPU/MPU data protection write enable configuration register" ULONG CU_MPL_ERROR_LOG_DETAILED[0].85 1 100 0.0 4294967295.0 ECU_ADDRESS 0xf0240380 BYTE_ORDER MSB_LAST /end MEASUREMENT
/begin COMPU_METHOD CU_MPL_ERROR_LOG_DETAILED[0].85 "Conversion method for mpl_error_log_detailed[0].err_log.cpu_log.dpwe[2]" RAT_FUNC "%10.0" "(not defined)" COEFFS 0.000000 1.000000 -0.000000 0.000000 0.000000 1.000000 /end COMPU_METHOD
/* Scalar measurable for DDE 'mpl_error_log_detailed[0].err_log.cpu_log.dpwe[3]'. */
/begin MEASUREMENT mpl_error_log_detailed[0].err56 "CPU/MPU data protection write enable configuration register" ULONG CU_MPL_ERROR_LOG_DETAILED[0].59 1 100 0.0 4294967295.0 ECU_ADDRESS 0xf0240384 BYTE_ORDER MSB_LAST /end MEASUREMENT
/begin COMPU_METHOD CU_MPL_ERROR_LOG_DETAILED[0].59 "Conversion method for mpl_error_log_detailed[0].err_log.cpu_log.dpwe[3]" RAT_FUNC "%10.0" "(not defined)" COEFFS 0.000000 1.000000 -0.000000 0.000000 0.000000 1.000000 /end COMPU_METHOD
/* Scalar measurable for DDE 'mpl_error_log_detailed[0].err_log.cpu_log.dpwe[4]'. */
/begin MEASUREMENT mpl_error_log_detailed[0].err84 "CPU/MPU data protection write enable configuration register" ULONG CU_MPL_ERROR_LOG_DETAILED[0].87 1 100 0.0 4294967295.0 ECU_ADDRESS 0xf0240388 BYTE_ORDER MSB_LAST /end MEASUREMENT
/begin COMPU_METHOD CU_MPL_ERROR_LOG_DETAILED[0].87 "Conversion method for mpl_error_log_detailed[0].err_log.cpu_log.dpwe[4]" RAT_FUNC "%10.0" "(not defined)" COEFFS 0.000000 1.000000 -0.000000 0.000000 0.000000 1.000000 /end COMPU_METHOD
/* Scalar measurable for DDE 'mpl_error_log_detailed[0].err_log.cpu_log.dpwe[5]'. */
/begin MEASUREMENT mpl_error_log_detailed[0].err99 "CPU/MPU data protection write enable configuration register" ULONG CU_MPL_ERROR_LOG_DETAILED[0]002 1 100 0.0 4294967295.0 ECU_ADDRESS 0xf024038c BYTE_ORDER MSB_LAST /end MEASUREMENT
/begin COMPU_METHOD CU_MPL_ERROR_LOG_DETAILED[0]002 "Conversion method for mpl_error_log_detailed[0].err_log.cpu_log.dpwe[5]" RAT_FUNC "%10.0" "(not defined)" COEFFS 0.000000 1.000000 -0.000000 0.000000 0.000000 1.000000 /end COMPU_METHOD
/* Scalar measurable for DDE 'mpl_error_log_detailed[0].err_log.cpu_log.dstr'. */
/begin MEASUREMENT mpl_error_log_detailed[0].er012 "CPU data synchronous error trap register" ULONG CU_MPL_ERROR_LOG_DETAILED[0]015 1 100 0.0 4294967295.0 ECU_ADDRESS 0xf0240228 BYTE_ORDER MSB_LAST /end MEASUREMENT
/begin COMPU_METHOD CU_MPL_ERROR_LOG_DETAILED[0]015 "Conversion method for mpl_error_log_detailed[0].err_log.cpu_log.dstr" RAT_FUNC "%10.0" "(not defined)" COEFFS 0.000000 1.000000 -0.000000 0.000000 0.000000 1.000000 /end COMPU_METHOD
/* Scalar measurable for DDE 'mpl_error_log_detailed[0].err_log.cpu_log.fcx'. */
/begin MEASUREMENT mpl_error_log_detailed[0].err86 "CPU free context list head pointer register" ULONG CU_MPL_ERROR_LOG_DETAILED[0].89 1 100 0.0 4294967295.0 ECU_ADDRESS 0xf024039c BYTE_ORDER MSB_LAST /end MEASUREMENT
/begin COMPU_METHOD CU_MPL_ERROR_LOG_DETAILED[0].89 "Conversion method for mpl_error_log_detailed[0].err_log.cpu_log.fcx" RAT_FUNC "%10.0" "(not defined)" COEFFS 0.000000 1.000000 -0.000000 0.000000 0.000000 1.000000 /end COMPU_METHOD
/* Scalar measurable for DDE 'mpl_error_log_detailed[0].err_log.cpu_log.flashcon0'. */
/begin MEASUREMENT mpl_error_log_detailed[0].er007 "CPU flash configuration register" ULONG CU_MPL_ERROR_LOG_DETAILED[0]010 1 100 0.0 4294967295.0 ECU_ADDRESS 0xf02403b0 BYTE_ORDER MSB_LAST /end MEASUREMENT
/begin COMPU_METHOD CU_MPL_ERROR_LOG_DETAILED[0]010 "Conversion method for mpl_error_log_detailed[0].err_log.cpu_log.flashcon0" RAT_FUNC "%10.0" "(not defined)" COEFFS 0.000000 1.000000 -0.000000 0.000000 0.000000 1.000000 /end COMPU_METHOD
/* Scalar measurable for DDE 'mpl_error_log_detailed[0].err_log.cpu_log.flashcon1'. */
/begin MEASUREMENT mpl_error_log_detailed[0].err20 "CPU flash configuration register" ULONG CU_MPL_ERROR_LOG_DETAILED[0].21 1 100 0.0 4294967295.0 ECU_ADDRESS 0xf02403b4 BYTE_ORDER MSB_LAST /end MEASUREMENT
/begin COMPU_METHOD CU_MPL_ERROR_LOG_DETAILED[0].21 "Conversion method for mpl_error_log_detailed[0].err_log.cpu_log.flashcon1" RAT_FUNC "%10.0" "(not defined)" COEFFS 0.000000 1.000000 -0.000000 0.000000 0.000000 1.000000 /end COMPU_METHOD
/* Scalar measurable for DDE 'mpl_error_log_detailed[0].err_log.cpu_log.flashcon2'. */
/begin MEASUREMENT mpl_error_log_detailed[0].er005 "CPU flash configuration register" ULONG CU_MPL_ERROR_LOG_DETAILED[0]008 1 100 0.0 4294967295.0 ECU_ADDRESS 0xf02403b8 BYTE_ORDER MSB_LAST /end MEASUREMENT
/begin COMPU_METHOD CU_MPL_ERROR_LOG_DETAILED[0]008 "Conversion method for mpl_error_log_detailed[0].err_log.cpu_log.flashcon2" RAT_FUNC "%10.0" "(not defined)" COEFFS 0.000000 1.000000 -0.000000 0.000000 0.000000 1.000000 /end COMPU_METHOD
/* Scalar measurable for DDE 'mpl_error_log_detailed[0].err_log.cpu_log.flashcon3'. */
/begin MEASUREMENT mpl_error_log_detailed[0].er006 "CPU flash configuration register" ULONG CU_MPL_ERROR_LOG_DETAILED[0]009 1 100 0.0 4294967295.0 ECU_ADDRESS 0xf02403bc BYTE_ORDER MSB_LAST /end MEASUREMENT
/begin COMPU_METHOD CU_MPL_ERROR_LOG_DETAILED[0]009 "Conversion method for mpl_error_log_detailed[0].err_log.cpu_log.flashcon3" RAT_FUNC "%10.0" "(not defined)" COEFFS 0.000000 1.000000 -0.000000 0.000000 0.000000 1.000000 /end COMPU_METHOD
/* Scalar measurable for DDE 'mpl_error_log_detailed[0].err_log.cpu_log.fpu_trap_con'. */
/begin MEASUREMENT mpl_error_log_detailed[0].er031 "CPU/FPU trap control register" ULONG CU_MPL_ERROR_LOG_DETAILED[0]034 1 100 0.0 4294967295.0 ECU_ADDRESS 0xf0240250 BYTE_ORDER MSB_LAST /end MEASUREMENT
/begin COMPU_METHOD CU_MPL_ERROR_LOG_DETAILED[0]034 "Conversion method for mpl_error_log_detailed[0].err_log.cpu_log.fpu_trap_con" RAT_FUNC "%10.0" "(not defined)" COEFFS 0.000000 1.000000 -0.000000 0.000000 0.000000 1.000000 /end COMPU_METHOD
/* Scalar measurable for DDE 'mpl_error_log_detailed[0].err_log.cpu_log.fpu_trap_opc'. */
/begin MEASUREMENT mpl_error_log_detailed[0].err85 "CPU/FPU trap instruction opcode register" ULONG CU_MPL_ERROR_LOG_DETAILED[0].88 1 100 0.0 4294967295.0 ECU_ADDRESS 0xf0240258 BYTE_ORDER MSB_LAST /end MEASUREMENT
/begin COMPU_METHOD CU_MPL_ERROR_LOG_DETAILED[0].88 "Conversion method for mpl_error_log_detailed[0].err_log.cpu_log.fpu_trap_opc" RAT_FUNC "%10.0" "(not defined)" COEFFS 0.000000 1.000000 -0.000000 0.000000 0.000000 1.000000 /end COMPU_METHOD
/* Scalar measurable for DDE 'mpl_error_log_detailed[0].err_log.cpu_log.fpu_trap_pc'. */
/begin MEASUREMENT mpl_error_log_detailed[0].err17 "CPU/FPU trap instruction program control register" ULONG CU_MPL_ERROR_LOG_DETAILED[0].18 1 100 0.0 4294967295.0 ECU_ADDRESS 0xf0240254 BYTE_ORDER MSB_LAST /end MEASUREMENT
/begin COMPU_METHOD CU_MPL_ERROR_LOG_DETAILED[0].18 "Conversion method for mpl_error_log_detailed[0].err_log.cpu_log.fpu_trap_pc" RAT_FUNC "%10.0" "(not defined)" COEFFS 0.000000 1.000000 -0.000000 0.000000 0.000000 1.000000 /end COMPU_METHOD
/* Scalar measurable for DDE 'mpl_error_log_detailed[0].err_log.cpu_log.fpu_trap_src1'. */
/begin MEASUREMENT mpl_error_log_detailed[0].err11 "CPU/FPU trap instruction operand register" ULONG CU_MPL_ERROR_LOG_DETAILED[0].12 1 100 0.0 4294967295.0 ECU_ADDRESS 0xf024025c BYTE_ORDER MSB_LAST /end MEASUREMENT
/begin COMPU_METHOD CU_MPL_ERROR_LOG_DETAILED[0].12 "Conversion method for mpl_error_log_detailed[0].err_log.cpu_log.fpu_trap_src1" RAT_FUNC "%10.0" "(not defined)" COEFFS 0.000000 1.000000 -0.000000 0.000000 0.000000 1.000000 /end COMPU_METHOD
/* Scalar measurable for DDE 'mpl_error_log_detailed[0].err_log.cpu_log.fpu_trap_src2'. */
/begin MEASUREMENT mpl_error_log_detailed[0].err12 "CPU/FPU trap instruction operand register" ULONG CU_MPL_ERROR_LOG_DETAILED[0].13 1 100 0.0 4294967295.0 ECU_ADDRESS 0xf0240260 BYTE_ORDER MSB_LAST /end MEASUREMENT
/begin COMPU_METHOD CU_MPL_ERROR_LOG_DETAILED[0].13 "Conversion method for mpl_error_log_detailed[0].err_log.cpu_log.fpu_trap_src2" RAT_FUNC "%10.0" "(not defined)" COEFFS 0.000000 1.000000 -0.000000 0.000000 0.000000 1.000000 /end COMPU_METHOD
/* Scalar measurable for DDE 'mpl_error_log_detailed[0].err_log.cpu_log.fpu_trap_src3'. */
/begin MEASUREMENT mpl_error_log_detailed[0].err13 "CPU/FPU trap instruction operand register" ULONG CU_MPL_ERROR_LOG_DETAILED[0].14 1 100 0.0 4294967295.0 ECU_ADDRESS 0xf0240264 BYTE_ORDER MSB_LAST /end MEASUREMENT
/begin COMPU_METHOD CU_MPL_ERROR_LOG_DETAILED[0].14 "Conversion method for mpl_error_log_detailed[0].err_log.cpu_log.fpu_trap_src3" RAT_FUNC "%10.0" "(not defined)" COEFFS 0.000000 1.000000 -0.000000 0.000000 0.000000 1.000000 /end COMPU_METHOD
/* Scalar measurable for DDE 'mpl_error_log_detailed[0].err_log.cpu_log.icr'. */
/begin MEASUREMENT mpl_error_log_detailed[0].err09 "CPU interrupt control register" ULONG CU_MPL_ERROR_LOG_DETAILED[0].10 1 100 0.0 4294967295.0 ECU_ADDRESS 0xf0240394 BYTE_ORDER MSB_LAST /end MEASUREMENT
/begin COMPU_METHOD CU_MPL_ERROR_LOG_DETAILED[0].10 "Conversion method for mpl_error_log_detailed[0].err_log.cpu_log.icr" RAT_FUNC "%10.0" "(not defined)" COEFFS 0.000000 1.000000 -0.000000 0.000000 0.000000 1.000000 /end COMPU_METHOD
/* Scalar measurable for DDE 'mpl_error_log_detailed[0].err_log.cpu_log.isp'. */
/begin MEASUREMENT mpl_error_log_detailed[0].err31 "CPU interrupt stack pointer register" ULONG CU_MPL_ERROR_LOG_DETAILED[0].33 1 100 0.0 4294967295.0 ECU_ADDRESS 0xf0240398 BYTE_ORDER MSB_LAST /end MEASUREMENT
/begin COMPU_METHOD CU_MPL_ERROR_LOG_DETAILED[0].33 "Conversion method for mpl_error_log_detailed[0].err_log.cpu_log.isp" RAT_FUNC "%10.0" "(not defined)" COEFFS 0.000000 1.000000 -0.000000 0.000000 0.000000 1.000000 /end COMPU_METHOD
/* Scalar measurable for DDE 'mpl_error_log_detailed[0].err_log.cpu_log.lcx'. */
/begin MEASUREMENT mpl_error_log_detailed[0].err39 "CPU free context list limit pointer register" ULONG CU_MPL_ERROR_LOG_DETAILED[0].41 1 100 0.0 4294967295.0 ECU_ADDRESS 0xf02403a0 BYTE_ORDER MSB_LAST /end MEASUREMENT
/begin COMPU_METHOD CU_MPL_ERROR_LOG_DETAILED[0].41 "Conversion method for mpl_error_log_detailed[0].err_log.cpu_log.lcx" RAT_FUNC "%10.0" "(not defined)" COEFFS 0.000000 1.000000 -0.000000 0.000000 0.000000 1.000000 /end COMPU_METHOD
/* Scalar measurable for DDE 'mpl_error_log_detailed[0].err_log.cpu_log.pcon0'. */
/begin MEASUREMENT mpl_error_log_detailed[0].err45 "CPU program memory configuration register" ULONG CU_MPL_ERROR_LOG_DETAILED[0].47 1 100 0.0 4294967295.0 ECU_ADDRESS 0xf024023c BYTE_ORDER MSB_LAST /end MEASUREMENT
/begin COMPU_METHOD CU_MPL_ERROR_LOG_DETAILED[0].47 "Conversion method for mpl_error_log_detailed[0].err_log.cpu_log.pcon0" RAT_FUNC "%10.0" "(not defined)" COEFFS 0.000000 1.000000 -0.000000 0.000000 0.000000 1.000000 /end COMPU_METHOD
/* Scalar measurable for DDE 'mpl_error_log_detailed[0].err_log.cpu_log.pcon1'. */
/begin MEASUREMENT mpl_error_log_detailed[0].err46 "CPU program memory configuration register" ULONG CU_MPL_ERROR_LOG_DETAILED[0].48 1 100 0.0 4294967295.0 ECU_ADDRESS 0xf0240240 BYTE_ORDER MSB_LAST /end MEASUREMENT
/begin COMPU_METHOD CU_MPL_ERROR_LOG_DETAILED[0].48 "Conversion method for mpl_error_log_detailed[0].err_log.cpu_log.pcon1" RAT_FUNC "%10.0" "(not defined)" COEFFS 0.000000 1.000000 -0.000000 0.000000 0.000000 1.000000 /end COMPU_METHOD
/* Scalar measurable for DDE 'mpl_error_log_detailed[0].err_log.cpu_log.pcon2'. */
/begin MEASUREMENT mpl_error_log_detailed[0].err47 "CPU program memory configuration register" ULONG CU_MPL_ERROR_LOG_DETAILED[0].49 1 100 0.0 4294967295.0 ECU_ADDRESS 0xf0240244 BYTE_ORDER MSB_LAST /end MEASUREMENT
/begin COMPU_METHOD CU_MPL_ERROR_LOG_DETAILED[0].49 "Conversion method for mpl_error_log_detailed[0].err_log.cpu_log.pcon2" RAT_FUNC "%10.0" "(not defined)" COEFFS 0.000000 1.000000 -0.000000 0.000000 0.000000 1.000000 /end COMPU_METHOD
/* Scalar measurable for DDE 'mpl_error_log_detailed[0].err_log.cpu_log.piear'. */
/begin MEASUREMENT mpl_error_log_detailed[0].err53 "CPU program integrity error address register" ULONG CU_MPL_ERROR_LOG_DETAILED[0].55 1 100 0.0 4294967295.0 ECU_ADDRESS 0xf0240248 BYTE_ORDER MSB_LAST /end MEASUREMENT
/begin COMPU_METHOD CU_MPL_ERROR_LOG_DETAILED[0].55 "Conversion method for mpl_error_log_detailed[0].err_log.cpu_log.piear" RAT_FUNC "%10.0" "(not defined)" COEFFS 0.000000 1.000000 -0.000000 0.000000 0.000000 1.000000 /end COMPU_METHOD
/* Scalar measurable for DDE 'mpl_error_log_detailed[0].err_log.cpu_log.pietr'. */
/begin MEASUREMENT mpl_error_log_detailed[0].err77 "CPU program integrity error trap register" ULONG CU_MPL_ERROR_LOG_DETAILED[0].80 1 100 0.0 4294967295.0 ECU_ADDRESS 0xf024024c BYTE_ORDER MSB_LAST /end MEASUREMENT
/begin COMPU_METHOD CU_MPL_ERROR_LOG_DETAILED[0].80 "Conversion method for mpl_error_log_detailed[0].err_log.cpu_log.pietr" RAT_FUNC "%10.0" "(not defined)" COEFFS 0.000000 1.000000 -0.000000 0.000000 0.000000 1.000000 /end COMPU_METHOD
/* Scalar measurable for DDE 'mpl_error_log_detailed[0].err_log.cpu_log.syscon'. */
/begin MEASUREMENT mpl_error_log_detailed[0].err98 "CPU system configuration register" ULONG CU_MPL_ERROR_LOG_DETAILED[0]001 1 100 0.0 4294967295.0 ECU_ADDRESS 0xf02403ac BYTE_ORDER MSB_LAST /end MEASUREMENT
/begin COMPU_METHOD CU_MPL_ERROR_LOG_DETAILED[0]001 "Conversion method for mpl_error_log_detailed[0].err_log.cpu_log.syscon" RAT_FUNC "%10.0" "(not defined)" COEFFS 0.000000 1.000000 -0.000000 0.000000 0.000000 1.000000 /end COMPU_METHOD
/* Scalar measurable for DDE 'mpl_error_log_detailed[0].err_log.cpu_log.tps_con'. */
/begin MEASUREMENT mpl_error_log_detailed[0].err_2 "CPU temporal protection system control register" ULONG CU_MPL_ERROR_LOG_DETAILED[0].E2 1 100 0.0 4294967295.0 ECU_ADDRESS 0xf0240390 BYTE_ORDER MSB_LAST /end MEASUREMENT
/begin COMPU_METHOD CU_MPL_ERROR_LOG_DETAILED[0].E2 "Conversion method for mpl_error_log_detailed[0].err_log.cpu_log.tps_con" RAT_FUNC "%10.0" "(not defined)" COEFFS 0.000000 1.000000 -0.000000 0.000000 0.000000 1.000000 /end COMPU_METHOD
/* Scalar measurable for DDE 'mpl_error_log_detailed[0].err_log.csa.lower.A2'. */
/begin MEASUREMENT mpl_error_log_detailed[0].err81 "CPU address register" ULONG CU_MPL_ERROR_LOG_DETAILED[0].84 1 100 0.0 4294967295.0 ECU_ADDRESS 0xf02401f0 BYTE_ORDER MSB_LAST /end MEASUREMENT
/begin COMPU_METHOD CU_MPL_ERROR_LOG_DETAILED[0].84 "Conversion method for mpl_error_log_detailed[0].err_log.csa.lower.A2" RAT_FUNC "%10.0" "(not defined)" COEFFS 0.000000 1.000000 -0.000000 0.000000 0.000000 1.000000 /end COMPU_METHOD
/* Scalar measurable for DDE 'mpl_error_log_detailed[0].err_log.csa.lower.A3'. */
/begin MEASUREMENT mpl_error_log_detailed[0].err80 "CPU address register" ULONG CU_MPL_ERROR_LOG_DETAILED[0].83 1 100 0.0 4294967295.0 ECU_ADDRESS 0xf02401f4 BYTE_ORDER MSB_LAST /end MEASUREMENT
/begin COMPU_METHOD CU_MPL_ERROR_LOG_DETAILED[0].83 "Conversion method for mpl_error_log_detailed[0].err_log.csa.lower.A3" RAT_FUNC "%10.0" "(not defined)" COEFFS 0.000000 1.000000 -0.000000 0.000000 0.000000 1.000000 /end COMPU_METHOD
/* Scalar measurable for DDE 'mpl_error_log_detailed[0].err_log.csa.lower.A4'. */
/begin MEASUREMENT mpl_error_log_detailed[0].err79 "CPU address register" ULONG CU_MPL_ERROR_LOG_DETAILED[0].82 1 100 0.0 4294967295.0 ECU_ADDRESS 0xf0240208 BYTE_ORDER MSB_LAST /end MEASUREMENT
/begin COMPU_METHOD CU_MPL_ERROR_LOG_DETAILED[0].82 "Conversion method for mpl_error_log_detailed[0].err_log.csa.lower.A4" RAT_FUNC "%10.0" "(not defined)" COEFFS 0.000000 1.000000 -0.000000 0.000000 0.000000 1.000000 /end COMPU_METHOD
/* Scalar measurable for DDE 'mpl_error_log_detailed[0].err_log.csa.lower.A5'. */
/begin MEASUREMENT mpl_error_log_detailed[0].err29 "CPU address register" ULONG CU_MPL_ERROR_LOG_DETAILED[0].31 1 100 0.0 4294967295.0 ECU_ADDRESS 0xf024020c BYTE_ORDER MSB_LAST /end MEASUREMENT
/begin COMPU_METHOD CU_MPL_ERROR_LOG_DETAILED[0].31 "Conversion method for mpl_error_log_detailed[0].err_log.csa.lower.A5" RAT_FUNC "%10.0" "(not defined)" COEFFS 0.000000 1.000000 -0.000000 0.000000 0.000000 1.000000 /end COMPU_METHOD
/* Scalar measurable for DDE 'mpl_error_log_detailed[0].err_log.csa.lower.A6'. */
/begin MEASUREMENT mpl_error_log_detailed[0].err30 "CPU address register" ULONG CU_MPL_ERROR_LOG_DETAILED[0].32 1 100 0.0 4294967295.0 ECU_ADDRESS 0xf0240210 BYTE_ORDER MSB_LAST /end MEASUREMENT
/begin COMPU_METHOD CU_MPL_ERROR_LOG_DETAILED[0].32 "Conversion method for mpl_error_log_detailed[0].err_log.csa.lower.A6" RAT_FUNC "%10.0" "(not defined)" COEFFS 0.000000 1.000000 -0.000000 0.000000 0.000000 1.000000 /end COMPU_METHOD
/* Scalar measurable for DDE 'mpl_error_log_detailed[0].err_log.csa.lower.A7'. */
/begin MEASUREMENT mpl_error_log_detailed[0].err83 "CPU address register" ULONG CU_MPL_ERROR_LOG_DETAILED[0].86 1 100 0.0 4294967295.0 ECU_ADDRESS 0xf0240214 BYTE_ORDER MSB_LAST /end MEASUREMENT
/begin COMPU_METHOD CU_MPL_ERROR_LOG_DETAILED[0].86 "Conversion method for mpl_error_log_detailed[0].err_log.csa.lower.A7" RAT_FUNC "%10.0" "(not defined)" COEFFS 0.000000 1.000000 -0.000000 0.000000 0.000000 1.000000 /end COMPU_METHOD
/* Scalar measurable for DDE 'mpl_error_log_detailed[0].err_log.csa.lower.D0'. */
/begin MEASUREMENT mpl_error_log_detailed[0].er018 "CPU data register" ULONG CU_MPL_ERROR_LOG_DETAILED[0]021 1 100 0.0 4294967295.0 ECU_ADDRESS 0xf02401f8 BYTE_ORDER MSB_LAST /end MEASUREMENT
/begin COMPU_METHOD CU_MPL_ERROR_LOG_DETAILED[0]021 "Conversion method for mpl_error_log_detailed[0].err_log.csa.lower.D0" RAT_FUNC "%10.0" "(not defined)" COEFFS 0.000000 1.000000 -0.000000 0.000000 0.000000 1.000000 /end COMPU_METHOD
/* Scalar measurable for DDE 'mpl_error_log_detailed[0].err_log.csa.lower.D1'. */
/begin MEASUREMENT mpl_error_log_detailed[0].er019 "CPU data register" ULONG CU_MPL_ERROR_LOG_DETAILED[0]022 1 100 0.0 4294967295.0 ECU_ADDRESS 0xf02401fc BYTE_ORDER MSB_LAST /end MEASUREMENT
/begin COMPU_METHOD CU_MPL_ERROR_LOG_DETAILED[0]022 "Conversion method for mpl_error_log_detailed[0].err_log.csa.lower.D1" RAT_FUNC "%10.0" "(not defined)" COEFFS 0.000000 1.000000 -0.000000 0.000000 0.000000 1.000000 /end COMPU_METHOD
/* Scalar measurable for DDE 'mpl_error_log_detailed[0].err_log.csa.lower.D2'. */
/begin MEASUREMENT mpl_error_log_detailed[0].er016 "CPU data register" ULONG CU_MPL_ERROR_LOG_DETAILED[0]019 1 100 0.0 4294967295.0 ECU_ADDRESS 0xf0240200 BYTE_ORDER MSB_LAST /end MEASUREMENT
/begin COMPU_METHOD CU_MPL_ERROR_LOG_DETAILED[0]019 "Conversion method for mpl_error_log_detailed[0].err_log.csa.lower.D2" RAT_FUNC "%10.0" "(not defined)" COEFFS 0.000000 1.000000 -0.000000 0.000000 0.000000 1.000000 /end COMPU_METHOD
/* Scalar measurable for DDE 'mpl_error_log_detailed[0].err_log.csa.lower.D3'. */
/begin MEASUREMENT mpl_error_log_detailed[0].er017 "CPU data register" ULONG CU_MPL_ERROR_LOG_DETAILED[0]020 1 100 0.0 4294967295.0 ECU_ADDRESS 0xf0240204 BYTE_ORDER MSB_LAST /end MEASUREMENT
/begin COMPU_METHOD CU_MPL_ERROR_LOG_DETAILED[0]020 "Conversion method for mpl_error_log_detailed[0].err_log.csa.lower.D3" RAT_FUNC "%10.0" "(not defined)" COEFFS 0.000000 1.000000 -0.000000 0.000000 0.000000 1.000000 /end COMPU_METHOD
/* Scalar measurable for DDE 'mpl_error_log_detailed[0].err_log.csa.lower.D4'. */
/begin MEASUREMENT mpl_error_log_detailed[0].er022 "CPU data register" ULONG CU_MPL_ERROR_LOG_DETAILED[0]025 1 100 0.0 4294967295.0 ECU_ADDRESS 0xf0240218 BYTE_ORDER MSB_LAST /end MEASUREMENT
/begin COMPU_METHOD CU_MPL_ERROR_LOG_DETAILED[0]025 "Conversion method for mpl_error_log_detailed[0].err_log.csa.lower.D4" RAT_FUNC "%10.0" "(not defined)" COEFFS 0.000000 1.000000 -0.000000 0.000000 0.000000 1.000000 /end COMPU_METHOD
/* Scalar measurable for DDE 'mpl_error_log_detailed[0].err_log.csa.lower.D5'. */
/begin MEASUREMENT mpl_error_log_detailed[0].err71 "CPU data register" ULONG CU_MPL_ERROR_LOG_DETAILED[0].74 1 100 0.0 4294967295.0 ECU_ADDRESS 0xf024021c BYTE_ORDER MSB_LAST /end MEASUREMENT
/begin COMPU_METHOD CU_MPL_ERROR_LOG_DETAILED[0].74 "Conversion method for mpl_error_log_detailed[0].err_log.csa.lower.D5" RAT_FUNC "%10.0" "(not defined)" COEFFS 0.000000 1.000000 -0.000000 0.000000 0.000000 1.000000 /end COMPU_METHOD
/* Scalar measurable for DDE 'mpl_error_log_detailed[0].err_log.csa.lower.D6'. */
/begin MEASUREMENT mpl_error_log_detailed[0].er020 "CPU data register" ULONG CU_MPL_ERROR_LOG_DETAILED[0]023 1 100 0.0 4294967295.0 ECU_ADDRESS 0xf0240220 BYTE_ORDER MSB_LAST /end MEASUREMENT
/begin COMPU_METHOD CU_MPL_ERROR_LOG_DETAILED[0]023 "Conversion method for mpl_error_log_detailed[0].err_log.csa.lower.D6" RAT_FUNC "%10.0" "(not defined)" COEFFS 0.000000 1.000000 -0.000000 0.000000 0.000000 1.000000 /end COMPU_METHOD
/* Scalar measurable for DDE 'mpl_error_log_detailed[0].err_log.csa.lower.D7'. */
/begin MEASUREMENT mpl_error_log_detailed[0].er021 "CPU data register" ULONG CU_MPL_ERROR_LOG_DETAILED[0]024 1 100 0.0 4294967295.0 ECU_ADDRESS 0xf0240224 BYTE_ORDER MSB_LAST /end MEASUREMENT
/begin COMPU_METHOD CU_MPL_ERROR_LOG_DETAILED[0]024 "Conversion method for mpl_error_log_detailed[0].err_log.csa.lower.D7" RAT_FUNC "%10.0" "(not defined)" COEFFS 0.000000 1.000000 -0.000000 0.000000 0.000000 1.000000 /end COMPU_METHOD
/* Scalar measurable for DDE 'mpl_error_log_detailed[0].err_log.csa.lower.PC'. */
/begin MEASUREMENT mpl_error_log_detailed[0].err92 "CPU program counter" ULONG CU_MPL_ERROR_LOG_DETAILED[0].95 1 100 0.0 4294967295.0 ECU_ADDRESS 0xf02401ec BYTE_ORDER MSB_LAST /end MEASUREMENT
/begin COMPU_METHOD CU_MPL_ERROR_LOG_DETAILED[0].95 "Conversion method for mpl_error_log_detailed[0].err_log.csa.lower.PC" RAT_FUNC "%10.0" "(not defined)" COEFFS 0.000000 1.000000 -0.000000 0.000000 0.000000 1.000000 /end COMPU_METHOD
/* Scalar measurable for DDE 'mpl_error_log_detailed[0].err_log.csa.upper.A10'. */
/begin MEASUREMENT mpl_error_log_detailed[0].err68 "CPU address register (aka stack pointer)" ULONG CU_MPL_ERROR_LOG_DETAILED[0].71 1 100 0.0 4294967295.0 ECU_ADDRESS 0xf02401f0 BYTE_ORDER MSB_LAST /end MEASUREMENT
/begin COMPU_METHOD CU_MPL_ERROR_LOG_DETAILED[0].71 "Conversion method for mpl_error_log_detailed[0].err_log.csa.upper.A10" RAT_FUNC "%10.0" "(not defined)" COEFFS 0.000000 1.000000 -0.000000 0.000000 0.000000 1.000000 /end COMPU_METHOD
/* Scalar measurable for DDE 'mpl_error_log_detailed[0].err_log.csa.upper.A11'. */
/begin MEASUREMENT mpl_error_log_detailed[0].err69 "CPU address register (aka return address" ULONG CU_MPL_ERROR_LOG_DETAILED[0].72 1 100 0.0 4294967295.0 ECU_ADDRESS 0xf02401f4 BYTE_ORDER MSB_LAST /end MEASUREMENT
/begin COMPU_METHOD CU_MPL_ERROR_LOG_DETAILED[0].72 "Conversion method for mpl_error_log_detailed[0].err_log.csa.upper.A11" RAT_FUNC "%10.0" "(not defined)" COEFFS 0.000000 1.000000 -0.000000 0.000000 0.000000 1.000000 /end COMPU_METHOD
/* Scalar measurable for DDE 'mpl_error_log_detailed[0].err_log.csa.upper.A12'. */
/begin MEASUREMENT mpl_error_log_detailed[0].err89 "CPU address register" ULONG CU_MPL_ERROR_LOG_DETAILED[0].92 1 100 0.0 4294967295.0 ECU_ADDRESS 0xf0240208 BYTE_ORDER MSB_LAST /end MEASUREMENT
/begin COMPU_METHOD CU_MPL_ERROR_LOG_DETAILED[0].92 "Conversion method for mpl_error_log_detailed[0].err_log.csa.upper.A12" RAT_FUNC "%10.0" "(not defined)" COEFFS 0.000000 1.000000 -0.000000 0.000000 0.000000 1.000000 /end COMPU_METHOD
/* Scalar measurable for DDE 'mpl_error_log_detailed[0].err_log.csa.upper.A13'. */
/begin MEASUREMENT mpl_error_log_detailed[0].err90 "CPU address register" ULONG CU_MPL_ERROR_LOG_DETAILED[0].93 1 100 0.0 4294967295.0 ECU_ADDRESS 0xf024020c BYTE_ORDER MSB_LAST /end MEASUREMENT
/begin COMPU_METHOD CU_MPL_ERROR_LOG_DETAILED[0].93 "Conversion method for mpl_error_log_detailed[0].err_log.csa.upper.A13" RAT_FUNC "%10.0" "(not defined)" COEFFS 0.000000 1.000000 -0.000000 0.000000 0.000000 1.000000 /end COMPU_METHOD
/* Scalar measurable for DDE 'mpl_error_log_detailed[0].err_log.csa.upper.A14'. */
/begin MEASUREMENT mpl_error_log_detailed[0].err88 "CPU address register" ULONG CU_MPL_ERROR_LOG_DETAILED[0].91 1 100 0.0 4294967295.0 ECU_ADDRESS 0xf0240210 BYTE_ORDER MSB_LAST /end MEASUREMENT
/begin COMPU_METHOD CU_MPL_ERROR_LOG_DETAILED[0].91 "Conversion method for mpl_error_log_detailed[0].err_log.csa.upper.A14" RAT_FUNC "%10.0" "(not defined)" COEFFS 0.000000 1.000000 -0.000000 0.000000 0.000000 1.000000 /end COMPU_METHOD
/* Scalar measurable for DDE 'mpl_error_log_detailed[0].err_log.csa.upper.A15'. */
/begin MEASUREMENT mpl_error_log_detailed[0].err66 "CPU address register" ULONG CU_MPL_ERROR_LOG_DETAILED[0].69 1 100 0.0 4294967295.0 ECU_ADDRESS 0xf0240214 BYTE_ORDER MSB_LAST /end MEASUREMENT
/begin COMPU_METHOD CU_MPL_ERROR_LOG_DETAILED[0].69 "Conversion method for mpl_error_log_detailed[0].err_log.csa.upper.A15" RAT_FUNC "%10.0" "(not defined)" COEFFS 0.000000 1.000000 -0.000000 0.000000 0.000000 1.000000 /end COMPU_METHOD
/* Scalar measurable for DDE 'mpl_error_log_detailed[0].err_log.csa.upper.D10'. */
/begin MEASUREMENT mpl_error_log_detailed[0].err00 "CPU data register" ULONG CU_MPL_ERROR_LOG_DETAILED[0].00 1 100 0.0 4294967295.0 ECU_ADDRESS 0xf0240200 BYTE_ORDER MSB_LAST /end MEASUREMENT
/begin COMPU_METHOD CU_MPL_ERROR_LOG_DETAILED[0].00 "Conversion method for mpl_error_log_detailed[0].err_log.csa.upper.D10" RAT_FUNC "%10.0" "(not defined)" COEFFS 0.000000 1.000000 -0.000000 0.000000 0.000000 1.000000 /end COMPU_METHOD
/* Scalar measurable for DDE 'mpl_error_log_detailed[0].err_log.csa.upper.D11'. */
/begin MEASUREMENT mpl_error_log_detailed[0].err_8 "CPU data register" ULONG CU_MPL_ERROR_LOG_DETAILED[0].E8 1 100 0.0 4294967295.0 ECU_ADDRESS 0xf0240204 BYTE_ORDER MSB_LAST /end MEASUREMENT
/begin COMPU_METHOD CU_MPL_ERROR_LOG_DETAILED[0].E8 "Conversion method for mpl_error_log_detailed[0].err_log.csa.upper.D11" RAT_FUNC "%10.0" "(not defined)" COEFFS 0.000000 1.000000 -0.000000 0.000000 0.000000 1.000000 /end COMPU_METHOD
/* Scalar measurable for DDE 'mpl_error_log_detailed[0].err_log.csa.upper.D12'. */
/begin MEASUREMENT mpl_error_log_detailed[0].er004 "CPU data register" ULONG CU_MPL_ERROR_LOG_DETAILED[0]007 1 100 0.0 4294967295.0 ECU_ADDRESS 0xf0240218 BYTE_ORDER MSB_LAST /end MEASUREMENT
/begin COMPU_METHOD CU_MPL_ERROR_LOG_DETAILED[0]007 "Conversion method for mpl_error_log_detailed[0].err_log.csa.upper.D12" RAT_FUNC "%10.0" "(not defined)" COEFFS 0.000000 1.000000 -0.000000 0.000000 0.000000 1.000000 /end COMPU_METHOD
/* Scalar measurable for DDE 'mpl_error_log_detailed[0].err_log.csa.upper.D13'. */
/begin MEASUREMENT mpl_error_log_detailed[0].er003 "CPU data register" ULONG CU_MPL_ERROR_LOG_DETAILED[0]006 1 100 0.0 4294967295.0 ECU_ADDRESS 0xf024021c BYTE_ORDER MSB_LAST /end MEASUREMENT
/begin COMPU_METHOD CU_MPL_ERROR_LOG_DETAILED[0]006 "Conversion method for mpl_error_log_detailed[0].err_log.csa.upper.D13" RAT_FUNC "%10.0" "(not defined)" COEFFS 0.000000 1.000000 -0.000000 0.000000 0.000000 1.000000 /end COMPU_METHOD
/* Scalar measurable for DDE 'mpl_error_log_detailed[0].err_log.csa.upper.D14'. */
/begin MEASUREMENT mpl_error_log_detailed[0].er002 "CPU data register" ULONG CU_MPL_ERROR_LOG_DETAILED[0]005 1 100 0.0 4294967295.0 ECU_ADDRESS 0xf0240220 BYTE_ORDER MSB_LAST /end MEASUREMENT
/begin COMPU_METHOD CU_MPL_ERROR_LOG_DETAILED[0]005 "Conversion method for mpl_error_log_detailed[0].err_log.csa.upper.D14" RAT_FUNC "%10.0" "(not defined)" COEFFS 0.000000 1.000000 -0.000000 0.000000 0.000000 1.000000 /end COMPU_METHOD
/* Scalar measurable for DDE 'mpl_error_log_detailed[0].err_log.csa.upper.D15'. */
/begin MEASUREMENT mpl_error_log_detailed[0].err64 "CPU data register" ULONG CU_MPL_ERROR_LOG_DETAILED[0].67 1 100 0.0 4294967295.0 ECU_ADDRESS 0xf0240224 BYTE_ORDER MSB_LAST /end MEASUREMENT
/begin COMPU_METHOD CU_MPL_ERROR_LOG_DETAILED[0].67 "Conversion method for mpl_error_log_detailed[0].err_log.csa.upper.D15" RAT_FUNC "%10.0" "(not defined)" COEFFS 0.000000 1.000000 -0.000000 0.000000 0.000000 1.000000 /end COMPU_METHOD
/* Scalar measurable for DDE 'mpl_error_log_detailed[0].err_log.csa.upper.D8'. */
/begin MEASUREMENT mpl_error_log_detailed[0].err50 "CPU data register" ULONG CU_MPL_ERROR_LOG_DETAILED[0].52 1 100 0.0 4294967295.0 ECU_ADDRESS 0xf02401f8 BYTE_ORDER MSB_LAST /end MEASUREMENT
/begin COMPU_METHOD CU_MPL_ERROR_LOG_DETAILED[0].52 "Conversion method for mpl_error_log_detailed[0].err_log.csa.upper.D8" RAT_FUNC "%10.0" "(not defined)" COEFFS 0.000000 1.000000 -0.000000 0.000000 0.000000 1.000000 /end COMPU_METHOD
/* Scalar measurable for DDE 'mpl_error_log_detailed[0].err_log.csa.upper.D9'. */
/begin MEASUREMENT mpl_error_log_detailed[0].err33 "CPU data register" ULONG CU_MPL_ERROR_LOG_DETAILED[0].35 1 100 0.0 4294967295.0 ECU_ADDRESS 0xf02401fc BYTE_ORDER MSB_LAST /end MEASUREMENT
/begin COMPU_METHOD CU_MPL_ERROR_LOG_DETAILED[0].35 "Conversion method for mpl_error_log_detailed[0].err_log.csa.upper.D9" RAT_FUNC "%10.0" "(not defined)" COEFFS 0.000000 1.000000 -0.000000 0.000000 0.000000 1.000000 /end COMPU_METHOD
/* Scalar measurable for DDE 'mpl_error_log_detailed[0].err_log.csa.upper.PSW'. */
/begin MEASUREMENT mpl_error_log_detailed[0].err07 "CPU program status word" ULONG CU_MPL_ERROR_LOG_DETAILED[0].07 1 100 0.0 4294967295.0 ECU_ADDRESS 0xf02401ec BYTE_ORDER MSB_LAST /end MEASUREMENT
/begin COMPU_METHOD CU_MPL_ERROR_LOG_DETAILED[0].07 "Conversion method for mpl_error_log_detailed[0].err_log.csa.upper.PSW" RAT_FUNC "%10.0" "(not defined)" COEFFS 0.000000 1.000000 -0.000000 0.000000 0.000000 1.000000 /end COMPU_METHOD
/* Scalar measurable for DDE 'mpl_error_log_detailed[0].err_log.run_task_id'. */
/begin MEASUREMENT mpl_error_log_detailed[0].er041 "Handle of PXROS task, zero if PXROS not started" ULONG CU_MPL_ERROR_LOG_DETAILED[0]044 1 100 0.0 4294967295.0 ECU_ADDRESS 0xf02401e4 BYTE_ORDER MSB_LAST /end MEASUREMENT
/begin COMPU_METHOD CU_MPL_ERROR_LOG_DETAILED[0]044 "Conversion method for mpl_error_log_detailed[0].err_log.run_task_id" RAT_FUNC "%10.0" "handle" COEFFS 0.000000 1.000000 -0.000000 0.000000 0.000000 1.000000 /end COMPU_METHOD
/* Scalar measurable for DDE 'mpl_error_log_detailed[0].err_log.smu_alarms.smu_ad[0]'. */
/begin MEASUREMENT mpl_error_log_detailed[0].err44 "CPU SMU alarm debug register" ULONG CU_MPL_ERROR_LOG_DETAILED[0].46 1 100 0.0 4294967295.0 ECU_ADDRESS 0xf02403f0 BYTE_ORDER MSB_LAST /end MEASUREMENT
/begin COMPU_METHOD CU_MPL_ERROR_LOG_DETAILED[0].46 "Conversion method for mpl_error_log_detailed[0].err_log.smu_alarms.smu_ad[0]" RAT_FUNC "%10.0" "(not defined)" COEFFS 0.000000 1.000000 -0.000000 0.000000 0.000000 1.000000 /end COMPU_METHOD
/* Scalar measurable for DDE 'mpl_error_log_detailed[0].err_log.smu_alarms.smu_ad[10]'. */
/begin MEASUREMENT mpl_error_log_detailed[0].err15 "CPU SMU alarm debug register" ULONG CU_MPL_ERROR_LOG_DETAILED[0].16 1 100 0.0 4294967295.0 ECU_ADDRESS 0xf0240418 BYTE_ORDER MSB_LAST /end MEASUREMENT
/begin COMPU_METHOD CU_MPL_ERROR_LOG_DETAILED[0].16 "Conversion method for mpl_error_log_detailed[0].err_log.smu_alarms.smu_ad[10]" RAT_FUNC "%10.0" "(not defined)" COEFFS 0.000000 1.000000 -0.000000 0.000000 0.000000 1.000000 /end COMPU_METHOD
/* Scalar measurable for DDE 'mpl_error_log_detailed[0].err_log.smu_alarms.smu_ad[11]'. */
/begin MEASUREMENT mpl_error_log_detailed[0].err59 "CPU SMU alarm debug register" ULONG CU_MPL_ERROR_LOG_DETAILED[0].62 1 100 0.0 4294967295.0 ECU_ADDRESS 0xf024041c BYTE_ORDER MSB_LAST /end MEASUREMENT
/begin COMPU_METHOD CU_MPL_ERROR_LOG_DETAILED[0].62 "Conversion method for mpl_error_log_detailed[0].err_log.smu_alarms.smu_ad[11]" RAT_FUNC "%10.0" "(not defined)" COEFFS 0.000000 1.000000 -0.000000 0.000000 0.000000 1.000000 /end COMPU_METHOD
/* Scalar measurable for DDE 'mpl_error_log_detailed[0].err_log.smu_alarms.smu_ad[1]'. */
/begin MEASUREMENT mpl_error_log_detailed[0].er027 "CPU SMU alarm debug register" ULONG CU_MPL_ERROR_LOG_DETAILED[0]030 1 100 0.0 4294967295.0 ECU_ADDRESS 0xf02403f4 BYTE_ORDER MSB_LAST /end MEASUREMENT
/begin COMPU_METHOD CU_MPL_ERROR_LOG_DETAILED[0]030 "Conversion method for mpl_error_log_detailed[0].err_log.smu_alarms.smu_ad[1]" RAT_FUNC "%10.0" "(not defined)" COEFFS 0.000000 1.000000 -0.000000 0.000000 0.000000 1.000000 /end COMPU_METHOD
/* Scalar measurable for DDE 'mpl_error_log_detailed[0].err_log.smu_alarms.smu_ad[2]'. */
/begin MEASUREMENT mpl_error_log_detailed[0].err91 "CPU SMU alarm debug register" ULONG CU_MPL_ERROR_LOG_DETAILED[0].94 1 100 0.0 4294967295.0 ECU_ADDRESS 0xf02403f8 BYTE_ORDER MSB_LAST /end MEASUREMENT
/begin COMPU_METHOD CU_MPL_ERROR_LOG_DETAILED[0].94 "Conversion method for mpl_error_log_detailed[0].err_log.smu_alarms.smu_ad[2]" RAT_FUNC "%10.0" "(not defined)" COEFFS 0.000000 1.000000 -0.000000 0.000000 0.000000 1.000000 /end COMPU_METHOD
/* Scalar measurable for DDE 'mpl_error_log_detailed[0].err_log.smu_alarms.smu_ad[3]'. */
/begin MEASUREMENT mpl_error_log_detailed[0].err97 "CPU SMU alarm debug register" ULONG CU_MPL_ERROR_LOG_DETAILED[0]000 1 100 0.0 4294967295.0 ECU_ADDRESS 0xf02403fc BYTE_ORDER MSB_LAST /end MEASUREMENT
/begin COMPU_METHOD CU_MPL_ERROR_LOG_DETAILED[0]000 "Conversion method for mpl_error_log_detailed[0].err_log.smu_alarms.smu_ad[3]" RAT_FUNC "%10.0" "(not defined)" COEFFS 0.000000 1.000000 -0.000000 0.000000 0.000000 1.000000 /end COMPU_METHOD
/* Scalar measurable for DDE 'mpl_error_log_detailed[0].err_log.smu_alarms.smu_ad[4]'. */
/begin MEASUREMENT mpl_error_log_detailed[0].er010 "CPU SMU alarm debug register" ULONG CU_MPL_ERROR_LOG_DETAILED[0]013 1 100 0.0 4294967295.0 ECU_ADDRESS 0xf0240400 BYTE_ORDER MSB_LAST /end MEASUREMENT
/begin COMPU_METHOD CU_MPL_ERROR_LOG_DETAILED[0]013 "Conversion method for mpl_error_log_detailed[0].err_log.smu_alarms.smu_ad[4]" RAT_FUNC "%10.0" "(not defined)" COEFFS 0.000000 1.000000 -0.000000 0.000000 0.000000 1.000000 /end COMPU_METHOD
/* Scalar measurable for DDE 'mpl_error_log_detailed[0].err_log.smu_alarms.smu_ad[5]'. */
/begin MEASUREMENT mpl_error_log_detailed[0].err65 "CPU SMU alarm debug register" ULONG CU_MPL_ERROR_LOG_DETAILED[0].68 1 100 0.0 4294967295.0 ECU_ADDRESS 0xf0240404 BYTE_ORDER MSB_LAST /end MEASUREMENT
/begin COMPU_METHOD CU_MPL_ERROR_LOG_DETAILED[0].68 "Conversion method for mpl_error_log_detailed[0].err_log.smu_alarms.smu_ad[5]" RAT_FUNC "%10.0" "(not defined)" COEFFS 0.000000 1.000000 -0.000000 0.000000 0.000000 1.000000 /end COMPU_METHOD
/* Scalar measurable for DDE 'mpl_error_log_detailed[0].err_log.smu_alarms.smu_ad[6]'. */
/begin MEASUREMENT mpl_error_log_detailed[0].er033 "CPU SMU alarm debug register" ULONG CU_MPL_ERROR_LOG_DETAILED[0]036 1 100 0.0 4294967295.0 ECU_ADDRESS 0xf0240408 BYTE_ORDER MSB_LAST /end MEASUREMENT
/begin COMPU_METHOD CU_MPL_ERROR_LOG_DETAILED[0]036 "Conversion method for mpl_error_log_detailed[0].err_log.smu_alarms.smu_ad[6]" RAT_FUNC "%10.0" "(not defined)" COEFFS 0.000000 1.000000 -0.000000 0.000000 0.000000 1.000000 /end COMPU_METHOD
/* Scalar measurable for DDE 'mpl_error_log_detailed[0].err_log.smu_alarms.smu_ad[7]'. */
/begin MEASUREMENT mpl_error_log_detailed[0].err48 "CPU SMU alarm debug register" ULONG CU_MPL_ERROR_LOG_DETAILED[0].50 1 100 0.0 4294967295.0 ECU_ADDRESS 0xf024040c BYTE_ORDER MSB_LAST /end MEASUREMENT
/begin COMPU_METHOD CU_MPL_ERROR_LOG_DETAILED[0].50 "Conversion method for mpl_error_log_detailed[0].err_log.smu_alarms.smu_ad[7]" RAT_FUNC "%10.0" "(not defined)" COEFFS 0.000000 1.000000 -0.000000 0.000000 0.000000 1.000000 /end COMPU_METHOD
/* Scalar measurable for DDE 'mpl_error_log_detailed[0].err_log.smu_alarms.smu_ad[8]'. */
/begin MEASUREMENT mpl_error_log_detailed[0].err36 "CPU SMU alarm debug register" ULONG CU_MPL_ERROR_LOG_DETAILED[0].38 1 100 0.0 4294967295.0 ECU_ADDRESS 0xf0240410 BYTE_ORDER MSB_LAST /end MEASUREMENT
/begin COMPU_METHOD CU_MPL_ERROR_LOG_DETAILED[0].38 "Conversion method for mpl_error_log_detailed[0].err_log.smu_alarms.smu_ad[8]" RAT_FUNC "%10.0" "(not defined)" COEFFS 0.000000 1.000000 -0.000000 0.000000 0.000000 1.000000 /end COMPU_METHOD
/* Scalar measurable for DDE 'mpl_error_log_detailed[0].err_log.smu_alarms.smu_ad[9]'. */
/begin MEASUREMENT mpl_error_log_detailed[0].err51 "CPU SMU alarm debug register" ULONG CU_MPL_ERROR_LOG_DETAILED[0].53 1 100 0.0 4294967295.0 ECU_ADDRESS 0xf0240414 BYTE_ORDER MSB_LAST /end MEASUREMENT
/begin COMPU_METHOD CU_MPL_ERROR_LOG_DETAILED[0].53 "Conversion method for mpl_error_log_detailed[0].err_log.smu_alarms.smu_ad[9]" RAT_FUNC "%10.0" "(not defined)" COEFFS 0.000000 1.000000 -0.000000 0.000000 0.000000 1.000000 /end COMPU_METHOD
/* Scalar measurable for DDE 'mpl_error_log_detailed[0].err_log.smu_alarms.smu_ag[0]'. */
/begin MEASUREMENT mpl_error_log_detailed[0].err73 "CPU SMU alarm status register" ULONG CU_MPL_ERROR_LOG_DETAILED[0].76 1 100 0.0 4294967295.0 ECU_ADDRESS 0xf02403c0 BYTE_ORDER MSB_LAST /end MEASUREMENT
/begin COMPU_METHOD CU_MPL_ERROR_LOG_DETAILED[0].76 "Conversion method for mpl_error_log_detailed[0].err_log.smu_alarms.smu_ag[0]" RAT_FUNC "%10.0" "(not defined)" COEFFS 0.000000 1.000000 -0.000000 0.000000 0.000000 1.000000 /end COMPU_METHOD
/* Scalar measurable for DDE 'mpl_error_log_detailed[0].err_log.smu_alarms.smu_ag[10]'. */
/begin MEASUREMENT mpl_error_log_detailed[0].err94 "CPU SMU alarm status register" ULONG CU_MPL_ERROR_LOG_DETAILED[0].97 1 100 0.0 4294967295.0 ECU_ADDRESS 0xf02403e8 BYTE_ORDER MSB_LAST /end MEASUREMENT
/begin COMPU_METHOD CU_MPL_ERROR_LOG_DETAILED[0].97 "Conversion method for mpl_error_log_detailed[0].err_log.smu_alarms.smu_ag[10]" RAT_FUNC "%10.0" "(not defined)" COEFFS 0.000000 1.000000 -0.000000 0.000000 0.000000 1.000000 /end COMPU_METHOD
/* Scalar measurable for DDE 'mpl_error_log_detailed[0].err_log.smu_alarms.smu_ag[11]'. */
/begin MEASUREMENT mpl_error_log_detailed[0].err19 "CPU SMU alarm status register" ULONG CU_MPL_ERROR_LOG_DETAILED[0].20 1 100 0.0 4294967295.0 ECU_ADDRESS 0xf02403ec BYTE_ORDER MSB_LAST /end MEASUREMENT
/begin COMPU_METHOD CU_MPL_ERROR_LOG_DETAILED[0].20 "Conversion method for mpl_error_log_detailed[0].err_log.smu_alarms.smu_ag[11]" RAT_FUNC "%10.0" "(not defined)" COEFFS 0.000000 1.000000 -0.000000 0.000000 0.000000 1.000000 /end COMPU_METHOD
/* Scalar measurable for DDE 'mpl_error_log_detailed[0].err_log.smu_alarms.smu_ag[1]'. */
/begin MEASUREMENT mpl_error_log_detailed[0].er000 "CPU SMU alarm status register" ULONG CU_MPL_ERROR_LOG_DETAILED[0]003 1 100 0.0 4294967295.0 ECU_ADDRESS 0xf02403c4 BYTE_ORDER MSB_LAST /end MEASUREMENT
/begin COMPU_METHOD CU_MPL_ERROR_LOG_DETAILED[0]003 "Conversion method for mpl_error_log_detailed[0].err_log.smu_alarms.smu_ag[1]" RAT_FUNC "%10.0" "(not defined)" COEFFS 0.000000 1.000000 -0.000000 0.000000 0.000000 1.000000 /end COMPU_METHOD
/* Scalar measurable for DDE 'mpl_error_log_detailed[0].err_log.smu_alarms.smu_ag[2]'. */
/begin MEASUREMENT mpl_error_log_detailed[0].er001 "CPU SMU alarm status register" ULONG CU_MPL_ERROR_LOG_DETAILED[0]004 1 100 0.0 4294967295.0 ECU_ADDRESS 0xf02403c8 BYTE_ORDER MSB_LAST /end MEASUREMENT
/begin COMPU_METHOD CU_MPL_ERROR_LOG_DETAILED[0]004 "Conversion method for mpl_error_log_detailed[0].err_log.smu_alarms.smu_ag[2]" RAT_FUNC "%10.0" "(not defined)" COEFFS 0.000000 1.000000 -0.000000 0.000000 0.000000 1.000000 /end COMPU_METHOD
/* Scalar measurable for DDE 'mpl_error_log_detailed[0].err_log.smu_alarms.smu_ag[3]'. */
/begin MEASUREMENT mpl_error_log_detailed[0].err67 "CPU SMU alarm status register" ULONG CU_MPL_ERROR_LOG_DETAILED[0].70 1 100 0.0 4294967295.0 ECU_ADDRESS 0xf02403cc BYTE_ORDER MSB_LAST /end MEASUREMENT
/begin COMPU_METHOD CU_MPL_ERROR_LOG_DETAILED[0].70 "Conversion method for mpl_error_log_detailed[0].err_log.smu_alarms.smu_ag[3]" RAT_FUNC "%10.0" "(not defined)" COEFFS 0.000000 1.000000 -0.000000 0.000000 0.000000 1.000000 /end COMPU_METHOD
/* Scalar measurable for DDE 'mpl_error_log_detailed[0].err_log.smu_alarms.smu_ag[4]'. */
/begin MEASUREMENT mpl_error_log_detailed[0].er028 "CPU SMU alarm status register" ULONG CU_MPL_ERROR_LOG_DETAILED[0]031 1 100 0.0 4294967295.0 ECU_ADDRESS 0xf02403d0 BYTE_ORDER MSB_LAST /end MEASUREMENT
/begin COMPU_METHOD CU_MPL_ERROR_LOG_DETAILED[0]031 "Conversion method for mpl_error_log_detailed[0].err_log.smu_alarms.smu_ag[4]" RAT_FUNC "%10.0" "(not defined)" COEFFS 0.000000 1.000000 -0.000000 0.000000 0.000000 1.000000 /end COMPU_METHOD
/* Scalar measurable for DDE 'mpl_error_log_detailed[0].err_log.smu_alarms.smu_ag[5]'. */
/begin MEASUREMENT mpl_error_log_detailed[0].err04 "CPU SMU alarm status register" ULONG CU_MPL_ERROR_LOG_DETAILED[0].04 1 100 0.0 4294967295.0 ECU_ADDRESS 0xf02403d4 BYTE_ORDER MSB_LAST /end MEASUREMENT
/begin COMPU_METHOD CU_MPL_ERROR_LOG_DETAILED[0].04 "Conversion method for mpl_error_log_detailed[0].err_log.smu_alarms.smu_ag[5]" RAT_FUNC "%10.0" "(not defined)" COEFFS 0.000000 1.000000 -0.000000 0.000000 0.000000 1.000000 /end COMPU_METHOD
/* Scalar measurable for DDE 'mpl_error_log_detailed[0].err_log.smu_alarms.smu_ag[6]'. */
/begin MEASUREMENT mpl_error_log_detailed[0].err58 "CPU SMU alarm status register" ULONG CU_MPL_ERROR_LOG_DETAILED[0].61 1 100 0.0 4294967295.0 ECU_ADDRESS 0xf02403d8 BYTE_ORDER MSB_LAST /end MEASUREMENT
/begin COMPU_METHOD CU_MPL_ERROR_LOG_DETAILED[0].61 "Conversion method for mpl_error_log_detailed[0].err_log.smu_alarms.smu_ag[6]" RAT_FUNC "%10.0" "(not defined)" COEFFS 0.000000 1.000000 -0.000000 0.000000 0.000000 1.000000 /end COMPU_METHOD
/* Scalar measurable for DDE 'mpl_error_log_detailed[0].err_log.smu_alarms.smu_ag[7]'. */
/begin MEASUREMENT mpl_error_log_detailed[0].err_3 "CPU SMU alarm status register" ULONG CU_MPL_ERROR_LOG_DETAILED[0].E3 1 100 0.0 4294967295.0 ECU_ADDRESS 0xf02403dc BYTE_ORDER MSB_LAST /end MEASUREMENT
/begin COMPU_METHOD CU_MPL_ERROR_LOG_DETAILED[0].E3 "Conversion method for mpl_error_log_detailed[0].err_log.smu_alarms.smu_ag[7]" RAT_FUNC "%10.0" "(not defined)" COEFFS 0.000000 1.000000 -0.000000 0.000000 0.000000 1.000000 /end COMPU_METHOD
/* Scalar measurable for DDE 'mpl_error_log_detailed[0].err_log.smu_alarms.smu_ag[8]'. */
/begin MEASUREMENT mpl_error_log_detailed[0].err05 "CPU SMU alarm status register" ULONG CU_MPL_ERROR_LOG_DETAILED[0].05 1 100 0.0 4294967295.0 ECU_ADDRESS 0xf02403e0 BYTE_ORDER MSB_LAST /end MEASUREMENT
/begin COMPU_METHOD CU_MPL_ERROR_LOG_DETAILED[0].05 "Conversion method for mpl_error_log_detailed[0].err_log.smu_alarms.smu_ag[8]" RAT_FUNC "%10.0" "(not defined)" COEFFS 0.000000 1.000000 -0.000000 0.000000 0.000000 1.000000 /end COMPU_METHOD
/* Scalar measurable for DDE 'mpl_error_log_detailed[0].err_log.smu_alarms.smu_ag[9]'. */
/begin MEASUREMENT mpl_error_log_detailed[0].er035 "CPU SMU alarm status register" ULONG CU_MPL_ERROR_LOG_DETAILED[0]038 1 100 0.0 4294967295.0 ECU_ADDRESS 0xf02403e4 BYTE_ORDER MSB_LAST /end MEASUREMENT
/begin COMPU_METHOD CU_MPL_ERROR_LOG_DETAILED[0]038 "Conversion method for mpl_error_log_detailed[0].err_log.smu_alarms.smu_ag[9]" RAT_FUNC "%10.0" "(not defined)" COEFFS 0.000000 1.000000 -0.000000 0.000000 0.000000 1.000000 /end COMPU_METHOD
/* Scalar measurable for DDE 'mpl_error_log_detailed[1].err.id'. */
/begin MEASUREMENT mpl_error_log_detailed[1].err.2 "Error code of fault raised" SWORD CU_MPL_ERROR_LOG_DETAILED[1].71 1 100 0.0 32767.0 ECU_ADDRESS 0xf0240420 BYTE_ORDER MSB_LAST /end MEASUREMENT
/begin COMPU_METHOD CU_MPL_ERROR_LOG_DETAILED[1].71 "Conversion method for mpl_error_log_detailed[1].err.id" TAB_VERB "%12.0" "code" COMPU_TAB_REF CT_MPL_ERROR_LOG_DETAILED[1].71 /end COMPU_METHOD
/begin COMPU_VTAB CT_MPL_ERROR_LOG_DETAILED[1].71 "Conversion method for mpl_error_log_detailed[1].err.id" TAB_VERB 464 0 "PIO_PSY_NO_ERROR" 1 "PIO_TRAP_0_TIN_0_VAF" 2 "PIO_TRAP_0_TIN_1_VAP" 3 "PIO_TRAP_0_TIN_UNKNOWN" 4 "PIO_TRAP_1_TIN_1_PRIV" 5 "PIO_TRAP_1_TIN_2_MPR" 6 "PIO_TRAP_1_TIN_3_MPW" 7 "PIO_TRAP_1_TIN_4_MPX" 8 "PIO_TRAP_1_TIN_5_MPP" 9 "PIO_TRAP_1_TIN_6_MPN" 10 "PIO_TRAP_1_TIN_7_GRWP" 11 "PIO_TRAP_1_TIN_UNKNOWN" 12 "PIO_TRAP_2_TIN_1_IOPC" 13 "PIO_TRAP_2_TIN_2_UOPC" 14 "PIO_TRAP_2_TIN_3_OPD" 15 "PIO_TRAP_2_TIN_4_ALN" 16 "PIO_TRAP_2_TIN_5_MEM" 17 "PIO_TRAP_2_TIN_UNKNOWN" 18 "PIO_TRAP_3_TIN_1_FCD" 19 "PIO_TRAP_3_TIN_2_FCD" 20 "PIO_TRAP_3_TIN_3_CDU" 21 "PIO_TRAP_3_TIN_4_FCU" 22 "PIO_TRAP_3_TIN_5_CSU" 23 "PIO_TRAP_3_TIN_6_CTYP" 24 "PIO_TRAP_3_TIN_7_NEST" 25 "PIO_TRAP_3_TIN_UNKNOWN" 26 "PIO_TRAP_4_TIN_1_PSE" 27 "PIO_TRAP_4_TIN_2_DSE" 28 "PIO_TRAP_4_TIN_3_DAE" 29 "PIO_TRAP_4_TIN_4_CAE" 30 "PIO_TRAP_4_TIN_4_CAE_UNEXPECTED" 31 "PIO_TRAP_4_TIN_4_CAE_UNEXPECTED_FW" 32 "PIO_TRAP_4_TIN_5_PIE" 33 "PIO_TRAP_4_TIN_6_DIE" 34 "PIO_TRAP_4_TIN_7_DIE" 35 "PIO_TRAP_4_TIN_5_6_UNEXPECTED" 36 "PIO_TRAP_4_TIN_UNKNOWN" 37 "PIO_TRAP_5_TIN_1_OVF" 38 "PIO_TRAP_5_TIN_2_SOVF" 39 "PIO_TRAP_5_TIN_UNKNOWN" 40 "PIO_TRAP_6_SYS_UNKNOWN" 41 "PIO_TRAP_7_TIN_0_NMI" 42 "PIO_TRAP_7_TIN_UNKNOWN" 43 "PIO_ISR_0_RESET" 44 "PIO_BSPI_FIRST" 45 "PIO_BSPI_TRANSFER_TIMEOUT" 46 "PIO_BSPI_TX_DMA_ERROR" 47 "PIO_BSPI_RX_DMA_ERROR" 48 "PIO_BSPI_DSPI_ERROR" 49 "PIO_BSPI_RX_FIFO_OVERFLOW" 50 "PIO_BSPI_TX_FIFO_UNDERFLOW" 51 "PIO_BSPI_TRANSFER_TERMINATED" 52 "PIO_BSPI_TRANSAC_FAILED" 53 "PIO_BSPI_INTERNAL_SOFTWARE_ERROR" 54 "PIO_BSPI_ISR_MINIMUM_DELAY_TIME_NOT_MET" 55 "PIO_BSPI_ISR_FALSE_INT" 56 "PIO_BSPI_DMA_SAFETY_ERROR" 57 "PIO_BSPI_LAST" 58 "PIO_P1WR_ISR_MINIMUM_DELAY_TIME_NOT_MET" 59 "PIO_PADC_BUFFER_INIT_FAILED" 60 "PIO_PAX_ADC_INPUT_INVALID_ARG" 61 "PIO_PAX_CHANNEL_INVALID" 62 "PIO_PAX_ADC_INPUT_CHANNEL_UNSUPPORTED" 63 "PIO_PAX_CC_OUTPUT_CHANNEL_UNSUPPORTED" 64 "PIO_PAX_AOT_OUTPUT_CHANNEL_UNSUPPORTED" 65 "PIO_PAX_ISR_MINIMUM_DELAY_TIME_NOT_MET" 66 "PIO_PCANOPEN_RESET" 67 "PIO_PCANOPEN_BUFFER_OUT_OF_RANGE" 68 "PIO_PCANOPEN_NULL_POINTER" 69 "PIO_PCCP_RESET" 70 "PIO_PCCU6_ISR_MINIMUM_DELAY_TIME_NOT_MET" 71 "PIO_PCFG_INTERNAL_SW_ERROR" 72 "PIO_PCX_ERR_BUS_ID_OUT_OF_RANGE" 73 "PIO_PCX_ERR_DATA_LENGTH_OUT_OF_RANGE" 74 "PIO_PCX_ERR_STD_ID_OUT_OF_RANGE" 75 "PIO_PCX_ERR_EXT_ID_OUT_OF_RANGE" 76 "PIO_PCX_ERR_SAME_TX_MSG_DIFFERING_ATTRIBS" 77 "PIO_PCX_ERR_TOO_MANY_TX_MSGS" 78 "PIO_PCX_ERR_DUPLICATE_RX_MSG" 79 "PIO_PCX_ERR_TOO_MANY_RX_MSGS" 80 "PIO_PCX_ERR_BIT_RATE_IN_CONFIG_DIFFERS" 81 "PIO_PCX_ERR_UNSUPPORTED_BIT_RATE" 82 "PIO_PCX_ERR_BUS_ID_IN_CONFIG" 83 "PIO_PCX_ERR_NO_BITRATE_TABLE_MATCH" 84 "PIO_PCX_ERR_PACK_MSG_INVALID_PARAM" 85 "PIO_PCX_ERR_PACK_MSG_FIELD_PARAM" 86 "PIO_PCX_ERR_UNPACK_MSG_INVALID_PARAM" 87 "PIO_PCX_ERR_UNPACK_MSG_FIELD_PARAM" 88 "PIO_PCX_ERR_PACK_VDB_MSG_INVALID_PARAM" 89 "PIO_PCX_ERR_UNPACK_VDB_MSG_INVALID_PARAM" 90 "PIO_PCX_ERR_SWITCHED_RATE_FOR_NONFD_BUS" 91 "PIO_PCX_ERR_RX_MSG_FOR_UNCONFIG_BUS_0" 92 "PIO_PCX_ERR_UNSUPPORTED_BUS_MODE" 93 "PIO_PCX_ERR_BUS_MODE_IN_CONFIG_DIFFERS" 94 "PIO_PCX_ERR_SAME_RX_MSG_DIFFERING_ATTRIBS" 95 "PIO_PCX_ERR_TX_MSG_FOR_UNCONFIG_BUS_0" 96 "PIO_PCX_ISR_MINIMUM_DELAY_TIME_NOT_MET" 97 "PIO_PDD_CHANNEL_INVALID" 98 "PIO_PDD_DIG_DATA_IN_CHANNEL_UNSUPPORTED" 99 "PIO_PDD_DIG_DATA_OUT_CHANNEL_UNSUPPORTED" 100 "PIO_PDG_ERR_FORCED_RESET" 101 "PIO_PDTC_UPDATE_INVALID_ARG" 102 "PIO_PDTC_CLEAR_ALL_INVALID_ARG" 103 "PIO_PDTC_CLEAR_ALL_IF_ACT_INVALID_ARG" 104 "PIO_PDTC_CLEAR_ALL_IF_INACT_INVALID_ARG" 105 "PIO_PDTC_GET_DTC_STATUS_INVALID_ARG" 106 "PIO_PDTC_MATCH_EXISTS_INVALID_ARG" 107 "PIO_PDTC_CLEAR_DTCS_INVALID_ARG" 108 "PIO_PDTC_BAD_LICENSE" 109 "PIO_PDX_DO_CHANNEL_UNSUPPORTED" 110 "PIO_PDX_DIG_IN_CHANNEL_UNSUPPORTED" 111 "PIO_PDX_FREQ_IN_CHANNEL_UNSUPPORTED" 112 "PIO_PDX_PERIOD_IN_CHANNEL_UNSUPPORTED" 113 "PIO_PDX_QDEC_FREQ_IN_INVALID_ARG" 114 "PIO_PDX_QDEC_FREQ_IN_CHANNEL_UNSUPPORTED" 115 "PIO_PDX_TPU_QFI_CHANNEL_DEVICE_ERROR" 116 "PIO_PDX_QDEC_IN_CHANNEL_UNSUPPORTED" 117 "PIO_PDX_TPU_QI_CHANNEL_DEVICE_ERROR" 118 "PIO_PDX_PWM_OUT_CHANNEL_UNSUPPORTED" 119 "PIO_PDX_PWM_IN_CHANNEL_UNSUPPORTED" 120 "PIO_PDX_CHANNEL_INVALID" 121 "PIO_PDX_HBRIDGE_INVALID_MODE" 122 "PIO_PDX_HBRIDGE_DECODE_ERROR" 123 "PIO_PDX_HBRIDGE_CHANNEL_GROUP_UNSUPPORTED" 124 "PIO_PEM_EXTERNAL_RAM_REQUIRED" 125 "PIO_PEM_MEM_CONFIG_UNKNOWN" 126 "PIO_PETH_ERR_DRIVER_INITIALIZATION_ERROR" 127 "PIO_PETH_ERR_NULL_CONFIGURATION_POINTER" 128 "PIO_PETH_ERR_DATA_LENGTH_OUT_OF_RANGE" 129 "PIO_PETH_ERR_TOO_MANY_TX_MSGS" 130 "PIO_PETH_ERR_NOT_SUPPORTED" 131 "PIO_PFF_HOLDING_ARRAY_INDEX_INVALID" 132 "PIO_PFF_HOLDING_ARRAY_STRT_END_INVALID" 133 "PIO_PFF_HOLDING_ARRAY_REC_DATA_INVALID" 134 "PIO_PFF_STORED_FF_DTC_INVALID" 135 "PIO_PFF_STORED_DTC_READ_FAILURE" 136 "PIO_PFF_CAPTURE_PID_DATA_FAILURE" 137 "PIO_PFF_STARTUP_FFNO_ERROR" 138 "PIO_PFF_NVM_ALLOCATION_EXCEEDED" 139 "PIO_PFS_ECC_ERROR_DURING_FLASH_OP" 140 "PIO_PFS_RUNTIME_CORRUPT_FILE_FOUND" 141 "PIO_PKN_ERR_KERNEL_STARTED_BELOW_KERNEL_LEVEL" 142 "PIO_PKN_ERR_INVALID_RESOURCE_HANDLE" 143 "PIO_PKN_ERR_TASK_NOT_DECLARED_AS_ACQUIRING_RESOURCE" 144 "PIO_PKN_ERR_INVALID_TASK_HANDLE" 145 "PIO_PKN_ERR_INVALID_PERIODIC_TASK_HANDLE" 146 "PIO_PKN_ERR_UNEXPECTED_EXCEPTION" 147 "PIO_PKN_ERR_TASK_RESOURCE_CORE_DIFFER" 148 "PIO_PKN_ERR_TASK_RELEASE_RESOURCE_FAIL" 149 "PIO_PKN_ERR_ACQUIRING_RESOURCE_PRIORITY_CHANGE_FAIL" 150 "PIO_PKN_ERR_RELEASING_RESOURCE_PRIORITY_CHANGE_FAIL" 151 "PIO_PKN_ERR_TASK_RELEASE_RESOURCE_NEVER_ACQ" 152 "PIO_PKN_ERR_CLEAR_RESOURCE_SET_TASK_PRIO" 153 "PIO_PKN_ERR_ACQUIRING_RESOURCE_ALREADY_ACQUIRED" 154 "PIO_PJ1939_INVALID_CHANNEL" 155 "PIO_PJ1939_PG_TRANSMIT_RING_DEQUEUE_FAIL" 156 "PIO_PJ1939_DM6_TRANSMIT_INVALID_ARG" 157 "PIO_PJ1939_DM12_TRANSMIT_INVALID_ARG" 158 "PIO_PJ1939_DM14_DECODE_INVALID_ARG" 159 "PIO_PJ1939_DM15_TRANSMIT_INVALID_ARG" 160 "PIO_PJ1939_DM16_DECODE_INVALID_ARG" 161 "PIO_PJ1939_DM23_TRANSMIT_INVALID_ARG" 162 "PIO_PJ1939_DM27_TRANSMIT_INVALID_ARG" 163 "PIO_PJ1939_DM28_TRANSMIT_INVALID_ARG" 164 "PIO_PJ1939_DM29_TRANSMIT_INVALID_ARG" 165 "PIO_PJ1939_DM31_TRANSMIT_INVALID_ARG" 166 "PIO_PJ1939_DM41_TRANSMIT_INVALID_ARG" 167 "PIO_PJ1939_DM42_TRANSMIT_INVALID_ARG" 168 "PIO_PJ1939_DM43_TRANSMIT_INVALID_ARG" 169 "PIO_PJ1939_DM44_TRANSMIT_INVALID_ARG" 170 "PIO_PJ1939_DM45_TRANSMIT_INVALID_ARG" 171 "PIO_PJ1939_DM46_TRANSMIT_INVALID_ARG" 172 "PIO_PJ1939_DM47_TRANSMIT_INVALID_ARG" 173 "PIO_PJ1939_DM48_TRANSMIT_INVALID_ARG" 174 "PIO_PJ1939_DM49_TRANSMIT_INVALID_ARG" 175 "PIO_PJ1939_DM50_TRANSMIT_INVALID_ARG" 176 "PIO_PJ1939_DM51_TRANSMIT_INVALID_ARG" 177 "PIO_PJ1939_DM52_TRANSMIT_INVALID_ARG" 178 "PIO_PJ1939_INVALID_RING_BUFFER_ARG" 179 "PIO_PJ1939_DM1_RECEIVE_INVALID_ARG" 180 "PIO_PJ1939_DM2_RECEIVE_INVALID_ARG" 181 "PIO_PMCAL_ADC_INIT_CHECK_ERROR" 182 "PIO_PSAF_ERROR_STANDBY_INIT" 183 "PIO_PSAF_ISR_MINIMUM_DELAY_TIME_NOT_MET" 184 "PIO_PSAF_ERROR_CLOCK_PLAUSIBILITY" 185 "PIO_PSC_DECODE_RESET_INVALID_ARG" 186 "PIO_PSC_ERR_FORCED_RESET" 187 "PIO_PSC_ERR_STANDY_ENTRY" 188 "PIO_PSC_ERR_VERSION_INVALID_PARAM" 189 "PIO_PSC_ERR_BUILD_DATE_INVALID_PARAM" 190 "PIO_PSC_ERR_PART_NUMBER_INVALID_PARAM" 191 "PIO_PSC_UNEXPECTED_CVN_CHANGE" 192 "PIO_PSC_ERR_HW_VERSION_UNKNOWN" 193 "PIO_PSENT_IN_CHANNEL_UNSUPPORTED" 194 "PIO_PSMC_INVALID_DATA" 195 "PIO_PSMC_INTERNAL_SW_ERROR" 196 "PIO_PSTP_SAFETPACK_INIT_FAILURE" 197 "PIO_PSTP_SMU_MODE_INVALID_DURING_INIT" 198 "PIO_PSTP_SMU_MODE_RUN_DURING_INIT" 199 "PIO_PSTP_SMU_FAIL_INIT" 200 "PIO_PSTP_SMU_FAIL_ALARM_CONFIG" 201 "PIO_PSTP_SMU_SW_ALARM_GROUP_0" 202 "PIO_PSTP_SMU_SW_ALARM_GROUP_1" 203 "PIO_PSTP_SMU_SW_ALARM_GROUP_2" 204 "PIO_PSTP_SMU_SW_ALARM_GROUP_3" 205 "PIO_PSTP_SMU_SW_ALARM_GROUP_4" 206 "PIO_PSTP_SMU_SW_ALARM_GROUP_5" 207 "PIO_PSTP_SMU_SW_ALARM_GROUP_6" 208 "PIO_PSTP_SMU_SW_ALARM_GROUP_7" 209 "PIO_PSTP_SMU_SW_ALARM_GROUP_8" 210 "PIO_PSTP_SMU_SW_ALARM_GROUP_9" 211 "PIO_PSTP_SMU_SW_ALARM_GROUP_10" 212 "PIO_PSTP_SMU_SW_ALARM_GROUP_11" 213 "PIO_PSTP_SMU_SW_ALARM_GROUP_12" 214 "PIO_PSTP_SMU_SW_ALARM_GROUP_13" 215 "PIO_PSTP_SMU_SW_ALARM_GROUP_14" 216 "PIO_PSTP_SMU_SW_ALARM_GROUP_15" 217 "PIO_PSTP_SWDGM_UNEXPECTED" 218 "PIO_PSTP_SWDGM_INIT_FAIL" 219 "PIO_PSTP_SWDGM_ACTIVATE_FAIL" 220 "PIO_PSTP_SWDGM_DEINIT_FAIL" 221 "PIO_PSTP_SWDGM_GETERRCNTR_FAIL" 222 "PIO_PSTP_SWDGM_GETINFO_FAIL" 223 "PIO_PSTP_SWDGM_GETSEED_FAIL" 224 "PIO_PSTP_SWDGM_USERREQ_FAIL" 225 "PIO_PSTP_SWDGM_SERVICE_FAIL" 226 "PIO_PSTP_TSTM_STARTUP_TEST_FAIL" 227 "PIO_PSTP_TSTM_RUNTIME_TEST_FAIL" 228 "PIO_PSTP_TSTM_INIT_FAIL" 229 "PIO_PSTP_TSTM_SWITCH_TO_RUN_FAIL" 230 "PIO_PSTP_TLF_TEST_FAIL" 231 "PIO_PSTP_TLF_MAXJOBS_FAIL" 232 "PIO_PSTP_SEID_INCORRECT" 233 "PIO_PSTP_CHECKPOINT_INCORRECT" 234 "PIO_PSTP_ERR_TASK_BUDGET_OVRRUN" 235 "PIO_PSTP_HTXTESTHND_INVALID_RESULT" 236 "PIO_PSTP_HTXTESTHND_TEST_NOT_EXECUTED" 237 "PIO_PSTP_HTXLBIST_CALLER_ADDR_ERR" 238 "PIO_PSTP_HTXLBIST_PORST_ERR" 239 "PIO_PSTP_HTXLBIST_TERMINATION_ERR" 240 "PIO_PSTP_HTXLBIST_DEFAULT_SIGNATURE_ERR" 241 "PIO_PSTP_HTXLBIST_CRC_ERR" 242 "PIO_PSTP_HTXLBIST_UNDEFINED_ERR" 243 "PIO_PSTP_HTXLBIST_INV_PARAM_ERR" 244 "PIO_PSTP_HTXSFRTST_CMP_INV_PARAM_ERR" 245 "PIO_PSTP_HTXSFRTST_CMP_OVERLOAD" 246 "PIO_PSTP_HTXSFRTST_CMP_VAL_ERR" 247 "PIO_PSTP_HTXSFRTST_CRC_INV_PARAM_ERR" 248 "PIO_PSTP_HTXSFRTST_CRC_DATAMISMATCH" 249 "PIO_PSTP_HTXREGMON_SMU_TIMEOUT" 250 "PIO_PSTP_HTXREGMON_ERR_UNDEFINED" 251 "PIO_PSTP_HTXREGMON_ERR_MTU_TIMEOUT_UND" 252 "PIO_PSTP_HTXREGMON_INV_PARAM_ERR" 253 "PIO_PSTP_HTXREGMON_ERR_MTU_FAILED" 254 "PIO_PSTP_HTXMONBIST_ERR_SMU_FLAG" 255 "PIO_PSTP_HTXMONBIST_ERR_PMS_FLAG" 256 "PIO_PSTP_HTXMONBIST_ERR_PMS_SMU_FLAG" 257 "PIO_PSTP_HTXMONBIST_ERR_TIMEOUT" 258 "PIO_PSTP_HTXMONBIST_ERR_UNSPECIFIED" 259 "PIO_PSTP_HTXMONBIST_ERR_SFR_CONFIG" 260 "PIO_PSTP_HTXDTSRESULT_A_FAILED_ERR_DIFF" 261 "PIO_PSTP_HTXDTSRESULT_B_FAILED_ERR_DIFF" 262 "PIO_PSTP_HTXSMUALIVEALARM_ERR_ALM_STS" 263 "PIO_PSTP_HTXSMUALIVEALARM_ERR_TRIG" 264 "PIO_PSTP_HTXSMUALIVEALARM_PREV_ALM_STS" 265 "PIO_PSTP_HTXSMUALIVEALARM_ERR_SMU_RUN" 266 "PIO_PSTP_HTXVMTMBIST_ERR_MTU_UNDEFINED" 267 "PIO_PSTP_HTXVMTMBIST_ERR_MTU_TIMEOUT_UND" 268 "PIO_PSTP_HTXVMTMBIST_INV_PARAM_ERR" 269 "PIO_PSTP_HTXFWCHECK_FAILED" 270 "PIO_PSTP_HTXFWCHECK_INV_PARAM_ERR" 271 "PIO_PSTP_HTXFWCHECK_RST_UNKNOWN" 272 "PIO_PSTP_HTXFWCHECK_SFR_NOT_CLEARED" 273 "PIO_PSTP_HTXFWCHECK_DATA_ERR" 274 "PIO_PSTP_HTXPFM_UNEXPECTED_ERROR" 275 "PIO_PSTP_HTXPFM_RAM_CORRUPTION" 276 "PIO_PSTP_HTXPFM_ILLEGAL_FUNCTION_ARGUMENT" 277 "PIO_PSTP_HTXPFM_SYSTEM_TIMER_READ_FAULT" 278 "PIO_PSTP_HTXPFM_ILLEGAL_REINIT" 279 "PIO_PSTP_HTXPFM_UNEXPECTED_SEID" 280 "PIO_PSTP_HTXPFM_LOGICAL_FAULT_DETECTED" 281 "PIO_PSTP_HTXPFM_DEADLINE_FAULT_DETECTED" 282 "PIO_PSTP_HTXPFM_TIMING_FAULT_DETECTED" 283 "PIO_PSTP_HTXPFM_ALIVENESS_FAULT_DETECTED" 284 "PIO_PSY_ERR_SMU_ASSERT" 285 "PIO_PTM_TIMER_ERROR" 286 "PIO_PUT_DEBOUNCE_BY_CYCLES_INVALID_ARG" 287 "PIO_PUT_LEAKY_BUCKET_INVALID_ARG" 288 "PIO_PUT_DEBOUNCE_BY_TIME_INVALID_ARG" 289 "PIO_PUT_DUTYCYCLE_PROCESSING_INVALID_ARG" 290 "PIO_PUT_STATE_PROCESSING_INVALID_ARG" 291 "PIO_PUT_ARRAY_SEARCH_INVALID_ARG" 292 "PIO_PUT_ERR_PACK_INVALID_PARAM" 293 "PIO_PUT_ERR_UNPACK_INVALID_PARAM" 294 "PIO_PXCP_RESET" 295 "PIO_PUART_MCAL_INIT_CHECK_ERROR" 296 "PIO_ALARM_0_TYPE_0_CPU" 297 "PIO_ALARM_0_TYPE_1_CPU" 298 "PIO_ALARM_0_TYPE_2_CPU" 299 "PIO_ALARM_0_TYPE_4_MTU" 300 "PIO_ALARM_0_TYPE_5_MTU" 301 "PIO_ALARM_0_TYPE_6_MTU" 302 "PIO_ALARM_0_TYPE_7_MTU" 303 "PIO_ALARM_0_TYPE_8_MTU" 304 "PIO_ALARM_0_TYPE_9_MTU" 305 "PIO_ALARM_0_TYPE_10_MTU" 306 "PIO_ALARM_0_TYPE_11_MTU" 307 "PIO_ALARM_0_TYPE_12_MTU" 308 "PIO_ALARM_0_TYPE_13_MTU" 309 "PIO_ALARM_0_TYPE_14_MTU" 310 "PIO_ALARM_0_TYPE_22_CPU" 311 "PIO_ALARM_0_TYPE_23_CPU" 312 "PIO_ALARM_0_TYPE_24_CPU" 313 "PIO_ALARM_1_TYPE_0_CPU" 314 "PIO_ALARM_1_TYPE_1_CPU" 315 "PIO_ALARM_1_TYPE_2_CPU" 316 "PIO_ALARM_1_TYPE_4_MTU" 317 "PIO_ALARM_1_TYPE_5_MTU" 318 "PIO_ALARM_1_TYPE_6_MTU" 319 "PIO_ALARM_1_TYPE_7_MTU" 320 "PIO_ALARM_1_TYPE_8_MTU" 321 "PIO_ALARM_1_TYPE_9_MTU" 322 "PIO_ALARM_1_TYPE_10_MTU" 323 "PIO_ALARM_1_TYPE_11_MTU" 324 "PIO_ALARM_1_TYPE_12_MTU" 325 "PIO_ALARM_1_TYPE_13_MTU" 326 "PIO_ALARM_1_TYPE_14_MTU" 327 "PIO_ALARM_1_TYPE_22_MTU" 328 "PIO_ALARM_1_TYPE_23_CPU" 329 "PIO_ALARM_1_TYPE_24_CPU" 330 "PIO_ALARM_6_TYPE_0_MTU" 331 "PIO_ALARM_6_TYPE_1_IOM" 332 "PIO_ALARM_6_TYPE_2_IR" 333 "PIO_ALARM_6_TYPE_4_SCU" 334 "PIO_ALARM_6_TYPE_5_PMS" 335 "PIO_ALARM_6_TYPE_6_DMA" 336 "PIO_ALARM_6_TYPE_7_SMU_CORE" 337 "PIO_ALARM_6_TYPE_8_CCU" 338 "PIO_ALARM_6_TYPE_10_GTM" 339 "PIO_ALARM_6_TYPE_11_GTM" 340 "PIO_ALARM_6_TYPE_12_GTM" 341 "PIO_ALARM_6_TYPE_13_ERAY" 342 "PIO_ALARM_6_TYPE_14_ERAY" 343 "PIO_ALARM_6_TYPE_15_SRAM" 344 "PIO_ALARM_6_TYPE_16_CAN" 345 "PIO_ALARM_6_TYPE_17_CAN" 346 "PIO_ALARM_6_TYPE_18_CAN" 347 "PIO_ALARM_6_TYPE_19_MISC" 348 "PIO_ALARM_6_TYPE_20_MISC" 349 "PIO_ALARM_6_TYPE_21_MISC" 350 "PIO_ALARM_6_TYPE_23_CBS" 351 "PIO_ALARM_6_TYPE_24_CCU" 352 "PIO_ALARM_6_TYPE_25_CCU" 353 "PIO_ALARM_7_TYPE_0_DAM0" 354 "PIO_ALARM_7_TYPE_1_LMU" 355 "PIO_ALARM_7_TYPE_2_LMU" 356 "PIO_ALARM_7_TYPE_17_XBAR0" 357 "PIO_ALARM_7_TYPE_20_SPB" 358 "PIO_ALARM_7_TYPE_22_FSI" 359 "PIO_ALARM_7_TYPE_23_FSI" 360 "PIO_ALARM_7_TYPE_24_FSI" 361 "PIO_ALARM_7_TYPE_25_FSI" 362 "PIO_ALARM_7_TYPE_26_FSI" 363 "PIO_ALARM_7_TYPE_27_FSI" 364 "PIO_ALARM_7_TYPE_28_FSI" 365 "PIO_ALARM_7_TYPE_29_FSI" 366 "PIO_ALARM_7_TYPE_30_FSI" 367 "PIO_ALARM_7_TYPE_31_FSI" 368 "PIO_ALARM_8_TYPE_0_SCU" 369 "PIO_ALARM_8_TYPE_1_CCU" 370 "PIO_ALARM_8_TYPE_2_CCU" 371 "PIO_ALARM_8_TYPE_3_SCU" 372 "PIO_ALARM_8_TYPE_4_SCU" 373 "PIO_ALARM_8_TYPE_5_SCU" 374 "PIO_ALARM_8_TYPE_6_SCU" 375 "PIO_ALARM_8_TYPE_7_SCU" 376 "PIO_ALARM_8_TYPE_8_SCU" 377 "PIO_ALARM_8_TYPE_9_SCU" 378 "PIO_ALARM_8_TYPE_10_SCU" 379 "PIO_ALARM_8_TYPE_11_SCU" 380 "PIO_ALARM_8_TYPE_16_SCU" 381 "PIO_ALARM_8_TYPE_17_SCU" 382 "PIO_ALARM_8_TYPE_18_SCU" 383 "PIO_ALARM_8_TYPE_19_SCU" 384 "PIO_ALARM_8_TYPE_20_SCU" 385 "PIO_ALARM_8_TYPE_21_SCU" 386 "PIO_ALARM_8_TYPE_22_IR" 387 "PIO_ALARM_8_TYPE_23_DMA" 388 "PIO_ALARM_8_TYPE_25_IOM" 389 "PIO_ALARM_8_TYPE_26_SCU" 390 "PIO_ALARM_8_TYPE_27_SCU" 391 "PIO_ALARM_8_TYPE_28_SCU" 392 "PIO_ALARM_8_TYPE_29_SCU" 393 "PIO_ALARM_8_TYPE_30_SCU" 394 "PIO_ALARM_8_TYPE_31_SCU" 395 "PIO_ALARM_9_TYPE_0_DTS" 396 "PIO_ALARM_9_TYPE_1_DTS" 397 "PIO_ALARM_9_TYPE_3_PMS" 398 "PIO_ALARM_9_TYPE_5_PMS" 399 "PIO_ALARM_9_TYPE_15_PMS" 400 "PIO_ALARM_9_TYPE_16_PMS" 401 "PIO_ALARM_9_TYPE_17_PMS" 402 "PIO_ALARM_10_TYPE_0_SW" 403 "PIO_ALARM_10_TYPE_1_SW" 404 "PIO_ALARM_10_TYPE_2_SW" 405 "PIO_ALARM_10_TYPE_3_SW" 406 "PIO_ALARM_10_TYPE_4_SW" 407 "PIO_ALARM_10_TYPE_5_SW" 408 "PIO_ALARM_10_TYPE_6_SW" 409 "PIO_ALARM_10_TYPE_7_SW" 410 "PIO_ALARM_10_TYPE_8_SW" 411 "PIO_ALARM_10_TYPE_9_SW" 412 "PIO_ALARM_10_TYPE_10_SW" 413 "PIO_ALARM_10_TYPE_11_SW" 414 "PIO_ALARM_10_TYPE_12_SW" 415 "PIO_ALARM_10_TYPE_13_SW" 416 "PIO_ALARM_10_TYPE_14_SW" 417 "PIO_ALARM_10_TYPE_15_SW" 418 "PIO_ALARM_10_TYPE_16_SMU_CORE" 419 "PIO_ALARM_10_TYPE_17_SMU_CORE" 420 "PIO_ALARM_10_TYPE_18_FSP" 421 "PIO_ALARM_10_TYPE_20_CCU" 422 "PIO_ALARM_10_TYPE_21_SFF" 423 "PIO_ALARM_10_TYPE_22_SFF" 424 "PIO_ALARM_11_TYPE_2_XBAR" 425 "PIO_ALARM_11_TYPE_3_XBAR" 426 "PIO_ALARM_11_TYPE_4_DMU" 427 "PIO_ALARM_11_TYPE_5_DMU" 428 "PIO_ALARM_11_TYPE_9_SFIBRIDGE1" 429 "PIO_ALARM_11_TYPE_10_HSSL" 430 "PIO_ALARM_11_TYPE_12_CONVERTER" 431 "PIO_ALARM_11_TYPE_13_XBAR" 432 "PIO_ALARM_20_TYPE_4_EVR" 433 "PIO_ALARM_20_TYPE_5_EVR" 434 "PIO_ALARM_20_TYPE_6_EVR" 435 "PIO_ALARM_20_TYPE_7_EVR" 436 "PIO_ALARM_20_TYPE_8_EVR" 437 "PIO_ALARM_20_TYPE_9_EVR" 438 "PIO_ALARM_20_TYPE_10_EVR" 439 "PIO_ALARM_20_TYPE_11_EVR" 440 "PIO_ALARM_20_TYPE_12_EVR" 441 "PIO_ALARM_20_TYPE_13_EVR" 442 "PIO_ALARM_20_TYPE_14_EVR" 443 "PIO_ALARM_20_TYPE_15_EVR" 444 "PIO_ALARM_21_TYPE_0_HSM" 445 "PIO_ALARM_21_TYPE_1_HSM" 446 "PIO_ALARM_21_TYPE_2_HSM" 447 "PIO_ALARM_21_TYPE_3_HSM" 448 "PIO_ALARM_21_TYPE_4_HSM" 449 "PIO_ALARM_21_TYPE_5_HSM" 450 "PIO_ALARM_21_TYPE_7_SMU" 451 "PIO_ALARM_21_TYPE_8_PMS" 452 "PIO_ALARM_21_TYPE_9_PMS" 453 "PIO_ALARM_21_TYPE_10_PMS" 454 "PIO_ALARM_21_TYPE_11_PMS" 455 "PIO_ALARM_21_TYPE_12_PMS" 456 "PIO_ALARM_21_TYPE_13_PMS" 457 "PIO_ALARM_21_TYPE_14_PMS" 458 "PIO_ALARM_21_TYPE_15_CCU" 459 "PIO_ALARM_21_TYPE_16_SMU_CORE" 460 "PIO_ALARM_MULTIPLE" 461 "PIO_ALARM_RESERVED" 462 "PIO_ALARM_UNEXPECTED" 463 "PIO_ERROR_ID_LAST" /end COMPU_VTAB
/* Scalar measurable for DDE 'mpl_error_log_detailed[1].err.mode'. */
/begin MEASUREMENT mpl_error_log_detailed[1].err.1 "Mode of the software when fault raised" SBYTE CU_MPL_ERROR_LOG_DETAILED[1].25 1 100 0.0 127.0 ECU_ADDRESS 0xf0240422 BYTE_ORDER MSB_LAST /end MEASUREMENT
/begin COMPU_METHOD CU_MPL_ERROR_LOG_DETAILED[1].25 "Conversion method for mpl_error_log_detailed[1].err.mode" TAB_VERB "%12.0" "code" COMPU_TAB_REF CT_MPL_ERROR_LOG_DETAILED[1].25 /end COMPU_METHOD
/begin COMPU_VTAB CT_MPL_ERROR_LOG_DETAILED[1].25 "Conversion method for mpl_error_log_detailed[1].err.mode" TAB_VERB 4 0 "PIO_EXEC_MODE_UNKNOWN" 1 "PIO_EXEC_MODE_PRG" 2 "PIO_EXEC_MODE_APP" 3 "PIO_EXEC_MODE_LAST" /end COMPU_VTAB
/* Scalar measurable for DDE 'mpl_error_log_detailed[1].err.reaction'. */
/begin MEASUREMENT mpl_error_log_detailed[1].err.0 "Reaction to the fault raised" SBYTE CU_MPL_ERROR_LOG_DETAILED[1].11 1 100 0.0 127.0 ECU_ADDRESS 0xf0240423 BYTE_ORDER MSB_LAST /end MEASUREMENT
/begin COMPU_METHOD CU_MPL_ERROR_LOG_DETAILED[1].11 "Conversion method for mpl_error_log_detailed[1].err.reaction" TAB_VERB "%12.0" "code" COMPU_TAB_REF CT_MPL_ERROR_LOG_DETAILED[1].11 /end COMPU_METHOD
/begin COMPU_VTAB CT_MPL_ERROR_LOG_DETAILED[1].11 "Conversion method for mpl_error_log_detailed[1].err.reaction" TAB_VERB 6 0 "PIO_CONTINUE" 1 "PIO_RESET" 2 "PIO_RECORD_AND_CONTINUE" 3 "PIO_RECORD_AND_RESET" 4 "PIO_RESET_AND_RECORD" 5 "PIO_FAULT_REACTION_LAST" /end COMPU_VTAB
/* Scalar measurable for DDE 'mpl_error_log_detailed[1].err_log.cpu_log.biv'. */
/begin MEASUREMENT mpl_error_log_detailed[1].er035 "CPU base address of interrupt vector table register" ULONG CU_MPL_ERROR_LOG_DETAILED[1]038 1 100 0.0 4294967295.0 ECU_ADDRESS 0xf02405e4 BYTE_ORDER MSB_LAST /end MEASUREMENT
/begin COMPU_METHOD CU_MPL_ERROR_LOG_DETAILED[1]038 "Conversion method for mpl_error_log_detailed[1].err_log.cpu_log.biv" RAT_FUNC "%10.0" "(not defined)" COEFFS 0.000000 1.000000 -0.000000 0.000000 0.000000 1.000000 /end COMPU_METHOD
/* Scalar measurable for DDE 'mpl_error_log_detailed[1].err_log.cpu_log.btv'. */
/begin MEASUREMENT mpl_error_log_detailed[1].er029 "CPU base address of trap vector table register" ULONG CU_MPL_ERROR_LOG_DETAILED[1]032 1 100 0.0 4294967295.0 ECU_ADDRESS 0xf02405e8 BYTE_ORDER MSB_LAST /end MEASUREMENT
/begin COMPU_METHOD CU_MPL_ERROR_LOG_DETAILED[1]032 "Conversion method for mpl_error_log_detailed[1].err_log.cpu_log.btv" RAT_FUNC "%10.0" "(not defined)" COEFFS 0.000000 1.000000 -0.000000 0.000000 0.000000 1.000000 /end COMPU_METHOD
/* Scalar measurable for DDE 'mpl_error_log_detailed[1].err_log.cpu_log.cpr_low[0]'. */
/begin MEASUREMENT mpl_error_log_detailed[1].er038 "CPU/MPU code segment protection register, lower" ULONG CU_MPL_ERROR_LOG_DETAILED[1]041 1 100 0.0 4294967295.0 ECU_ADDRESS 0xf0240538 BYTE_ORDER MSB_LAST /end MEASUREMENT
/begin COMPU_METHOD CU_MPL_ERROR_LOG_DETAILED[1]041 "Conversion method for mpl_error_log_detailed[1].err_log.cpu_log.cpr_low[0]" RAT_FUNC "%10.0" "(not defined)" COEFFS 0.000000 1.000000 -0.000000 0.000000 0.000000 1.000000 /end COMPU_METHOD
/* Scalar measurable for DDE 'mpl_error_log_detailed[1].err_log.cpu_log.cpr_low[1]'. */
/begin MEASUREMENT mpl_error_log_detailed[1].err_4 "CPU/MPU code segment protection register, lower" ULONG CU_MPL_ERROR_LOG_DETAILED[1].E4 1 100 0.0 4294967295.0 ECU_ADDRESS 0xf024053c BYTE_ORDER MSB_LAST /end MEASUREMENT
/begin COMPU_METHOD CU_MPL_ERROR_LOG_DETAILED[1].E4 "Conversion method for mpl_error_log_detailed[1].err_log.cpu_log.cpr_low[1]" RAT_FUNC "%10.0" "(not defined)" COEFFS 0.000000 1.000000 -0.000000 0.000000 0.000000 1.000000 /end COMPU_METHOD
/* Scalar measurable for DDE 'mpl_error_log_detailed[1].err_log.cpu_log.cpr_low[2]'. */
/begin MEASUREMENT mpl_error_log_detailed[1].err40 "CPU/MPU code segment protection register, lower" ULONG CU_MPL_ERROR_LOG_DETAILED[1].42 1 100 0.0 4294967295.0 ECU_ADDRESS 0xf0240540 BYTE_ORDER MSB_LAST /end MEASUREMENT
/begin COMPU_METHOD CU_MPL_ERROR_LOG_DETAILED[1].42 "Conversion method for mpl_error_log_detailed[1].err_log.cpu_log.cpr_low[2]" RAT_FUNC "%10.0" "(not defined)" COEFFS 0.000000 1.000000 -0.000000 0.000000 0.000000 1.000000 /end COMPU_METHOD
/* Scalar measurable for DDE 'mpl_error_log_detailed[1].err_log.cpu_log.cpr_low[3]'. */
/begin MEASUREMENT mpl_error_log_detailed[1].er034 "CPU/MPU code segment protection register, lower" ULONG CU_MPL_ERROR_LOG_DETAILED[1]037 1 100 0.0 4294967295.0 ECU_ADDRESS 0xf0240544 BYTE_ORDER MSB_LAST /end MEASUREMENT
/begin COMPU_METHOD CU_MPL_ERROR_LOG_DETAILED[1]037 "Conversion method for mpl_error_log_detailed[1].err_log.cpu_log.cpr_low[3]" RAT_FUNC "%10.0" "(not defined)" COEFFS 0.000000 1.000000 -0.000000 0.000000 0.000000 1.000000 /end COMPU_METHOD
/* Scalar measurable for DDE 'mpl_error_log_detailed[1].err_log.cpu_log.cpr_low[4]'. */
/begin MEASUREMENT mpl_error_log_detailed[1].err07 "CPU/MPU code segment protection register, lower" ULONG CU_MPL_ERROR_LOG_DETAILED[1].07 1 100 0.0 4294967295.0 ECU_ADDRESS 0xf0240548 BYTE_ORDER MSB_LAST /end MEASUREMENT
/begin COMPU_METHOD CU_MPL_ERROR_LOG_DETAILED[1].07 "Conversion method for mpl_error_log_detailed[1].err_log.cpu_log.cpr_low[4]" RAT_FUNC "%10.0" "(not defined)" COEFFS 0.000000 1.000000 -0.000000 0.000000 0.000000 1.000000 /end COMPU_METHOD
/* Scalar measurable for DDE 'mpl_error_log_detailed[1].err_log.cpu_log.cpr_low[5]'. */
/begin MEASUREMENT mpl_error_log_detailed[1].er014 "CPU/MPU code segment protection register, lower" ULONG CU_MPL_ERROR_LOG_DETAILED[1]017 1 100 0.0 4294967295.0 ECU_ADDRESS 0xf024054c BYTE_ORDER MSB_LAST /end MEASUREMENT
/begin COMPU_METHOD CU_MPL_ERROR_LOG_DETAILED[1]017 "Conversion method for mpl_error_log_detailed[1].err_log.cpu_log.cpr_low[5]" RAT_FUNC "%10.0" "(not defined)" COEFFS 0.000000 1.000000 -0.000000 0.000000 0.000000 1.000000 /end COMPU_METHOD
/* Scalar measurable for DDE 'mpl_error_log_detailed[1].err_log.cpu_log.cpr_low[6]'. */
/begin MEASUREMENT mpl_error_log_detailed[1].er007 "CPU/MPU code segment protection register, lower" ULONG CU_MPL_ERROR_LOG_DETAILED[1]010 1 100 0.0 4294967295.0 ECU_ADDRESS 0xf0240550 BYTE_ORDER MSB_LAST /end MEASUREMENT
/begin COMPU_METHOD CU_MPL_ERROR_LOG_DETAILED[1]010 "Conversion method for mpl_error_log_detailed[1].err_log.cpu_log.cpr_low[6]" RAT_FUNC "%10.0" "(not defined)" COEFFS 0.000000 1.000000 -0.000000 0.000000 0.000000 1.000000 /end COMPU_METHOD
/* Scalar measurable for DDE 'mpl_error_log_detailed[1].err_log.cpu_log.cpr_low[7]'. */
/begin MEASUREMENT mpl_error_log_detailed[1].er012 "CPU/MPU code segment protection register, lower" ULONG CU_MPL_ERROR_LOG_DETAILED[1]015 1 100 0.0 4294967295.0 ECU_ADDRESS 0xf0240554 BYTE_ORDER MSB_LAST /end MEASUREMENT
/begin COMPU_METHOD CU_MPL_ERROR_LOG_DETAILED[1]015 "Conversion method for mpl_error_log_detailed[1].err_log.cpu_log.cpr_low[7]" RAT_FUNC "%10.0" "(not defined)" COEFFS 0.000000 1.000000 -0.000000 0.000000 0.000000 1.000000 /end COMPU_METHOD
/* Scalar measurable for DDE 'mpl_error_log_detailed[1].err_log.cpu_log.cpr_low[8]'. */
/begin MEASUREMENT mpl_error_log_detailed[1].err57 "CPU/MPU code segment protection register, lower" ULONG CU_MPL_ERROR_LOG_DETAILED[1].59 1 100 0.0 4294967295.0 ECU_ADDRESS 0xf0240558 BYTE_ORDER MSB_LAST /end MEASUREMENT
/begin COMPU_METHOD CU_MPL_ERROR_LOG_DETAILED[1].59 "Conversion method for mpl_error_log_detailed[1].err_log.cpu_log.cpr_low[8]" RAT_FUNC "%10.0" "(not defined)" COEFFS 0.000000 1.000000 -0.000000 0.000000 0.000000 1.000000 /end COMPU_METHOD
/* Scalar measurable for DDE 'mpl_error_log_detailed[1].err_log.cpu_log.cpr_low[9]'. */
/begin MEASUREMENT mpl_error_log_detailed[1].err64 "CPU/MPU code segment protection register, lower" ULONG CU_MPL_ERROR_LOG_DETAILED[1].66 1 100 0.0 4294967295.0 ECU_ADDRESS 0xf024055c BYTE_ORDER MSB_LAST /end MEASUREMENT
/begin COMPU_METHOD CU_MPL_ERROR_LOG_DETAILED[1].66 "Conversion method for mpl_error_log_detailed[1].err_log.cpu_log.cpr_low[9]" RAT_FUNC "%10.0" "(not defined)" COEFFS 0.000000 1.000000 -0.000000 0.000000 0.000000 1.000000 /end COMPU_METHOD
/* Scalar measurable for DDE 'mpl_error_log_detailed[1].err_log.cpu_log.cpr_upr[0]'. */
/begin MEASUREMENT mpl_error_log_detailed[1].err_0 "CPU/MPU code segment protection register, upper" ULONG CU_MPL_ERROR_LOG_DETAILED[1].E0 1 100 0.0 4294967295.0 ECU_ADDRESS 0xf0240560 BYTE_ORDER MSB_LAST /end MEASUREMENT
/begin COMPU_METHOD CU_MPL_ERROR_LOG_DETAILED[1].E0 "Conversion method for mpl_error_log_detailed[1].err_log.cpu_log.cpr_upr[0]" RAT_FUNC "%10.0" "(not defined)" COEFFS 0.000000 1.000000 -0.000000 0.000000 0.000000 1.000000 /end COMPU_METHOD
/* Scalar measurable for DDE 'mpl_error_log_detailed[1].err_log.cpu_log.cpr_upr[1]'. */
/begin MEASUREMENT mpl_error_log_detailed[1].err34 "CPU/MPU code segment protection register, upper" ULONG CU_MPL_ERROR_LOG_DETAILED[1].36 1 100 0.0 4294967295.0 ECU_ADDRESS 0xf0240564 BYTE_ORDER MSB_LAST /end MEASUREMENT
/begin COMPU_METHOD CU_MPL_ERROR_LOG_DETAILED[1].36 "Conversion method for mpl_error_log_detailed[1].err_log.cpu_log.cpr_upr[1]" RAT_FUNC "%10.0" "(not defined)" COEFFS 0.000000 1.000000 -0.000000 0.000000 0.000000 1.000000 /end COMPU_METHOD
/* Scalar measurable for DDE 'mpl_error_log_detailed[1].err_log.cpu_log.cpr_upr[2]'. */
/begin MEASUREMENT mpl_error_log_detailed[1].err39 "CPU/MPU code segment protection register, upper" ULONG CU_MPL_ERROR_LOG_DETAILED[1].41 1 100 0.0 4294967295.0 ECU_ADDRESS 0xf0240568 BYTE_ORDER MSB_LAST /end MEASUREMENT
/begin COMPU_METHOD CU_MPL_ERROR_LOG_DETAILED[1].41 "Conversion method for mpl_error_log_detailed[1].err_log.cpu_log.cpr_upr[2]" RAT_FUNC "%10.0" "(not defined)" COEFFS 0.000000 1.000000 -0.000000 0.000000 0.000000 1.000000 /end COMPU_METHOD
/* Scalar measurable for DDE 'mpl_error_log_detailed[1].err_log.cpu_log.cpr_upr[3]'. */
/begin MEASUREMENT mpl_error_log_detailed[1].err94 "CPU/MPU code segment protection register, upper" ULONG CU_MPL_ERROR_LOG_DETAILED[1].97 1 100 0.0 4294967295.0 ECU_ADDRESS 0xf024056c BYTE_ORDER MSB_LAST /end MEASUREMENT
/begin COMPU_METHOD CU_MPL_ERROR_LOG_DETAILED[1].97 "Conversion method for mpl_error_log_detailed[1].err_log.cpu_log.cpr_upr[3]" RAT_FUNC "%10.0" "(not defined)" COEFFS 0.000000 1.000000 -0.000000 0.000000 0.000000 1.000000 /end COMPU_METHOD
/* Scalar measurable for DDE 'mpl_error_log_detailed[1].err_log.cpu_log.cpr_upr[4]'. */
/begin MEASUREMENT mpl_error_log_detailed[1].er000 "CPU/MPU code segment protection register, upper" ULONG CU_MPL_ERROR_LOG_DETAILED[1]003 1 100 0.0 4294967295.0 ECU_ADDRESS 0xf0240570 BYTE_ORDER MSB_LAST /end MEASUREMENT
/begin COMPU_METHOD CU_MPL_ERROR_LOG_DETAILED[1]003 "Conversion method for mpl_error_log_detailed[1].err_log.cpu_log.cpr_upr[4]" RAT_FUNC "%10.0" "(not defined)" COEFFS 0.000000 1.000000 -0.000000 0.000000 0.000000 1.000000 /end COMPU_METHOD
/* Scalar measurable for DDE 'mpl_error_log_detailed[1].err_log.cpu_log.cpr_upr[5]'. */
/begin MEASUREMENT mpl_error_log_detailed[1].er016 "CPU/MPU code segment protection register, upper" ULONG CU_MPL_ERROR_LOG_DETAILED[1]019 1 100 0.0 4294967295.0 ECU_ADDRESS 0xf0240574 BYTE_ORDER MSB_LAST /end MEASUREMENT
/begin COMPU_METHOD CU_MPL_ERROR_LOG_DETAILED[1]019 "Conversion method for mpl_error_log_detailed[1].err_log.cpu_log.cpr_upr[5]" RAT_FUNC "%10.0" "(not defined)" COEFFS 0.000000 1.000000 -0.000000 0.000000 0.000000 1.000000 /end COMPU_METHOD
/* Scalar measurable for DDE 'mpl_error_log_detailed[1].err_log.cpu_log.cpr_upr[6]'. */
/begin MEASUREMENT mpl_error_log_detailed[1].err84 "CPU/MPU code segment protection register, upper" ULONG CU_MPL_ERROR_LOG_DETAILED[1].87 1 100 0.0 4294967295.0 ECU_ADDRESS 0xf0240578 BYTE_ORDER MSB_LAST /end MEASUREMENT
/begin COMPU_METHOD CU_MPL_ERROR_LOG_DETAILED[1].87 "Conversion method for mpl_error_log_detailed[1].err_log.cpu_log.cpr_upr[6]" RAT_FUNC "%10.0" "(not defined)" COEFFS 0.000000 1.000000 -0.000000 0.000000 0.000000 1.000000 /end COMPU_METHOD
/* Scalar measurable for DDE 'mpl_error_log_detailed[1].err_log.cpu_log.cpr_upr[7]'. */
/begin MEASUREMENT mpl_error_log_detailed[1].err96 "CPU/MPU code segment protection register, upper" ULONG CU_MPL_ERROR_LOG_DETAILED[1].99 1 100 0.0 4294967295.0 ECU_ADDRESS 0xf024057c BYTE_ORDER MSB_LAST /end MEASUREMENT
/begin COMPU_METHOD CU_MPL_ERROR_LOG_DETAILED[1].99 "Conversion method for mpl_error_log_detailed[1].err_log.cpu_log.cpr_upr[7]" RAT_FUNC "%10.0" "(not defined)" COEFFS 0.000000 1.000000 -0.000000 0.000000 0.000000 1.000000 /end COMPU_METHOD
/* Scalar measurable for DDE 'mpl_error_log_detailed[1].err_log.cpu_log.cpr_upr[8]'. */
/begin MEASUREMENT mpl_error_log_detailed[1].err80 "CPU/MPU code segment protection register, upper" ULONG CU_MPL_ERROR_LOG_DETAILED[1].83 1 100 0.0 4294967295.0 ECU_ADDRESS 0xf0240580 BYTE_ORDER MSB_LAST /end MEASUREMENT
/begin COMPU_METHOD CU_MPL_ERROR_LOG_DETAILED[1].83 "Conversion method for mpl_error_log_detailed[1].err_log.cpu_log.cpr_upr[8]" RAT_FUNC "%10.0" "(not defined)" COEFFS 0.000000 1.000000 -0.000000 0.000000 0.000000 1.000000 /end COMPU_METHOD
/* Scalar measurable for DDE 'mpl_error_log_detailed[1].err_log.cpu_log.cpr_upr[9]'. */
/begin MEASUREMENT mpl_error_log_detailed[1].err91 "CPU/MPU code segment protection register, upper" ULONG CU_MPL_ERROR_LOG_DETAILED[1].94 1 100 0.0 4294967295.0 ECU_ADDRESS 0xf0240584 BYTE_ORDER MSB_LAST /end MEASUREMENT
/begin COMPU_METHOD CU_MPL_ERROR_LOG_DETAILED[1].94 "Conversion method for mpl_error_log_detailed[1].err_log.cpu_log.cpr_upr[9]" RAT_FUNC "%10.0" "(not defined)" COEFFS 0.000000 1.000000 -0.000000 0.000000 0.000000 1.000000 /end COMPU_METHOD
/* Scalar measurable for DDE 'mpl_error_log_detailed[1].err_log.cpu_log.cpxe[0]'. */
/begin MEASUREMENT mpl_error_log_detailed[1].err58 "CPU/MPU code protection execution enable configuration register" ULONG CU_MPL_ERROR_LOG_DETAILED[1].60 1 100 0.0 4294967295.0 ECU_ADDRESS 0xf0240588 BYTE_ORDER MSB_LAST /end MEASUREMENT
/begin COMPU_METHOD CU_MPL_ERROR_LOG_DETAILED[1].60 "Conversion method for mpl_error_log_detailed[1].err_log.cpu_log.cpxe[0]" RAT_FUNC "%10.0" "(not defined)" COEFFS 0.000000 1.000000 -0.000000 0.000000 0.000000 1.000000 /end COMPU_METHOD
/* Scalar measurable for DDE 'mpl_error_log_detailed[1].err_log.cpu_log.cpxe[1]'. */
/begin MEASUREMENT mpl_error_log_detailed[1].err50 "CPU/MPU code protection execution enable configuration register" ULONG CU_MPL_ERROR_LOG_DETAILED[1].52 1 100 0.0 4294967295.0 ECU_ADDRESS 0xf024058c BYTE_ORDER MSB_LAST /end MEASUREMENT
/begin COMPU_METHOD CU_MPL_ERROR_LOG_DETAILED[1].52 "Conversion method for mpl_error_log_detailed[1].err_log.cpu_log.cpxe[1]" RAT_FUNC "%10.0" "(not defined)" COEFFS 0.000000 1.000000 -0.000000 0.000000 0.000000 1.000000 /end COMPU_METHOD
/* Scalar measurable for DDE 'mpl_error_log_detailed[1].err_log.cpu_log.cpxe[2]'. */
/begin MEASUREMENT mpl_error_log_detailed[1].err79 "CPU/MPU code protection execution enable configuration register" ULONG CU_MPL_ERROR_LOG_DETAILED[1].82 1 100 0.0 4294967295.0 ECU_ADDRESS 0xf0240590 BYTE_ORDER MSB_LAST /end MEASUREMENT
/begin COMPU_METHOD CU_MPL_ERROR_LOG_DETAILED[1].82 "Conversion method for mpl_error_log_detailed[1].err_log.cpu_log.cpxe[2]" RAT_FUNC "%10.0" "(not defined)" COEFFS 0.000000 1.000000 -0.000000 0.000000 0.000000 1.000000 /end COMPU_METHOD
/* Scalar measurable for DDE 'mpl_error_log_detailed[1].err_log.cpu_log.cpxe[3]'. */
/begin MEASUREMENT mpl_error_log_detailed[1].err68 "CPU/MPU code protection execution enable configuration register" ULONG CU_MPL_ERROR_LOG_DETAILED[1].70 1 100 0.0 4294967295.0 ECU_ADDRESS 0xf0240594 BYTE_ORDER MSB_LAST /end MEASUREMENT
/begin COMPU_METHOD CU_MPL_ERROR_LOG_DETAILED[1].70 "Conversion method for mpl_error_log_detailed[1].err_log.cpu_log.cpxe[3]" RAT_FUNC "%10.0" "(not defined)" COEFFS 0.000000 1.000000 -0.000000 0.000000 0.000000 1.000000 /end COMPU_METHOD
/* Scalar measurable for DDE 'mpl_error_log_detailed[1].err_log.cpu_log.cpxe[4]'. */
/begin MEASUREMENT mpl_error_log_detailed[1].err21 "CPU/MPU code protection execution enable configuration register" ULONG CU_MPL_ERROR_LOG_DETAILED[1].22 1 100 0.0 4294967295.0 ECU_ADDRESS 0xf0240598 BYTE_ORDER MSB_LAST /end MEASUREMENT
/begin COMPU_METHOD CU_MPL_ERROR_LOG_DETAILED[1].22 "Conversion method for mpl_error_log_detailed[1].err_log.cpu_log.cpxe[4]" RAT_FUNC "%10.0" "(not defined)" COEFFS 0.000000 1.000000 -0.000000 0.000000 0.000000 1.000000 /end COMPU_METHOD
/* Scalar measurable for DDE 'mpl_error_log_detailed[1].err_log.cpu_log.cpxe[5]'. */
/begin MEASUREMENT mpl_error_log_detailed[1].err05 "CPU/MPU code protection execution enable configuration register" ULONG CU_MPL_ERROR_LOG_DETAILED[1].05 1 100 0.0 4294967295.0 ECU_ADDRESS 0xf024059c BYTE_ORDER MSB_LAST /end MEASUREMENT
/begin COMPU_METHOD CU_MPL_ERROR_LOG_DETAILED[1].05 "Conversion method for mpl_error_log_detailed[1].err_log.cpu_log.cpxe[5]" RAT_FUNC "%10.0" "(not defined)" COEFFS 0.000000 1.000000 -0.000000 0.000000 0.000000 1.000000 /end COMPU_METHOD
/* Scalar measurable for DDE 'mpl_error_log_detailed[1].err_log.cpu_log.datr'. */
/begin MEASUREMENT mpl_error_log_detailed[1].err66 "CPU data asynchronous error trap register" ULONG CU_MPL_ERROR_LOG_DETAILED[1].68 1 100 0.0 4294967295.0 ECU_ADDRESS 0xf024046c BYTE_ORDER MSB_LAST /end MEASUREMENT
/begin COMPU_METHOD CU_MPL_ERROR_LOG_DETAILED[1].68 "Conversion method for mpl_error_log_detailed[1].err_log.cpu_log.datr" RAT_FUNC "%10.0" "(not defined)" COEFFS 0.000000 1.000000 -0.000000 0.000000 0.000000 1.000000 /end COMPU_METHOD
/* Scalar measurable for DDE 'mpl_error_log_detailed[1].err_log.cpu_log.deadd'. */
/begin MEASUREMENT mpl_error_log_detailed[1].err13 "CPU data error address register" ULONG CU_MPL_ERROR_LOG_DETAILED[1].14 1 100 0.0 4294967295.0 ECU_ADDRESS 0xf0240470 BYTE_ORDER MSB_LAST /end MEASUREMENT
/begin COMPU_METHOD CU_MPL_ERROR_LOG_DETAILED[1].14 "Conversion method for mpl_error_log_detailed[1].err_log.cpu_log.deadd" RAT_FUNC "%10.0" "(not defined)" COEFFS 0.000000 1.000000 -0.000000 0.000000 0.000000 1.000000 /end COMPU_METHOD
/* Scalar measurable for DDE 'mpl_error_log_detailed[1].err_log.cpu_log.diear'. */
/begin MEASUREMENT mpl_error_log_detailed[1].er024 "CPU data integrity error address register" ULONG CU_MPL_ERROR_LOG_DETAILED[1]027 1 100 0.0 4294967295.0 ECU_ADDRESS 0xf0240474 BYTE_ORDER MSB_LAST /end MEASUREMENT
/begin COMPU_METHOD CU_MPL_ERROR_LOG_DETAILED[1]027 "Conversion method for mpl_error_log_detailed[1].err_log.cpu_log.diear" RAT_FUNC "%10.0" "(not defined)" COEFFS 0.000000 1.000000 -0.000000 0.000000 0.000000 1.000000 /end COMPU_METHOD
/* Scalar measurable for DDE 'mpl_error_log_detailed[1].err_log.cpu_log.dietr'. */
/begin MEASUREMENT mpl_error_log_detailed[1].err83 "CPU data integrity error trap register" ULONG CU_MPL_ERROR_LOG_DETAILED[1].86 1 100 0.0 4294967295.0 ECU_ADDRESS 0xf0240478 BYTE_ORDER MSB_LAST /end MEASUREMENT
/begin COMPU_METHOD CU_MPL_ERROR_LOG_DETAILED[1].86 "Conversion method for mpl_error_log_detailed[1].err_log.cpu_log.dietr" RAT_FUNC "%10.0" "(not defined)" COEFFS 0.000000 1.000000 -0.000000 0.000000 0.000000 1.000000 /end COMPU_METHOD
/* Scalar measurable for DDE 'mpl_error_log_detailed[1].err_log.cpu_log.dpr_low[0]'. */
/begin MEASUREMENT mpl_error_log_detailed[1].err78 "CPU/MPU data segment protection register, lower" ULONG CU_MPL_ERROR_LOG_DETAILED[1].81 1 100 0.0 4294967295.0 ECU_ADDRESS 0xf02404a8 BYTE_ORDER MSB_LAST /end MEASUREMENT
/begin COMPU_METHOD CU_MPL_ERROR_LOG_DETAILED[1].81 "Conversion method for mpl_error_log_detailed[1].err_log.cpu_log.dpr_low[0]" RAT_FUNC "%10.0" "(not defined)" COEFFS 0.000000 1.000000 -0.000000 0.000000 0.000000 1.000000 /end COMPU_METHOD
/* Scalar measurable for DDE 'mpl_error_log_detailed[1].err_log.cpu_log.dpr_low[10]'. */
/begin MEASUREMENT mpl_error_log_detailed[1].err20 "CPU/MPU data segment protection register, lower" ULONG CU_MPL_ERROR_LOG_DETAILED[1].21 1 100 0.0 4294967295.0 ECU_ADDRESS 0xf02404d0 BYTE_ORDER MSB_LAST /end MEASUREMENT
/begin COMPU_METHOD CU_MPL_ERROR_LOG_DETAILED[1].21 "Conversion method for mpl_error_log_detailed[1].err_log.cpu_log.dpr_low[10]" RAT_FUNC "%10.0" "(not defined)" COEFFS 0.000000 1.000000 -0.000000 0.000000 0.000000 1.000000 /end COMPU_METHOD
/* Scalar measurable for DDE 'mpl_error_log_detailed[1].err_log.cpu_log.dpr_low[11]'. */
/begin MEASUREMENT mpl_error_log_detailed[1].er033 "CPU/MPU data segment protection register, lower" ULONG CU_MPL_ERROR_LOG_DETAILED[1]036 1 100 0.0 4294967295.0 ECU_ADDRESS 0xf02404d4 BYTE_ORDER MSB_LAST /end MEASUREMENT
/begin COMPU_METHOD CU_MPL_ERROR_LOG_DETAILED[1]036 "Conversion method for mpl_error_log_detailed[1].err_log.cpu_log.dpr_low[11]" RAT_FUNC "%10.0" "(not defined)" COEFFS 0.000000 1.000000 -0.000000 0.000000 0.000000 1.000000 /end COMPU_METHOD
/* Scalar measurable for DDE 'mpl_error_log_detailed[1].err_log.cpu_log.dpr_low[12]'. */
/begin MEASUREMENT mpl_error_log_detailed[1].err55 "CPU/MPU data segment protection register, lower" ULONG CU_MPL_ERROR_LOG_DETAILED[1].57 1 100 0.0 4294967295.0 ECU_ADDRESS 0xf02404d8 BYTE_ORDER MSB_LAST /end MEASUREMENT
/begin COMPU_METHOD CU_MPL_ERROR_LOG_DETAILED[1].57 "Conversion method for mpl_error_log_detailed[1].err_log.cpu_log.dpr_low[12]" RAT_FUNC "%10.0" "(not defined)" COEFFS 0.000000 1.000000 -0.000000 0.000000 0.000000 1.000000 /end COMPU_METHOD
/* Scalar measurable for DDE 'mpl_error_log_detailed[1].err_log.cpu_log.dpr_low[13]'. */
/begin MEASUREMENT mpl_error_log_detailed[1].er036 "CPU/MPU data segment protection register, lower" ULONG CU_MPL_ERROR_LOG_DETAILED[1]039 1 100 0.0 4294967295.0 ECU_ADDRESS 0xf02404dc BYTE_ORDER MSB_LAST /end MEASUREMENT
/begin COMPU_METHOD CU_MPL_ERROR_LOG_DETAILED[1]039 "Conversion method for mpl_error_log_detailed[1].err_log.cpu_log.dpr_low[13]" RAT_FUNC "%10.0" "(not defined)" COEFFS 0.000000 1.000000 -0.000000 0.000000 0.000000 1.000000 /end COMPU_METHOD
/* Scalar measurable for DDE 'mpl_error_log_detailed[1].err_log.cpu_log.dpr_low[14]'. */
/begin MEASUREMENT mpl_error_log_detailed[1].err77 "CPU/MPU data segment protection register, lower" ULONG CU_MPL_ERROR_LOG_DETAILED[1].80 1 100 0.0 4294967295.0 ECU_ADDRESS 0xf02404e0 BYTE_ORDER MSB_LAST /end MEASUREMENT
/begin COMPU_METHOD CU_MPL_ERROR_LOG_DETAILED[1].80 "Conversion method for mpl_error_log_detailed[1].err_log.cpu_log.dpr_low[14]" RAT_FUNC "%10.0" "(not defined)" COEFFS 0.000000 1.000000 -0.000000 0.000000 0.000000 1.000000 /end COMPU_METHOD
/* Scalar measurable for DDE 'mpl_error_log_detailed[1].err_log.cpu_log.dpr_low[15]'. */
/begin MEASUREMENT mpl_error_log_detailed[1].er017 "CPU/MPU data segment protection register, lower" ULONG CU_MPL_ERROR_LOG_DETAILED[1]020 1 100 0.0 4294967295.0 ECU_ADDRESS 0xf02404e4 BYTE_ORDER MSB_LAST /end MEASUREMENT
/begin COMPU_METHOD CU_MPL_ERROR_LOG_DETAILED[1]020 "Conversion method for mpl_error_log_detailed[1].err_log.cpu_log.dpr_low[15]" RAT_FUNC "%10.0" "(not defined)" COEFFS 0.000000 1.000000 -0.000000 0.000000 0.000000 1.000000 /end COMPU_METHOD
/* Scalar measurable for DDE 'mpl_error_log_detailed[1].err_log.cpu_log.dpr_low[16]'. */
/begin MEASUREMENT mpl_error_log_detailed[1].er010 "CPU/MPU data segment protection register, lower" ULONG CU_MPL_ERROR_LOG_DETAILED[1]013 1 100 0.0 4294967295.0 ECU_ADDRESS 0xf02404e8 BYTE_ORDER MSB_LAST /end MEASUREMENT
/begin COMPU_METHOD CU_MPL_ERROR_LOG_DETAILED[1]013 "Conversion method for mpl_error_log_detailed[1].err_log.cpu_log.dpr_low[16]" RAT_FUNC "%10.0" "(not defined)" COEFFS 0.000000 1.000000 -0.000000 0.000000 0.000000 1.000000 /end COMPU_METHOD
/* Scalar measurable for DDE 'mpl_error_log_detailed[1].err_log.cpu_log.dpr_low[17]'. */
/begin MEASUREMENT mpl_error_log_detailed[1].er041 "CPU/MPU data segment protection register, lower" ULONG CU_MPL_ERROR_LOG_DETAILED[1]044 1 100 0.0 4294967295.0 ECU_ADDRESS 0xf02404ec BYTE_ORDER MSB_LAST /end MEASUREMENT
/begin COMPU_METHOD CU_MPL_ERROR_LOG_DETAILED[1]044 "Conversion method for mpl_error_log_detailed[1].err_log.cpu_log.dpr_low[17]" RAT_FUNC "%10.0" "(not defined)" COEFFS 0.000000 1.000000 -0.000000 0.000000 0.000000 1.000000 /end COMPU_METHOD
/* Scalar measurable for DDE 'mpl_error_log_detailed[1].err_log.cpu_log.dpr_low[1]'. */
/begin MEASUREMENT mpl_error_log_detailed[1].er042 "CPU/MPU data segment protection register, lower" ULONG CU_MPL_ERROR_LOG_DETAILED[1]045 1 100 0.0 4294967295.0 ECU_ADDRESS 0xf02404ac BYTE_ORDER MSB_LAST /end MEASUREMENT
/begin COMPU_METHOD CU_MPL_ERROR_LOG_DETAILED[1]045 "Conversion method for mpl_error_log_detailed[1].err_log.cpu_log.dpr_low[1]" RAT_FUNC "%10.0" "(not defined)" COEFFS 0.000000 1.000000 -0.000000 0.000000 0.000000 1.000000 /end COMPU_METHOD
/* Scalar measurable for DDE 'mpl_error_log_detailed[1].err_log.cpu_log.dpr_low[2]'. */
/begin MEASUREMENT mpl_error_log_detailed[1].er009 "CPU/MPU data segment protection register, lower" ULONG CU_MPL_ERROR_LOG_DETAILED[1]012 1 100 0.0 4294967295.0 ECU_ADDRESS 0xf02404b0 BYTE_ORDER MSB_LAST /end MEASUREMENT
/begin COMPU_METHOD CU_MPL_ERROR_LOG_DETAILED[1]012 "Conversion method for mpl_error_log_detailed[1].err_log.cpu_log.dpr_low[2]" RAT_FUNC "%10.0" "(not defined)" COEFFS 0.000000 1.000000 -0.000000 0.000000 0.000000 1.000000 /end COMPU_METHOD
/* Scalar measurable for DDE 'mpl_error_log_detailed[1].err_log.cpu_log.dpr_low[3]'. */
/begin MEASUREMENT mpl_error_log_detailed[1].er018 "CPU/MPU data segment protection register, lower" ULONG CU_MPL_ERROR_LOG_DETAILED[1]021 1 100 0.0 4294967295.0 ECU_ADDRESS 0xf02404b4 BYTE_ORDER MSB_LAST /end MEASUREMENT
/begin COMPU_METHOD CU_MPL_ERROR_LOG_DETAILED[1]021 "Conversion method for mpl_error_log_detailed[1].err_log.cpu_log.dpr_low[3]" RAT_FUNC "%10.0" "(not defined)" COEFFS 0.000000 1.000000 -0.000000 0.000000 0.000000 1.000000 /end COMPU_METHOD
/* Scalar measurable for DDE 'mpl_error_log_detailed[1].err_log.cpu_log.dpr_low[4]'. */
/begin MEASUREMENT mpl_error_log_detailed[1].er028 "CPU/MPU data segment protection register, lower" ULONG CU_MPL_ERROR_LOG_DETAILED[1]031 1 100 0.0 4294967295.0 ECU_ADDRESS 0xf02404b8 BYTE_ORDER MSB_LAST /end MEASUREMENT
/begin COMPU_METHOD CU_MPL_ERROR_LOG_DETAILED[1]031 "Conversion method for mpl_error_log_detailed[1].err_log.cpu_log.dpr_low[4]" RAT_FUNC "%10.0" "(not defined)" COEFFS 0.000000 1.000000 -0.000000 0.000000 0.000000 1.000000 /end COMPU_METHOD
/* Scalar measurable for DDE 'mpl_error_log_detailed[1].err_log.cpu_log.dpr_low[5]'. */
/begin MEASUREMENT mpl_error_log_detailed[1].err52 "CPU/MPU data segment protection register, lower" ULONG CU_MPL_ERROR_LOG_DETAILED[1].54 1 100 0.0 4294967295.0 ECU_ADDRESS 0xf02404bc BYTE_ORDER MSB_LAST /end MEASUREMENT
/begin COMPU_METHOD CU_MPL_ERROR_LOG_DETAILED[1].54 "Conversion method for mpl_error_log_detailed[1].err_log.cpu_log.dpr_low[5]" RAT_FUNC "%10.0" "(not defined)" COEFFS 0.000000 1.000000 -0.000000 0.000000 0.000000 1.000000 /end COMPU_METHOD
/* Scalar measurable for DDE 'mpl_error_log_detailed[1].err_log.cpu_log.dpr_low[6]'. */
/begin MEASUREMENT mpl_error_log_detailed[1].err89 "CPU/MPU data segment protection register, lower" ULONG CU_MPL_ERROR_LOG_DETAILED[1].92 1 100 0.0 4294967295.0 ECU_ADDRESS 0xf02404c0 BYTE_ORDER MSB_LAST /end MEASUREMENT
/begin COMPU_METHOD CU_MPL_ERROR_LOG_DETAILED[1].92 "Conversion method for mpl_error_log_detailed[1].err_log.cpu_log.dpr_low[6]" RAT_FUNC "%10.0" "(not defined)" COEFFS 0.000000 1.000000 -0.000000 0.000000 0.000000 1.000000 /end COMPU_METHOD
/* Scalar measurable for DDE 'mpl_error_log_detailed[1].err_log.cpu_log.dpr_low[7]'. */
/begin MEASUREMENT mpl_error_log_detailed[1].err09 "CPU/MPU data segment protection register, lower" ULONG CU_MPL_ERROR_LOG_DETAILED[1].09 1 100 0.0 4294967295.0 ECU_ADDRESS 0xf02404c4 BYTE_ORDER MSB_LAST /end MEASUREMENT
/begin COMPU_METHOD CU_MPL_ERROR_LOG_DETAILED[1].09 "Conversion method for mpl_error_log_detailed[1].err_log.cpu_log.dpr_low[7]" RAT_FUNC "%10.0" "(not defined)" COEFFS 0.000000 1.000000 -0.000000 0.000000 0.000000 1.000000 /end COMPU_METHOD
/* Scalar measurable for DDE 'mpl_error_log_detailed[1].err_log.cpu_log.dpr_low[8]'. */
/begin MEASUREMENT mpl_error_log_detailed[1].err19 "CPU/MPU data segment protection register, lower" ULONG CU_MPL_ERROR_LOG_DETAILED[1].20 1 100 0.0 4294967295.0 ECU_ADDRESS 0xf02404c8 BYTE_ORDER MSB_LAST /end MEASUREMENT
/begin COMPU_METHOD CU_MPL_ERROR_LOG_DETAILED[1].20 "Conversion method for mpl_error_log_detailed[1].err_log.cpu_log.dpr_low[8]" RAT_FUNC "%10.0" "(not defined)" COEFFS 0.000000 1.000000 -0.000000 0.000000 0.000000 1.000000 /end COMPU_METHOD
/* Scalar measurable for DDE 'mpl_error_log_detailed[1].err_log.cpu_log.dpr_low[9]'. */
/begin MEASUREMENT mpl_error_log_detailed[1].err27 "CPU/MPU data segment protection register, lower" ULONG CU_MPL_ERROR_LOG_DETAILED[1].29 1 100 0.0 4294967295.0 ECU_ADDRESS 0xf02404cc BYTE_ORDER MSB_LAST /end MEASUREMENT
/begin COMPU_METHOD CU_MPL_ERROR_LOG_DETAILED[1].29 "Conversion method for mpl_error_log_detailed[1].err_log.cpu_log.dpr_low[9]" RAT_FUNC "%10.0" "(not defined)" COEFFS 0.000000 1.000000 -0.000000 0.000000 0.000000 1.000000 /end COMPU_METHOD
/* Scalar measurable for DDE 'mpl_error_log_detailed[1].err_log.cpu_log.dpr_upr[0]'. */
/begin MEASUREMENT mpl_error_log_detailed[1].err23 "CPU/MPU data segment protection register, upper" ULONG CU_MPL_ERROR_LOG_DETAILED[1].24 1 100 0.0 4294967295.0 ECU_ADDRESS 0xf02404f0 BYTE_ORDER MSB_LAST /end MEASUREMENT
/begin COMPU_METHOD CU_MPL_ERROR_LOG_DETAILED[1].24 "Conversion method for mpl_error_log_detailed[1].err_log.cpu_log.dpr_upr[0]" RAT_FUNC "%10.0" "(not defined)" COEFFS 0.000000 1.000000 -0.000000 0.000000 0.000000 1.000000 /end COMPU_METHOD
/* Scalar measurable for DDE 'mpl_error_log_detailed[1].err_log.cpu_log.dpr_upr[10]'. */
/begin MEASUREMENT mpl_error_log_detailed[1].er027 "CPU/MPU data segment protection register, upper" ULONG CU_MPL_ERROR_LOG_DETAILED[1]030 1 100 0.0 4294967295.0 ECU_ADDRESS 0xf0240518 BYTE_ORDER MSB_LAST /end MEASUREMENT
/begin COMPU_METHOD CU_MPL_ERROR_LOG_DETAILED[1]030 "Conversion method for mpl_error_log_detailed[1].err_log.cpu_log.dpr_upr[10]" RAT_FUNC "%10.0" "(not defined)" COEFFS 0.000000 1.000000 -0.000000 0.000000 0.000000 1.000000 /end COMPU_METHOD
/* Scalar measurable for DDE 'mpl_error_log_detailed[1].err_log.cpu_log.dpr_upr[11]'. */
/begin MEASUREMENT mpl_error_log_detailed[1].er021 "CPU/MPU data segment protection register, upper" ULONG CU_MPL_ERROR_LOG_DETAILED[1]024 1 100 0.0 4294967295.0 ECU_ADDRESS 0xf024051c BYTE_ORDER MSB_LAST /end MEASUREMENT
/begin COMPU_METHOD CU_MPL_ERROR_LOG_DETAILED[1]024 "Conversion method for mpl_error_log_detailed[1].err_log.cpu_log.dpr_upr[11]" RAT_FUNC "%10.0" "(not defined)" COEFFS 0.000000 1.000000 -0.000000 0.000000 0.000000 1.000000 /end COMPU_METHOD
/* Scalar measurable for DDE 'mpl_error_log_detailed[1].err_log.cpu_log.dpr_upr[12]'. */
/begin MEASUREMENT mpl_error_log_detailed[1].er046 "CPU/MPU data segment protection register, upper" ULONG CU_MPL_ERROR_LOG_DETAILED[1]049 1 100 0.0 4294967295.0 ECU_ADDRESS 0xf0240520 BYTE_ORDER MSB_LAST /end MEASUREMENT
/begin COMPU_METHOD CU_MPL_ERROR_LOG_DETAILED[1]049 "Conversion method for mpl_error_log_detailed[1].err_log.cpu_log.dpr_upr[12]" RAT_FUNC "%10.0" "(not defined)" COEFFS 0.000000 1.000000 -0.000000 0.000000 0.000000 1.000000 /end COMPU_METHOD
/* Scalar measurable for DDE 'mpl_error_log_detailed[1].err_log.cpu_log.dpr_upr[13]'. */
/begin MEASUREMENT mpl_error_log_detailed[1].err_3 "CPU/MPU data segment protection register, upper" ULONG CU_MPL_ERROR_LOG_DETAILED[1].E3 1 100 0.0 4294967295.0 ECU_ADDRESS 0xf0240524 BYTE_ORDER MSB_LAST /end MEASUREMENT
/begin COMPU_METHOD CU_MPL_ERROR_LOG_DETAILED[1].E3 "Conversion method for mpl_error_log_detailed[1].err_log.cpu_log.dpr_upr[13]" RAT_FUNC "%10.0" "(not defined)" COEFFS 0.000000 1.000000 -0.000000 0.000000 0.000000 1.000000 /end COMPU_METHOD
/* Scalar measurable for DDE 'mpl_error_log_detailed[1].err_log.cpu_log.dpr_upr[14]'. */
/begin MEASUREMENT mpl_error_log_detailed[1].err14 "CPU/MPU data segment protection register, upper" ULONG CU_MPL_ERROR_LOG_DETAILED[1].15 1 100 0.0 4294967295.0 ECU_ADDRESS 0xf0240528 BYTE_ORDER MSB_LAST /end MEASUREMENT
/begin COMPU_METHOD CU_MPL_ERROR_LOG_DETAILED[1].15 "Conversion method for mpl_error_log_detailed[1].err_log.cpu_log.dpr_upr[14]" RAT_FUNC "%10.0" "(not defined)" COEFFS 0.000000 1.000000 -0.000000 0.000000 0.000000 1.000000 /end COMPU_METHOD
/* Scalar measurable for DDE 'mpl_error_log_detailed[1].err_log.cpu_log.dpr_upr[15]'. */
/begin MEASUREMENT mpl_error_log_detailed[1].err25 "CPU/MPU data segment protection register, upper" ULONG CU_MPL_ERROR_LOG_DETAILED[1].27 1 100 0.0 4294967295.0 ECU_ADDRESS 0xf024052c BYTE_ORDER MSB_LAST /end MEASUREMENT
/begin COMPU_METHOD CU_MPL_ERROR_LOG_DETAILED[1].27 "Conversion method for mpl_error_log_detailed[1].err_log.cpu_log.dpr_upr[15]" RAT_FUNC "%10.0" "(not defined)" COEFFS 0.000000 1.000000 -0.000000 0.000000 0.000000 1.000000 /end COMPU_METHOD
/* Scalar measurable for DDE 'mpl_error_log_detailed[1].err_log.cpu_log.dpr_upr[16]'. */
/begin MEASUREMENT mpl_error_log_detailed[1].err32 "CPU/MPU data segment protection register, upper" ULONG CU_MPL_ERROR_LOG_DETAILED[1].34 1 100 0.0 4294967295.0 ECU_ADDRESS 0xf0240530 BYTE_ORDER MSB_LAST /end MEASUREMENT
/begin COMPU_METHOD CU_MPL_ERROR_LOG_DETAILED[1].34 "Conversion method for mpl_error_log_detailed[1].err_log.cpu_log.dpr_upr[16]" RAT_FUNC "%10.0" "(not defined)" COEFFS 0.000000 1.000000 -0.000000 0.000000 0.000000 1.000000 /end COMPU_METHOD
/* Scalar measurable for DDE 'mpl_error_log_detailed[1].err_log.cpu_log.dpr_upr[17]'. */
/begin MEASUREMENT mpl_error_log_detailed[1].err48 "CPU/MPU data segment protection register, upper" ULONG CU_MPL_ERROR_LOG_DETAILED[1].50 1 100 0.0 4294967295.0 ECU_ADDRESS 0xf0240534 BYTE_ORDER MSB_LAST /end MEASUREMENT
/begin COMPU_METHOD CU_MPL_ERROR_LOG_DETAILED[1].50 "Conversion method for mpl_error_log_detailed[1].err_log.cpu_log.dpr_upr[17]" RAT_FUNC "%10.0" "(not defined)" COEFFS 0.000000 1.000000 -0.000000 0.000000 0.000000 1.000000 /end COMPU_METHOD
/* Scalar measurable for DDE 'mpl_error_log_detailed[1].err_log.cpu_log.dpr_upr[1]'. */
/begin MEASUREMENT mpl_error_log_detailed[1].err11 "CPU/MPU data segment protection register, upper" ULONG CU_MPL_ERROR_LOG_DETAILED[1].12 1 100 0.0 4294967295.0 ECU_ADDRESS 0xf02404f4 BYTE_ORDER MSB_LAST /end MEASUREMENT
/begin COMPU_METHOD CU_MPL_ERROR_LOG_DETAILED[1].12 "Conversion method for mpl_error_log_detailed[1].err_log.cpu_log.dpr_upr[1]" RAT_FUNC "%10.0" "(not defined)" COEFFS 0.000000 1.000000 -0.000000 0.000000 0.000000 1.000000 /end COMPU_METHOD
/* Scalar measurable for DDE 'mpl_error_log_detailed[1].err_log.cpu_log.dpr_upr[2]'. */
/begin MEASUREMENT mpl_error_log_detailed[1].err42 "CPU/MPU data segment protection register, upper" ULONG CU_MPL_ERROR_LOG_DETAILED[1].44 1 100 0.0 4294967295.0 ECU_ADDRESS 0xf02404f8 BYTE_ORDER MSB_LAST /end MEASUREMENT
/begin COMPU_METHOD CU_MPL_ERROR_LOG_DETAILED[1].44 "Conversion method for mpl_error_log_detailed[1].err_log.cpu_log.dpr_upr[2]" RAT_FUNC "%10.0" "(not defined)" COEFFS 0.000000 1.000000 -0.000000 0.000000 0.000000 1.000000 /end COMPU_METHOD
/* Scalar measurable for DDE 'mpl_error_log_detailed[1].err_log.cpu_log.dpr_upr[3]'. */
/begin MEASUREMENT mpl_error_log_detailed[1].err71 "CPU/MPU data segment protection register, upper" ULONG CU_MPL_ERROR_LOG_DETAILED[1].74 1 100 0.0 4294967295.0 ECU_ADDRESS 0xf02404fc BYTE_ORDER MSB_LAST /end MEASUREMENT
/begin COMPU_METHOD CU_MPL_ERROR_LOG_DETAILED[1].74 "Conversion method for mpl_error_log_detailed[1].err_log.cpu_log.dpr_upr[3]" RAT_FUNC "%10.0" "(not defined)" COEFFS 0.000000 1.000000 -0.000000 0.000000 0.000000 1.000000 /end COMPU_METHOD
/* Scalar measurable for DDE 'mpl_error_log_detailed[1].err_log.cpu_log.dpr_upr[4]'. */
/begin MEASUREMENT mpl_error_log_detailed[1].err61 "CPU/MPU data segment protection register, upper" ULONG CU_MPL_ERROR_LOG_DETAILED[1].63 1 100 0.0 4294967295.0 ECU_ADDRESS 0xf0240500 BYTE_ORDER MSB_LAST /end MEASUREMENT
/begin COMPU_METHOD CU_MPL_ERROR_LOG_DETAILED[1].63 "Conversion method for mpl_error_log_detailed[1].err_log.cpu_log.dpr_upr[4]" RAT_FUNC "%10.0" "(not defined)" COEFFS 0.000000 1.000000 -0.000000 0.000000 0.000000 1.000000 /end COMPU_METHOD
/* Scalar measurable for DDE 'mpl_error_log_detailed[1].err_log.cpu_log.dpr_upr[5]'. */
/begin MEASUREMENT mpl_error_log_detailed[1].err53 "CPU/MPU data segment protection register, upper" ULONG CU_MPL_ERROR_LOG_DETAILED[1].55 1 100 0.0 4294967295.0 ECU_ADDRESS 0xf0240504 BYTE_ORDER MSB_LAST /end MEASUREMENT
/begin COMPU_METHOD CU_MPL_ERROR_LOG_DETAILED[1].55 "Conversion method for mpl_error_log_detailed[1].err_log.cpu_log.dpr_upr[5]" RAT_FUNC "%10.0" "(not defined)" COEFFS 0.000000 1.000000 -0.000000 0.000000 0.000000 1.000000 /end COMPU_METHOD
/* Scalar measurable for DDE 'mpl_error_log_detailed[1].err_log.cpu_log.dpr_upr[6]'. */
/begin MEASUREMENT mpl_error_log_detailed[1].err85 "CPU/MPU data segment protection register, upper" ULONG CU_MPL_ERROR_LOG_DETAILED[1].88 1 100 0.0 4294967295.0 ECU_ADDRESS 0xf0240508 BYTE_ORDER MSB_LAST /end MEASUREMENT
/begin COMPU_METHOD CU_MPL_ERROR_LOG_DETAILED[1].88 "Conversion method for mpl_error_log_detailed[1].err_log.cpu_log.dpr_upr[6]" RAT_FUNC "%10.0" "(not defined)" COEFFS 0.000000 1.000000 -0.000000 0.000000 0.000000 1.000000 /end COMPU_METHOD
/* Scalar measurable for DDE 'mpl_error_log_detailed[1].err_log.cpu_log.dpr_upr[7]'. */
/begin MEASUREMENT mpl_error_log_detailed[1].err49 "CPU/MPU data segment protection register, upper" ULONG CU_MPL_ERROR_LOG_DETAILED[1].51 1 100 0.0 4294967295.0 ECU_ADDRESS 0xf024050c BYTE_ORDER MSB_LAST /end MEASUREMENT
/begin COMPU_METHOD CU_MPL_ERROR_LOG_DETAILED[1].51 "Conversion method for mpl_error_log_detailed[1].err_log.cpu_log.dpr_upr[7]" RAT_FUNC "%10.0" "(not defined)" COEFFS 0.000000 1.000000 -0.000000 0.000000 0.000000 1.000000 /end COMPU_METHOD
/* Scalar measurable for DDE 'mpl_error_log_detailed[1].err_log.cpu_log.dpr_upr[8]'. */
/begin MEASUREMENT mpl_error_log_detailed[1].er011 "CPU/MPU data segment protection register, upper" ULONG CU_MPL_ERROR_LOG_DETAILED[1]014 1 100 0.0 4294967295.0 ECU_ADDRESS 0xf0240510 BYTE_ORDER MSB_LAST /end MEASUREMENT
/begin COMPU_METHOD CU_MPL_ERROR_LOG_DETAILED[1]014 "Conversion method for mpl_error_log_detailed[1].err_log.cpu_log.dpr_upr[8]" RAT_FUNC "%10.0" "(not defined)" COEFFS 0.000000 1.000000 -0.000000 0.000000 0.000000 1.000000 /end COMPU_METHOD
/* Scalar measurable for DDE 'mpl_error_log_detailed[1].err_log.cpu_log.dpr_upr[9]'. */
/begin MEASUREMENT mpl_error_log_detailed[1].er002 "CPU/MPU data segment protection register, upper" ULONG CU_MPL_ERROR_LOG_DETAILED[1]005 1 100 0.0 4294967295.0 ECU_ADDRESS 0xf0240514 BYTE_ORDER MSB_LAST /end MEASUREMENT
/begin COMPU_METHOD CU_MPL_ERROR_LOG_DETAILED[1]005 "Conversion method for mpl_error_log_detailed[1].err_log.cpu_log.dpr_upr[9]" RAT_FUNC "%10.0" "(not defined)" COEFFS 0.000000 1.000000 -0.000000 0.000000 0.000000 1.000000 /end COMPU_METHOD
/* Scalar measurable for DDE 'mpl_error_log_detailed[1].err_log.cpu_log.dpre[0]'. */
/begin MEASUREMENT mpl_error_log_detailed[1].err99 "CPU/MPU data protection read enable configuration register" ULONG CU_MPL_ERROR_LOG_DETAILED[1]002 1 100 0.0 4294967295.0 ECU_ADDRESS 0xf02405a0 BYTE_ORDER MSB_LAST /end MEASUREMENT
/begin COMPU_METHOD CU_MPL_ERROR_LOG_DETAILED[1]002 "Conversion method for mpl_error_log_detailed[1].err_log.cpu_log.dpre[0]" RAT_FUNC "%10.0" "(not defined)" COEFFS 0.000000 1.000000 -0.000000 0.000000 0.000000 1.000000 /end COMPU_METHOD
/* Scalar measurable for DDE 'mpl_error_log_detailed[1].err_log.cpu_log.dpre[1]'. */
/begin MEASUREMENT mpl_error_log_detailed[1].er015 "CPU/MPU data protection read enable configuration register" ULONG CU_MPL_ERROR_LOG_DETAILED[1]018 1 100 0.0 4294967295.0 ECU_ADDRESS 0xf02405a4 BYTE_ORDER MSB_LAST /end MEASUREMENT
/begin COMPU_METHOD CU_MPL_ERROR_LOG_DETAILED[1]018 "Conversion method for mpl_error_log_detailed[1].err_log.cpu_log.dpre[1]" RAT_FUNC "%10.0" "(not defined)" COEFFS 0.000000 1.000000 -0.000000 0.000000 0.000000 1.000000 /end COMPU_METHOD
/* Scalar measurable for DDE 'mpl_error_log_detailed[1].err_log.cpu_log.dpre[2]'. */
/begin MEASUREMENT mpl_error_log_detailed[1].err73 "CPU/MPU data protection read enable configuration register" ULONG CU_MPL_ERROR_LOG_DETAILED[1].76 1 100 0.0 4294967295.0 ECU_ADDRESS 0xf02405a8 BYTE_ORDER MSB_LAST /end MEASUREMENT
/begin COMPU_METHOD CU_MPL_ERROR_LOG_DETAILED[1].76 "Conversion method for mpl_error_log_detailed[1].err_log.cpu_log.dpre[2]" RAT_FUNC "%10.0" "(not defined)" COEFFS 0.000000 1.000000 -0.000000 0.000000 0.000000 1.000000 /end COMPU_METHOD
/* Scalar measurable for DDE 'mpl_error_log_detailed[1].err_log.cpu_log.dpre[3]'. */
/begin MEASUREMENT mpl_error_log_detailed[1].err88 "CPU/MPU data protection read enable configuration register" ULONG CU_MPL_ERROR_LOG_DETAILED[1].91 1 100 0.0 4294967295.0 ECU_ADDRESS 0xf02405ac BYTE_ORDER MSB_LAST /end MEASUREMENT
/begin COMPU_METHOD CU_MPL_ERROR_LOG_DETAILED[1].91 "Conversion method for mpl_error_log_detailed[1].err_log.cpu_log.dpre[3]" RAT_FUNC "%10.0" "(not defined)" COEFFS 0.000000 1.000000 -0.000000 0.000000 0.000000 1.000000 /end COMPU_METHOD
/* Scalar measurable for DDE 'mpl_error_log_detailed[1].err_log.cpu_log.dpre[4]'. */
/begin MEASUREMENT mpl_error_log_detailed[1].er043 "CPU/MPU data protection read enable configuration register" ULONG CU_MPL_ERROR_LOG_DETAILED[1]046 1 100 0.0 4294967295.0 ECU_ADDRESS 0xf02405b0 BYTE_ORDER MSB_LAST /end MEASUREMENT
/begin COMPU_METHOD CU_MPL_ERROR_LOG_DETAILED[1]046 "Conversion method for mpl_error_log_detailed[1].err_log.cpu_log.dpre[4]" RAT_FUNC "%10.0" "(not defined)" COEFFS 0.000000 1.000000 -0.000000 0.000000 0.000000 1.000000 /end COMPU_METHOD
/* Scalar measurable for DDE 'mpl_error_log_detailed[1].err_log.cpu_log.dpre[5]'. */
/begin MEASUREMENT mpl_error_log_detailed[1].err43 "CPU/MPU data protection read enable configuration register" ULONG CU_MPL_ERROR_LOG_DETAILED[1].45 1 100 0.0 4294967295.0 ECU_ADDRESS 0xf02405b4 BYTE_ORDER MSB_LAST /end MEASUREMENT
/begin COMPU_METHOD CU_MPL_ERROR_LOG_DETAILED[1].45 "Conversion method for mpl_error_log_detailed[1].err_log.cpu_log.dpre[5]" RAT_FUNC "%10.0" "(not defined)" COEFFS 0.000000 1.000000 -0.000000 0.000000 0.000000 1.000000 /end COMPU_METHOD
/* Scalar measurable for DDE 'mpl_error_log_detailed[1].err_log.cpu_log.dpwe[0]'. */
/begin MEASUREMENT mpl_error_log_detailed[1].err74 "CPU/MPU data protection write enable configuration register" ULONG CU_MPL_ERROR_LOG_DETAILED[1].77 1 100 0.0 4294967295.0 ECU_ADDRESS 0xf02405b8 BYTE_ORDER MSB_LAST /end MEASUREMENT
/begin COMPU_METHOD CU_MPL_ERROR_LOG_DETAILED[1].77 "Conversion method for mpl_error_log_detailed[1].err_log.cpu_log.dpwe[0]" RAT_FUNC "%10.0" "(not defined)" COEFFS 0.000000 1.000000 -0.000000 0.000000 0.000000 1.000000 /end COMPU_METHOD
/* Scalar measurable for DDE 'mpl_error_log_detailed[1].err_log.cpu_log.dpwe[1]'. */
/begin MEASUREMENT mpl_error_log_detailed[1].err67 "CPU/MPU data protection write enable configuration register" ULONG CU_MPL_ERROR_LOG_DETAILED[1].69 1 100 0.0 4294967295.0 ECU_ADDRESS 0xf02405bc BYTE_ORDER MSB_LAST /end MEASUREMENT
/begin COMPU_METHOD CU_MPL_ERROR_LOG_DETAILED[1].69 "Conversion method for mpl_error_log_detailed[1].err_log.cpu_log.dpwe[1]" RAT_FUNC "%10.0" "(not defined)" COEFFS 0.000000 1.000000 -0.000000 0.000000 0.000000 1.000000 /end COMPU_METHOD
/* Scalar measurable for DDE 'mpl_error_log_detailed[1].err_log.cpu_log.dpwe[2]'. */
/begin MEASUREMENT mpl_error_log_detailed[1].er001 "CPU/MPU data protection write enable configuration register" ULONG CU_MPL_ERROR_LOG_DETAILED[1]004 1 100 0.0 4294967295.0 ECU_ADDRESS 0xf02405c0 BYTE_ORDER MSB_LAST /end MEASUREMENT
/begin COMPU_METHOD CU_MPL_ERROR_LOG_DETAILED[1]004 "Conversion method for mpl_error_log_detailed[1].err_log.cpu_log.dpwe[2]" RAT_FUNC "%10.0" "(not defined)" COEFFS 0.000000 1.000000 -0.000000 0.000000 0.000000 1.000000 /end COMPU_METHOD
/* Scalar measurable for DDE 'mpl_error_log_detailed[1].err_log.cpu_log.dpwe[3]'. */
/begin MEASUREMENT mpl_error_log_detailed[1].err90 "CPU/MPU data protection write enable configuration register" ULONG CU_MPL_ERROR_LOG_DETAILED[1].93 1 100 0.0 4294967295.0 ECU_ADDRESS 0xf02405c4 BYTE_ORDER MSB_LAST /end MEASUREMENT
/begin COMPU_METHOD CU_MPL_ERROR_LOG_DETAILED[1].93 "Conversion method for mpl_error_log_detailed[1].err_log.cpu_log.dpwe[3]" RAT_FUNC "%10.0" "(not defined)" COEFFS 0.000000 1.000000 -0.000000 0.000000 0.000000 1.000000 /end COMPU_METHOD
/* Scalar measurable for DDE 'mpl_error_log_detailed[1].err_log.cpu_log.dpwe[4]'. */
/begin MEASUREMENT mpl_error_log_detailed[1].err31 "CPU/MPU data protection write enable configuration register" ULONG CU_MPL_ERROR_LOG_DETAILED[1].33 1 100 0.0 4294967295.0 ECU_ADDRESS 0xf02405c8 BYTE_ORDER MSB_LAST /end MEASUREMENT
/begin COMPU_METHOD CU_MPL_ERROR_LOG_DETAILED[1].33 "Conversion method for mpl_error_log_detailed[1].err_log.cpu_log.dpwe[4]" RAT_FUNC "%10.0" "(not defined)" COEFFS 0.000000 1.000000 -0.000000 0.000000 0.000000 1.000000 /end COMPU_METHOD
/* Scalar measurable for DDE 'mpl_error_log_detailed[1].err_log.cpu_log.dpwe[5]'. */
/begin MEASUREMENT mpl_error_log_detailed[1].err24 "CPU/MPU data protection write enable configuration register" ULONG CU_MPL_ERROR_LOG_DETAILED[1].26 1 100 0.0 4294967295.0 ECU_ADDRESS 0xf02405cc BYTE_ORDER MSB_LAST /end MEASUREMENT
/begin COMPU_METHOD CU_MPL_ERROR_LOG_DETAILED[1].26 "Conversion method for mpl_error_log_detailed[1].err_log.cpu_log.dpwe[5]" RAT_FUNC "%10.0" "(not defined)" COEFFS 0.000000 1.000000 -0.000000 0.000000 0.000000 1.000000 /end COMPU_METHOD
/* Scalar measurable for DDE 'mpl_error_log_detailed[1].err_log.cpu_log.dstr'. */
/begin MEASUREMENT mpl_error_log_detailed[1].er044 "CPU data synchronous error trap register" ULONG CU_MPL_ERROR_LOG_DETAILED[1]047 1 100 0.0 4294967295.0 ECU_ADDRESS 0xf0240468 BYTE_ORDER MSB_LAST /end MEASUREMENT
/begin COMPU_METHOD CU_MPL_ERROR_LOG_DETAILED[1]047 "Conversion method for mpl_error_log_detailed[1].err_log.cpu_log.dstr" RAT_FUNC "%10.0" "(not defined)" COEFFS 0.000000 1.000000 -0.000000 0.000000 0.000000 1.000000 /end COMPU_METHOD
/* Scalar measurable for DDE 'mpl_error_log_detailed[1].err_log.cpu_log.fcx'. */
/begin MEASUREMENT mpl_error_log_detailed[1].err70 "CPU free context list head pointer register" ULONG CU_MPL_ERROR_LOG_DETAILED[1].73 1 100 0.0 4294967295.0 ECU_ADDRESS 0xf02405dc BYTE_ORDER MSB_LAST /end MEASUREMENT
/begin COMPU_METHOD CU_MPL_ERROR_LOG_DETAILED[1].73 "Conversion method for mpl_error_log_detailed[1].err_log.cpu_log.fcx" RAT_FUNC "%10.0" "(not defined)" COEFFS 0.000000 1.000000 -0.000000 0.000000 0.000000 1.000000 /end COMPU_METHOD
/* Scalar measurable for DDE 'mpl_error_log_detailed[1].err_log.cpu_log.flashcon0'. */
/begin MEASUREMENT mpl_error_log_detailed[1].err03 "CPU flash configuration register" ULONG CU_MPL_ERROR_LOG_DETAILED[1].03 1 100 0.0 4294967295.0 ECU_ADDRESS 0xf02405f0 BYTE_ORDER MSB_LAST /end MEASUREMENT
/begin COMPU_METHOD CU_MPL_ERROR_LOG_DETAILED[1].03 "Conversion method for mpl_error_log_detailed[1].err_log.cpu_log.flashcon0" RAT_FUNC "%10.0" "(not defined)" COEFFS 0.000000 1.000000 -0.000000 0.000000 0.000000 1.000000 /end COMPU_METHOD
/* Scalar measurable for DDE 'mpl_error_log_detailed[1].err_log.cpu_log.flashcon1'. */
/begin MEASUREMENT mpl_error_log_detailed[1].err02 "CPU flash configuration register" ULONG CU_MPL_ERROR_LOG_DETAILED[1].02 1 100 0.0 4294967295.0 ECU_ADDRESS 0xf02405f4 BYTE_ORDER MSB_LAST /end MEASUREMENT
/begin COMPU_METHOD CU_MPL_ERROR_LOG_DETAILED[1].02 "Conversion method for mpl_error_log_detailed[1].err_log.cpu_log.flashcon1" RAT_FUNC "%10.0" "(not defined)" COEFFS 0.000000 1.000000 -0.000000 0.000000 0.000000 1.000000 /end COMPU_METHOD
/* Scalar measurable for DDE 'mpl_error_log_detailed[1].err_log.cpu_log.flashcon2'. */
/begin MEASUREMENT mpl_error_log_detailed[1].err98 "CPU flash configuration register" ULONG CU_MPL_ERROR_LOG_DETAILED[1]001 1 100 0.0 4294967295.0 ECU_ADDRESS 0xf02405f8 BYTE_ORDER MSB_LAST /end MEASUREMENT
/begin COMPU_METHOD CU_MPL_ERROR_LOG_DETAILED[1]001 "Conversion method for mpl_error_log_detailed[1].err_log.cpu_log.flashcon2" RAT_FUNC "%10.0" "(not defined)" COEFFS 0.000000 1.000000 -0.000000 0.000000 0.000000 1.000000 /end COMPU_METHOD
/* Scalar measurable for DDE 'mpl_error_log_detailed[1].err_log.cpu_log.flashcon3'. */
/begin MEASUREMENT mpl_error_log_detailed[1].err59 "CPU flash configuration register" ULONG CU_MPL_ERROR_LOG_DETAILED[1].61 1 100 0.0 4294967295.0 ECU_ADDRESS 0xf02405fc BYTE_ORDER MSB_LAST /end MEASUREMENT
/begin COMPU_METHOD CU_MPL_ERROR_LOG_DETAILED[1].61 "Conversion method for mpl_error_log_detailed[1].err_log.cpu_log.flashcon3" RAT_FUNC "%10.0" "(not defined)" COEFFS 0.000000 1.000000 -0.000000 0.000000 0.000000 1.000000 /end COMPU_METHOD
/* Scalar measurable for DDE 'mpl_error_log_detailed[1].err_log.cpu_log.fpu_trap_con'. */
/begin MEASUREMENT mpl_error_log_detailed[1].err72 "CPU/FPU trap control register" ULONG CU_MPL_ERROR_LOG_DETAILED[1].75 1 100 0.0 4294967295.0 ECU_ADDRESS 0xf0240490 BYTE_ORDER MSB_LAST /end MEASUREMENT
/begin COMPU_METHOD CU_MPL_ERROR_LOG_DETAILED[1].75 "Conversion method for mpl_error_log_detailed[1].err_log.cpu_log.fpu_trap_con" RAT_FUNC "%10.0" "(not defined)" COEFFS 0.000000 1.000000 -0.000000 0.000000 0.000000 1.000000 /end COMPU_METHOD
/* Scalar measurable for DDE 'mpl_error_log_detailed[1].err_log.cpu_log.fpu_trap_opc'. */
/begin MEASUREMENT mpl_error_log_detailed[1].err81 "CPU/FPU trap instruction opcode register" ULONG CU_MPL_ERROR_LOG_DETAILED[1].84 1 100 0.0 4294967295.0 ECU_ADDRESS 0xf0240498 BYTE_ORDER MSB_LAST /end MEASUREMENT
/begin COMPU_METHOD CU_MPL_ERROR_LOG_DETAILED[1].84 "Conversion method for mpl_error_log_detailed[1].err_log.cpu_log.fpu_trap_opc" RAT_FUNC "%10.0" "(not defined)" COEFFS 0.000000 1.000000 -0.000000 0.000000 0.000000 1.000000 /end COMPU_METHOD
/* Scalar measurable for DDE 'mpl_error_log_detailed[1].err_log.cpu_log.fpu_trap_pc'. */
/begin MEASUREMENT mpl_error_log_detailed[1].err47 "CPU/FPU trap instruction program control register" ULONG CU_MPL_ERROR_LOG_DETAILED[1].49 1 100 0.0 4294967295.0 ECU_ADDRESS 0xf0240494 BYTE_ORDER MSB_LAST /end MEASUREMENT
/begin COMPU_METHOD CU_MPL_ERROR_LOG_DETAILED[1].49 "Conversion method for mpl_error_log_detailed[1].err_log.cpu_log.fpu_trap_pc" RAT_FUNC "%10.0" "(not defined)" COEFFS 0.000000 1.000000 -0.000000 0.000000 0.000000 1.000000 /end COMPU_METHOD
/* Scalar measurable for DDE 'mpl_error_log_detailed[1].err_log.cpu_log.fpu_trap_src1'. */
/begin MEASUREMENT mpl_error_log_detailed[1].err_1 "CPU/FPU trap instruction operand register" ULONG CU_MPL_ERROR_LOG_DETAILED[1].E1 1 100 0.0 4294967295.0 ECU_ADDRESS 0xf024049c BYTE_ORDER MSB_LAST /end MEASUREMENT
/begin COMPU_METHOD CU_MPL_ERROR_LOG_DETAILED[1].E1 "Conversion method for mpl_error_log_detailed[1].err_log.cpu_log.fpu_trap_src1" RAT_FUNC "%10.0" "(not defined)" COEFFS 0.000000 1.000000 -0.000000 0.000000 0.000000 1.000000 /end COMPU_METHOD
/* Scalar measurable for DDE 'mpl_error_log_detailed[1].err_log.cpu_log.fpu_trap_src2'. */
/begin MEASUREMENT mpl_error_log_detailed[1].er026 "CPU/FPU trap instruction operand register" ULONG CU_MPL_ERROR_LOG_DETAILED[1]029 1 100 0.0 4294967295.0 ECU_ADDRESS 0xf02404a0 BYTE_ORDER MSB_LAST /end MEASUREMENT
/begin COMPU_METHOD CU_MPL_ERROR_LOG_DETAILED[1]029 "Conversion method for mpl_error_log_detailed[1].err_log.cpu_log.fpu_trap_src2" RAT_FUNC "%10.0" "(not defined)" COEFFS 0.000000 1.000000 -0.000000 0.000000 0.000000 1.000000 /end COMPU_METHOD
/* Scalar measurable for DDE 'mpl_error_log_detailed[1].err_log.cpu_log.fpu_trap_src3'. */
/begin MEASUREMENT mpl_error_log_detailed[1].er025 "CPU/FPU trap instruction operand register" ULONG CU_MPL_ERROR_LOG_DETAILED[1]028 1 100 0.0 4294967295.0 ECU_ADDRESS 0xf02404a4 BYTE_ORDER MSB_LAST /end MEASUREMENT
/begin COMPU_METHOD CU_MPL_ERROR_LOG_DETAILED[1]028 "Conversion method for mpl_error_log_detailed[1].err_log.cpu_log.fpu_trap_src3" RAT_FUNC "%10.0" "(not defined)" COEFFS 0.000000 1.000000 -0.000000 0.000000 0.000000 1.000000 /end COMPU_METHOD
/* Scalar measurable for DDE 'mpl_error_log_detailed[1].err_log.cpu_log.icr'. */
/begin MEASUREMENT mpl_error_log_detailed[1].err06 "CPU interrupt control register" ULONG CU_MPL_ERROR_LOG_DETAILED[1].06 1 100 0.0 4294967295.0 ECU_ADDRESS 0xf02405d4 BYTE_ORDER MSB_LAST /end MEASUREMENT
/begin COMPU_METHOD CU_MPL_ERROR_LOG_DETAILED[1].06 "Conversion method for mpl_error_log_detailed[1].err_log.cpu_log.icr" RAT_FUNC "%10.0" "(not defined)" COEFFS 0.000000 1.000000 -0.000000 0.000000 0.000000 1.000000 /end COMPU_METHOD
/* Scalar measurable for DDE 'mpl_error_log_detailed[1].err_log.cpu_log.isp'. */
/begin MEASUREMENT mpl_error_log_detailed[1].err30 "CPU interrupt stack pointer register" ULONG CU_MPL_ERROR_LOG_DETAILED[1].32 1 100 0.0 4294967295.0 ECU_ADDRESS 0xf02405d8 BYTE_ORDER MSB_LAST /end MEASUREMENT
/begin COMPU_METHOD CU_MPL_ERROR_LOG_DETAILED[1].32 "Conversion method for mpl_error_log_detailed[1].err_log.cpu_log.isp" RAT_FUNC "%10.0" "(not defined)" COEFFS 0.000000 1.000000 -0.000000 0.000000 0.000000 1.000000 /end COMPU_METHOD
/* Scalar measurable for DDE 'mpl_error_log_detailed[1].err_log.cpu_log.lcx'. */
/begin MEASUREMENT mpl_error_log_detailed[1].err28 "CPU free context list limit pointer register" ULONG CU_MPL_ERROR_LOG_DETAILED[1].30 1 100 0.0 4294967295.0 ECU_ADDRESS 0xf02405e0 BYTE_ORDER MSB_LAST /end MEASUREMENT
/begin COMPU_METHOD CU_MPL_ERROR_LOG_DETAILED[1].30 "Conversion method for mpl_error_log_detailed[1].err_log.cpu_log.lcx" RAT_FUNC "%10.0" "(not defined)" COEFFS 0.000000 1.000000 -0.000000 0.000000 0.000000 1.000000 /end COMPU_METHOD
/* Scalar measurable for DDE 'mpl_error_log_detailed[1].err_log.cpu_log.pcon0'. */
/begin MEASUREMENT mpl_error_log_detailed[1].er040 "CPU program memory configuration register" ULONG CU_MPL_ERROR_LOG_DETAILED[1]043 1 100 0.0 4294967295.0 ECU_ADDRESS 0xf024047c BYTE_ORDER MSB_LAST /end MEASUREMENT
/begin COMPU_METHOD CU_MPL_ERROR_LOG_DETAILED[1]043 "Conversion method for mpl_error_log_detailed[1].err_log.cpu_log.pcon0" RAT_FUNC "%10.0" "(not defined)" COEFFS 0.000000 1.000000 -0.000000 0.000000 0.000000 1.000000 /end COMPU_METHOD
/* Scalar measurable for DDE 'mpl_error_log_detailed[1].err_log.cpu_log.pcon1'. */
/begin MEASUREMENT mpl_error_log_detailed[1].er020 "CPU program memory configuration register" ULONG CU_MPL_ERROR_LOG_DETAILED[1]023 1 100 0.0 4294967295.0 ECU_ADDRESS 0xf0240480 BYTE_ORDER MSB_LAST /end MEASUREMENT
/begin COMPU_METHOD CU_MPL_ERROR_LOG_DETAILED[1]023 "Conversion method for mpl_error_log_detailed[1].err_log.cpu_log.pcon1" RAT_FUNC "%10.0" "(not defined)" COEFFS 0.000000 1.000000 -0.000000 0.000000 0.000000 1.000000 /end COMPU_METHOD
/* Scalar measurable for DDE 'mpl_error_log_detailed[1].err_log.cpu_log.pcon2'. */
/begin MEASUREMENT mpl_error_log_detailed[1].er019 "CPU program memory configuration register" ULONG CU_MPL_ERROR_LOG_DETAILED[1]022 1 100 0.0 4294967295.0 ECU_ADDRESS 0xf0240484 BYTE_ORDER MSB_LAST /end MEASUREMENT
/begin COMPU_METHOD CU_MPL_ERROR_LOG_DETAILED[1]022 "Conversion method for mpl_error_log_detailed[1].err_log.cpu_log.pcon2" RAT_FUNC "%10.0" "(not defined)" COEFFS 0.000000 1.000000 -0.000000 0.000000 0.000000 1.000000 /end COMPU_METHOD
/* Scalar measurable for DDE 'mpl_error_log_detailed[1].err_log.cpu_log.piear'. */
/begin MEASUREMENT mpl_error_log_detailed[1].err04 "CPU program integrity error address register" ULONG CU_MPL_ERROR_LOG_DETAILED[1].04 1 100 0.0 4294967295.0 ECU_ADDRESS 0xf0240488 BYTE_ORDER MSB_LAST /end MEASUREMENT
/begin COMPU_METHOD CU_MPL_ERROR_LOG_DETAILED[1].04 "Conversion method for mpl_error_log_detailed[1].err_log.cpu_log.piear" RAT_FUNC "%10.0" "(not defined)" COEFFS 0.000000 1.000000 -0.000000 0.000000 0.000000 1.000000 /end COMPU_METHOD
/* Scalar measurable for DDE 'mpl_error_log_detailed[1].err_log.cpu_log.pietr'. */
/begin MEASUREMENT mpl_error_log_detailed[1].er003 "CPU program integrity error trap register" ULONG CU_MPL_ERROR_LOG_DETAILED[1]006 1 100 0.0 4294967295.0 ECU_ADDRESS 0xf024048c BYTE_ORDER MSB_LAST /end MEASUREMENT
/begin COMPU_METHOD CU_MPL_ERROR_LOG_DETAILED[1]006 "Conversion method for mpl_error_log_detailed[1].err_log.cpu_log.pietr" RAT_FUNC "%10.0" "(not defined)" COEFFS 0.000000 1.000000 -0.000000 0.000000 0.000000 1.000000 /end COMPU_METHOD
/* Scalar measurable for DDE 'mpl_error_log_detailed[1].err_log.cpu_log.syscon'. */
/begin MEASUREMENT mpl_error_log_detailed[1].err92 "CPU system configuration register" ULONG CU_MPL_ERROR_LOG_DETAILED[1].95 1 100 0.0 4294967295.0 ECU_ADDRESS 0xf02405ec BYTE_ORDER MSB_LAST /end MEASUREMENT
/begin COMPU_METHOD CU_MPL_ERROR_LOG_DETAILED[1].95 "Conversion method for mpl_error_log_detailed[1].err_log.cpu_log.syscon" RAT_FUNC "%10.0" "(not defined)" COEFFS 0.000000 1.000000 -0.000000 0.000000 0.000000 1.000000 /end COMPU_METHOD
/* Scalar measurable for DDE 'mpl_error_log_detailed[1].err_log.cpu_log.tps_con'. */
/begin MEASUREMENT mpl_error_log_detailed[1].err93 "CPU temporal protection system control register" ULONG CU_MPL_ERROR_LOG_DETAILED[1].96 1 100 0.0 4294967295.0 ECU_ADDRESS 0xf02405d0 BYTE_ORDER MSB_LAST /end MEASUREMENT
/begin COMPU_METHOD CU_MPL_ERROR_LOG_DETAILED[1].96 "Conversion method for mpl_error_log_detailed[1].err_log.cpu_log.tps_con" RAT_FUNC "%10.0" "(not defined)" COEFFS 0.000000 1.000000 -0.000000 0.000000 0.000000 1.000000 /end COMPU_METHOD
/* Scalar measurable for DDE 'mpl_error_log_detailed[1].err_log.csa.lower.A2'. */
/begin MEASUREMENT mpl_error_log_detailed[1].err29 "CPU address register" ULONG CU_MPL_ERROR_LOG_DETAILED[1].31 1 100 0.0 4294967295.0 ECU_ADDRESS 0xf0240430 BYTE_ORDER MSB_LAST /end MEASUREMENT
/begin COMPU_METHOD CU_MPL_ERROR_LOG_DETAILED[1].31 "Conversion method for mpl_error_log_detailed[1].err_log.csa.lower.A2" RAT_FUNC "%10.0" "(not defined)" COEFFS 0.000000 1.000000 -0.000000 0.000000 0.000000 1.000000 /end COMPU_METHOD
/* Scalar measurable for DDE 'mpl_error_log_detailed[1].err_log.csa.lower.A3'. */
/begin MEASUREMENT mpl_error_log_detailed[1].err38 "CPU address register" ULONG CU_MPL_ERROR_LOG_DETAILED[1].40 1 100 0.0 4294967295.0 ECU_ADDRESS 0xf0240434 BYTE_ORDER MSB_LAST /end MEASUREMENT
/begin COMPU_METHOD CU_MPL_ERROR_LOG_DETAILED[1].40 "Conversion method for mpl_error_log_detailed[1].err_log.csa.lower.A3" RAT_FUNC "%10.0" "(not defined)" COEFFS 0.000000 1.000000 -0.000000 0.000000 0.000000 1.000000 /end COMPU_METHOD
/* Scalar measurable for DDE 'mpl_error_log_detailed[1].err_log.csa.lower.A4'. */
/begin MEASUREMENT mpl_error_log_detailed[1].err35 "CPU address register" ULONG CU_MPL_ERROR_LOG_DETAILED[1].37 1 100 0.0 4294967295.0 ECU_ADDRESS 0xf0240448 BYTE_ORDER MSB_LAST /end MEASUREMENT
/begin COMPU_METHOD CU_MPL_ERROR_LOG_DETAILED[1].37 "Conversion method for mpl_error_log_detailed[1].err_log.csa.lower.A4" RAT_FUNC "%10.0" "(not defined)" COEFFS 0.000000 1.000000 -0.000000 0.000000 0.000000 1.000000 /end COMPU_METHOD
/* Scalar measurable for DDE 'mpl_error_log_detailed[1].err_log.csa.lower.A5'. */
/begin MEASUREMENT mpl_error_log_detailed[1].err36 "CPU address register" ULONG CU_MPL_ERROR_LOG_DETAILED[1].38 1 100 0.0 4294967295.0 ECU_ADDRESS 0xf024044c BYTE_ORDER MSB_LAST /end MEASUREMENT
/begin COMPU_METHOD CU_MPL_ERROR_LOG_DETAILED[1].38 "Conversion method for mpl_error_log_detailed[1].err_log.csa.lower.A5" RAT_FUNC "%10.0" "(not defined)" COEFFS 0.000000 1.000000 -0.000000 0.000000 0.000000 1.000000 /end COMPU_METHOD
/* Scalar measurable for DDE 'mpl_error_log_detailed[1].err_log.csa.lower.A6'. */
/begin MEASUREMENT mpl_error_log_detailed[1].er006 "CPU address register" ULONG CU_MPL_ERROR_LOG_DETAILED[1]009 1 100 0.0 4294967295.0 ECU_ADDRESS 0xf0240450 BYTE_ORDER MSB_LAST /end MEASUREMENT
/begin COMPU_METHOD CU_MPL_ERROR_LOG_DETAILED[1]009 "Conversion method for mpl_error_log_detailed[1].err_log.csa.lower.A6" RAT_FUNC "%10.0" "(not defined)" COEFFS 0.000000 1.000000 -0.000000 0.000000 0.000000 1.000000 /end COMPU_METHOD
/* Scalar measurable for DDE 'mpl_error_log_detailed[1].err_log.csa.lower.A7'. */
/begin MEASUREMENT mpl_error_log_detailed[1].err37 "CPU address register" ULONG CU_MPL_ERROR_LOG_DETAILED[1].39 1 100 0.0 4294967295.0 ECU_ADDRESS 0xf0240454 BYTE_ORDER MSB_LAST /end MEASUREMENT
/begin COMPU_METHOD CU_MPL_ERROR_LOG_DETAILED[1].39 "Conversion method for mpl_error_log_detailed[1].err_log.csa.lower.A7" RAT_FUNC "%10.0" "(not defined)" COEFFS 0.000000 1.000000 -0.000000 0.000000 0.000000 1.000000 /end COMPU_METHOD
/* Scalar measurable for DDE 'mpl_error_log_detailed[1].err_log.csa.lower.D0'. */
/begin MEASUREMENT mpl_error_log_detailed[1].err01 "CPU data register" ULONG CU_MPL_ERROR_LOG_DETAILED[1].01 1 100 0.0 4294967295.0 ECU_ADDRESS 0xf0240438 BYTE_ORDER MSB_LAST /end MEASUREMENT
/begin COMPU_METHOD CU_MPL_ERROR_LOG_DETAILED[1].01 "Conversion method for mpl_error_log_detailed[1].err_log.csa.lower.D0" RAT_FUNC "%10.0" "(not defined)" COEFFS 0.000000 1.000000 -0.000000 0.000000 0.000000 1.000000 /end COMPU_METHOD
/begin FUNCTION Automatic "Group /ByType/Automatic"
 /begin LOC_MEASUREMENT mpl_bspi_task.timing.overruns mpl_bspi_task.timing.runs mpl_bspi_task.timing.task_time mpl_cpu_loaded_1000ms_c0 mpl_cpu_loaded_1000ms_c1 mpl_cpu_loaded_50ms_c0 mpl_cpu_loaded_50ms_c1 mpl_cpu_loaded_c0 mpl_cpu_loaded_c1 mpl_ecc_flash_address mpl_ecc_ram_address mpl_error_log_detailed[0].err.1 mpl_error_log_detailed[0].err.0 mpl_error_log_detailed[0].err.2 mpl_error_log_detailed[0].err74 mpl_error_log_detailed[0].err70 mpl_error_log_detailed[0].err76 mpl_error_log_detailed[0].err43 mpl_error_log_detailed[0].er045 mpl_error_log_detailed[0].err21 mpl_error_log_detailed[0].err75 mpl_error_log_detailed[0].err78 mpl_error_log_detailed[0].err_5 mpl_error_log_detailed[0].er023 mpl_error_log_detailed[0].er009 mpl_error_log_detailed[0].er024 mpl_error_log_detailed[0].err42 mpl_error_log_detailed[0].err28 mpl_error_log_detailed[0].err60 mpl_error_log_detailed[0].err32 mpl_error_log_detailed[0].err_7 mpl_error_log_detailed[0].err27 mpl_error_log_detailed[0].err23 mpl_error_log_detailed[0].err06 mpl_error_log_detailed[0].er039 mpl_error_log_detailed[0].er026 mpl_error_log_detailed[0].er008 mpl_error_log_detailed[0].err54 mpl_error_log_detailed[0].er030 mpl_error_log_detailed[0].er042 mpl_error_log_detailed[0].err37 mpl_error_log_detailed[0].err62 mpl_error_log_detailed[0].err35 mpl_error_log_detailed[0].err96 mpl_error_log_detailed[0].er040 mpl_error_log_detailed[0].err14 mpl_error_log_detailed[0].er037 mpl_error_log_detailed[0].err08 mpl_error_log_detailed[0].err25 mpl_error_log_detailed[0].er032 mpl_error_log_detailed[0].err01 mpl_error_log_detailed[0].err_4 mpl_error_log_detailed[0].er043 mpl_error_log_detailed[0].er011 mpl_error_log_detailed[0].err18 mpl_error_log_detailed[0].er014 mpl_error_log_detailed[0].er015 mpl_error_log_detailed[0].er038 mpl_error_log_detailed[0].er034 mpl_error_log_detailed[0].err02 mpl_error_log_detailed[0].err_0 mpl_error_log_detailed[0].er044 mpl_error_log_detailed[0].err40 mpl_error_log_detailed[0].err26 mpl_error_log_detailed[0].er036 mpl_error_log_detailed[0].err10 mpl_error_log_detailed[0].err_6 mpl_error_log_detailed[0].err38 mpl_error_log_detailed[0].err34 mpl_error_log_detailed[0].err_1 mpl_error_log_detailed[0].err93 mpl_error_log_detailed[0].err87 mpl_error_log_detailed[0].err55 mpl_error_log_detailed[0].er025 mpl_error_log_detailed[0].er013 mpl_error_log_detailed[0].er029 mpl_error_log_detailed[0].err16 mpl_error_log_detailed[0].err24 mpl_error_log_detailed[0].er046 mpl_error_log_detailed[0].err_9 mpl_error_log_detailed[0].err57 mpl_error_log_detailed[0].err63 mpl_error_log_detailed[0].err72 mpl_error_log_detailed[0].err61 mpl_error_log_detailed[0].err52 mpl_error_log_detailed[0].err41 mpl_error_log_detailed[0].err49 mpl_error_log_detailed[0].err22 mpl_error_log_detailed[0].err03 mpl_error_log_detailed[0].err95 mpl_error_log_detailed[0].err82 mpl_error_log_detailed[0].err56 mpl_error_log_detailed[0].err84 mpl_error_log_detailed[0].err99 mpl_error_log_detailed[0].er012 mpl_error_log_detailed[0].err86 mpl_error_log_detailed[0].er007 mpl_error_log_detailed[0].err20 mpl_error_log_detailed[0].er005 mpl_error_log_detailed[0].er006 mpl_error_log_detailed[0].er031 mpl_error_log_detailed[0].err85 mpl_error_log_detailed[0].err17 mpl_error_log_detailed[0].err11 mpl_error_log_detailed[0].err12 mpl_error_log_detailed[0].err13 mpl_error_log_detailed[0].err09 mpl_error_log_detailed[0].err31 mpl_error_log_detailed[0].err39 mpl_error_log_detailed[0].err45 mpl_error_log_detailed[0].err46 mpl_error_log_detailed[0].err47 mpl_error_log_detailed[0].err53 mpl_error_log_detailed[0].err77 mpl_error_log_detailed[0].err98 mpl_error_log_detailed[0].err_2 mpl_error_log_detailed[0].err81 mpl_error_log_detailed[0].err80 mpl_error_log_detailed[0].err79 mpl_error_log_detailed[0].err29 mpl_error_log_detailed[0].err30 mpl_error_log_detailed[0].err83 mpl_error_log_detailed[0].er018 mpl_error_log_detailed[0].er019 mpl_error_log_detailed[0].er016 mpl_error_log_detailed[0].er017 mpl_error_log_detailed[0].er022 mpl_error_log_detailed[0].err71 mpl_error_log_detailed[0].er020 mpl_error_log_detailed[0].er021 mpl_error_log_detailed[0].err92 mpl_error_log_detailed[0].err68 mpl_error_log_detailed[0].err69 mpl_error_log_detailed[0].err89 mpl_error_log_detailed[0].err90 mpl_error_log_detailed[0].err88 mpl_error_log_detailed[0].err66 mpl_error_log_detailed[0].err00 mpl_error_log_detailed[0].err_8 mpl_error_log_detailed[0].er004 mpl_error_log_detailed[0].er003 mpl_error_log_detailed[0].er002 mpl_error_log_detailed[0].err64 mpl_error_log_detailed[0].err50 mpl_error_log_detailed[0].err33 mpl_error_log_detailed[0].err07 mpl_error_log_detailed[0].er041 mpl_error_log_detailed[0].err44 mpl_error_log_detailed[0].err15 mpl_error_log_detailed[0].err59 mpl_error_log_detailed[0].er027 mpl_error_log_detailed[0].err91 mpl_error_log_detailed[0].err97 mpl_error_log_detailed[0].er010 mpl_error_log_detailed[0].err65 mpl_error_log_detailed[0].er033 mpl_error_log_detailed[0].err48 mpl_error_log_detailed[0].err36 mpl_error_log_detailed[0].err51 mpl_error_log_detailed[0].err73 mpl_error_log_detailed[0].err94 mpl_error_log_detailed[0].err19 mpl_error_log_detailed[0].er000 mpl_error_log_detailed[0].er001 mpl_error_log_detailed[0].err67 mpl_error_log_detailed[0].er028 mpl_error_log_detailed[0].err04 mpl_error_log_detailed[0].err58 mpl_error_log_detailed[0].err_3 mpl_error_log_detailed[0].err05 mpl_error_log_detailed[0].er035 mpl_error_log_detailed[1].err.2 mpl_error_log_detailed[1].err.1 mpl_error_log_detailed[1].err.0 mpl_error_log_detailed[1].er035 mpl_error_log_detailed[1].er029 mpl_error_log_detailed[1].er038 mpl_error_log_detailed[1].err_4 mpl_error_log_detailed[1].err40 mpl_error_log_detailed[1].er034 mpl_error_log_detailed[1].err07 mpl_error_log_detailed[1].er014 mpl_error_log_detailed[1].er007 mpl_error_log_detailed[1].er012 mpl_error_log_detailed[1].err57 mpl_error_log_detailed[1].err64 mpl_error_log_detailed[1].err_0 mpl_error_log_detailed[1].err34 mpl_error_log_detailed[1].err39 mpl_error_log_detailed[1].err94 mpl_error_log_detailed[1].er000 mpl_error_log_detailed[1].er016 mpl_error_log_detailed[1].err84 mpl_error_log_detailed[1].err96 mpl_error_log_detailed[1].err80 mpl_error_log_detailed[1].err91 mpl_error_log_detailed[1].err58 mpl_error_log_detailed[1].err50 mpl_error_log_detailed[1].err79 mpl_error_log_detailed[1].err68 mpl_error_log_detailed[1].err21 mpl_error_log_detailed[1].err05 mpl_error_log_detailed[1].err66 mpl_error_log_detailed[1].err13 mpl_error_log_detailed[1].er024 mpl_error_log_detailed[1].err83 mpl_error_log_detailed[1].err78 mpl_error_log_detailed[1].err20 mpl_error_log_detailed[1].er033 mpl_error_log_detailed[1].err55 mpl_error_log_detailed[1].er036 mpl_error_log_detailed[1].err77 mpl_error_log_detailed[1].er017 mpl_error_log_detailed[1].er010 mpl_error_log_detailed[1].er041 mpl_error_log_detailed[1].er042 mpl_error_log_detailed[1].er009 mpl_error_log_detailed[1].er018 mpl_error_log_detailed[1].er028 mpl_error_log_detailed[1].err52 mpl_error_log_detailed[1].err89 mpl_error_log_detailed[1].err09 mpl_error_log_detailed[1].err19 mpl_error_log_detailed[1].err27 mpl_error_log_detailed[1].err23 mpl_error_log_detailed[1].er027 mpl_error_log_detailed[1].er021 mpl_error_log_detailed[1].er046 mpl_error_log_detailed[1].err_3 mpl_error_log_detailed[1].err14 mpl_error_log_detailed[1].err25 mpl_error_log_detailed[1].err32 mpl_error_log_detailed[1].err48 mpl_error_log_detailed[1].err11 mpl_error_log_detailed[1].err42 mpl_error_log_detailed[1].err71 mpl_error_log_detailed[1].err61 mpl_error_log_detailed[1].err53 mpl_error_log_detailed[1].err85 mpl_error_log_detailed[1].err49 mpl_error_log_detailed[1].er011 mpl_error_log_detailed[1].er002 mpl_error_log_detailed[1].err99 mpl_error_log_detailed[1].er015 mpl_error_log_detailed[1].err73 mpl_error_log_detailed[1].err88 mpl_error_log_detailed[1].er043 mpl_error_log_detailed[1].err43 mpl_error_log_detailed[1].err74 mpl_error_log_detailed[1].err67 mpl_error_log_detailed[1].er001 mpl_error_log_detailed[1].err90 mpl_error_log_detailed[1].err31 mpl_error_log_detailed[1].err24 mpl_error_log_detailed[1].er044 mpl_error_log_detailed[1].err70 mpl_error_log_detailed[1].err03 mpl_error_log_detailed[1].err02 mpl_error_log_detailed[1].err98 mpl_error_log_detailed[1].err59 mpl_error_log_detailed[1].err72 mpl_error_log_detailed[1].err81 mpl_error_log_detailed[1].err47 mpl_error_log_detailed[1].err_1 mpl_error_log_detailed[1].er026 mpl_error_log_detailed[1].er025 mpl_error_log_detailed[1].err06 mpl_error_log_detailed[1].err30 mpl_error_log_detailed[1].err28 mpl_error_log_detailed[1].er040 mpl_error_log_detailed[1].er020 mpl_error_log_detailed[1].er019 mpl_error_log_detailed[1].err04 mpl_error_log_detailed[1].er003 mpl_error_log_detailed[1].err92 mpl_error_log_detailed[1].err93 mpl_error_log_detailed[1].err29 mpl_error_log_detailed[1].err38 mpl_error_log_detailed[1].err35 mpl_error_log_detailed[1].err36 mpl_error_log_detailed[1].er006 mpl_error_log_detailed[1].err37 mpl_error_log_detailed[1].err01 /end LOC_MEASUREMENT
/end FUNCTION
/end MODULE
/end PROJECT
