ASAP2_VERSION 1 31
/begin PROJECT LaForge_CCU_TestApp "Test Application for LaForge TC367"
/begin HEADER "Dana" VERSION "0_3_1" /end HEADER
/begin MODULE OpenECU_TC367_001 ""
/* Scalar measurable for DDE 'mpl_error_log_detailed[1].err_log.csa.lower.D1'. */
/begin MEASUREMENT mpl_error_log_detailed[1].err00 "CPU data register" ULONG CU_MPL_ERROR_LOG_DETAILED[1].00 1 100 0.0 4294967295.0 ECU_ADDRESS 0xf024043c BYTE_ORDER MSB_LAST /end MEASUREMENT
/begin COMPU_METHOD CU_MPL_ERROR_LOG_DETAILED[1].00 "Conversion method for mpl_error_log_detailed[1].err_log.csa.lower.D1" RAT_FUNC "%10.0" "(not defined)" COEFFS 0.000000 1.000000 -0.000000 0.000000 0.000000 1.000000 /end COMPU_METHOD
/* Scalar measurable for DDE 'mpl_error_log_detailed[1].err_log.csa.lower.D2'. */
/begin MEASUREMENT mpl_error_log_detailed[1].err_9 "CPU data register" ULONG CU_MPL_ERROR_LOG_DETAILED[1].E9 1 100 0.0 4294967295.0 ECU_ADDRESS 0xf0240440 BYTE_ORDER MSB_LAST /end MEASUREMENT
/begin COMPU_METHOD CU_MPL_ERROR_LOG_DETAILED[1].E9 "Conversion method for mpl_error_log_detailed[1].err_log.csa.lower.D2" RAT_FUNC "%10.0" "(not defined)" COEFFS 0.000000 1.000000 -0.000000 0.000000 0.000000 1.000000 /end COMPU_METHOD
/* Scalar measurable for DDE 'mpl_error_log_detailed[1].err_log.csa.lower.D3'. */
/begin MEASUREMENT mpl_error_log_detailed[1].err_8 "CPU data register" ULONG CU_MPL_ERROR_LOG_DETAILED[1].E8 1 100 0.0 4294967295.0 ECU_ADDRESS 0xf0240444 BYTE_ORDER MSB_LAST /end MEASUREMENT
/begin COMPU_METHOD CU_MPL_ERROR_LOG_DETAILED[1].E8 "Conversion method for mpl_error_log_detailed[1].err_log.csa.lower.D3" RAT_FUNC "%10.0" "(not defined)" COEFFS 0.000000 1.000000 -0.000000 0.000000 0.000000 1.000000 /end COMPU_METHOD
/* Scalar measurable for DDE 'mpl_error_log_detailed[1].err_log.csa.lower.D4'. */
/begin MEASUREMENT mpl_error_log_detailed[1].err_7 "CPU data register" ULONG CU_MPL_ERROR_LOG_DETAILED[1].E7 1 100 0.0 4294967295.0 ECU_ADDRESS 0xf0240458 BYTE_ORDER MSB_LAST /end MEASUREMENT
/begin COMPU_METHOD CU_MPL_ERROR_LOG_DETAILED[1].E7 "Conversion method for mpl_error_log_detailed[1].err_log.csa.lower.D4" RAT_FUNC "%10.0" "(not defined)" COEFFS 0.000000 1.000000 -0.000000 0.000000 0.000000 1.000000 /end COMPU_METHOD
/* Scalar measurable for DDE 'mpl_error_log_detailed[1].err_log.csa.lower.D5'. */
/begin MEASUREMENT mpl_error_log_detailed[1].err_6 "CPU data register" ULONG CU_MPL_ERROR_LOG_DETAILED[1].E6 1 100 0.0 4294967295.0 ECU_ADDRESS 0xf024045c BYTE_ORDER MSB_LAST /end MEASUREMENT
/begin COMPU_METHOD CU_MPL_ERROR_LOG_DETAILED[1].E6 "Conversion method for mpl_error_log_detailed[1].err_log.csa.lower.D5" RAT_FUNC "%10.0" "(not defined)" COEFFS 0.000000 1.000000 -0.000000 0.000000 0.000000 1.000000 /end COMPU_METHOD
/* Scalar measurable for DDE 'mpl_error_log_detailed[1].err_log.csa.lower.D6'. */
/begin MEASUREMENT mpl_error_log_detailed[1].err62 "CPU data register" ULONG CU_MPL_ERROR_LOG_DETAILED[1].64 1 100 0.0 4294967295.0 ECU_ADDRESS 0xf0240460 BYTE_ORDER MSB_LAST /end MEASUREMENT
/begin COMPU_METHOD CU_MPL_ERROR_LOG_DETAILED[1].64 "Conversion method for mpl_error_log_detailed[1].err_log.csa.lower.D6" RAT_FUNC "%10.0" "(not defined)" COEFFS 0.000000 1.000000 -0.000000 0.000000 0.000000 1.000000 /end COMPU_METHOD
/* Scalar measurable for DDE 'mpl_error_log_detailed[1].err_log.csa.lower.D7'. */
/begin MEASUREMENT mpl_error_log_detailed[1].err_5 "CPU data register" ULONG CU_MPL_ERROR_LOG_DETAILED[1].E5 1 100 0.0 4294967295.0 ECU_ADDRESS 0xf0240464 BYTE_ORDER MSB_LAST /end MEASUREMENT
/begin COMPU_METHOD CU_MPL_ERROR_LOG_DETAILED[1].E5 "Conversion method for mpl_error_log_detailed[1].err_log.csa.lower.D7" RAT_FUNC "%10.0" "(not defined)" COEFFS 0.000000 1.000000 -0.000000 0.000000 0.000000 1.000000 /end COMPU_METHOD
/* Scalar measurable for DDE 'mpl_error_log_detailed[1].err_log.csa.lower.PC'. */
/begin MEASUREMENT mpl_error_log_detailed[1].err26 "CPU program counter" ULONG CU_MPL_ERROR_LOG_DETAILED[1].28 1 100 0.0 4294967295.0 ECU_ADDRESS 0xf024042c BYTE_ORDER MSB_LAST /end MEASUREMENT
/begin COMPU_METHOD CU_MPL_ERROR_LOG_DETAILED[1].28 "Conversion method for mpl_error_log_detailed[1].err_log.csa.lower.PC" RAT_FUNC "%10.0" "(not defined)" COEFFS 0.000000 1.000000 -0.000000 0.000000 0.000000 1.000000 /end COMPU_METHOD
/* Scalar measurable for DDE 'mpl_error_log_detailed[1].err_log.csa.upper.A10'. */
/begin MEASUREMENT mpl_error_log_detailed[1].err10 "CPU address register (aka stack pointer)" ULONG CU_MPL_ERROR_LOG_DETAILED[1].10 1 100 0.0 4294967295.0 ECU_ADDRESS 0xf0240430 BYTE_ORDER MSB_LAST /end MEASUREMENT
/begin COMPU_METHOD CU_MPL_ERROR_LOG_DETAILED[1].10 "Conversion method for mpl_error_log_detailed[1].err_log.csa.upper.A10" RAT_FUNC "%10.0" "(not defined)" COEFFS 0.000000 1.000000 -0.000000 0.000000 0.000000 1.000000 /end COMPU_METHOD
/* Scalar measurable for DDE 'mpl_error_log_detailed[1].err_log.csa.upper.A11'. */
/begin MEASUREMENT mpl_error_log_detailed[1].err08 "CPU address register (aka return address" ULONG CU_MPL_ERROR_LOG_DETAILED[1].08 1 100 0.0 4294967295.0 ECU_ADDRESS 0xf0240434 BYTE_ORDER MSB_LAST /end MEASUREMENT
/begin COMPU_METHOD CU_MPL_ERROR_LOG_DETAILED[1].08 "Conversion method for mpl_error_log_detailed[1].err_log.csa.upper.A11" RAT_FUNC "%10.0" "(not defined)" COEFFS 0.000000 1.000000 -0.000000 0.000000 0.000000 1.000000 /end COMPU_METHOD
/* Scalar measurable for DDE 'mpl_error_log_detailed[1].err_log.csa.upper.A12'. */
/begin MEASUREMENT mpl_error_log_detailed[1].er013 "CPU address register" ULONG CU_MPL_ERROR_LOG_DETAILED[1]016 1 100 0.0 4294967295.0 ECU_ADDRESS 0xf0240448 BYTE_ORDER MSB_LAST /end MEASUREMENT
/begin COMPU_METHOD CU_MPL_ERROR_LOG_DETAILED[1]016 "Conversion method for mpl_error_log_detailed[1].err_log.csa.upper.A12" RAT_FUNC "%10.0" "(not defined)" COEFFS 0.000000 1.000000 -0.000000 0.000000 0.000000 1.000000 /end COMPU_METHOD
/* Scalar measurable for DDE 'mpl_error_log_detailed[1].err_log.csa.upper.A13'. */
/begin MEASUREMENT mpl_error_log_detailed[1].err46 "CPU address register" ULONG CU_MPL_ERROR_LOG_DETAILED[1].48 1 100 0.0 4294967295.0 ECU_ADDRESS 0xf024044c BYTE_ORDER MSB_LAST /end MEASUREMENT
/begin COMPU_METHOD CU_MPL_ERROR_LOG_DETAILED[1].48 "Conversion method for mpl_error_log_detailed[1].err_log.csa.upper.A13" RAT_FUNC "%10.0" "(not defined)" COEFFS 0.000000 1.000000 -0.000000 0.000000 0.000000 1.000000 /end COMPU_METHOD
/* Scalar measurable for DDE 'mpl_error_log_detailed[1].err_log.csa.upper.A14'. */
/begin MEASUREMENT mpl_error_log_detailed[1].err45 "CPU address register" ULONG CU_MPL_ERROR_LOG_DETAILED[1].47 1 100 0.0 4294967295.0 ECU_ADDRESS 0xf0240450 BYTE_ORDER MSB_LAST /end MEASUREMENT
/begin COMPU_METHOD CU_MPL_ERROR_LOG_DETAILED[1].47 "Conversion method for mpl_error_log_detailed[1].err_log.csa.upper.A14" RAT_FUNC "%10.0" "(not defined)" COEFFS 0.000000 1.000000 -0.000000 0.000000 0.000000 1.000000 /end COMPU_METHOD
/* Scalar measurable for DDE 'mpl_error_log_detailed[1].err_log.csa.upper.A15'. */
/begin MEASUREMENT mpl_error_log_detailed[1].err44 "CPU address register" ULONG CU_MPL_ERROR_LOG_DETAILED[1].46 1 100 0.0 4294967295.0 ECU_ADDRESS 0xf0240454 BYTE_ORDER MSB_LAST /end MEASUREMENT
/begin COMPU_METHOD CU_MPL_ERROR_LOG_DETAILED[1].46 "Conversion method for mpl_error_log_detailed[1].err_log.csa.upper.A15" RAT_FUNC "%10.0" "(not defined)" COEFFS 0.000000 1.000000 -0.000000 0.000000 0.000000 1.000000 /end COMPU_METHOD
/* Scalar measurable for DDE 'mpl_error_log_detailed[1].err_log.csa.upper.D10'. */
/begin MEASUREMENT mpl_error_log_detailed[1].err18 "CPU data register" ULONG CU_MPL_ERROR_LOG_DETAILED[1].19 1 100 0.0 4294967295.0 ECU_ADDRESS 0xf0240440 BYTE_ORDER MSB_LAST /end MEASUREMENT
/begin COMPU_METHOD CU_MPL_ERROR_LOG_DETAILED[1].19 "Conversion method for mpl_error_log_detailed[1].err_log.csa.upper.D10" RAT_FUNC "%10.0" "(not defined)" COEFFS 0.000000 1.000000 -0.000000 0.000000 0.000000 1.000000 /end COMPU_METHOD
/* Scalar measurable for DDE 'mpl_error_log_detailed[1].err_log.csa.upper.D11'. */
/begin MEASUREMENT mpl_error_log_detailed[1].er022 "CPU data register" ULONG CU_MPL_ERROR_LOG_DETAILED[1]025 1 100 0.0 4294967295.0 ECU_ADDRESS 0xf0240444 BYTE_ORDER MSB_LAST /end MEASUREMENT
/begin COMPU_METHOD CU_MPL_ERROR_LOG_DETAILED[1]025 "Conversion method for mpl_error_log_detailed[1].err_log.csa.upper.D11" RAT_FUNC "%10.0" "(not defined)" COEFFS 0.000000 1.000000 -0.000000 0.000000 0.000000 1.000000 /end COMPU_METHOD
/* Scalar measurable for DDE 'mpl_error_log_detailed[1].err_log.csa.upper.D12'. */
/begin MEASUREMENT mpl_error_log_detailed[1].er023 "CPU data register" ULONG CU_MPL_ERROR_LOG_DETAILED[1]026 1 100 0.0 4294967295.0 ECU_ADDRESS 0xf0240458 BYTE_ORDER MSB_LAST /end MEASUREMENT
/begin COMPU_METHOD CU_MPL_ERROR_LOG_DETAILED[1]026 "Conversion method for mpl_error_log_detailed[1].err_log.csa.upper.D12" RAT_FUNC "%10.0" "(not defined)" COEFFS 0.000000 1.000000 -0.000000 0.000000 0.000000 1.000000 /end COMPU_METHOD
/* Scalar measurable for DDE 'mpl_error_log_detailed[1].err_log.csa.upper.D13'. */
/begin MEASUREMENT mpl_error_log_detailed[1].er039 "CPU data register" ULONG CU_MPL_ERROR_LOG_DETAILED[1]042 1 100 0.0 4294967295.0 ECU_ADDRESS 0xf024045c BYTE_ORDER MSB_LAST /end MEASUREMENT
/begin COMPU_METHOD CU_MPL_ERROR_LOG_DETAILED[1]042 "Conversion method for mpl_error_log_detailed[1].err_log.csa.upper.D13" RAT_FUNC "%10.0" "(not defined)" COEFFS 0.000000 1.000000 -0.000000 0.000000 0.000000 1.000000 /end COMPU_METHOD
/* Scalar measurable for DDE 'mpl_error_log_detailed[1].err_log.csa.upper.D14'. */
/begin MEASUREMENT mpl_error_log_detailed[1].err16 "CPU data register" ULONG CU_MPL_ERROR_LOG_DETAILED[1].17 1 100 0.0 4294967295.0 ECU_ADDRESS 0xf0240460 BYTE_ORDER MSB_LAST /end MEASUREMENT
/begin COMPU_METHOD CU_MPL_ERROR_LOG_DETAILED[1].17 "Conversion method for mpl_error_log_detailed[1].err_log.csa.upper.D14" RAT_FUNC "%10.0" "(not defined)" COEFFS 0.000000 1.000000 -0.000000 0.000000 0.000000 1.000000 /end COMPU_METHOD
/* Scalar measurable for DDE 'mpl_error_log_detailed[1].err_log.csa.upper.D15'. */
/begin MEASUREMENT mpl_error_log_detailed[1].err17 "CPU data register" ULONG CU_MPL_ERROR_LOG_DETAILED[1].18 1 100 0.0 4294967295.0 ECU_ADDRESS 0xf0240464 BYTE_ORDER MSB_LAST /end MEASUREMENT
/begin COMPU_METHOD CU_MPL_ERROR_LOG_DETAILED[1].18 "Conversion method for mpl_error_log_detailed[1].err_log.csa.upper.D15" RAT_FUNC "%10.0" "(not defined)" COEFFS 0.000000 1.000000 -0.000000 0.000000 0.000000 1.000000 /end COMPU_METHOD
/* Scalar measurable for DDE 'mpl_error_log_detailed[1].err_log.csa.upper.D8'. */
/begin MEASUREMENT mpl_error_log_detailed[1].er004 "CPU data register" ULONG CU_MPL_ERROR_LOG_DETAILED[1]007 1 100 0.0 4294967295.0 ECU_ADDRESS 0xf0240438 BYTE_ORDER MSB_LAST /end MEASUREMENT
/begin COMPU_METHOD CU_MPL_ERROR_LOG_DETAILED[1]007 "Conversion method for mpl_error_log_detailed[1].err_log.csa.upper.D8" RAT_FUNC "%10.0" "(not defined)" COEFFS 0.000000 1.000000 -0.000000 0.000000 0.000000 1.000000 /end COMPU_METHOD
/* Scalar measurable for DDE 'mpl_error_log_detailed[1].err_log.csa.upper.D9'. */
/begin MEASUREMENT mpl_error_log_detailed[1].er005 "CPU data register" ULONG CU_MPL_ERROR_LOG_DETAILED[1]008 1 100 0.0 4294967295.0 ECU_ADDRESS 0xf024043c BYTE_ORDER MSB_LAST /end MEASUREMENT
/begin COMPU_METHOD CU_MPL_ERROR_LOG_DETAILED[1]008 "Conversion method for mpl_error_log_detailed[1].err_log.csa.upper.D9" RAT_FUNC "%10.0" "(not defined)" COEFFS 0.000000 1.000000 -0.000000 0.000000 0.000000 1.000000 /end COMPU_METHOD
/* Scalar measurable for DDE 'mpl_error_log_detailed[1].err_log.csa.upper.PSW'. */
/begin MEASUREMENT mpl_error_log_detailed[1].err54 "CPU program status word" ULONG CU_MPL_ERROR_LOG_DETAILED[1].56 1 100 0.0 4294967295.0 ECU_ADDRESS 0xf024042c BYTE_ORDER MSB_LAST /end MEASUREMENT
/begin COMPU_METHOD CU_MPL_ERROR_LOG_DETAILED[1].56 "Conversion method for mpl_error_log_detailed[1].err_log.csa.upper.PSW" RAT_FUNC "%10.0" "(not defined)" COEFFS 0.000000 1.000000 -0.000000 0.000000 0.000000 1.000000 /end COMPU_METHOD
/* Scalar measurable for DDE 'mpl_error_log_detailed[1].err_log.run_task_id'. */
/begin MEASUREMENT mpl_error_log_detailed[1].err_2 "Handle of PXROS task, zero if PXROS not started" ULONG CU_MPL_ERROR_LOG_DETAILED[1].E2 1 100 0.0 4294967295.0 ECU_ADDRESS 0xf0240424 BYTE_ORDER MSB_LAST /end MEASUREMENT
/begin COMPU_METHOD CU_MPL_ERROR_LOG_DETAILED[1].E2 "Conversion method for mpl_error_log_detailed[1].err_log.run_task_id" RAT_FUNC "%10.0" "handle" COEFFS 0.000000 1.000000 -0.000000 0.000000 0.000000 1.000000 /end COMPU_METHOD
/* Scalar measurable for DDE 'mpl_error_log_detailed[1].err_log.smu_alarms.smu_ad[0]'. */
/begin MEASUREMENT mpl_error_log_detailed[1].err33 "CPU SMU alarm debug register" ULONG CU_MPL_ERROR_LOG_DETAILED[1].35 1 100 0.0 4294967295.0 ECU_ADDRESS 0xf0240630 BYTE_ORDER MSB_LAST /end MEASUREMENT
/begin COMPU_METHOD CU_MPL_ERROR_LOG_DETAILED[1].35 "Conversion method for mpl_error_log_detailed[1].err_log.smu_alarms.smu_ad[0]" RAT_FUNC "%10.0" "(not defined)" COEFFS 0.000000 1.000000 -0.000000 0.000000 0.000000 1.000000 /end COMPU_METHOD
/* Scalar measurable for DDE 'mpl_error_log_detailed[1].err_log.smu_alarms.smu_ad[10]'. */
/begin MEASUREMENT mpl_error_log_detailed[1].err63 "CPU SMU alarm debug register" ULONG CU_MPL_ERROR_LOG_DETAILED[1].65 1 100 0.0 4294967295.0 ECU_ADDRESS 0xf0240658 BYTE_ORDER MSB_LAST /end MEASUREMENT
/begin COMPU_METHOD CU_MPL_ERROR_LOG_DETAILED[1].65 "Conversion method for mpl_error_log_detailed[1].err_log.smu_alarms.smu_ad[10]" RAT_FUNC "%10.0" "(not defined)" COEFFS 0.000000 1.000000 -0.000000 0.000000 0.000000 1.000000 /end COMPU_METHOD
/* Scalar measurable for DDE 'mpl_error_log_detailed[1].err_log.smu_alarms.smu_ad[11]'. */
/begin MEASUREMENT mpl_error_log_detailed[1].err56 "CPU SMU alarm debug register" ULONG CU_MPL_ERROR_LOG_DETAILED[1].58 1 100 0.0 4294967295.0 ECU_ADDRESS 0xf024065c BYTE_ORDER MSB_LAST /end MEASUREMENT
/begin COMPU_METHOD CU_MPL_ERROR_LOG_DETAILED[1].58 "Conversion method for mpl_error_log_detailed[1].err_log.smu_alarms.smu_ad[11]" RAT_FUNC "%10.0" "(not defined)" COEFFS 0.000000 1.000000 -0.000000 0.000000 0.000000 1.000000 /end COMPU_METHOD
/* Scalar measurable for DDE 'mpl_error_log_detailed[1].err_log.smu_alarms.smu_ad[1]'. */
/begin MEASUREMENT mpl_error_log_detailed[1].err95 "CPU SMU alarm debug register" ULONG CU_MPL_ERROR_LOG_DETAILED[1].98 1 100 0.0 4294967295.0 ECU_ADDRESS 0xf0240634 BYTE_ORDER MSB_LAST /end MEASUREMENT
/begin COMPU_METHOD CU_MPL_ERROR_LOG_DETAILED[1].98 "Conversion method for mpl_error_log_detailed[1].err_log.smu_alarms.smu_ad[1]" RAT_FUNC "%10.0" "(not defined)" COEFFS 0.000000 1.000000 -0.000000 0.000000 0.000000 1.000000 /end COMPU_METHOD
/* Scalar measurable for DDE 'mpl_error_log_detailed[1].err_log.smu_alarms.smu_ad[2]'. */
/begin MEASUREMENT mpl_error_log_detailed[1].err65 "CPU SMU alarm debug register" ULONG CU_MPL_ERROR_LOG_DETAILED[1].67 1 100 0.0 4294967295.0 ECU_ADDRESS 0xf0240638 BYTE_ORDER MSB_LAST /end MEASUREMENT
/begin COMPU_METHOD CU_MPL_ERROR_LOG_DETAILED[1].67 "Conversion method for mpl_error_log_detailed[1].err_log.smu_alarms.smu_ad[2]" RAT_FUNC "%10.0" "(not defined)" COEFFS 0.000000 1.000000 -0.000000 0.000000 0.000000 1.000000 /end COMPU_METHOD
/* Scalar measurable for DDE 'mpl_error_log_detailed[1].err_log.smu_alarms.smu_ad[3]'. */
/begin MEASUREMENT mpl_error_log_detailed[1].err41 "CPU SMU alarm debug register" ULONG CU_MPL_ERROR_LOG_DETAILED[1].43 1 100 0.0 4294967295.0 ECU_ADDRESS 0xf024063c BYTE_ORDER MSB_LAST /end MEASUREMENT
/begin COMPU_METHOD CU_MPL_ERROR_LOG_DETAILED[1].43 "Conversion method for mpl_error_log_detailed[1].err_log.smu_alarms.smu_ad[3]" RAT_FUNC "%10.0" "(not defined)" COEFFS 0.000000 1.000000 -0.000000 0.000000 0.000000 1.000000 /end COMPU_METHOD
/* Scalar measurable for DDE 'mpl_error_log_detailed[1].err_log.smu_alarms.smu_ad[4]'. */
/begin MEASUREMENT mpl_error_log_detailed[1].er045 "CPU SMU alarm debug register" ULONG CU_MPL_ERROR_LOG_DETAILED[1]048 1 100 0.0 4294967295.0 ECU_ADDRESS 0xf0240640 BYTE_ORDER MSB_LAST /end MEASUREMENT
/begin COMPU_METHOD CU_MPL_ERROR_LOG_DETAILED[1]048 "Conversion method for mpl_error_log_detailed[1].err_log.smu_alarms.smu_ad[4]" RAT_FUNC "%10.0" "(not defined)" COEFFS 0.000000 1.000000 -0.000000 0.000000 0.000000 1.000000 /end COMPU_METHOD
/* Scalar measurable for DDE 'mpl_error_log_detailed[1].err_log.smu_alarms.smu_ad[5]'. */
/begin MEASUREMENT mpl_error_log_detailed[1].er032 "CPU SMU alarm debug register" ULONG CU_MPL_ERROR_LOG_DETAILED[1]035 1 100 0.0 4294967295.0 ECU_ADDRESS 0xf0240644 BYTE_ORDER MSB_LAST /end MEASUREMENT
/begin COMPU_METHOD CU_MPL_ERROR_LOG_DETAILED[1]035 "Conversion method for mpl_error_log_detailed[1].err_log.smu_alarms.smu_ad[5]" RAT_FUNC "%10.0" "(not defined)" COEFFS 0.000000 1.000000 -0.000000 0.000000 0.000000 1.000000 /end COMPU_METHOD
/* Scalar measurable for DDE 'mpl_error_log_detailed[1].err_log.smu_alarms.smu_ad[6]'. */
/begin MEASUREMENT mpl_error_log_detailed[1].err15 "CPU SMU alarm debug register" ULONG CU_MPL_ERROR_LOG_DETAILED[1].16 1 100 0.0 4294967295.0 ECU_ADDRESS 0xf0240648 BYTE_ORDER MSB_LAST /end MEASUREMENT
/begin COMPU_METHOD CU_MPL_ERROR_LOG_DETAILED[1].16 "Conversion method for mpl_error_log_detailed[1].err_log.smu_alarms.smu_ad[6]" RAT_FUNC "%10.0" "(not defined)" COEFFS 0.000000 1.000000 -0.000000 0.000000 0.000000 1.000000 /end COMPU_METHOD
/* Scalar measurable for DDE 'mpl_error_log_detailed[1].err_log.smu_alarms.smu_ad[7]'. */
/begin MEASUREMENT mpl_error_log_detailed[1].er037 "CPU SMU alarm debug register" ULONG CU_MPL_ERROR_LOG_DETAILED[1]040 1 100 0.0 4294967295.0 ECU_ADDRESS 0xf024064c BYTE_ORDER MSB_LAST /end MEASUREMENT
/begin COMPU_METHOD CU_MPL_ERROR_LOG_DETAILED[1]040 "Conversion method for mpl_error_log_detailed[1].err_log.smu_alarms.smu_ad[7]" RAT_FUNC "%10.0" "(not defined)" COEFFS 0.000000 1.000000 -0.000000 0.000000 0.000000 1.000000 /end COMPU_METHOD
/* Scalar measurable for DDE 'mpl_error_log_detailed[1].err_log.smu_alarms.smu_ad[8]'. */
/begin MEASUREMENT mpl_error_log_detailed[1].er008 "CPU SMU alarm debug register" ULONG CU_MPL_ERROR_LOG_DETAILED[1]011 1 100 0.0 4294967295.0 ECU_ADDRESS 0xf0240650 BYTE_ORDER MSB_LAST /end MEASUREMENT
/begin COMPU_METHOD CU_MPL_ERROR_LOG_DETAILED[1]011 "Conversion method for mpl_error_log_detailed[1].err_log.smu_alarms.smu_ad[8]" RAT_FUNC "%10.0" "(not defined)" COEFFS 0.000000 1.000000 -0.000000 0.000000 0.000000 1.000000 /end COMPU_METHOD
/* Scalar measurable for DDE 'mpl_error_log_detailed[1].err_log.smu_alarms.smu_ad[9]'. */
/begin MEASUREMENT mpl_error_log_detailed[1].err82 "CPU SMU alarm debug register" ULONG CU_MPL_ERROR_LOG_DETAILED[1].85 1 100 0.0 4294967295.0 ECU_ADDRESS 0xf0240654 BYTE_ORDER MSB_LAST /end MEASUREMENT
/begin COMPU_METHOD CU_MPL_ERROR_LOG_DETAILED[1].85 "Conversion method for mpl_error_log_detailed[1].err_log.smu_alarms.smu_ad[9]" RAT_FUNC "%10.0" "(not defined)" COEFFS 0.000000 1.000000 -0.000000 0.000000 0.000000 1.000000 /end COMPU_METHOD
/* Scalar measurable for DDE 'mpl_error_log_detailed[1].err_log.smu_alarms.smu_ag[0]'. */
/begin MEASUREMENT mpl_error_log_detailed[1].err69 "CPU SMU alarm status register" ULONG CU_MPL_ERROR_LOG_DETAILED[1].72 1 100 0.0 4294967295.0 ECU_ADDRESS 0xf0240600 BYTE_ORDER MSB_LAST /end MEASUREMENT
/begin COMPU_METHOD CU_MPL_ERROR_LOG_DETAILED[1].72 "Conversion method for mpl_error_log_detailed[1].err_log.smu_alarms.smu_ag[0]" RAT_FUNC "%10.0" "(not defined)" COEFFS 0.000000 1.000000 -0.000000 0.000000 0.000000 1.000000 /end COMPU_METHOD
/* Scalar measurable for DDE 'mpl_error_log_detailed[1].err_log.smu_alarms.smu_ag[10]'. */
/begin MEASUREMENT mpl_error_log_detailed[1].err87 "CPU SMU alarm status register" ULONG CU_MPL_ERROR_LOG_DETAILED[1].90 1 100 0.0 4294967295.0 ECU_ADDRESS 0xf0240628 BYTE_ORDER MSB_LAST /end MEASUREMENT
/begin COMPU_METHOD CU_MPL_ERROR_LOG_DETAILED[1].90 "Conversion method for mpl_error_log_detailed[1].err_log.smu_alarms.smu_ag[10]" RAT_FUNC "%10.0" "(not defined)" COEFFS 0.000000 1.000000 -0.000000 0.000000 0.000000 1.000000 /end COMPU_METHOD
/* Scalar measurable for DDE 'mpl_error_log_detailed[1].err_log.smu_alarms.smu_ag[11]'. */
/begin MEASUREMENT mpl_error_log_detailed[1].err76 "CPU SMU alarm status register" ULONG CU_MPL_ERROR_LOG_DETAILED[1].79 1 100 0.0 4294967295.0 ECU_ADDRESS 0xf024062c BYTE_ORDER MSB_LAST /end MEASUREMENT
/begin COMPU_METHOD CU_MPL_ERROR_LOG_DETAILED[1].79 "Conversion method for mpl_error_log_detailed[1].err_log.smu_alarms.smu_ag[11]" RAT_FUNC "%10.0" "(not defined)" COEFFS 0.000000 1.000000 -0.000000 0.000000 0.000000 1.000000 /end COMPU_METHOD
/* Scalar measurable for DDE 'mpl_error_log_detailed[1].err_log.smu_alarms.smu_ag[1]'. */
/begin MEASUREMENT mpl_error_log_detailed[1].er031 "CPU SMU alarm status register" ULONG CU_MPL_ERROR_LOG_DETAILED[1]034 1 100 0.0 4294967295.0 ECU_ADDRESS 0xf0240604 BYTE_ORDER MSB_LAST /end MEASUREMENT
/begin COMPU_METHOD CU_MPL_ERROR_LOG_DETAILED[1]034 "Conversion method for mpl_error_log_detailed[1].err_log.smu_alarms.smu_ag[1]" RAT_FUNC "%10.0" "(not defined)" COEFFS 0.000000 1.000000 -0.000000 0.000000 0.000000 1.000000 /end COMPU_METHOD
/* Scalar measurable for DDE 'mpl_error_log_detailed[1].err_log.smu_alarms.smu_ag[2]'. */
/begin MEASUREMENT mpl_error_log_detailed[1].err12 "CPU SMU alarm status register" ULONG CU_MPL_ERROR_LOG_DETAILED[1].13 1 100 0.0 4294967295.0 ECU_ADDRESS 0xf0240608 BYTE_ORDER MSB_LAST /end MEASUREMENT
/begin COMPU_METHOD CU_MPL_ERROR_LOG_DETAILED[1].13 "Conversion method for mpl_error_log_detailed[1].err_log.smu_alarms.smu_ag[2]" RAT_FUNC "%10.0" "(not defined)" COEFFS 0.000000 1.000000 -0.000000 0.000000 0.000000 1.000000 /end COMPU_METHOD
/* Scalar measurable for DDE 'mpl_error_log_detailed[1].err_log.smu_alarms.smu_ag[3]'. */
/begin MEASUREMENT mpl_error_log_detailed[1].err22 "CPU SMU alarm status register" ULONG CU_MPL_ERROR_LOG_DETAILED[1].23 1 100 0.0 4294967295.0 ECU_ADDRESS 0xf024060c BYTE_ORDER MSB_LAST /end MEASUREMENT
/begin COMPU_METHOD CU_MPL_ERROR_LOG_DETAILED[1].23 "Conversion method for mpl_error_log_detailed[1].err_log.smu_alarms.smu_ag[3]" RAT_FUNC "%10.0" "(not defined)" COEFFS 0.000000 1.000000 -0.000000 0.000000 0.000000 1.000000 /end COMPU_METHOD
/* Scalar measurable for DDE 'mpl_error_log_detailed[1].err_log.smu_alarms.smu_ag[4]'. */
/begin MEASUREMENT mpl_error_log_detailed[1].err75 "CPU SMU alarm status register" ULONG CU_MPL_ERROR_LOG_DETAILED[1].78 1 100 0.0 4294967295.0 ECU_ADDRESS 0xf0240610 BYTE_ORDER MSB_LAST /end MEASUREMENT
/begin COMPU_METHOD CU_MPL_ERROR_LOG_DETAILED[1].78 "Conversion method for mpl_error_log_detailed[1].err_log.smu_alarms.smu_ag[4]" RAT_FUNC "%10.0" "(not defined)" COEFFS 0.000000 1.000000 -0.000000 0.000000 0.000000 1.000000 /end COMPU_METHOD
/* Scalar measurable for DDE 'mpl_error_log_detailed[1].err_log.smu_alarms.smu_ag[5]'. */
/begin MEASUREMENT mpl_error_log_detailed[1].err86 "CPU SMU alarm status register" ULONG CU_MPL_ERROR_LOG_DETAILED[1].89 1 100 0.0 4294967295.0 ECU_ADDRESS 0xf0240614 BYTE_ORDER MSB_LAST /end MEASUREMENT
/begin COMPU_METHOD CU_MPL_ERROR_LOG_DETAILED[1].89 "Conversion method for mpl_error_log_detailed[1].err_log.smu_alarms.smu_ag[5]" RAT_FUNC "%10.0" "(not defined)" COEFFS 0.000000 1.000000 -0.000000 0.000000 0.000000 1.000000 /end COMPU_METHOD
/* Scalar measurable for DDE 'mpl_error_log_detailed[1].err_log.smu_alarms.smu_ag[6]'. */
/begin MEASUREMENT mpl_error_log_detailed[1].err51 "CPU SMU alarm status register" ULONG CU_MPL_ERROR_LOG_DETAILED[1].53 1 100 0.0 4294967295.0 ECU_ADDRESS 0xf0240618 BYTE_ORDER MSB_LAST /end MEASUREMENT
/begin COMPU_METHOD CU_MPL_ERROR_LOG_DETAILED[1].53 "Conversion method for mpl_error_log_detailed[1].err_log.smu_alarms.smu_ag[6]" RAT_FUNC "%10.0" "(not defined)" COEFFS 0.000000 1.000000 -0.000000 0.000000 0.000000 1.000000 /end COMPU_METHOD
/* Scalar measurable for DDE 'mpl_error_log_detailed[1].err_log.smu_alarms.smu_ag[7]'. */
/begin MEASUREMENT mpl_error_log_detailed[1].err60 "CPU SMU alarm status register" ULONG CU_MPL_ERROR_LOG_DETAILED[1].62 1 100 0.0 4294967295.0 ECU_ADDRESS 0xf024061c BYTE_ORDER MSB_LAST /end MEASUREMENT
/begin COMPU_METHOD CU_MPL_ERROR_LOG_DETAILED[1].62 "Conversion method for mpl_error_log_detailed[1].err_log.smu_alarms.smu_ag[7]" RAT_FUNC "%10.0" "(not defined)" COEFFS 0.000000 1.000000 -0.000000 0.000000 0.000000 1.000000 /end COMPU_METHOD
/* Scalar measurable for DDE 'mpl_error_log_detailed[1].err_log.smu_alarms.smu_ag[8]'. */
/begin MEASUREMENT mpl_error_log_detailed[1].err97 "CPU SMU alarm status register" ULONG CU_MPL_ERROR_LOG_DETAILED[1]000 1 100 0.0 4294967295.0 ECU_ADDRESS 0xf0240620 BYTE_ORDER MSB_LAST /end MEASUREMENT
/begin COMPU_METHOD CU_MPL_ERROR_LOG_DETAILED[1]000 "Conversion method for mpl_error_log_detailed[1].err_log.smu_alarms.smu_ag[8]" RAT_FUNC "%10.0" "(not defined)" COEFFS 0.000000 1.000000 -0.000000 0.000000 0.000000 1.000000 /end COMPU_METHOD
/* Scalar measurable for DDE 'mpl_error_log_detailed[1].err_log.smu_alarms.smu_ag[9]'. */
/begin MEASUREMENT mpl_error_log_detailed[1].er030 "CPU SMU alarm status register" ULONG CU_MPL_ERROR_LOG_DETAILED[1]033 1 100 0.0 4294967295.0 ECU_ADDRESS 0xf0240624 BYTE_ORDER MSB_LAST /end MEASUREMENT
/begin COMPU_METHOD CU_MPL_ERROR_LOG_DETAILED[1]033 "Conversion method for mpl_error_log_detailed[1].err_log.smu_alarms.smu_ag[9]" RAT_FUNC "%10.0" "(not defined)" COEFFS 0.000000 1.000000 -0.000000 0.000000 0.000000 1.000000 /end COMPU_METHOD
/* Scalar measurable for DDE 'mpl_error_log_detailed[2].err.id'. */
/begin MEASUREMENT mpl_error_log_detailed[2].err.2 "Error code of fault raised" SWORD CU_MPL_ERROR_LOG_DETAILED[2]014 1 100 0.0 32767.0 ECU_ADDRESS 0xf0240660 BYTE_ORDER MSB_LAST /end MEASUREMENT
/begin COMPU_METHOD CU_MPL_ERROR_LOG_DETAILED[2]014 "Conversion method for mpl_error_log_detailed[2].err.id" TAB_VERB "%12.0" "code" COMPU_TAB_REF CT_MPL_ERROR_LOG_DETAILED[2]014 /end COMPU_METHOD
/begin COMPU_VTAB CT_MPL_ERROR_LOG_DETAILED[2]014 "Conversion method for mpl_error_log_detailed[2].err.id" TAB_VERB 464 0 "PIO_PSY_NO_ERROR" 1 "PIO_TRAP_0_TIN_0_VAF" 2 "PIO_TRAP_0_TIN_1_VAP" 3 "PIO_TRAP_0_TIN_UNKNOWN" 4 "PIO_TRAP_1_TIN_1_PRIV" 5 "PIO_TRAP_1_TIN_2_MPR" 6 "PIO_TRAP_1_TIN_3_MPW" 7 "PIO_TRAP_1_TIN_4_MPX" 8 "PIO_TRAP_1_TIN_5_MPP" 9 "PIO_TRAP_1_TIN_6_MPN" 10 "PIO_TRAP_1_TIN_7_GRWP" 11 "PIO_TRAP_1_TIN_UNKNOWN" 12 "PIO_TRAP_2_TIN_1_IOPC" 13 "PIO_TRAP_2_TIN_2_UOPC" 14 "PIO_TRAP_2_TIN_3_OPD" 15 "PIO_TRAP_2_TIN_4_ALN" 16 "PIO_TRAP_2_TIN_5_MEM" 17 "PIO_TRAP_2_TIN_UNKNOWN" 18 "PIO_TRAP_3_TIN_1_FCD" 19 "PIO_TRAP_3_TIN_2_FCD" 20 "PIO_TRAP_3_TIN_3_CDU" 21 "PIO_TRAP_3_TIN_4_FCU" 22 "PIO_TRAP_3_TIN_5_CSU" 23 "PIO_TRAP_3_TIN_6_CTYP" 24 "PIO_TRAP_3_TIN_7_NEST" 25 "PIO_TRAP_3_TIN_UNKNOWN" 26 "PIO_TRAP_4_TIN_1_PSE" 27 "PIO_TRAP_4_TIN_2_DSE" 28 "PIO_TRAP_4_TIN_3_DAE" 29 "PIO_TRAP_4_TIN_4_CAE" 30 "PIO_TRAP_4_TIN_4_CAE_UNEXPECTED" 31 "PIO_TRAP_4_TIN_4_CAE_UNEXPECTED_FW" 32 "PIO_TRAP_4_TIN_5_PIE" 33 "PIO_TRAP_4_TIN_6_DIE" 34 "PIO_TRAP_4_TIN_7_DIE" 35 "PIO_TRAP_4_TIN_5_6_UNEXPECTED" 36 "PIO_TRAP_4_TIN_UNKNOWN" 37 "PIO_TRAP_5_TIN_1_OVF" 38 "PIO_TRAP_5_TIN_2_SOVF" 39 "PIO_TRAP_5_TIN_UNKNOWN" 40 "PIO_TRAP_6_SYS_UNKNOWN" 41 "PIO_TRAP_7_TIN_0_NMI" 42 "PIO_TRAP_7_TIN_UNKNOWN" 43 "PIO_ISR_0_RESET" 44 "PIO_BSPI_FIRST" 45 "PIO_BSPI_TRANSFER_TIMEOUT" 46 "PIO_BSPI_TX_DMA_ERROR" 47 "PIO_BSPI_RX_DMA_ERROR" 48 "PIO_BSPI_DSPI_ERROR" 49 "PIO_BSPI_RX_FIFO_OVERFLOW" 50 "PIO_BSPI_TX_FIFO_UNDERFLOW" 51 "PIO_BSPI_TRANSFER_TERMINATED" 52 "PIO_BSPI_TRANSAC_FAILED" 53 "PIO_BSPI_INTERNAL_SOFTWARE_ERROR" 54 "PIO_BSPI_ISR_MINIMUM_DELAY_TIME_NOT_MET" 55 "PIO_BSPI_ISR_FALSE_INT" 56 "PIO_BSPI_DMA_SAFETY_ERROR" 57 "PIO_BSPI_LAST" 58 "PIO_P1WR_ISR_MINIMUM_DELAY_TIME_NOT_MET" 59 "PIO_PADC_BUFFER_INIT_FAILED" 60 "PIO_PAX_ADC_INPUT_INVALID_ARG" 61 "PIO_PAX_CHANNEL_INVALID" 62 "PIO_PAX_ADC_INPUT_CHANNEL_UNSUPPORTED" 63 "PIO_PAX_CC_OUTPUT_CHANNEL_UNSUPPORTED" 64 "PIO_PAX_AOT_OUTPUT_CHANNEL_UNSUPPORTED" 65 "PIO_PAX_ISR_MINIMUM_DELAY_TIME_NOT_MET" 66 "PIO_PCANOPEN_RESET" 67 "PIO_PCANOPEN_BUFFER_OUT_OF_RANGE" 68 "PIO_PCANOPEN_NULL_POINTER" 69 "PIO_PCCP_RESET" 70 "PIO_PCCU6_ISR_MINIMUM_DELAY_TIME_NOT_MET" 71 "PIO_PCFG_INTERNAL_SW_ERROR" 72 "PIO_PCX_ERR_BUS_ID_OUT_OF_RANGE" 73 "PIO_PCX_ERR_DATA_LENGTH_OUT_OF_RANGE" 74 "PIO_PCX_ERR_STD_ID_OUT_OF_RANGE" 75 "PIO_PCX_ERR_EXT_ID_OUT_OF_RANGE" 76 "PIO_PCX_ERR_SAME_TX_MSG_DIFFERING_ATTRIBS" 77 "PIO_PCX_ERR_TOO_MANY_TX_MSGS" 78 "PIO_PCX_ERR_DUPLICATE_RX_MSG" 79 "PIO_PCX_ERR_TOO_MANY_RX_MSGS" 80 "PIO_PCX_ERR_BIT_RATE_IN_CONFIG_DIFFERS" 81 "PIO_PCX_ERR_UNSUPPORTED_BIT_RATE" 82 "PIO_PCX_ERR_BUS_ID_IN_CONFIG" 83 "PIO_PCX_ERR_NO_BITRATE_TABLE_MATCH" 84 "PIO_PCX_ERR_PACK_MSG_INVALID_PARAM" 85 "PIO_PCX_ERR_PACK_MSG_FIELD_PARAM" 86 "PIO_PCX_ERR_UNPACK_MSG_INVALID_PARAM" 87 "PIO_PCX_ERR_UNPACK_MSG_FIELD_PARAM" 88 "PIO_PCX_ERR_PACK_VDB_MSG_INVALID_PARAM" 89 "PIO_PCX_ERR_UNPACK_VDB_MSG_INVALID_PARAM" 90 "PIO_PCX_ERR_SWITCHED_RATE_FOR_NONFD_BUS" 91 "PIO_PCX_ERR_RX_MSG_FOR_UNCONFIG_BUS_0" 92 "PIO_PCX_ERR_UNSUPPORTED_BUS_MODE" 93 "PIO_PCX_ERR_BUS_MODE_IN_CONFIG_DIFFERS" 94 "PIO_PCX_ERR_SAME_RX_MSG_DIFFERING_ATTRIBS" 95 "PIO_PCX_ERR_TX_MSG_FOR_UNCONFIG_BUS_0" 96 "PIO_PCX_ISR_MINIMUM_DELAY_TIME_NOT_MET" 97 "PIO_PDD_CHANNEL_INVALID" 98 "PIO_PDD_DIG_DATA_IN_CHANNEL_UNSUPPORTED" 99 "PIO_PDD_DIG_DATA_OUT_CHANNEL_UNSUPPORTED" 100 "PIO_PDG_ERR_FORCED_RESET" 101 "PIO_PDTC_UPDATE_INVALID_ARG" 102 "PIO_PDTC_CLEAR_ALL_INVALID_ARG" 103 "PIO_PDTC_CLEAR_ALL_IF_ACT_INVALID_ARG" 104 "PIO_PDTC_CLEAR_ALL_IF_INACT_INVALID_ARG" 105 "PIO_PDTC_GET_DTC_STATUS_INVALID_ARG" 106 "PIO_PDTC_MATCH_EXISTS_INVALID_ARG" 107 "PIO_PDTC_CLEAR_DTCS_INVALID_ARG" 108 "PIO_PDTC_BAD_LICENSE" 109 "PIO_PDX_DO_CHANNEL_UNSUPPORTED" 110 "PIO_PDX_DIG_IN_CHANNEL_UNSUPPORTED" 111 "PIO_PDX_FREQ_IN_CHANNEL_UNSUPPORTED" 112 "PIO_PDX_PERIOD_IN_CHANNEL_UNSUPPORTED" 113 "PIO_PDX_QDEC_FREQ_IN_INVALID_ARG" 114 "PIO_PDX_QDEC_FREQ_IN_CHANNEL_UNSUPPORTED" 115 "PIO_PDX_TPU_QFI_CHANNEL_DEVICE_ERROR" 116 "PIO_PDX_QDEC_IN_CHANNEL_UNSUPPORTED" 117 "PIO_PDX_TPU_QI_CHANNEL_DEVICE_ERROR" 118 "PIO_PDX_PWM_OUT_CHANNEL_UNSUPPORTED" 119 "PIO_PDX_PWM_IN_CHANNEL_UNSUPPORTED" 120 "PIO_PDX_CHANNEL_INVALID" 121 "PIO_PDX_HBRIDGE_INVALID_MODE" 122 "PIO_PDX_HBRIDGE_DECODE_ERROR" 123 "PIO_PDX_HBRIDGE_CHANNEL_GROUP_UNSUPPORTED" 124 "PIO_PEM_EXTERNAL_RAM_REQUIRED" 125 "PIO_PEM_MEM_CONFIG_UNKNOWN" 126 "PIO_PETH_ERR_DRIVER_INITIALIZATION_ERROR" 127 "PIO_PETH_ERR_NULL_CONFIGURATION_POINTER" 128 "PIO_PETH_ERR_DATA_LENGTH_OUT_OF_RANGE" 129 "PIO_PETH_ERR_TOO_MANY_TX_MSGS" 130 "PIO_PETH_ERR_NOT_SUPPORTED" 131 "PIO_PFF_HOLDING_ARRAY_INDEX_INVALID" 132 "PIO_PFF_HOLDING_ARRAY_STRT_END_INVALID" 133 "PIO_PFF_HOLDING_ARRAY_REC_DATA_INVALID" 134 "PIO_PFF_STORED_FF_DTC_INVALID" 135 "PIO_PFF_STORED_DTC_READ_FAILURE" 136 "PIO_PFF_CAPTURE_PID_DATA_FAILURE" 137 "PIO_PFF_STARTUP_FFNO_ERROR" 138 "PIO_PFF_NVM_ALLOCATION_EXCEEDED" 139 "PIO_PFS_ECC_ERROR_DURING_FLASH_OP" 140 "PIO_PFS_RUNTIME_CORRUPT_FILE_FOUND" 141 "PIO_PKN_ERR_KERNEL_STARTED_BELOW_KERNEL_LEVEL" 142 "PIO_PKN_ERR_INVALID_RESOURCE_HANDLE" 143 "PIO_PKN_ERR_TASK_NOT_DECLARED_AS_ACQUIRING_RESOURCE" 144 "PIO_PKN_ERR_INVALID_TASK_HANDLE" 145 "PIO_PKN_ERR_INVALID_PERIODIC_TASK_HANDLE" 146 "PIO_PKN_ERR_UNEXPECTED_EXCEPTION" 147 "PIO_PKN_ERR_TASK_RESOURCE_CORE_DIFFER" 148 "PIO_PKN_ERR_TASK_RELEASE_RESOURCE_FAIL" 149 "PIO_PKN_ERR_ACQUIRING_RESOURCE_PRIORITY_CHANGE_FAIL" 150 "PIO_PKN_ERR_RELEASING_RESOURCE_PRIORITY_CHANGE_FAIL" 151 "PIO_PKN_ERR_TASK_RELEASE_RESOURCE_NEVER_ACQ" 152 "PIO_PKN_ERR_CLEAR_RESOURCE_SET_TASK_PRIO" 153 "PIO_PKN_ERR_ACQUIRING_RESOURCE_ALREADY_ACQUIRED" 154 "PIO_PJ1939_INVALID_CHANNEL" 155 "PIO_PJ1939_PG_TRANSMIT_RING_DEQUEUE_FAIL" 156 "PIO_PJ1939_DM6_TRANSMIT_INVALID_ARG" 157 "PIO_PJ1939_DM12_TRANSMIT_INVALID_ARG" 158 "PIO_PJ1939_DM14_DECODE_INVALID_ARG" 159 "PIO_PJ1939_DM15_TRANSMIT_INVALID_ARG" 160 "PIO_PJ1939_DM16_DECODE_INVALID_ARG" 161 "PIO_PJ1939_DM23_TRANSMIT_INVALID_ARG" 162 "PIO_PJ1939_DM27_TRANSMIT_INVALID_ARG" 163 "PIO_PJ1939_DM28_TRANSMIT_INVALID_ARG" 164 "PIO_PJ1939_DM29_TRANSMIT_INVALID_ARG" 165 "PIO_PJ1939_DM31_TRANSMIT_INVALID_ARG" 166 "PIO_PJ1939_DM41_TRANSMIT_INVALID_ARG" 167 "PIO_PJ1939_DM42_TRANSMIT_INVALID_ARG" 168 "PIO_PJ1939_DM43_TRANSMIT_INVALID_ARG" 169 "PIO_PJ1939_DM44_TRANSMIT_INVALID_ARG" 170 "PIO_PJ1939_DM45_TRANSMIT_INVALID_ARG" 171 "PIO_PJ1939_DM46_TRANSMIT_INVALID_ARG" 172 "PIO_PJ1939_DM47_TRANSMIT_INVALID_ARG" 173 "PIO_PJ1939_DM48_TRANSMIT_INVALID_ARG" 174 "PIO_PJ1939_DM49_TRANSMIT_INVALID_ARG" 175 "PIO_PJ1939_DM50_TRANSMIT_INVALID_ARG" 176 "PIO_PJ1939_DM51_TRANSMIT_INVALID_ARG" 177 "PIO_PJ1939_DM52_TRANSMIT_INVALID_ARG" 178 "PIO_PJ1939_INVALID_RING_BUFFER_ARG" 179 "PIO_PJ1939_DM1_RECEIVE_INVALID_ARG" 180 "PIO_PJ1939_DM2_RECEIVE_INVALID_ARG" 181 "PIO_PMCAL_ADC_INIT_CHECK_ERROR" 182 "PIO_PSAF_ERROR_STANDBY_INIT" 183 "PIO_PSAF_ISR_MINIMUM_DELAY_TIME_NOT_MET" 184 "PIO_PSAF_ERROR_CLOCK_PLAUSIBILITY" 185 "PIO_PSC_DECODE_RESET_INVALID_ARG" 186 "PIO_PSC_ERR_FORCED_RESET" 187 "PIO_PSC_ERR_STANDY_ENTRY" 188 "PIO_PSC_ERR_VERSION_INVALID_PARAM" 189 "PIO_PSC_ERR_BUILD_DATE_INVALID_PARAM" 190 "PIO_PSC_ERR_PART_NUMBER_INVALID_PARAM" 191 "PIO_PSC_UNEXPECTED_CVN_CHANGE" 192 "PIO_PSC_ERR_HW_VERSION_UNKNOWN" 193 "PIO_PSENT_IN_CHANNEL_UNSUPPORTED" 194 "PIO_PSMC_INVALID_DATA" 195 "PIO_PSMC_INTERNAL_SW_ERROR" 196 "PIO_PSTP_SAFETPACK_INIT_FAILURE" 197 "PIO_PSTP_SMU_MODE_INVALID_DURING_INIT" 198 "PIO_PSTP_SMU_MODE_RUN_DURING_INIT" 199 "PIO_PSTP_SMU_FAIL_INIT" 200 "PIO_PSTP_SMU_FAIL_ALARM_CONFIG" 201 "PIO_PSTP_SMU_SW_ALARM_GROUP_0" 202 "PIO_PSTP_SMU_SW_ALARM_GROUP_1" 203 "PIO_PSTP_SMU_SW_ALARM_GROUP_2" 204 "PIO_PSTP_SMU_SW_ALARM_GROUP_3" 205 "PIO_PSTP_SMU_SW_ALARM_GROUP_4" 206 "PIO_PSTP_SMU_SW_ALARM_GROUP_5" 207 "PIO_PSTP_SMU_SW_ALARM_GROUP_6" 208 "PIO_PSTP_SMU_SW_ALARM_GROUP_7" 209 "PIO_PSTP_SMU_SW_ALARM_GROUP_8" 210 "PIO_PSTP_SMU_SW_ALARM_GROUP_9" 211 "PIO_PSTP_SMU_SW_ALARM_GROUP_10" 212 "PIO_PSTP_SMU_SW_ALARM_GROUP_11" 213 "PIO_PSTP_SMU_SW_ALARM_GROUP_12" 214 "PIO_PSTP_SMU_SW_ALARM_GROUP_13" 215 "PIO_PSTP_SMU_SW_ALARM_GROUP_14" 216 "PIO_PSTP_SMU_SW_ALARM_GROUP_15" 217 "PIO_PSTP_SWDGM_UNEXPECTED" 218 "PIO_PSTP_SWDGM_INIT_FAIL" 219 "PIO_PSTP_SWDGM_ACTIVATE_FAIL" 220 "PIO_PSTP_SWDGM_DEINIT_FAIL" 221 "PIO_PSTP_SWDGM_GETERRCNTR_FAIL" 222 "PIO_PSTP_SWDGM_GETINFO_FAIL" 223 "PIO_PSTP_SWDGM_GETSEED_FAIL" 224 "PIO_PSTP_SWDGM_USERREQ_FAIL" 225 "PIO_PSTP_SWDGM_SERVICE_FAIL" 226 "PIO_PSTP_TSTM_STARTUP_TEST_FAIL" 227 "PIO_PSTP_TSTM_RUNTIME_TEST_FAIL" 228 "PIO_PSTP_TSTM_INIT_FAIL" 229 "PIO_PSTP_TSTM_SWITCH_TO_RUN_FAIL" 230 "PIO_PSTP_TLF_TEST_FAIL" 231 "PIO_PSTP_TLF_MAXJOBS_FAIL" 232 "PIO_PSTP_SEID_INCORRECT" 233 "PIO_PSTP_CHECKPOINT_INCORRECT" 234 "PIO_PSTP_ERR_TASK_BUDGET_OVRRUN" 235 "PIO_PSTP_HTXTESTHND_INVALID_RESULT" 236 "PIO_PSTP_HTXTESTHND_TEST_NOT_EXECUTED" 237 "PIO_PSTP_HTXLBIST_CALLER_ADDR_ERR" 238 "PIO_PSTP_HTXLBIST_PORST_ERR" 239 "PIO_PSTP_HTXLBIST_TERMINATION_ERR" 240 "PIO_PSTP_HTXLBIST_DEFAULT_SIGNATURE_ERR" 241 "PIO_PSTP_HTXLBIST_CRC_ERR" 242 "PIO_PSTP_HTXLBIST_UNDEFINED_ERR" 243 "PIO_PSTP_HTXLBIST_INV_PARAM_ERR" 244 "PIO_PSTP_HTXSFRTST_CMP_INV_PARAM_ERR" 245 "PIO_PSTP_HTXSFRTST_CMP_OVERLOAD" 246 "PIO_PSTP_HTXSFRTST_CMP_VAL_ERR" 247 "PIO_PSTP_HTXSFRTST_CRC_INV_PARAM_ERR" 248 "PIO_PSTP_HTXSFRTST_CRC_DATAMISMATCH" 249 "PIO_PSTP_HTXREGMON_SMU_TIMEOUT" 250 "PIO_PSTP_HTXREGMON_ERR_UNDEFINED" 251 "PIO_PSTP_HTXREGMON_ERR_MTU_TIMEOUT_UND" 252 "PIO_PSTP_HTXREGMON_INV_PARAM_ERR" 253 "PIO_PSTP_HTXREGMON_ERR_MTU_FAILED" 254 "PIO_PSTP_HTXMONBIST_ERR_SMU_FLAG" 255 "PIO_PSTP_HTXMONBIST_ERR_PMS_FLAG" 256 "PIO_PSTP_HTXMONBIST_ERR_PMS_SMU_FLAG" 257 "PIO_PSTP_HTXMONBIST_ERR_TIMEOUT" 258 "PIO_PSTP_HTXMONBIST_ERR_UNSPECIFIED" 259 "PIO_PSTP_HTXMONBIST_ERR_SFR_CONFIG" 260 "PIO_PSTP_HTXDTSRESULT_A_FAILED_ERR_DIFF" 261 "PIO_PSTP_HTXDTSRESULT_B_FAILED_ERR_DIFF" 262 "PIO_PSTP_HTXSMUALIVEALARM_ERR_ALM_STS" 263 "PIO_PSTP_HTXSMUALIVEALARM_ERR_TRIG" 264 "PIO_PSTP_HTXSMUALIVEALARM_PREV_ALM_STS" 265 "PIO_PSTP_HTXSMUALIVEALARM_ERR_SMU_RUN" 266 "PIO_PSTP_HTXVMTMBIST_ERR_MTU_UNDEFINED" 267 "PIO_PSTP_HTXVMTMBIST_ERR_MTU_TIMEOUT_UND" 268 "PIO_PSTP_HTXVMTMBIST_INV_PARAM_ERR" 269 "PIO_PSTP_HTXFWCHECK_FAILED" 270 "PIO_PSTP_HTXFWCHECK_INV_PARAM_ERR" 271 "PIO_PSTP_HTXFWCHECK_RST_UNKNOWN" 272 "PIO_PSTP_HTXFWCHECK_SFR_NOT_CLEARED" 273 "PIO_PSTP_HTXFWCHECK_DATA_ERR" 274 "PIO_PSTP_HTXPFM_UNEXPECTED_ERROR" 275 "PIO_PSTP_HTXPFM_RAM_CORRUPTION" 276 "PIO_PSTP_HTXPFM_ILLEGAL_FUNCTION_ARGUMENT" 277 "PIO_PSTP_HTXPFM_SYSTEM_TIMER_READ_FAULT" 278 "PIO_PSTP_HTXPFM_ILLEGAL_REINIT" 279 "PIO_PSTP_HTXPFM_UNEXPECTED_SEID" 280 "PIO_PSTP_HTXPFM_LOGICAL_FAULT_DETECTED" 281 "PIO_PSTP_HTXPFM_DEADLINE_FAULT_DETECTED" 282 "PIO_PSTP_HTXPFM_TIMING_FAULT_DETECTED" 283 "PIO_PSTP_HTXPFM_ALIVENESS_FAULT_DETECTED" 284 "PIO_PSY_ERR_SMU_ASSERT" 285 "PIO_PTM_TIMER_ERROR" 286 "PIO_PUT_DEBOUNCE_BY_CYCLES_INVALID_ARG" 287 "PIO_PUT_LEAKY_BUCKET_INVALID_ARG" 288 "PIO_PUT_DEBOUNCE_BY_TIME_INVALID_ARG" 289 "PIO_PUT_DUTYCYCLE_PROCESSING_INVALID_ARG" 290 "PIO_PUT_STATE_PROCESSING_INVALID_ARG" 291 "PIO_PUT_ARRAY_SEARCH_INVALID_ARG" 292 "PIO_PUT_ERR_PACK_INVALID_PARAM" 293 "PIO_PUT_ERR_UNPACK_INVALID_PARAM" 294 "PIO_PXCP_RESET" 295 "PIO_PUART_MCAL_INIT_CHECK_ERROR" 296 "PIO_ALARM_0_TYPE_0_CPU" 297 "PIO_ALARM_0_TYPE_1_CPU" 298 "PIO_ALARM_0_TYPE_2_CPU" 299 "PIO_ALARM_0_TYPE_4_MTU" 300 "PIO_ALARM_0_TYPE_5_MTU" 301 "PIO_ALARM_0_TYPE_6_MTU" 302 "PIO_ALARM_0_TYPE_7_MTU" 303 "PIO_ALARM_0_TYPE_8_MTU" 304 "PIO_ALARM_0_TYPE_9_MTU" 305 "PIO_ALARM_0_TYPE_10_MTU" 306 "PIO_ALARM_0_TYPE_11_MTU" 307 "PIO_ALARM_0_TYPE_12_MTU" 308 "PIO_ALARM_0_TYPE_13_MTU" 309 "PIO_ALARM_0_TYPE_14_MTU" 310 "PIO_ALARM_0_TYPE_22_CPU" 311 "PIO_ALARM_0_TYPE_23_CPU" 312 "PIO_ALARM_0_TYPE_24_CPU" 313 "PIO_ALARM_1_TYPE_0_CPU" 314 "PIO_ALARM_1_TYPE_1_CPU" 315 "PIO_ALARM_1_TYPE_2_CPU" 316 "PIO_ALARM_1_TYPE_4_MTU" 317 "PIO_ALARM_1_TYPE_5_MTU" 318 "PIO_ALARM_1_TYPE_6_MTU" 319 "PIO_ALARM_1_TYPE_7_MTU" 320 "PIO_ALARM_1_TYPE_8_MTU" 321 "PIO_ALARM_1_TYPE_9_MTU" 322 "PIO_ALARM_1_TYPE_10_MTU" 323 "PIO_ALARM_1_TYPE_11_MTU" 324 "PIO_ALARM_1_TYPE_12_MTU" 325 "PIO_ALARM_1_TYPE_13_MTU" 326 "PIO_ALARM_1_TYPE_14_MTU" 327 "PIO_ALARM_1_TYPE_22_MTU" 328 "PIO_ALARM_1_TYPE_23_CPU" 329 "PIO_ALARM_1_TYPE_24_CPU" 330 "PIO_ALARM_6_TYPE_0_MTU" 331 "PIO_ALARM_6_TYPE_1_IOM" 332 "PIO_ALARM_6_TYPE_2_IR" 333 "PIO_ALARM_6_TYPE_4_SCU" 334 "PIO_ALARM_6_TYPE_5_PMS" 335 "PIO_ALARM_6_TYPE_6_DMA" 336 "PIO_ALARM_6_TYPE_7_SMU_CORE" 337 "PIO_ALARM_6_TYPE_8_CCU" 338 "PIO_ALARM_6_TYPE_10_GTM" 339 "PIO_ALARM_6_TYPE_11_GTM" 340 "PIO_ALARM_6_TYPE_12_GTM" 341 "PIO_ALARM_6_TYPE_13_ERAY" 342 "PIO_ALARM_6_TYPE_14_ERAY" 343 "PIO_ALARM_6_TYPE_15_SRAM" 344 "PIO_ALARM_6_TYPE_16_CAN" 345 "PIO_ALARM_6_TYPE_17_CAN" 346 "PIO_ALARM_6_TYPE_18_CAN" 347 "PIO_ALARM_6_TYPE_19_MISC" 348 "PIO_ALARM_6_TYPE_20_MISC" 349 "PIO_ALARM_6_TYPE_21_MISC" 350 "PIO_ALARM_6_TYPE_23_CBS" 351 "PIO_ALARM_6_TYPE_24_CCU" 352 "PIO_ALARM_6_TYPE_25_CCU" 353 "PIO_ALARM_7_TYPE_0_DAM0" 354 "PIO_ALARM_7_TYPE_1_LMU" 355 "PIO_ALARM_7_TYPE_2_LMU" 356 "PIO_ALARM_7_TYPE_17_XBAR0" 357 "PIO_ALARM_7_TYPE_20_SPB" 358 "PIO_ALARM_7_TYPE_22_FSI" 359 "PIO_ALARM_7_TYPE_23_FSI" 360 "PIO_ALARM_7_TYPE_24_FSI" 361 "PIO_ALARM_7_TYPE_25_FSI" 362 "PIO_ALARM_7_TYPE_26_FSI" 363 "PIO_ALARM_7_TYPE_27_FSI" 364 "PIO_ALARM_7_TYPE_28_FSI" 365 "PIO_ALARM_7_TYPE_29_FSI" 366 "PIO_ALARM_7_TYPE_30_FSI" 367 "PIO_ALARM_7_TYPE_31_FSI" 368 "PIO_ALARM_8_TYPE_0_SCU" 369 "PIO_ALARM_8_TYPE_1_CCU" 370 "PIO_ALARM_8_TYPE_2_CCU" 371 "PIO_ALARM_8_TYPE_3_SCU" 372 "PIO_ALARM_8_TYPE_4_SCU" 373 "PIO_ALARM_8_TYPE_5_SCU" 374 "PIO_ALARM_8_TYPE_6_SCU" 375 "PIO_ALARM_8_TYPE_7_SCU" 376 "PIO_ALARM_8_TYPE_8_SCU" 377 "PIO_ALARM_8_TYPE_9_SCU" 378 "PIO_ALARM_8_TYPE_10_SCU" 379 "PIO_ALARM_8_TYPE_11_SCU" 380 "PIO_ALARM_8_TYPE_16_SCU" 381 "PIO_ALARM_8_TYPE_17_SCU" 382 "PIO_ALARM_8_TYPE_18_SCU" 383 "PIO_ALARM_8_TYPE_19_SCU" 384 "PIO_ALARM_8_TYPE_20_SCU" 385 "PIO_ALARM_8_TYPE_21_SCU" 386 "PIO_ALARM_8_TYPE_22_IR" 387 "PIO_ALARM_8_TYPE_23_DMA" 388 "PIO_ALARM_8_TYPE_25_IOM" 389 "PIO_ALARM_8_TYPE_26_SCU" 390 "PIO_ALARM_8_TYPE_27_SCU" 391 "PIO_ALARM_8_TYPE_28_SCU" 392 "PIO_ALARM_8_TYPE_29_SCU" 393 "PIO_ALARM_8_TYPE_30_SCU" 394 "PIO_ALARM_8_TYPE_31_SCU" 395 "PIO_ALARM_9_TYPE_0_DTS" 396 "PIO_ALARM_9_TYPE_1_DTS" 397 "PIO_ALARM_9_TYPE_3_PMS" 398 "PIO_ALARM_9_TYPE_5_PMS" 399 "PIO_ALARM_9_TYPE_15_PMS" 400 "PIO_ALARM_9_TYPE_16_PMS" 401 "PIO_ALARM_9_TYPE_17_PMS" 402 "PIO_ALARM_10_TYPE_0_SW" 403 "PIO_ALARM_10_TYPE_1_SW" 404 "PIO_ALARM_10_TYPE_2_SW" 405 "PIO_ALARM_10_TYPE_3_SW" 406 "PIO_ALARM_10_TYPE_4_SW" 407 "PIO_ALARM_10_TYPE_5_SW" 408 "PIO_ALARM_10_TYPE_6_SW" 409 "PIO_ALARM_10_TYPE_7_SW" 410 "PIO_ALARM_10_TYPE_8_SW" 411 "PIO_ALARM_10_TYPE_9_SW" 412 "PIO_ALARM_10_TYPE_10_SW" 413 "PIO_ALARM_10_TYPE_11_SW" 414 "PIO_ALARM_10_TYPE_12_SW" 415 "PIO_ALARM_10_TYPE_13_SW" 416 "PIO_ALARM_10_TYPE_14_SW" 417 "PIO_ALARM_10_TYPE_15_SW" 418 "PIO_ALARM_10_TYPE_16_SMU_CORE" 419 "PIO_ALARM_10_TYPE_17_SMU_CORE" 420 "PIO_ALARM_10_TYPE_18_FSP" 421 "PIO_ALARM_10_TYPE_20_CCU" 422 "PIO_ALARM_10_TYPE_21_SFF" 423 "PIO_ALARM_10_TYPE_22_SFF" 424 "PIO_ALARM_11_TYPE_2_XBAR" 425 "PIO_ALARM_11_TYPE_3_XBAR" 426 "PIO_ALARM_11_TYPE_4_DMU" 427 "PIO_ALARM_11_TYPE_5_DMU" 428 "PIO_ALARM_11_TYPE_9_SFIBRIDGE1" 429 "PIO_ALARM_11_TYPE_10_HSSL" 430 "PIO_ALARM_11_TYPE_12_CONVERTER" 431 "PIO_ALARM_11_TYPE_13_XBAR" 432 "PIO_ALARM_20_TYPE_4_EVR" 433 "PIO_ALARM_20_TYPE_5_EVR" 434 "PIO_ALARM_20_TYPE_6_EVR" 435 "PIO_ALARM_20_TYPE_7_EVR" 436 "PIO_ALARM_20_TYPE_8_EVR" 437 "PIO_ALARM_20_TYPE_9_EVR" 438 "PIO_ALARM_20_TYPE_10_EVR" 439 "PIO_ALARM_20_TYPE_11_EVR" 440 "PIO_ALARM_20_TYPE_12_EVR" 441 "PIO_ALARM_20_TYPE_13_EVR" 442 "PIO_ALARM_20_TYPE_14_EVR" 443 "PIO_ALARM_20_TYPE_15_EVR" 444 "PIO_ALARM_21_TYPE_0_HSM" 445 "PIO_ALARM_21_TYPE_1_HSM" 446 "PIO_ALARM_21_TYPE_2_HSM" 447 "PIO_ALARM_21_TYPE_3_HSM" 448 "PIO_ALARM_21_TYPE_4_HSM" 449 "PIO_ALARM_21_TYPE_5_HSM" 450 "PIO_ALARM_21_TYPE_7_SMU" 451 "PIO_ALARM_21_TYPE_8_PMS" 452 "PIO_ALARM_21_TYPE_9_PMS" 453 "PIO_ALARM_21_TYPE_10_PMS" 454 "PIO_ALARM_21_TYPE_11_PMS" 455 "PIO_ALARM_21_TYPE_12_PMS" 456 "PIO_ALARM_21_TYPE_13_PMS" 457 "PIO_ALARM_21_TYPE_14_PMS" 458 "PIO_ALARM_21_TYPE_15_CCU" 459 "PIO_ALARM_21_TYPE_16_SMU_CORE" 460 "PIO_ALARM_MULTIPLE" 461 "PIO_ALARM_RESERVED" 462 "PIO_ALARM_UNEXPECTED" 463 "PIO_ERROR_ID_LAST" /end COMPU_VTAB
/* Scalar measurable for DDE 'mpl_error_log_detailed[2].err.mode'. */
/begin MEASUREMENT mpl_error_log_detailed[2].err.0 "Mode of the software when fault raised" SBYTE CU_MPL_ERROR_LOG_DETAILED[2].30 1 100 0.0 127.0 ECU_ADDRESS 0xf0240662 BYTE_ORDER MSB_LAST /end MEASUREMENT
/begin COMPU_METHOD CU_MPL_ERROR_LOG_DETAILED[2].30 "Conversion method for mpl_error_log_detailed[2].err.mode" TAB_VERB "%12.0" "code" COMPU_TAB_REF CT_MPL_ERROR_LOG_DETAILED[2].30 /end COMPU_METHOD
/begin COMPU_VTAB CT_MPL_ERROR_LOG_DETAILED[2].30 "Conversion method for mpl_error_log_detailed[2].err.mode" TAB_VERB 4 0 "PIO_EXEC_MODE_UNKNOWN" 1 "PIO_EXEC_MODE_PRG" 2 "PIO_EXEC_MODE_APP" 3 "PIO_EXEC_MODE_LAST" /end COMPU_VTAB
/* Scalar measurable for DDE 'mpl_error_log_detailed[2].err.reaction'. */
/begin MEASUREMENT mpl_error_log_detailed[2].err.1 "Reaction to the fault raised" SBYTE CU_MPL_ERROR_LOG_DETAILED[2].58 1 100 0.0 127.0 ECU_ADDRESS 0xf0240663 BYTE_ORDER MSB_LAST /end MEASUREMENT
/begin COMPU_METHOD CU_MPL_ERROR_LOG_DETAILED[2].58 "Conversion method for mpl_error_log_detailed[2].err.reaction" TAB_VERB "%12.0" "code" COMPU_TAB_REF CT_MPL_ERROR_LOG_DETAILED[2].58 /end COMPU_METHOD
/begin COMPU_VTAB CT_MPL_ERROR_LOG_DETAILED[2].58 "Conversion method for mpl_error_log_detailed[2].err.reaction" TAB_VERB 6 0 "PIO_CONTINUE" 1 "PIO_RESET" 2 "PIO_RECORD_AND_CONTINUE" 3 "PIO_RECORD_AND_RESET" 4 "PIO_RESET_AND_RECORD" 5 "PIO_FAULT_REACTION_LAST" /end COMPU_VTAB
/* Scalar measurable for DDE 'mpl_error_log_detailed[2].err_log.cpu_log.biv'. */
/begin MEASUREMENT mpl_error_log_detailed[2].err21 "CPU base address of interrupt vector table register" ULONG CU_MPL_ERROR_LOG_DETAILED[2].21 1 100 0.0 4294967295.0 ECU_ADDRESS 0xf0240824 BYTE_ORDER MSB_LAST /end MEASUREMENT
/begin COMPU_METHOD CU_MPL_ERROR_LOG_DETAILED[2].21 "Conversion method for mpl_error_log_detailed[2].err_log.cpu_log.biv" RAT_FUNC "%10.0" "(not defined)" COEFFS 0.000000 1.000000 -0.000000 0.000000 0.000000 1.000000 /end COMPU_METHOD
/* Scalar measurable for DDE 'mpl_error_log_detailed[2].err_log.cpu_log.btv'. */
/begin MEASUREMENT mpl_error_log_detailed[2].err_1 "CPU base address of trap vector table register" ULONG CU_MPL_ERROR_LOG_DETAILED[2].E1 1 100 0.0 4294967295.0 ECU_ADDRESS 0xf0240828 BYTE_ORDER MSB_LAST /end MEASUREMENT
/begin COMPU_METHOD CU_MPL_ERROR_LOG_DETAILED[2].E1 "Conversion method for mpl_error_log_detailed[2].err_log.cpu_log.btv" RAT_FUNC "%10.0" "(not defined)" COEFFS 0.000000 1.000000 -0.000000 0.000000 0.000000 1.000000 /end COMPU_METHOD
/* Scalar measurable for DDE 'mpl_error_log_detailed[2].err_log.cpu_log.cpr_low[0]'. */
/begin MEASUREMENT mpl_error_log_detailed[2].err_3 "CPU/MPU code segment protection register, lower" ULONG CU_MPL_ERROR_LOG_DETAILED[2].E3 1 100 0.0 4294967295.0 ECU_ADDRESS 0xf0240778 BYTE_ORDER MSB_LAST /end MEASUREMENT
/begin COMPU_METHOD CU_MPL_ERROR_LOG_DETAILED[2].E3 "Conversion method for mpl_error_log_detailed[2].err_log.cpu_log.cpr_low[0]" RAT_FUNC "%10.0" "(not defined)" COEFFS 0.000000 1.000000 -0.000000 0.000000 0.000000 1.000000 /end COMPU_METHOD
/* Scalar measurable for DDE 'mpl_error_log_detailed[2].err_log.cpu_log.cpr_low[1]'. */
/begin MEASUREMENT mpl_error_log_detailed[2].er007 "CPU/MPU code segment protection register, lower" ULONG CU_MPL_ERROR_LOG_DETAILED[2]009 1 100 0.0 4294967295.0 ECU_ADDRESS 0xf024077c BYTE_ORDER MSB_LAST /end MEASUREMENT
/begin COMPU_METHOD CU_MPL_ERROR_LOG_DETAILED[2]009 "Conversion method for mpl_error_log_detailed[2].err_log.cpu_log.cpr_low[1]" RAT_FUNC "%10.0" "(not defined)" COEFFS 0.000000 1.000000 -0.000000 0.000000 0.000000 1.000000 /end COMPU_METHOD
/* Scalar measurable for DDE 'mpl_error_log_detailed[2].err_log.cpu_log.cpr_low[2]'. */
/begin MEASUREMENT mpl_error_log_detailed[2].err45 "CPU/MPU code segment protection register, lower" ULONG CU_MPL_ERROR_LOG_DETAILED[2].46 1 100 0.0 4294967295.0 ECU_ADDRESS 0xf0240780 BYTE_ORDER MSB_LAST /end MEASUREMENT
/begin COMPU_METHOD CU_MPL_ERROR_LOG_DETAILED[2].46 "Conversion method for mpl_error_log_detailed[2].err_log.cpu_log.cpr_low[2]" RAT_FUNC "%10.0" "(not defined)" COEFFS 0.000000 1.000000 -0.000000 0.000000 0.000000 1.000000 /end COMPU_METHOD
/* Scalar measurable for DDE 'mpl_error_log_detailed[2].err_log.cpu_log.cpr_low[3]'. */
/begin MEASUREMENT mpl_error_log_detailed[2].er029 "CPU/MPU code segment protection register, lower" ULONG CU_MPL_ERROR_LOG_DETAILED[2]032 1 100 0.0 4294967295.0 ECU_ADDRESS 0xf0240784 BYTE_ORDER MSB_LAST /end MEASUREMENT
/begin COMPU_METHOD CU_MPL_ERROR_LOG_DETAILED[2]032 "Conversion method for mpl_error_log_detailed[2].err_log.cpu_log.cpr_low[3]" RAT_FUNC "%10.0" "(not defined)" COEFFS 0.000000 1.000000 -0.000000 0.000000 0.000000 1.000000 /end COMPU_METHOD
/* Scalar measurable for DDE 'mpl_error_log_detailed[2].err_log.cpu_log.cpr_low[4]'. */
/begin MEASUREMENT mpl_error_log_detailed[2].err75 "CPU/MPU code segment protection register, lower" ULONG CU_MPL_ERROR_LOG_DETAILED[2].77 1 100 0.0 4294967295.0 ECU_ADDRESS 0xf0240788 BYTE_ORDER MSB_LAST /end MEASUREMENT
/begin COMPU_METHOD CU_MPL_ERROR_LOG_DETAILED[2].77 "Conversion method for mpl_error_log_detailed[2].err_log.cpu_log.cpr_low[4]" RAT_FUNC "%10.0" "(not defined)" COEFFS 0.000000 1.000000 -0.000000 0.000000 0.000000 1.000000 /end COMPU_METHOD
/* Scalar measurable for DDE 'mpl_error_log_detailed[2].err_log.cpu_log.cpr_low[5]'. */
/begin MEASUREMENT mpl_error_log_detailed[2].er022 "CPU/MPU code segment protection register, lower" ULONG CU_MPL_ERROR_LOG_DETAILED[2]025 1 100 0.0 4294967295.0 ECU_ADDRESS 0xf024078c BYTE_ORDER MSB_LAST /end MEASUREMENT
/begin COMPU_METHOD CU_MPL_ERROR_LOG_DETAILED[2]025 "Conversion method for mpl_error_log_detailed[2].err_log.cpu_log.cpr_low[5]" RAT_FUNC "%10.0" "(not defined)" COEFFS 0.000000 1.000000 -0.000000 0.000000 0.000000 1.000000 /end COMPU_METHOD
/* Scalar measurable for DDE 'mpl_error_log_detailed[2].err_log.cpu_log.cpr_low[6]'. */
/begin MEASUREMENT mpl_error_log_detailed[2].err87 "CPU/MPU code segment protection register, lower" ULONG CU_MPL_ERROR_LOG_DETAILED[2].89 1 100 0.0 4294967295.0 ECU_ADDRESS 0xf0240790 BYTE_ORDER MSB_LAST /end MEASUREMENT
/begin COMPU_METHOD CU_MPL_ERROR_LOG_DETAILED[2].89 "Conversion method for mpl_error_log_detailed[2].err_log.cpu_log.cpr_low[6]" RAT_FUNC "%10.0" "(not defined)" COEFFS 0.000000 1.000000 -0.000000 0.000000 0.000000 1.000000 /end COMPU_METHOD
/* Scalar measurable for DDE 'mpl_error_log_detailed[2].err_log.cpu_log.cpr_low[7]'. */
/begin MEASUREMENT mpl_error_log_detailed[2].er002 "CPU/MPU code segment protection register, lower" ULONG CU_MPL_ERROR_LOG_DETAILED[2]004 1 100 0.0 4294967295.0 ECU_ADDRESS 0xf0240794 BYTE_ORDER MSB_LAST /end MEASUREMENT
/begin COMPU_METHOD CU_MPL_ERROR_LOG_DETAILED[2]004 "Conversion method for mpl_error_log_detailed[2].err_log.cpu_log.cpr_low[7]" RAT_FUNC "%10.0" "(not defined)" COEFFS 0.000000 1.000000 -0.000000 0.000000 0.000000 1.000000 /end COMPU_METHOD
/* Scalar measurable for DDE 'mpl_error_log_detailed[2].err_log.cpu_log.cpr_low[8]'. */
/begin MEASUREMENT mpl_error_log_detailed[2].er005 "CPU/MPU code segment protection register, lower" ULONG CU_MPL_ERROR_LOG_DETAILED[2]007 1 100 0.0 4294967295.0 ECU_ADDRESS 0xf0240798 BYTE_ORDER MSB_LAST /end MEASUREMENT
/begin COMPU_METHOD CU_MPL_ERROR_LOG_DETAILED[2]007 "Conversion method for mpl_error_log_detailed[2].err_log.cpu_log.cpr_low[8]" RAT_FUNC "%10.0" "(not defined)" COEFFS 0.000000 1.000000 -0.000000 0.000000 0.000000 1.000000 /end COMPU_METHOD
/* Scalar measurable for DDE 'mpl_error_log_detailed[2].err_log.cpu_log.cpr_low[9]'. */
/begin MEASUREMENT mpl_error_log_detailed[2].err99 "CPU/MPU code segment protection register, lower" ULONG CU_MPL_ERROR_LOG_DETAILED[2]001 1 100 0.0 4294967295.0 ECU_ADDRESS 0xf024079c BYTE_ORDER MSB_LAST /end MEASUREMENT
/begin COMPU_METHOD CU_MPL_ERROR_LOG_DETAILED[2]001 "Conversion method for mpl_error_log_detailed[2].err_log.cpu_log.cpr_low[9]" RAT_FUNC "%10.0" "(not defined)" COEFFS 0.000000 1.000000 -0.000000 0.000000 0.000000 1.000000 /end COMPU_METHOD
/* Scalar measurable for DDE 'mpl_error_log_detailed[2].err_log.cpu_log.cpr_upr[0]'. */
/begin MEASUREMENT mpl_error_log_detailed[2].err77 "CPU/MPU code segment protection register, upper" ULONG CU_MPL_ERROR_LOG_DETAILED[2].79 1 100 0.0 4294967295.0 ECU_ADDRESS 0xf02407a0 BYTE_ORDER MSB_LAST /end MEASUREMENT
/begin COMPU_METHOD CU_MPL_ERROR_LOG_DETAILED[2].79 "Conversion method for mpl_error_log_detailed[2].err_log.cpu_log.cpr_upr[0]" RAT_FUNC "%10.0" "(not defined)" COEFFS 0.000000 1.000000 -0.000000 0.000000 0.000000 1.000000 /end COMPU_METHOD
/* Scalar measurable for DDE 'mpl_error_log_detailed[2].err_log.cpu_log.cpr_upr[1]'. */
/begin MEASUREMENT mpl_error_log_detailed[2].err73 "CPU/MPU code segment protection register, upper" ULONG CU_MPL_ERROR_LOG_DETAILED[2].75 1 100 0.0 4294967295.0 ECU_ADDRESS 0xf02407a4 BYTE_ORDER MSB_LAST /end MEASUREMENT
/begin COMPU_METHOD CU_MPL_ERROR_LOG_DETAILED[2].75 "Conversion method for mpl_error_log_detailed[2].err_log.cpu_log.cpr_upr[1]" RAT_FUNC "%10.0" "(not defined)" COEFFS 0.000000 1.000000 -0.000000 0.000000 0.000000 1.000000 /end COMPU_METHOD
/* Scalar measurable for DDE 'mpl_error_log_detailed[2].err_log.cpu_log.cpr_upr[2]'. */
/begin MEASUREMENT mpl_error_log_detailed[2].err57 "CPU/MPU code segment protection register, upper" ULONG CU_MPL_ERROR_LOG_DETAILED[2].59 1 100 0.0 4294967295.0 ECU_ADDRESS 0xf02407a8 BYTE_ORDER MSB_LAST /end MEASUREMENT
/begin COMPU_METHOD CU_MPL_ERROR_LOG_DETAILED[2].59 "Conversion method for mpl_error_log_detailed[2].err_log.cpu_log.cpr_upr[2]" RAT_FUNC "%10.0" "(not defined)" COEFFS 0.000000 1.000000 -0.000000 0.000000 0.000000 1.000000 /end COMPU_METHOD
/* Scalar measurable for DDE 'mpl_error_log_detailed[2].err_log.cpu_log.cpr_upr[3]'. */
/begin MEASUREMENT mpl_error_log_detailed[2].err41 "CPU/MPU code segment protection register, upper" ULONG CU_MPL_ERROR_LOG_DETAILED[2].42 1 100 0.0 4294967295.0 ECU_ADDRESS 0xf02407ac BYTE_ORDER MSB_LAST /end MEASUREMENT
/begin COMPU_METHOD CU_MPL_ERROR_LOG_DETAILED[2].42 "Conversion method for mpl_error_log_detailed[2].err_log.cpu_log.cpr_upr[3]" RAT_FUNC "%10.0" "(not defined)" COEFFS 0.000000 1.000000 -0.000000 0.000000 0.000000 1.000000 /end COMPU_METHOD
/* Scalar measurable for DDE 'mpl_error_log_detailed[2].err_log.cpu_log.cpr_upr[4]'. */
/begin MEASUREMENT mpl_error_log_detailed[2].err28 "CPU/MPU code segment protection register, upper" ULONG CU_MPL_ERROR_LOG_DETAILED[2].28 1 100 0.0 4294967295.0 ECU_ADDRESS 0xf02407b0 BYTE_ORDER MSB_LAST /end MEASUREMENT
/begin COMPU_METHOD CU_MPL_ERROR_LOG_DETAILED[2].28 "Conversion method for mpl_error_log_detailed[2].err_log.cpu_log.cpr_upr[4]" RAT_FUNC "%10.0" "(not defined)" COEFFS 0.000000 1.000000 -0.000000 0.000000 0.000000 1.000000 /end COMPU_METHOD
/* Scalar measurable for DDE 'mpl_error_log_detailed[2].err_log.cpu_log.cpr_upr[5]'. */
/begin MEASUREMENT mpl_error_log_detailed[2].err35 "CPU/MPU code segment protection register, upper" ULONG CU_MPL_ERROR_LOG_DETAILED[2].36 1 100 0.0 4294967295.0 ECU_ADDRESS 0xf02407b4 BYTE_ORDER MSB_LAST /end MEASUREMENT
/begin COMPU_METHOD CU_MPL_ERROR_LOG_DETAILED[2].36 "Conversion method for mpl_error_log_detailed[2].err_log.cpu_log.cpr_upr[5]" RAT_FUNC "%10.0" "(not defined)" COEFFS 0.000000 1.000000 -0.000000 0.000000 0.000000 1.000000 /end COMPU_METHOD
/* Scalar measurable for DDE 'mpl_error_log_detailed[2].err_log.cpu_log.cpr_upr[6]'. */
/begin MEASUREMENT mpl_error_log_detailed[2].err07 "CPU/MPU code segment protection register, upper" ULONG CU_MPL_ERROR_LOG_DETAILED[2].07 1 100 0.0 4294967295.0 ECU_ADDRESS 0xf02407b8 BYTE_ORDER MSB_LAST /end MEASUREMENT
/begin COMPU_METHOD CU_MPL_ERROR_LOG_DETAILED[2].07 "Conversion method for mpl_error_log_detailed[2].err_log.cpu_log.cpr_upr[6]" RAT_FUNC "%10.0" "(not defined)" COEFFS 0.000000 1.000000 -0.000000 0.000000 0.000000 1.000000 /end COMPU_METHOD
/* Scalar measurable for DDE 'mpl_error_log_detailed[2].err_log.cpu_log.cpr_upr[7]'. */
/begin MEASUREMENT mpl_error_log_detailed[2].err65 "CPU/MPU code segment protection register, upper" ULONG CU_MPL_ERROR_LOG_DETAILED[2].67 1 100 0.0 4294967295.0 ECU_ADDRESS 0xf02407bc BYTE_ORDER MSB_LAST /end MEASUREMENT
/begin COMPU_METHOD CU_MPL_ERROR_LOG_DETAILED[2].67 "Conversion method for mpl_error_log_detailed[2].err_log.cpu_log.cpr_upr[7]" RAT_FUNC "%10.0" "(not defined)" COEFFS 0.000000 1.000000 -0.000000 0.000000 0.000000 1.000000 /end COMPU_METHOD
/* Scalar measurable for DDE 'mpl_error_log_detailed[2].err_log.cpu_log.cpr_upr[8]'. */
/begin MEASUREMENT mpl_error_log_detailed[2].er046 "CPU/MPU code segment protection register, upper" ULONG CU_MPL_ERROR_LOG_DETAILED[2]049 1 100 0.0 4294967295.0 ECU_ADDRESS 0xf02407c0 BYTE_ORDER MSB_LAST /end MEASUREMENT
/begin COMPU_METHOD CU_MPL_ERROR_LOG_DETAILED[2]049 "Conversion method for mpl_error_log_detailed[2].err_log.cpu_log.cpr_upr[8]" RAT_FUNC "%10.0" "(not defined)" COEFFS 0.000000 1.000000 -0.000000 0.000000 0.000000 1.000000 /end COMPU_METHOD
/* Scalar measurable for DDE 'mpl_error_log_detailed[2].err_log.cpu_log.cpr_upr[9]'. */
/begin MEASUREMENT mpl_error_log_detailed[2].err42 "CPU/MPU code segment protection register, upper" ULONG CU_MPL_ERROR_LOG_DETAILED[2].43 1 100 0.0 4294967295.0 ECU_ADDRESS 0xf02407c4 BYTE_ORDER MSB_LAST /end MEASUREMENT
/begin COMPU_METHOD CU_MPL_ERROR_LOG_DETAILED[2].43 "Conversion method for mpl_error_log_detailed[2].err_log.cpu_log.cpr_upr[9]" RAT_FUNC "%10.0" "(not defined)" COEFFS 0.000000 1.000000 -0.000000 0.000000 0.000000 1.000000 /end COMPU_METHOD
/* Scalar measurable for DDE 'mpl_error_log_detailed[2].err_log.cpu_log.cpxe[0]'. */
/begin MEASUREMENT mpl_error_log_detailed[2].err43 "CPU/MPU code protection execution enable configuration register" ULONG CU_MPL_ERROR_LOG_DETAILED[2].44 1 100 0.0 4294967295.0 ECU_ADDRESS 0xf02407c8 BYTE_ORDER MSB_LAST /end MEASUREMENT
/begin COMPU_METHOD CU_MPL_ERROR_LOG_DETAILED[2].44 "Conversion method for mpl_error_log_detailed[2].err_log.cpu_log.cpxe[0]" RAT_FUNC "%10.0" "(not defined)" COEFFS 0.000000 1.000000 -0.000000 0.000000 0.000000 1.000000 /end COMPU_METHOD
/* Scalar measurable for DDE 'mpl_error_log_detailed[2].err_log.cpu_log.cpxe[1]'. */
/begin MEASUREMENT mpl_error_log_detailed[2].err60 "CPU/MPU code protection execution enable configuration register" ULONG CU_MPL_ERROR_LOG_DETAILED[2].62 1 100 0.0 4294967295.0 ECU_ADDRESS 0xf02407cc BYTE_ORDER MSB_LAST /end MEASUREMENT
/begin COMPU_METHOD CU_MPL_ERROR_LOG_DETAILED[2].62 "Conversion method for mpl_error_log_detailed[2].err_log.cpu_log.cpxe[1]" RAT_FUNC "%10.0" "(not defined)" COEFFS 0.000000 1.000000 -0.000000 0.000000 0.000000 1.000000 /end COMPU_METHOD
/* Scalar measurable for DDE 'mpl_error_log_detailed[2].err_log.cpu_log.cpxe[2]'. */
/begin MEASUREMENT mpl_error_log_detailed[2].err23 "CPU/MPU code protection execution enable configuration register" ULONG CU_MPL_ERROR_LOG_DETAILED[2].23 1 100 0.0 4294967295.0 ECU_ADDRESS 0xf02407d0 BYTE_ORDER MSB_LAST /end MEASUREMENT
/begin COMPU_METHOD CU_MPL_ERROR_LOG_DETAILED[2].23 "Conversion method for mpl_error_log_detailed[2].err_log.cpu_log.cpxe[2]" RAT_FUNC "%10.0" "(not defined)" COEFFS 0.000000 1.000000 -0.000000 0.000000 0.000000 1.000000 /end COMPU_METHOD
/* Scalar measurable for DDE 'mpl_error_log_detailed[2].err_log.cpu_log.cpxe[3]'. */
/begin MEASUREMENT mpl_error_log_detailed[2].err30 "CPU/MPU code protection execution enable configuration register" ULONG CU_MPL_ERROR_LOG_DETAILED[2].31 1 100 0.0 4294967295.0 ECU_ADDRESS 0xf02407d4 BYTE_ORDER MSB_LAST /end MEASUREMENT
/begin COMPU_METHOD CU_MPL_ERROR_LOG_DETAILED[2].31 "Conversion method for mpl_error_log_detailed[2].err_log.cpu_log.cpxe[3]" RAT_FUNC "%10.0" "(not defined)" COEFFS 0.000000 1.000000 -0.000000 0.000000 0.000000 1.000000 /end COMPU_METHOD
/* Scalar measurable for DDE 'mpl_error_log_detailed[2].err_log.cpu_log.cpxe[4]'. */
/begin MEASUREMENT mpl_error_log_detailed[2].err01 "CPU/MPU code protection execution enable configuration register" ULONG CU_MPL_ERROR_LOG_DETAILED[2].01 1 100 0.0 4294967295.0 ECU_ADDRESS 0xf02407d8 BYTE_ORDER MSB_LAST /end MEASUREMENT
/begin COMPU_METHOD CU_MPL_ERROR_LOG_DETAILED[2].01 "Conversion method for mpl_error_log_detailed[2].err_log.cpu_log.cpxe[4]" RAT_FUNC "%10.0" "(not defined)" COEFFS 0.000000 1.000000 -0.000000 0.000000 0.000000 1.000000 /end COMPU_METHOD
/* Scalar measurable for DDE 'mpl_error_log_detailed[2].err_log.cpu_log.cpxe[5]'. */
/begin MEASUREMENT mpl_error_log_detailed[2].err08 "CPU/MPU code protection execution enable configuration register" ULONG CU_MPL_ERROR_LOG_DETAILED[2].08 1 100 0.0 4294967295.0 ECU_ADDRESS 0xf02407dc BYTE_ORDER MSB_LAST /end MEASUREMENT
/begin COMPU_METHOD CU_MPL_ERROR_LOG_DETAILED[2].08 "Conversion method for mpl_error_log_detailed[2].err_log.cpu_log.cpxe[5]" RAT_FUNC "%10.0" "(not defined)" COEFFS 0.000000 1.000000 -0.000000 0.000000 0.000000 1.000000 /end COMPU_METHOD
/* Scalar measurable for DDE 'mpl_error_log_detailed[2].err_log.cpu_log.datr'. */
/begin MEASUREMENT mpl_error_log_detailed[2].er026 "CPU data asynchronous error trap register" ULONG CU_MPL_ERROR_LOG_DETAILED[2]029 1 100 0.0 4294967295.0 ECU_ADDRESS 0xf02406ac BYTE_ORDER MSB_LAST /end MEASUREMENT
/begin COMPU_METHOD CU_MPL_ERROR_LOG_DETAILED[2]029 "Conversion method for mpl_error_log_detailed[2].err_log.cpu_log.datr" RAT_FUNC "%10.0" "(not defined)" COEFFS 0.000000 1.000000 -0.000000 0.000000 0.000000 1.000000 /end COMPU_METHOD
/* Scalar measurable for DDE 'mpl_error_log_detailed[2].err_log.cpu_log.deadd'. */
/begin MEASUREMENT mpl_error_log_detailed[2].er006 "CPU data error address register" ULONG CU_MPL_ERROR_LOG_DETAILED[2]008 1 100 0.0 4294967295.0 ECU_ADDRESS 0xf02406b0 BYTE_ORDER MSB_LAST /end MEASUREMENT
/begin COMPU_METHOD CU_MPL_ERROR_LOG_DETAILED[2]008 "Conversion method for mpl_error_log_detailed[2].err_log.cpu_log.deadd" RAT_FUNC "%10.0" "(not defined)" COEFFS 0.000000 1.000000 -0.000000 0.000000 0.000000 1.000000 /end COMPU_METHOD
/* Scalar measurable for DDE 'mpl_error_log_detailed[2].err_log.cpu_log.diear'. */
/begin MEASUREMENT mpl_error_log_detailed[2].err58 "CPU data integrity error address register" ULONG CU_MPL_ERROR_LOG_DETAILED[2].60 1 100 0.0 4294967295.0 ECU_ADDRESS 0xf02406b4 BYTE_ORDER MSB_LAST /end MEASUREMENT
/begin COMPU_METHOD CU_MPL_ERROR_LOG_DETAILED[2].60 "Conversion method for mpl_error_log_detailed[2].err_log.cpu_log.diear" RAT_FUNC "%10.0" "(not defined)" COEFFS 0.000000 1.000000 -0.000000 0.000000 0.000000 1.000000 /end COMPU_METHOD
/* Scalar measurable for DDE 'mpl_error_log_detailed[2].err_log.cpu_log.dietr'. */
/begin MEASUREMENT mpl_error_log_detailed[2].err12 "CPU data integrity error trap register" ULONG CU_MPL_ERROR_LOG_DETAILED[2].12 1 100 0.0 4294967295.0 ECU_ADDRESS 0xf02406b8 BYTE_ORDER MSB_LAST /end MEASUREMENT
/begin COMPU_METHOD CU_MPL_ERROR_LOG_DETAILED[2].12 "Conversion method for mpl_error_log_detailed[2].err_log.cpu_log.dietr" RAT_FUNC "%10.0" "(not defined)" COEFFS 0.000000 1.000000 -0.000000 0.000000 0.000000 1.000000 /end COMPU_METHOD
/* Scalar measurable for DDE 'mpl_error_log_detailed[2].err_log.cpu_log.dpr_low[0]'. */
/begin MEASUREMENT mpl_error_log_detailed[2].er038 "CPU/MPU data segment protection register, lower" ULONG CU_MPL_ERROR_LOG_DETAILED[2]041 1 100 0.0 4294967295.0 ECU_ADDRESS 0xf02406e8 BYTE_ORDER MSB_LAST /end MEASUREMENT
/begin COMPU_METHOD CU_MPL_ERROR_LOG_DETAILED[2]041 "Conversion method for mpl_error_log_detailed[2].err_log.cpu_log.dpr_low[0]" RAT_FUNC "%10.0" "(not defined)" COEFFS 0.000000 1.000000 -0.000000 0.000000 0.000000 1.000000 /end COMPU_METHOD
/* Scalar measurable for DDE 'mpl_error_log_detailed[2].err_log.cpu_log.dpr_low[10]'. */
/begin MEASUREMENT mpl_error_log_detailed[2].er032 "CPU/MPU data segment protection register, lower" ULONG CU_MPL_ERROR_LOG_DETAILED[2]035 1 100 0.0 4294967295.0 ECU_ADDRESS 0xf0240710 BYTE_ORDER MSB_LAST /end MEASUREMENT
/begin COMPU_METHOD CU_MPL_ERROR_LOG_DETAILED[2]035 "Conversion method for mpl_error_log_detailed[2].err_log.cpu_log.dpr_low[10]" RAT_FUNC "%10.0" "(not defined)" COEFFS 0.000000 1.000000 -0.000000 0.000000 0.000000 1.000000 /end COMPU_METHOD
/* Scalar measurable for DDE 'mpl_error_log_detailed[2].err_log.cpu_log.dpr_low[11]'. */
/begin MEASUREMENT mpl_error_log_detailed[2].err62 "CPU/MPU data segment protection register, lower" ULONG CU_MPL_ERROR_LOG_DETAILED[2].64 1 100 0.0 4294967295.0 ECU_ADDRESS 0xf0240714 BYTE_ORDER MSB_LAST /end MEASUREMENT
/begin COMPU_METHOD CU_MPL_ERROR_LOG_DETAILED[2].64 "Conversion method for mpl_error_log_detailed[2].err_log.cpu_log.dpr_low[11]" RAT_FUNC "%10.0" "(not defined)" COEFFS 0.000000 1.000000 -0.000000 0.000000 0.000000 1.000000 /end COMPU_METHOD
/* Scalar measurable for DDE 'mpl_error_log_detailed[2].err_log.cpu_log.dpr_low[12]'. */
/begin MEASUREMENT mpl_error_log_detailed[2].er010 "CPU/MPU data segment protection register, lower" ULONG CU_MPL_ERROR_LOG_DETAILED[2]012 1 100 0.0 4294967295.0 ECU_ADDRESS 0xf0240718 BYTE_ORDER MSB_LAST /end MEASUREMENT
/begin COMPU_METHOD CU_MPL_ERROR_LOG_DETAILED[2]012 "Conversion method for mpl_error_log_detailed[2].err_log.cpu_log.dpr_low[12]" RAT_FUNC "%10.0" "(not defined)" COEFFS 0.000000 1.000000 -0.000000 0.000000 0.000000 1.000000 /end COMPU_METHOD
/* Scalar measurable for DDE 'mpl_error_log_detailed[2].err_log.cpu_log.dpr_low[13]'. */
/begin MEASUREMENT mpl_error_log_detailed[2].err20 "CPU/MPU data segment protection register, lower" ULONG CU_MPL_ERROR_LOG_DETAILED[2].20 1 100 0.0 4294967295.0 ECU_ADDRESS 0xf024071c BYTE_ORDER MSB_LAST /end MEASUREMENT
/begin COMPU_METHOD CU_MPL_ERROR_LOG_DETAILED[2].20 "Conversion method for mpl_error_log_detailed[2].err_log.cpu_log.dpr_low[13]" RAT_FUNC "%10.0" "(not defined)" COEFFS 0.000000 1.000000 -0.000000 0.000000 0.000000 1.000000 /end COMPU_METHOD
/* Scalar measurable for DDE 'mpl_error_log_detailed[2].err_log.cpu_log.dpr_low[14]'. */
/begin MEASUREMENT mpl_error_log_detailed[2].err25 "CPU/MPU data segment protection register, lower" ULONG CU_MPL_ERROR_LOG_DETAILED[2].25 1 100 0.0 4294967295.0 ECU_ADDRESS 0xf0240720 BYTE_ORDER MSB_LAST /end MEASUREMENT
/begin COMPU_METHOD CU_MPL_ERROR_LOG_DETAILED[2].25 "Conversion method for mpl_error_log_detailed[2].err_log.cpu_log.dpr_low[14]" RAT_FUNC "%10.0" "(not defined)" COEFFS 0.000000 1.000000 -0.000000 0.000000 0.000000 1.000000 /end COMPU_METHOD
/* Scalar measurable for DDE 'mpl_error_log_detailed[2].err_log.cpu_log.dpr_low[15]'. */
/begin MEASUREMENT mpl_error_log_detailed[2].er018 "CPU/MPU data segment protection register, lower" ULONG CU_MPL_ERROR_LOG_DETAILED[2]021 1 100 0.0 4294967295.0 ECU_ADDRESS 0xf0240724 BYTE_ORDER MSB_LAST /end MEASUREMENT
/begin COMPU_METHOD CU_MPL_ERROR_LOG_DETAILED[2]021 "Conversion method for mpl_error_log_detailed[2].err_log.cpu_log.dpr_low[15]" RAT_FUNC "%10.0" "(not defined)" COEFFS 0.000000 1.000000 -0.000000 0.000000 0.000000 1.000000 /end COMPU_METHOD
/* Scalar measurable for DDE 'mpl_error_log_detailed[2].err_log.cpu_log.dpr_low[16]'. */
/begin MEASUREMENT mpl_error_log_detailed[2].er024 "CPU/MPU data segment protection register, lower" ULONG CU_MPL_ERROR_LOG_DETAILED[2]027 1 100 0.0 4294967295.0 ECU_ADDRESS 0xf0240728 BYTE_ORDER MSB_LAST /end MEASUREMENT
/begin COMPU_METHOD CU_MPL_ERROR_LOG_DETAILED[2]027 "Conversion method for mpl_error_log_detailed[2].err_log.cpu_log.dpr_low[16]" RAT_FUNC "%10.0" "(not defined)" COEFFS 0.000000 1.000000 -0.000000 0.000000 0.000000 1.000000 /end COMPU_METHOD
/* Scalar measurable for DDE 'mpl_error_log_detailed[2].err_log.cpu_log.dpr_low[17]'. */
/begin MEASUREMENT mpl_error_log_detailed[2].er034 "CPU/MPU data segment protection register, lower" ULONG CU_MPL_ERROR_LOG_DETAILED[2]037 1 100 0.0 4294967295.0 ECU_ADDRESS 0xf024072c BYTE_ORDER MSB_LAST /end MEASUREMENT
/begin COMPU_METHOD CU_MPL_ERROR_LOG_DETAILED[2]037 "Conversion method for mpl_error_log_detailed[2].err_log.cpu_log.dpr_low[17]" RAT_FUNC "%10.0" "(not defined)" COEFFS 0.000000 1.000000 -0.000000 0.000000 0.000000 1.000000 /end COMPU_METHOD
/* Scalar measurable for DDE 'mpl_error_log_detailed[2].err_log.cpu_log.dpr_low[1]'. */
/begin MEASUREMENT mpl_error_log_detailed[2].er027 "CPU/MPU data segment protection register, lower" ULONG CU_MPL_ERROR_LOG_DETAILED[2]030 1 100 0.0 4294967295.0 ECU_ADDRESS 0xf02406ec BYTE_ORDER MSB_LAST /end MEASUREMENT
/begin COMPU_METHOD CU_MPL_ERROR_LOG_DETAILED[2]030 "Conversion method for mpl_error_log_detailed[2].err_log.cpu_log.dpr_low[1]" RAT_FUNC "%10.0" "(not defined)" COEFFS 0.000000 1.000000 -0.000000 0.000000 0.000000 1.000000 /end COMPU_METHOD
/* Scalar measurable for DDE 'mpl_error_log_detailed[2].err_log.cpu_log.dpr_low[2]'. */
/begin MEASUREMENT mpl_error_log_detailed[2].err04 "CPU/MPU data segment protection register, lower" ULONG CU_MPL_ERROR_LOG_DETAILED[2].04 1 100 0.0 4294967295.0 ECU_ADDRESS 0xf02406f0 BYTE_ORDER MSB_LAST /end MEASUREMENT
/begin COMPU_METHOD CU_MPL_ERROR_LOG_DETAILED[2].04 "Conversion method for mpl_error_log_detailed[2].err_log.cpu_log.dpr_low[2]" RAT_FUNC "%10.0" "(not defined)" COEFFS 0.000000 1.000000 -0.000000 0.000000 0.000000 1.000000 /end COMPU_METHOD
/* Scalar measurable for DDE 'mpl_error_log_detailed[2].err_log.cpu_log.dpr_low[3]'. */
/begin MEASUREMENT mpl_error_log_detailed[2].err_5 "CPU/MPU data segment protection register, lower" ULONG CU_MPL_ERROR_LOG_DETAILED[2].E5 1 100 0.0 4294967295.0 ECU_ADDRESS 0xf02406f4 BYTE_ORDER MSB_LAST /end MEASUREMENT
/begin COMPU_METHOD CU_MPL_ERROR_LOG_DETAILED[2].E5 "Conversion method for mpl_error_log_detailed[2].err_log.cpu_log.dpr_low[3]" RAT_FUNC "%10.0" "(not defined)" COEFFS 0.000000 1.000000 -0.000000 0.000000 0.000000 1.000000 /end COMPU_METHOD
/* Scalar measurable for DDE 'mpl_error_log_detailed[2].err_log.cpu_log.dpr_low[4]'. */
/begin MEASUREMENT mpl_error_log_detailed[2].er000 "CPU/MPU data segment protection register, lower" ULONG CU_MPL_ERROR_LOG_DETAILED[2]002 1 100 0.0 4294967295.0 ECU_ADDRESS 0xf02406f8 BYTE_ORDER MSB_LAST /end MEASUREMENT
/begin COMPU_METHOD CU_MPL_ERROR_LOG_DETAILED[2]002 "Conversion method for mpl_error_log_detailed[2].err_log.cpu_log.dpr_low[4]" RAT_FUNC "%10.0" "(not defined)" COEFFS 0.000000 1.000000 -0.000000 0.000000 0.000000 1.000000 /end COMPU_METHOD
/* Scalar measurable for DDE 'mpl_error_log_detailed[2].err_log.cpu_log.dpr_low[5]'. */
/begin MEASUREMENT mpl_error_log_detailed[2].err83 "CPU/MPU data segment protection register, lower" ULONG CU_MPL_ERROR_LOG_DETAILED[2].85 1 100 0.0 4294967295.0 ECU_ADDRESS 0xf02406fc BYTE_ORDER MSB_LAST /end MEASUREMENT
/begin COMPU_METHOD CU_MPL_ERROR_LOG_DETAILED[2].85 "Conversion method for mpl_error_log_detailed[2].err_log.cpu_log.dpr_low[5]" RAT_FUNC "%10.0" "(not defined)" COEFFS 0.000000 1.000000 -0.000000 0.000000 0.000000 1.000000 /end COMPU_METHOD
/* Scalar measurable for DDE 'mpl_error_log_detailed[2].err_log.cpu_log.dpr_low[6]'. */
/begin MEASUREMENT mpl_error_log_detailed[2].err22 "CPU/MPU data segment protection register, lower" ULONG CU_MPL_ERROR_LOG_DETAILED[2].22 1 100 0.0 4294967295.0 ECU_ADDRESS 0xf0240700 BYTE_ORDER MSB_LAST /end MEASUREMENT
/begin COMPU_METHOD CU_MPL_ERROR_LOG_DETAILED[2].22 "Conversion method for mpl_error_log_detailed[2].err_log.cpu_log.dpr_low[6]" RAT_FUNC "%10.0" "(not defined)" COEFFS 0.000000 1.000000 -0.000000 0.000000 0.000000 1.000000 /end COMPU_METHOD
/* Scalar measurable for DDE 'mpl_error_log_detailed[2].err_log.cpu_log.dpr_low[7]'. */
/begin MEASUREMENT mpl_error_log_detailed[2].er028 "CPU/MPU data segment protection register, lower" ULONG CU_MPL_ERROR_LOG_DETAILED[2]031 1 100 0.0 4294967295.0 ECU_ADDRESS 0xf0240704 BYTE_ORDER MSB_LAST /end MEASUREMENT
/begin COMPU_METHOD CU_MPL_ERROR_LOG_DETAILED[2]031 "Conversion method for mpl_error_log_detailed[2].err_log.cpu_log.dpr_low[7]" RAT_FUNC "%10.0" "(not defined)" COEFFS 0.000000 1.000000 -0.000000 0.000000 0.000000 1.000000 /end COMPU_METHOD
/* Scalar measurable for DDE 'mpl_error_log_detailed[2].err_log.cpu_log.dpr_low[8]'. */
/begin MEASUREMENT mpl_error_log_detailed[2].err74 "CPU/MPU data segment protection register, lower" ULONG CU_MPL_ERROR_LOG_DETAILED[2].76 1 100 0.0 4294967295.0 ECU_ADDRESS 0xf0240708 BYTE_ORDER MSB_LAST /end MEASUREMENT
/begin COMPU_METHOD CU_MPL_ERROR_LOG_DETAILED[2].76 "Conversion method for mpl_error_log_detailed[2].err_log.cpu_log.dpr_low[8]" RAT_FUNC "%10.0" "(not defined)" COEFFS 0.000000 1.000000 -0.000000 0.000000 0.000000 1.000000 /end COMPU_METHOD
/* Scalar measurable for DDE 'mpl_error_log_detailed[2].err_log.cpu_log.dpr_low[9]'. */
/begin MEASUREMENT mpl_error_log_detailed[2].er020 "CPU/MPU data segment protection register, lower" ULONG CU_MPL_ERROR_LOG_DETAILED[2]023 1 100 0.0 4294967295.0 ECU_ADDRESS 0xf024070c BYTE_ORDER MSB_LAST /end MEASUREMENT
/begin COMPU_METHOD CU_MPL_ERROR_LOG_DETAILED[2]023 "Conversion method for mpl_error_log_detailed[2].err_log.cpu_log.dpr_low[9]" RAT_FUNC "%10.0" "(not defined)" COEFFS 0.000000 1.000000 -0.000000 0.000000 0.000000 1.000000 /end COMPU_METHOD
/* Scalar measurable for DDE 'mpl_error_log_detailed[2].err_log.cpu_log.dpr_upr[0]'. */
/begin MEASUREMENT mpl_error_log_detailed[2].err68 "CPU/MPU data segment protection register, upper" ULONG CU_MPL_ERROR_LOG_DETAILED[2].70 1 100 0.0 4294967295.0 ECU_ADDRESS 0xf0240730 BYTE_ORDER MSB_LAST /end MEASUREMENT
/begin COMPU_METHOD CU_MPL_ERROR_LOG_DETAILED[2].70 "Conversion method for mpl_error_log_detailed[2].err_log.cpu_log.dpr_upr[0]" RAT_FUNC "%10.0" "(not defined)" COEFFS 0.000000 1.000000 -0.000000 0.000000 0.000000 1.000000 /end COMPU_METHOD
/* Scalar measurable for DDE 'mpl_error_log_detailed[2].err_log.cpu_log.dpr_upr[10]'. */
/begin MEASUREMENT mpl_error_log_detailed[2].err00 "CPU/MPU data segment protection register, upper" ULONG CU_MPL_ERROR_LOG_DETAILED[2].00 1 100 0.0 4294967295.0 ECU_ADDRESS 0xf0240758 BYTE_ORDER MSB_LAST /end MEASUREMENT
/begin COMPU_METHOD CU_MPL_ERROR_LOG_DETAILED[2].00 "Conversion method for mpl_error_log_detailed[2].err_log.cpu_log.dpr_upr[10]" RAT_FUNC "%10.0" "(not defined)" COEFFS 0.000000 1.000000 -0.000000 0.000000 0.000000 1.000000 /end COMPU_METHOD
/* Scalar measurable for DDE 'mpl_error_log_detailed[2].err_log.cpu_log.dpr_upr[11]'. */
/begin MEASUREMENT mpl_error_log_detailed[2].er017 "CPU/MPU data segment protection register, upper" ULONG CU_MPL_ERROR_LOG_DETAILED[2]020 1 100 0.0 4294967295.0 ECU_ADDRESS 0xf024075c BYTE_ORDER MSB_LAST /end MEASUREMENT
/begin COMPU_METHOD CU_MPL_ERROR_LOG_DETAILED[2]020 "Conversion method for mpl_error_log_detailed[2].err_log.cpu_log.dpr_upr[11]" RAT_FUNC "%10.0" "(not defined)" COEFFS 0.000000 1.000000 -0.000000 0.000000 0.000000 1.000000 /end COMPU_METHOD
/* Scalar measurable for DDE 'mpl_error_log_detailed[2].err_log.cpu_log.dpr_upr[12]'. */
/begin MEASUREMENT mpl_error_log_detailed[2].er012 "CPU/MPU data segment protection register, upper" ULONG CU_MPL_ERROR_LOG_DETAILED[2]015 1 100 0.0 4294967295.0 ECU_ADDRESS 0xf0240760 BYTE_ORDER MSB_LAST /end MEASUREMENT
/begin COMPU_METHOD CU_MPL_ERROR_LOG_DETAILED[2]015 "Conversion method for mpl_error_log_detailed[2].err_log.cpu_log.dpr_upr[12]" RAT_FUNC "%10.0" "(not defined)" COEFFS 0.000000 1.000000 -0.000000 0.000000 0.000000 1.000000 /end COMPU_METHOD
/* Scalar measurable for DDE 'mpl_error_log_detailed[2].err_log.cpu_log.dpr_upr[13]'. */
/begin MEASUREMENT mpl_error_log_detailed[2].err96 "CPU/MPU data segment protection register, upper" ULONG CU_MPL_ERROR_LOG_DETAILED[2].98 1 100 0.0 4294967295.0 ECU_ADDRESS 0xf0240764 BYTE_ORDER MSB_LAST /end MEASUREMENT
/begin COMPU_METHOD CU_MPL_ERROR_LOG_DETAILED[2].98 "Conversion method for mpl_error_log_detailed[2].err_log.cpu_log.dpr_upr[13]" RAT_FUNC "%10.0" "(not defined)" COEFFS 0.000000 1.000000 -0.000000 0.000000 0.000000 1.000000 /end COMPU_METHOD
/* Scalar measurable for DDE 'mpl_error_log_detailed[2].err_log.cpu_log.dpr_upr[14]'. */
/begin MEASUREMENT mpl_error_log_detailed[2].err76 "CPU/MPU data segment protection register, upper" ULONG CU_MPL_ERROR_LOG_DETAILED[2].78 1 100 0.0 4294967295.0 ECU_ADDRESS 0xf0240768 BYTE_ORDER MSB_LAST /end MEASUREMENT
/begin COMPU_METHOD CU_MPL_ERROR_LOG_DETAILED[2].78 "Conversion method for mpl_error_log_detailed[2].err_log.cpu_log.dpr_upr[14]" RAT_FUNC "%10.0" "(not defined)" COEFFS 0.000000 1.000000 -0.000000 0.000000 0.000000 1.000000 /end COMPU_METHOD
/* Scalar measurable for DDE 'mpl_error_log_detailed[2].err_log.cpu_log.dpr_upr[15]'. */
/begin MEASUREMENT mpl_error_log_detailed[2].err_8 "CPU/MPU data segment protection register, upper" ULONG CU_MPL_ERROR_LOG_DETAILED[2].E8 1 100 0.0 4294967295.0 ECU_ADDRESS 0xf024076c BYTE_ORDER MSB_LAST /end MEASUREMENT
/begin COMPU_METHOD CU_MPL_ERROR_LOG_DETAILED[2].E8 "Conversion method for mpl_error_log_detailed[2].err_log.cpu_log.dpr_upr[15]" RAT_FUNC "%10.0" "(not defined)" COEFFS 0.000000 1.000000 -0.000000 0.000000 0.000000 1.000000 /end COMPU_METHOD
/* Scalar measurable for DDE 'mpl_error_log_detailed[2].err_log.cpu_log.dpr_upr[16]'. */
/begin MEASUREMENT mpl_error_log_detailed[2].er045 "CPU/MPU data segment protection register, upper" ULONG CU_MPL_ERROR_LOG_DETAILED[2]048 1 100 0.0 4294967295.0 ECU_ADDRESS 0xf0240770 BYTE_ORDER MSB_LAST /end MEASUREMENT
/begin COMPU_METHOD CU_MPL_ERROR_LOG_DETAILED[2]048 "Conversion method for mpl_error_log_detailed[2].err_log.cpu_log.dpr_upr[16]" RAT_FUNC "%10.0" "(not defined)" COEFFS 0.000000 1.000000 -0.000000 0.000000 0.000000 1.000000 /end COMPU_METHOD
/* Scalar measurable for DDE 'mpl_error_log_detailed[2].err_log.cpu_log.dpr_upr[17]'. */
/begin MEASUREMENT mpl_error_log_detailed[2].er035 "CPU/MPU data segment protection register, upper" ULONG CU_MPL_ERROR_LOG_DETAILED[2]038 1 100 0.0 4294967295.0 ECU_ADDRESS 0xf0240774 BYTE_ORDER MSB_LAST /end MEASUREMENT
/begin COMPU_METHOD CU_MPL_ERROR_LOG_DETAILED[2]038 "Conversion method for mpl_error_log_detailed[2].err_log.cpu_log.dpr_upr[17]" RAT_FUNC "%10.0" "(not defined)" COEFFS 0.000000 1.000000 -0.000000 0.000000 0.000000 1.000000 /end COMPU_METHOD
/* Scalar measurable for DDE 'mpl_error_log_detailed[2].err_log.cpu_log.dpr_upr[1]'. */
/begin MEASUREMENT mpl_error_log_detailed[2].err78 "CPU/MPU data segment protection register, upper" ULONG CU_MPL_ERROR_LOG_DETAILED[2].80 1 100 0.0 4294967295.0 ECU_ADDRESS 0xf0240734 BYTE_ORDER MSB_LAST /end MEASUREMENT
/begin COMPU_METHOD CU_MPL_ERROR_LOG_DETAILED[2].80 "Conversion method for mpl_error_log_detailed[2].err_log.cpu_log.dpr_upr[1]" RAT_FUNC "%10.0" "(not defined)" COEFFS 0.000000 1.000000 -0.000000 0.000000 0.000000 1.000000 /end COMPU_METHOD
/* Scalar measurable for DDE 'mpl_error_log_detailed[2].err_log.cpu_log.dpr_upr[2]'. */
/begin MEASUREMENT mpl_error_log_detailed[2].err86 "CPU/MPU data segment protection register, upper" ULONG CU_MPL_ERROR_LOG_DETAILED[2].88 1 100 0.0 4294967295.0 ECU_ADDRESS 0xf0240738 BYTE_ORDER MSB_LAST /end MEASUREMENT
/begin COMPU_METHOD CU_MPL_ERROR_LOG_DETAILED[2].88 "Conversion method for mpl_error_log_detailed[2].err_log.cpu_log.dpr_upr[2]" RAT_FUNC "%10.0" "(not defined)" COEFFS 0.000000 1.000000 -0.000000 0.000000 0.000000 1.000000 /end COMPU_METHOD
/* Scalar measurable for DDE 'mpl_error_log_detailed[2].err_log.cpu_log.dpr_upr[3]'. */
/begin MEASUREMENT mpl_error_log_detailed[2].err16 "CPU/MPU data segment protection register, upper" ULONG CU_MPL_ERROR_LOG_DETAILED[2].16 1 100 0.0 4294967295.0 ECU_ADDRESS 0xf024073c BYTE_ORDER MSB_LAST /end MEASUREMENT
/begin COMPU_METHOD CU_MPL_ERROR_LOG_DETAILED[2].16 "Conversion method for mpl_error_log_detailed[2].err_log.cpu_log.dpr_upr[3]" RAT_FUNC "%10.0" "(not defined)" COEFFS 0.000000 1.000000 -0.000000 0.000000 0.000000 1.000000 /end COMPU_METHOD
/* Scalar measurable for DDE 'mpl_error_log_detailed[2].err_log.cpu_log.dpr_upr[4]'. */
/begin MEASUREMENT mpl_error_log_detailed[2].err59 "CPU/MPU data segment protection register, upper" ULONG CU_MPL_ERROR_LOG_DETAILED[2].61 1 100 0.0 4294967295.0 ECU_ADDRESS 0xf0240740 BYTE_ORDER MSB_LAST /end MEASUREMENT
/begin COMPU_METHOD CU_MPL_ERROR_LOG_DETAILED[2].61 "Conversion method for mpl_error_log_detailed[2].err_log.cpu_log.dpr_upr[4]" RAT_FUNC "%10.0" "(not defined)" COEFFS 0.000000 1.000000 -0.000000 0.000000 0.000000 1.000000 /end COMPU_METHOD
/* Scalar measurable for DDE 'mpl_error_log_detailed[2].err_log.cpu_log.dpr_upr[5]'. */
/begin MEASUREMENT mpl_error_log_detailed[2].err81 "CPU/MPU data segment protection register, upper" ULONG CU_MPL_ERROR_LOG_DETAILED[2].83 1 100 0.0 4294967295.0 ECU_ADDRESS 0xf0240744 BYTE_ORDER MSB_LAST /end MEASUREMENT
/begin COMPU_METHOD CU_MPL_ERROR_LOG_DETAILED[2].83 "Conversion method for mpl_error_log_detailed[2].err_log.cpu_log.dpr_upr[5]" RAT_FUNC "%10.0" "(not defined)" COEFFS 0.000000 1.000000 -0.000000 0.000000 0.000000 1.000000 /end COMPU_METHOD
/* Scalar measurable for DDE 'mpl_error_log_detailed[2].err_log.cpu_log.dpr_upr[6]'. */
/begin MEASUREMENT mpl_error_log_detailed[2].er033 "CPU/MPU data segment protection register, upper" ULONG CU_MPL_ERROR_LOG_DETAILED[2]036 1 100 0.0 4294967295.0 ECU_ADDRESS 0xf0240748 BYTE_ORDER MSB_LAST /end MEASUREMENT
/begin COMPU_METHOD CU_MPL_ERROR_LOG_DETAILED[2]036 "Conversion method for mpl_error_log_detailed[2].err_log.cpu_log.dpr_upr[6]" RAT_FUNC "%10.0" "(not defined)" COEFFS 0.000000 1.000000 -0.000000 0.000000 0.000000 1.000000 /end COMPU_METHOD
/* Scalar measurable for DDE 'mpl_error_log_detailed[2].err_log.cpu_log.dpr_upr[7]'. */
/begin MEASUREMENT mpl_error_log_detailed[2].er039 "CPU/MPU data segment protection register, upper" ULONG CU_MPL_ERROR_LOG_DETAILED[2]042 1 100 0.0 4294967295.0 ECU_ADDRESS 0xf024074c BYTE_ORDER MSB_LAST /end MEASUREMENT
/begin COMPU_METHOD CU_MPL_ERROR_LOG_DETAILED[2]042 "Conversion method for mpl_error_log_detailed[2].err_log.cpu_log.dpr_upr[7]" RAT_FUNC "%10.0" "(not defined)" COEFFS 0.000000 1.000000 -0.000000 0.000000 0.000000 1.000000 /end COMPU_METHOD
/* Scalar measurable for DDE 'mpl_error_log_detailed[2].err_log.cpu_log.dpr_upr[8]'. */
/begin MEASUREMENT mpl_error_log_detailed[2].err40 "CPU/MPU data segment protection register, upper" ULONG CU_MPL_ERROR_LOG_DETAILED[2].41 1 100 0.0 4294967295.0 ECU_ADDRESS 0xf0240750 BYTE_ORDER MSB_LAST /end MEASUREMENT
/begin COMPU_METHOD CU_MPL_ERROR_LOG_DETAILED[2].41 "Conversion method for mpl_error_log_detailed[2].err_log.cpu_log.dpr_upr[8]" RAT_FUNC "%10.0" "(not defined)" COEFFS 0.000000 1.000000 -0.000000 0.000000 0.000000 1.000000 /end COMPU_METHOD
/* Scalar measurable for DDE 'mpl_error_log_detailed[2].err_log.cpu_log.dpr_upr[9]'. */
/begin MEASUREMENT mpl_error_log_detailed[2].er013 "CPU/MPU data segment protection register, upper" ULONG CU_MPL_ERROR_LOG_DETAILED[2]016 1 100 0.0 4294967295.0 ECU_ADDRESS 0xf0240754 BYTE_ORDER MSB_LAST /end MEASUREMENT
/begin COMPU_METHOD CU_MPL_ERROR_LOG_DETAILED[2]016 "Conversion method for mpl_error_log_detailed[2].err_log.cpu_log.dpr_upr[9]" RAT_FUNC "%10.0" "(not defined)" COEFFS 0.000000 1.000000 -0.000000 0.000000 0.000000 1.000000 /end COMPU_METHOD
/* Scalar measurable for DDE 'mpl_error_log_detailed[2].err_log.cpu_log.dpre[0]'. */
/begin MEASUREMENT mpl_error_log_detailed[2].err13 "CPU/MPU data protection read enable configuration register" ULONG CU_MPL_ERROR_LOG_DETAILED[2].13 1 100 0.0 4294967295.0 ECU_ADDRESS 0xf02407e0 BYTE_ORDER MSB_LAST /end MEASUREMENT
/begin COMPU_METHOD CU_MPL_ERROR_LOG_DETAILED[2].13 "Conversion method for mpl_error_log_detailed[2].err_log.cpu_log.dpre[0]" RAT_FUNC "%10.0" "(not defined)" COEFFS 0.000000 1.000000 -0.000000 0.000000 0.000000 1.000000 /end COMPU_METHOD
/* Scalar measurable for DDE 'mpl_error_log_detailed[2].err_log.cpu_log.dpre[1]'. */
/begin MEASUREMENT mpl_error_log_detailed[2].err05 "CPU/MPU data protection read enable configuration register" ULONG CU_MPL_ERROR_LOG_DETAILED[2].05 1 100 0.0 4294967295.0 ECU_ADDRESS 0xf02407e4 BYTE_ORDER MSB_LAST /end MEASUREMENT
/begin COMPU_METHOD CU_MPL_ERROR_LOG_DETAILED[2].05 "Conversion method for mpl_error_log_detailed[2].err_log.cpu_log.dpre[1]" RAT_FUNC "%10.0" "(not defined)" COEFFS 0.000000 1.000000 -0.000000 0.000000 0.000000 1.000000 /end COMPU_METHOD
/* Scalar measurable for DDE 'mpl_error_log_detailed[2].err_log.cpu_log.dpre[2]'. */
/begin MEASUREMENT mpl_error_log_detailed[2].err37 "CPU/MPU data protection read enable configuration register" ULONG CU_MPL_ERROR_LOG_DETAILED[2].38 1 100 0.0 4294967295.0 ECU_ADDRESS 0xf02407e8 BYTE_ORDER MSB_LAST /end MEASUREMENT
/begin COMPU_METHOD CU_MPL_ERROR_LOG_DETAILED[2].38 "Conversion method for mpl_error_log_detailed[2].err_log.cpu_log.dpre[2]" RAT_FUNC "%10.0" "(not defined)" COEFFS 0.000000 1.000000 -0.000000 0.000000 0.000000 1.000000 /end COMPU_METHOD
/* Scalar measurable for DDE 'mpl_error_log_detailed[2].err_log.cpu_log.dpre[3]'. */
/begin MEASUREMENT mpl_error_log_detailed[2].err71 "CPU/MPU data protection read enable configuration register" ULONG CU_MPL_ERROR_LOG_DETAILED[2].73 1 100 0.0 4294967295.0 ECU_ADDRESS 0xf02407ec BYTE_ORDER MSB_LAST /end MEASUREMENT
/begin COMPU_METHOD CU_MPL_ERROR_LOG_DETAILED[2].73 "Conversion method for mpl_error_log_detailed[2].err_log.cpu_log.dpre[3]" RAT_FUNC "%10.0" "(not defined)" COEFFS 0.000000 1.000000 -0.000000 0.000000 0.000000 1.000000 /end COMPU_METHOD
/* Scalar measurable for DDE 'mpl_error_log_detailed[2].err_log.cpu_log.dpre[4]'. */
/begin MEASUREMENT mpl_error_log_detailed[2].err64 "CPU/MPU data protection read enable configuration register" ULONG CU_MPL_ERROR_LOG_DETAILED[2].66 1 100 0.0 4294967295.0 ECU_ADDRESS 0xf02407f0 BYTE_ORDER MSB_LAST /end MEASUREMENT
/begin COMPU_METHOD CU_MPL_ERROR_LOG_DETAILED[2].66 "Conversion method for mpl_error_log_detailed[2].err_log.cpu_log.dpre[4]" RAT_FUNC "%10.0" "(not defined)" COEFFS 0.000000 1.000000 -0.000000 0.000000 0.000000 1.000000 /end COMPU_METHOD
/* Scalar measurable for DDE 'mpl_error_log_detailed[2].err_log.cpu_log.dpre[5]'. */
/begin MEASUREMENT mpl_error_log_detailed[2].err56 "CPU/MPU data protection read enable configuration register" ULONG CU_MPL_ERROR_LOG_DETAILED[2].57 1 100 0.0 4294967295.0 ECU_ADDRESS 0xf02407f4 BYTE_ORDER MSB_LAST /end MEASUREMENT
/begin COMPU_METHOD CU_MPL_ERROR_LOG_DETAILED[2].57 "Conversion method for mpl_error_log_detailed[2].err_log.cpu_log.dpre[5]" RAT_FUNC "%10.0" "(not defined)" COEFFS 0.000000 1.000000 -0.000000 0.000000 0.000000 1.000000 /end COMPU_METHOD
/* Scalar measurable for DDE 'mpl_error_log_detailed[2].err_log.cpu_log.dpwe[0]'. */
/begin MEASUREMENT mpl_error_log_detailed[2].err82 "CPU/MPU data protection write enable configuration register" ULONG CU_MPL_ERROR_LOG_DETAILED[2].84 1 100 0.0 4294967295.0 ECU_ADDRESS 0xf02407f8 BYTE_ORDER MSB_LAST /end MEASUREMENT
/begin COMPU_METHOD CU_MPL_ERROR_LOG_DETAILED[2].84 "Conversion method for mpl_error_log_detailed[2].err_log.cpu_log.dpwe[0]" RAT_FUNC "%10.0" "(not defined)" COEFFS 0.000000 1.000000 -0.000000 0.000000 0.000000 1.000000 /end COMPU_METHOD
/* Scalar measurable for DDE 'mpl_error_log_detailed[2].err_log.cpu_log.dpwe[1]'. */
/begin MEASUREMENT mpl_error_log_detailed[2].err97 "CPU/MPU data protection write enable configuration register" ULONG CU_MPL_ERROR_LOG_DETAILED[2].99 1 100 0.0 4294967295.0 ECU_ADDRESS 0xf02407fc BYTE_ORDER MSB_LAST /end MEASUREMENT
/begin COMPU_METHOD CU_MPL_ERROR_LOG_DETAILED[2].99 "Conversion method for mpl_error_log_detailed[2].err_log.cpu_log.dpwe[1]" RAT_FUNC "%10.0" "(not defined)" COEFFS 0.000000 1.000000 -0.000000 0.000000 0.000000 1.000000 /end COMPU_METHOD
/* Scalar measurable for DDE 'mpl_error_log_detailed[2].err_log.cpu_log.dpwe[2]'. */
/begin MEASUREMENT mpl_error_log_detailed[2].err11 "CPU/MPU data protection write enable configuration register" ULONG CU_MPL_ERROR_LOG_DETAILED[2].11 1 100 0.0 4294967295.0 ECU_ADDRESS 0xf0240800 BYTE_ORDER MSB_LAST /end MEASUREMENT
/begin COMPU_METHOD CU_MPL_ERROR_LOG_DETAILED[2].11 "Conversion method for mpl_error_log_detailed[2].err_log.cpu_log.dpwe[2]" RAT_FUNC "%10.0" "(not defined)" COEFFS 0.000000 1.000000 -0.000000 0.000000 0.000000 1.000000 /end COMPU_METHOD
/* Scalar measurable for DDE 'mpl_error_log_detailed[2].err_log.cpu_log.dpwe[3]'. */
/begin MEASUREMENT mpl_error_log_detailed[2].err06 "CPU/MPU data protection write enable configuration register" ULONG CU_MPL_ERROR_LOG_DETAILED[2].06 1 100 0.0 4294967295.0 ECU_ADDRESS 0xf0240804 BYTE_ORDER MSB_LAST /end MEASUREMENT
/begin COMPU_METHOD CU_MPL_ERROR_LOG_DETAILED[2].06 "Conversion method for mpl_error_log_detailed[2].err_log.cpu_log.dpwe[3]" RAT_FUNC "%10.0" "(not defined)" COEFFS 0.000000 1.000000 -0.000000 0.000000 0.000000 1.000000 /end COMPU_METHOD
/* Scalar measurable for DDE 'mpl_error_log_detailed[2].err_log.cpu_log.dpwe[4]'. */
/begin MEASUREMENT mpl_error_log_detailed[2].er016 "CPU/MPU data protection write enable configuration register" ULONG CU_MPL_ERROR_LOG_DETAILED[2]019 1 100 0.0 4294967295.0 ECU_ADDRESS 0xf0240808 BYTE_ORDER MSB_LAST /end MEASUREMENT
/begin COMPU_METHOD CU_MPL_ERROR_LOG_DETAILED[2]019 "Conversion method for mpl_error_log_detailed[2].err_log.cpu_log.dpwe[4]" RAT_FUNC "%10.0" "(not defined)" COEFFS 0.000000 1.000000 -0.000000 0.000000 0.000000 1.000000 /end COMPU_METHOD
/* Scalar measurable for DDE 'mpl_error_log_detailed[2].err_log.cpu_log.dpwe[5]'. */
/begin MEASUREMENT mpl_error_log_detailed[2].err46 "CPU/MPU data protection write enable configuration register" ULONG CU_MPL_ERROR_LOG_DETAILED[2].47 1 100 0.0 4294967295.0 ECU_ADDRESS 0xf024080c BYTE_ORDER MSB_LAST /end MEASUREMENT
/begin COMPU_METHOD CU_MPL_ERROR_LOG_DETAILED[2].47 "Conversion method for mpl_error_log_detailed[2].err_log.cpu_log.dpwe[5]" RAT_FUNC "%10.0" "(not defined)" COEFFS 0.000000 1.000000 -0.000000 0.000000 0.000000 1.000000 /end COMPU_METHOD
/* Scalar measurable for DDE 'mpl_error_log_detailed[2].err_log.cpu_log.dstr'. */
/begin MEASUREMENT mpl_error_log_detailed[2].err69 "CPU data synchronous error trap register" ULONG CU_MPL_ERROR_LOG_DETAILED[2].71 1 100 0.0 4294967295.0 ECU_ADDRESS 0xf02406a8 BYTE_ORDER MSB_LAST /end MEASUREMENT
/begin COMPU_METHOD CU_MPL_ERROR_LOG_DETAILED[2].71 "Conversion method for mpl_error_log_detailed[2].err_log.cpu_log.dstr" RAT_FUNC "%10.0" "(not defined)" COEFFS 0.000000 1.000000 -0.000000 0.000000 0.000000 1.000000 /end COMPU_METHOD
/* Scalar measurable for DDE 'mpl_error_log_detailed[2].err_log.cpu_log.fcx'. */
/begin MEASUREMENT mpl_error_log_detailed[2].err03 "CPU free context list head pointer register" ULONG CU_MPL_ERROR_LOG_DETAILED[2].03 1 100 0.0 4294967295.0 ECU_ADDRESS 0xf024081c BYTE_ORDER MSB_LAST /end MEASUREMENT
/begin COMPU_METHOD CU_MPL_ERROR_LOG_DETAILED[2].03 "Conversion method for mpl_error_log_detailed[2].err_log.cpu_log.fcx" RAT_FUNC "%10.0" "(not defined)" COEFFS 0.000000 1.000000 -0.000000 0.000000 0.000000 1.000000 /end COMPU_METHOD
/* Scalar measurable for DDE 'mpl_error_log_detailed[2].err_log.cpu_log.flashcon0'. */
/begin MEASUREMENT mpl_error_log_detailed[2].err53 "CPU flash configuration register" ULONG CU_MPL_ERROR_LOG_DETAILED[2].54 1 100 0.0 4294967295.0 ECU_ADDRESS 0xf0240830 BYTE_ORDER MSB_LAST /end MEASUREMENT
/begin COMPU_METHOD CU_MPL_ERROR_LOG_DETAILED[2].54 "Conversion method for mpl_error_log_detailed[2].err_log.cpu_log.flashcon0" RAT_FUNC "%10.0" "(not defined)" COEFFS 0.000000 1.000000 -0.000000 0.000000 0.000000 1.000000 /end COMPU_METHOD
/* Scalar measurable for DDE 'mpl_error_log_detailed[2].err_log.cpu_log.flashcon1'. */
/begin MEASUREMENT mpl_error_log_detailed[2].err54 "CPU flash configuration register" ULONG CU_MPL_ERROR_LOG_DETAILED[2].55 1 100 0.0 4294967295.0 ECU_ADDRESS 0xf0240834 BYTE_ORDER MSB_LAST /end MEASUREMENT
/begin COMPU_METHOD CU_MPL_ERROR_LOG_DETAILED[2].55 "Conversion method for mpl_error_log_detailed[2].err_log.cpu_log.flashcon1" RAT_FUNC "%10.0" "(not defined)" COEFFS 0.000000 1.000000 -0.000000 0.000000 0.000000 1.000000 /end COMPU_METHOD
/* Scalar measurable for DDE 'mpl_error_log_detailed[2].err_log.cpu_log.flashcon2'. */
/begin MEASUREMENT mpl_error_log_detailed[2].err55 "CPU flash configuration register" ULONG CU_MPL_ERROR_LOG_DETAILED[2].56 1 100 0.0 4294967295.0 ECU_ADDRESS 0xf0240838 BYTE_ORDER MSB_LAST /end MEASUREMENT
/begin COMPU_METHOD CU_MPL_ERROR_LOG_DETAILED[2].56 "Conversion method for mpl_error_log_detailed[2].err_log.cpu_log.flashcon2" RAT_FUNC "%10.0" "(not defined)" COEFFS 0.000000 1.000000 -0.000000 0.000000 0.000000 1.000000 /end COMPU_METHOD
/* Scalar measurable for DDE 'mpl_error_log_detailed[2].err_log.cpu_log.flashcon3'. */
/begin MEASUREMENT mpl_error_log_detailed[2].err93 "CPU flash configuration register" ULONG CU_MPL_ERROR_LOG_DETAILED[2].95 1 100 0.0 4294967295.0 ECU_ADDRESS 0xf024083c BYTE_ORDER MSB_LAST /end MEASUREMENT
/begin COMPU_METHOD CU_MPL_ERROR_LOG_DETAILED[2].95 "Conversion method for mpl_error_log_detailed[2].err_log.cpu_log.flashcon3" RAT_FUNC "%10.0" "(not defined)" COEFFS 0.000000 1.000000 -0.000000 0.000000 0.000000 1.000000 /end COMPU_METHOD
/* Scalar measurable for DDE 'mpl_error_log_detailed[2].err_log.cpu_log.fpu_trap_con'. */
/begin MEASUREMENT mpl_error_log_detailed[2].er001 "CPU/FPU trap control register" ULONG CU_MPL_ERROR_LOG_DETAILED[2]003 1 100 0.0 4294967295.0 ECU_ADDRESS 0xf02406d0 BYTE_ORDER MSB_LAST /end MEASUREMENT
/begin COMPU_METHOD CU_MPL_ERROR_LOG_DETAILED[2]003 "Conversion method for mpl_error_log_detailed[2].err_log.cpu_log.fpu_trap_con" RAT_FUNC "%10.0" "(not defined)" COEFFS 0.000000 1.000000 -0.000000 0.000000 0.000000 1.000000 /end COMPU_METHOD
/* Scalar measurable for DDE 'mpl_error_log_detailed[2].err_log.cpu_log.fpu_trap_opc'. */
/begin MEASUREMENT mpl_error_log_detailed[2].err09 "CPU/FPU trap instruction opcode register" ULONG CU_MPL_ERROR_LOG_DETAILED[2].09 1 100 0.0 4294967295.0 ECU_ADDRESS 0xf02406d8 BYTE_ORDER MSB_LAST /end MEASUREMENT
/begin COMPU_METHOD CU_MPL_ERROR_LOG_DETAILED[2].09 "Conversion method for mpl_error_log_detailed[2].err_log.cpu_log.fpu_trap_opc" RAT_FUNC "%10.0" "(not defined)" COEFFS 0.000000 1.000000 -0.000000 0.000000 0.000000 1.000000 /end COMPU_METHOD
/* Scalar measurable for DDE 'mpl_error_log_detailed[2].err_log.cpu_log.fpu_trap_pc'. */
/begin MEASUREMENT mpl_error_log_detailed[2].err17 "CPU/FPU trap instruction program control register" ULONG CU_MPL_ERROR_LOG_DETAILED[2].17 1 100 0.0 4294967295.0 ECU_ADDRESS 0xf02406d4 BYTE_ORDER MSB_LAST /end MEASUREMENT
/begin COMPU_METHOD CU_MPL_ERROR_LOG_DETAILED[2].17 "Conversion method for mpl_error_log_detailed[2].err_log.cpu_log.fpu_trap_pc" RAT_FUNC "%10.0" "(not defined)" COEFFS 0.000000 1.000000 -0.000000 0.000000 0.000000 1.000000 /end COMPU_METHOD
/* Scalar measurable for DDE 'mpl_error_log_detailed[2].err_log.cpu_log.fpu_trap_src1'. */
/begin MEASUREMENT mpl_error_log_detailed[2].err_0 "CPU/FPU trap instruction operand register" ULONG CU_MPL_ERROR_LOG_DETAILED[2].E0 1 100 0.0 4294967295.0 ECU_ADDRESS 0xf02406dc BYTE_ORDER MSB_LAST /end MEASUREMENT
/begin COMPU_METHOD CU_MPL_ERROR_LOG_DETAILED[2].E0 "Conversion method for mpl_error_log_detailed[2].err_log.cpu_log.fpu_trap_src1" RAT_FUNC "%10.0" "(not defined)" COEFFS 0.000000 1.000000 -0.000000 0.000000 0.000000 1.000000 /end COMPU_METHOD
/* Scalar measurable for DDE 'mpl_error_log_detailed[2].err_log.cpu_log.fpu_trap_src2'. */
/begin MEASUREMENT mpl_error_log_detailed[2].er019 "CPU/FPU trap instruction operand register" ULONG CU_MPL_ERROR_LOG_DETAILED[2]022 1 100 0.0 4294967295.0 ECU_ADDRESS 0xf02406e0 BYTE_ORDER MSB_LAST /end MEASUREMENT
/begin COMPU_METHOD CU_MPL_ERROR_LOG_DETAILED[2]022 "Conversion method for mpl_error_log_detailed[2].err_log.cpu_log.fpu_trap_src2" RAT_FUNC "%10.0" "(not defined)" COEFFS 0.000000 1.000000 -0.000000 0.000000 0.000000 1.000000 /end COMPU_METHOD
/* Scalar measurable for DDE 'mpl_error_log_detailed[2].err_log.cpu_log.fpu_trap_src3'. */
/begin MEASUREMENT mpl_error_log_detailed[2].er014 "CPU/FPU trap instruction operand register" ULONG CU_MPL_ERROR_LOG_DETAILED[2]017 1 100 0.0 4294967295.0 ECU_ADDRESS 0xf02406e4 BYTE_ORDER MSB_LAST /end MEASUREMENT
/begin COMPU_METHOD CU_MPL_ERROR_LOG_DETAILED[2]017 "Conversion method for mpl_error_log_detailed[2].err_log.cpu_log.fpu_trap_src3" RAT_FUNC "%10.0" "(not defined)" COEFFS 0.000000 1.000000 -0.000000 0.000000 0.000000 1.000000 /end COMPU_METHOD
/* Scalar measurable for DDE 'mpl_error_log_detailed[2].err_log.cpu_log.icr'. */
/begin MEASUREMENT mpl_error_log_detailed[2].err14 "CPU interrupt control register" ULONG CU_MPL_ERROR_LOG_DETAILED[2].14 1 100 0.0 4294967295.0 ECU_ADDRESS 0xf0240814 BYTE_ORDER MSB_LAST /end MEASUREMENT
/begin COMPU_METHOD CU_MPL_ERROR_LOG_DETAILED[2].14 "Conversion method for mpl_error_log_detailed[2].err_log.cpu_log.icr" RAT_FUNC "%10.0" "(not defined)" COEFFS 0.000000 1.000000 -0.000000 0.000000 0.000000 1.000000 /end COMPU_METHOD
/* Scalar measurable for DDE 'mpl_error_log_detailed[2].err_log.cpu_log.isp'. */
/begin MEASUREMENT mpl_error_log_detailed[2].err27 "CPU interrupt stack pointer register" ULONG CU_MPL_ERROR_LOG_DETAILED[2].27 1 100 0.0 4294967295.0 ECU_ADDRESS 0xf0240818 BYTE_ORDER MSB_LAST /end MEASUREMENT
/begin COMPU_METHOD CU_MPL_ERROR_LOG_DETAILED[2].27 "Conversion method for mpl_error_log_detailed[2].err_log.cpu_log.isp" RAT_FUNC "%10.0" "(not defined)" COEFFS 0.000000 1.000000 -0.000000 0.000000 0.000000 1.000000 /end COMPU_METHOD
/* Scalar measurable for DDE 'mpl_error_log_detailed[2].err_log.cpu_log.lcx'. */
/begin MEASUREMENT mpl_error_log_detailed[2].err02 "CPU free context list limit pointer register" ULONG CU_MPL_ERROR_LOG_DETAILED[2].02 1 100 0.0 4294967295.0 ECU_ADDRESS 0xf0240820 BYTE_ORDER MSB_LAST /end MEASUREMENT
/begin COMPU_METHOD CU_MPL_ERROR_LOG_DETAILED[2].02 "Conversion method for mpl_error_log_detailed[2].err_log.cpu_log.lcx" RAT_FUNC "%10.0" "(not defined)" COEFFS 0.000000 1.000000 -0.000000 0.000000 0.000000 1.000000 /end COMPU_METHOD
/* Scalar measurable for DDE 'mpl_error_log_detailed[2].err_log.cpu_log.pcon0'. */
/begin MEASUREMENT mpl_error_log_detailed[2].err10 "CPU program memory configuration register" ULONG CU_MPL_ERROR_LOG_DETAILED[2].10 1 100 0.0 4294967295.0 ECU_ADDRESS 0xf02406bc BYTE_ORDER MSB_LAST /end MEASUREMENT
/begin COMPU_METHOD CU_MPL_ERROR_LOG_DETAILED[2].10 "Conversion method for mpl_error_log_detailed[2].err_log.cpu_log.pcon0" RAT_FUNC "%10.0" "(not defined)" COEFFS 0.000000 1.000000 -0.000000 0.000000 0.000000 1.000000 /end COMPU_METHOD
/* Scalar measurable for DDE 'mpl_error_log_detailed[2].err_log.cpu_log.pcon1'. */
/begin MEASUREMENT mpl_error_log_detailed[2].er009 "CPU program memory configuration register" ULONG CU_MPL_ERROR_LOG_DETAILED[2]011 1 100 0.0 4294967295.0 ECU_ADDRESS 0xf02406c0 BYTE_ORDER MSB_LAST /end MEASUREMENT
/begin COMPU_METHOD CU_MPL_ERROR_LOG_DETAILED[2]011 "Conversion method for mpl_error_log_detailed[2].err_log.cpu_log.pcon1" RAT_FUNC "%10.0" "(not defined)" COEFFS 0.000000 1.000000 -0.000000 0.000000 0.000000 1.000000 /end COMPU_METHOD
/* Scalar measurable for DDE 'mpl_error_log_detailed[2].err_log.cpu_log.pcon2'. */
/begin MEASUREMENT mpl_error_log_detailed[2].er008 "CPU program memory configuration register" ULONG CU_MPL_ERROR_LOG_DETAILED[2]010 1 100 0.0 4294967295.0 ECU_ADDRESS 0xf02406c4 BYTE_ORDER MSB_LAST /end MEASUREMENT
/begin COMPU_METHOD CU_MPL_ERROR_LOG_DETAILED[2]010 "Conversion method for mpl_error_log_detailed[2].err_log.cpu_log.pcon2" RAT_FUNC "%10.0" "(not defined)" COEFFS 0.000000 1.000000 -0.000000 0.000000 0.000000 1.000000 /end COMPU_METHOD
/* Scalar measurable for DDE 'mpl_error_log_detailed[2].err_log.cpu_log.piear'. */
/begin MEASUREMENT mpl_error_log_detailed[2].err26 "CPU program integrity error address register" ULONG CU_MPL_ERROR_LOG_DETAILED[2].26 1 100 0.0 4294967295.0 ECU_ADDRESS 0xf02406c8 BYTE_ORDER MSB_LAST /end MEASUREMENT
/begin COMPU_METHOD CU_MPL_ERROR_LOG_DETAILED[2].26 "Conversion method for mpl_error_log_detailed[2].err_log.cpu_log.piear" RAT_FUNC "%10.0" "(not defined)" COEFFS 0.000000 1.000000 -0.000000 0.000000 0.000000 1.000000 /end COMPU_METHOD
/* Scalar measurable for DDE 'mpl_error_log_detailed[2].err_log.cpu_log.pietr'. */
/begin MEASUREMENT mpl_error_log_detailed[2].err_2 "CPU program integrity error trap register" ULONG CU_MPL_ERROR_LOG_DETAILED[2].E2 1 100 0.0 4294967295.0 ECU_ADDRESS 0xf02406cc BYTE_ORDER MSB_LAST /end MEASUREMENT
/begin COMPU_METHOD CU_MPL_ERROR_LOG_DETAILED[2].E2 "Conversion method for mpl_error_log_detailed[2].err_log.cpu_log.pietr" RAT_FUNC "%10.0" "(not defined)" COEFFS 0.000000 1.000000 -0.000000 0.000000 0.000000 1.000000 /end COMPU_METHOD
/* Scalar measurable for DDE 'mpl_error_log_detailed[2].err_log.cpu_log.syscon'. */
/begin MEASUREMENT mpl_error_log_detailed[2].er025 "CPU system configuration register" ULONG CU_MPL_ERROR_LOG_DETAILED[2]028 1 100 0.0 4294967295.0 ECU_ADDRESS 0xf024082c BYTE_ORDER MSB_LAST /end MEASUREMENT
/begin COMPU_METHOD CU_MPL_ERROR_LOG_DETAILED[2]028 "Conversion method for mpl_error_log_detailed[2].err_log.cpu_log.syscon" RAT_FUNC "%10.0" "(not defined)" COEFFS 0.000000 1.000000 -0.000000 0.000000 0.000000 1.000000 /end COMPU_METHOD
/* Scalar measurable for DDE 'mpl_error_log_detailed[2].err_log.cpu_log.tps_con'. */
/begin MEASUREMENT mpl_error_log_detailed[2].err95 "CPU temporal protection system control register" ULONG CU_MPL_ERROR_LOG_DETAILED[2].97 1 100 0.0 4294967295.0 ECU_ADDRESS 0xf0240810 BYTE_ORDER MSB_LAST /end MEASUREMENT
/begin COMPU_METHOD CU_MPL_ERROR_LOG_DETAILED[2].97 "Conversion method for mpl_error_log_detailed[2].err_log.cpu_log.tps_con" RAT_FUNC "%10.0" "(not defined)" COEFFS 0.000000 1.000000 -0.000000 0.000000 0.000000 1.000000 /end COMPU_METHOD
/* Scalar measurable for DDE 'mpl_error_log_detailed[2].err_log.csa.lower.A2'. */
/begin MEASUREMENT mpl_error_log_detailed[2].er041 "CPU address register" ULONG CU_MPL_ERROR_LOG_DETAILED[2]044 1 100 0.0 4294967295.0 ECU_ADDRESS 0xf0240670 BYTE_ORDER MSB_LAST /end MEASUREMENT
/begin COMPU_METHOD CU_MPL_ERROR_LOG_DETAILED[2]044 "Conversion method for mpl_error_log_detailed[2].err_log.csa.lower.A2" RAT_FUNC "%10.0" "(not defined)" COEFFS 0.000000 1.000000 -0.000000 0.000000 0.000000 1.000000 /end COMPU_METHOD
/* Scalar measurable for DDE 'mpl_error_log_detailed[2].err_log.csa.lower.A3'. */
/begin MEASUREMENT mpl_error_log_detailed[2].er040 "CPU address register" ULONG CU_MPL_ERROR_LOG_DETAILED[2]043 1 100 0.0 4294967295.0 ECU_ADDRESS 0xf0240674 BYTE_ORDER MSB_LAST /end MEASUREMENT
/begin COMPU_METHOD CU_MPL_ERROR_LOG_DETAILED[2]043 "Conversion method for mpl_error_log_detailed[2].err_log.csa.lower.A3" RAT_FUNC "%10.0" "(not defined)" COEFFS 0.000000 1.000000 -0.000000 0.000000 0.000000 1.000000 /end COMPU_METHOD
/* Scalar measurable for DDE 'mpl_error_log_detailed[2].err_log.csa.lower.A4'. */
/begin MEASUREMENT mpl_error_log_detailed[2].er044 "CPU address register" ULONG CU_MPL_ERROR_LOG_DETAILED[2]047 1 100 0.0 4294967295.0 ECU_ADDRESS 0xf0240688 BYTE_ORDER MSB_LAST /end MEASUREMENT
/begin COMPU_METHOD CU_MPL_ERROR_LOG_DETAILED[2]047 "Conversion method for mpl_error_log_detailed[2].err_log.csa.lower.A4" RAT_FUNC "%10.0" "(not defined)" COEFFS 0.000000 1.000000 -0.000000 0.000000 0.000000 1.000000 /end COMPU_METHOD
/* Scalar measurable for DDE 'mpl_error_log_detailed[2].err_log.csa.lower.A5'. */
/begin MEASUREMENT mpl_error_log_detailed[2].er023 "CPU address register" ULONG CU_MPL_ERROR_LOG_DETAILED[2]026 1 100 0.0 4294967295.0 ECU_ADDRESS 0xf024068c BYTE_ORDER MSB_LAST /end MEASUREMENT
/begin COMPU_METHOD CU_MPL_ERROR_LOG_DETAILED[2]026 "Conversion method for mpl_error_log_detailed[2].err_log.csa.lower.A5" RAT_FUNC "%10.0" "(not defined)" COEFFS 0.000000 1.000000 -0.000000 0.000000 0.000000 1.000000 /end COMPU_METHOD
/* Scalar measurable for DDE 'mpl_error_log_detailed[2].err_log.csa.lower.A6'. */
/begin MEASUREMENT mpl_error_log_detailed[2].er043 "CPU address register" ULONG CU_MPL_ERROR_LOG_DETAILED[2]046 1 100 0.0 4294967295.0 ECU_ADDRESS 0xf0240690 BYTE_ORDER MSB_LAST /end MEASUREMENT
/begin COMPU_METHOD CU_MPL_ERROR_LOG_DETAILED[2]046 "Conversion method for mpl_error_log_detailed[2].err_log.csa.lower.A6" RAT_FUNC "%10.0" "(not defined)" COEFFS 0.000000 1.000000 -0.000000 0.000000 0.000000 1.000000 /end COMPU_METHOD
/* Scalar measurable for DDE 'mpl_error_log_detailed[2].err_log.csa.lower.A7'. */
/begin MEASUREMENT mpl_error_log_detailed[2].er042 "CPU address register" ULONG CU_MPL_ERROR_LOG_DETAILED[2]045 1 100 0.0 4294967295.0 ECU_ADDRESS 0xf0240694 BYTE_ORDER MSB_LAST /end MEASUREMENT
/begin COMPU_METHOD CU_MPL_ERROR_LOG_DETAILED[2]045 "Conversion method for mpl_error_log_detailed[2].err_log.csa.lower.A7" RAT_FUNC "%10.0" "(not defined)" COEFFS 0.000000 1.000000 -0.000000 0.000000 0.000000 1.000000 /end COMPU_METHOD
/* Scalar measurable for DDE 'mpl_error_log_detailed[2].err_log.csa.lower.D0'. */
/begin MEASUREMENT mpl_error_log_detailed[2].er011 "CPU data register" ULONG CU_MPL_ERROR_LOG_DETAILED[2]013 1 100 0.0 4294967295.0 ECU_ADDRESS 0xf0240678 BYTE_ORDER MSB_LAST /end MEASUREMENT
/begin COMPU_METHOD CU_MPL_ERROR_LOG_DETAILED[2]013 "Conversion method for mpl_error_log_detailed[2].err_log.csa.lower.D0" RAT_FUNC "%10.0" "(not defined)" COEFFS 0.000000 1.000000 -0.000000 0.000000 0.000000 1.000000 /end COMPU_METHOD
/* Scalar measurable for DDE 'mpl_error_log_detailed[2].err_log.csa.lower.D1'. */
/begin MEASUREMENT mpl_error_log_detailed[2].err88 "CPU data register" ULONG CU_MPL_ERROR_LOG_DETAILED[2].90 1 100 0.0 4294967295.0 ECU_ADDRESS 0xf024067c BYTE_ORDER MSB_LAST /end MEASUREMENT
/begin COMPU_METHOD CU_MPL_ERROR_LOG_DETAILED[2].90 "Conversion method for mpl_error_log_detailed[2].err_log.csa.lower.D1" RAT_FUNC "%10.0" "(not defined)" COEFFS 0.000000 1.000000 -0.000000 0.000000 0.000000 1.000000 /end COMPU_METHOD
/* Scalar measurable for DDE 'mpl_error_log_detailed[2].err_log.csa.lower.D2'. */
/begin MEASUREMENT mpl_error_log_detailed[2].err29 "CPU data register" ULONG CU_MPL_ERROR_LOG_DETAILED[2].29 1 100 0.0 4294967295.0 ECU_ADDRESS 0xf0240680 BYTE_ORDER MSB_LAST /end MEASUREMENT
/begin COMPU_METHOD CU_MPL_ERROR_LOG_DETAILED[2].29 "Conversion method for mpl_error_log_detailed[2].err_log.csa.lower.D2" RAT_FUNC "%10.0" "(not defined)" COEFFS 0.000000 1.000000 -0.000000 0.000000 0.000000 1.000000 /end COMPU_METHOD
/* Scalar measurable for DDE 'mpl_error_log_detailed[2].err_log.csa.lower.D3'. */
/begin MEASUREMENT mpl_error_log_detailed[2].err89 "CPU data register" ULONG CU_MPL_ERROR_LOG_DETAILED[2].91 1 100 0.0 4294967295.0 ECU_ADDRESS 0xf0240684 BYTE_ORDER MSB_LAST /end MEASUREMENT
/begin COMPU_METHOD CU_MPL_ERROR_LOG_DETAILED[2].91 "Conversion method for mpl_error_log_detailed[2].err_log.csa.lower.D3" RAT_FUNC "%10.0" "(not defined)" COEFFS 0.000000 1.000000 -0.000000 0.000000 0.000000 1.000000 /end COMPU_METHOD
/* Scalar measurable for DDE 'mpl_error_log_detailed[2].err_log.csa.lower.D4'. */
/begin MEASUREMENT mpl_error_log_detailed[2].err90 "CPU data register" ULONG CU_MPL_ERROR_LOG_DETAILED[2].92 1 100 0.0 4294967295.0 ECU_ADDRESS 0xf0240698 BYTE_ORDER MSB_LAST /end MEASUREMENT
/begin COMPU_METHOD CU_MPL_ERROR_LOG_DETAILED[2].92 "Conversion method for mpl_error_log_detailed[2].err_log.csa.lower.D4" RAT_FUNC "%10.0" "(not defined)" COEFFS 0.000000 1.000000 -0.000000 0.000000 0.000000 1.000000 /end COMPU_METHOD
/* Scalar measurable for DDE 'mpl_error_log_detailed[2].err_log.csa.lower.D5'. */
/begin MEASUREMENT mpl_error_log_detailed[2].err91 "CPU data register" ULONG CU_MPL_ERROR_LOG_DETAILED[2].93 1 100 0.0 4294967295.0 ECU_ADDRESS 0xf024069c BYTE_ORDER MSB_LAST /end MEASUREMENT
/begin COMPU_METHOD CU_MPL_ERROR_LOG_DETAILED[2].93 "Conversion method for mpl_error_log_detailed[2].err_log.csa.lower.D5" RAT_FUNC "%10.0" "(not defined)" COEFFS 0.000000 1.000000 -0.000000 0.000000 0.000000 1.000000 /end COMPU_METHOD
/* Scalar measurable for DDE 'mpl_error_log_detailed[2].err_log.csa.lower.D6'. */
/begin MEASUREMENT mpl_error_log_detailed[2].err70 "CPU data register" ULONG CU_MPL_ERROR_LOG_DETAILED[2].72 1 100 0.0 4294967295.0 ECU_ADDRESS 0xf02406a0 BYTE_ORDER MSB_LAST /end MEASUREMENT
/begin COMPU_METHOD CU_MPL_ERROR_LOG_DETAILED[2].72 "Conversion method for mpl_error_log_detailed[2].err_log.csa.lower.D6" RAT_FUNC "%10.0" "(not defined)" COEFFS 0.000000 1.000000 -0.000000 0.000000 0.000000 1.000000 /end COMPU_METHOD
/* Scalar measurable for DDE 'mpl_error_log_detailed[2].err_log.csa.lower.D7'. */
/begin MEASUREMENT mpl_error_log_detailed[2].err92 "CPU data register" ULONG CU_MPL_ERROR_LOG_DETAILED[2].94 1 100 0.0 4294967295.0 ECU_ADDRESS 0xf02406a4 BYTE_ORDER MSB_LAST /end MEASUREMENT
/begin COMPU_METHOD CU_MPL_ERROR_LOG_DETAILED[2].94 "Conversion method for mpl_error_log_detailed[2].err_log.csa.lower.D7" RAT_FUNC "%10.0" "(not defined)" COEFFS 0.000000 1.000000 -0.000000 0.000000 0.000000 1.000000 /end COMPU_METHOD
/* Scalar measurable for DDE 'mpl_error_log_detailed[2].err_log.csa.lower.PC'. */
/begin MEASUREMENT mpl_error_log_detailed[2].err84 "CPU program counter" ULONG CU_MPL_ERROR_LOG_DETAILED[2].86 1 100 0.0 4294967295.0 ECU_ADDRESS 0xf024066c BYTE_ORDER MSB_LAST /end MEASUREMENT
/begin COMPU_METHOD CU_MPL_ERROR_LOG_DETAILED[2].86 "Conversion method for mpl_error_log_detailed[2].err_log.csa.lower.PC" RAT_FUNC "%10.0" "(not defined)" COEFFS 0.000000 1.000000 -0.000000 0.000000 0.000000 1.000000 /end COMPU_METHOD
/* Scalar measurable for DDE 'mpl_error_log_detailed[2].err_log.csa.upper.A10'. */
/begin MEASUREMENT mpl_error_log_detailed[2].err31 "CPU address register (aka stack pointer)" ULONG CU_MPL_ERROR_LOG_DETAILED[2].32 1 100 0.0 4294967295.0 ECU_ADDRESS 0xf0240670 BYTE_ORDER MSB_LAST /end MEASUREMENT
/begin COMPU_METHOD CU_MPL_ERROR_LOG_DETAILED[2].32 "Conversion method for mpl_error_log_detailed[2].err_log.csa.upper.A10" RAT_FUNC "%10.0" "(not defined)" COEFFS 0.000000 1.000000 -0.000000 0.000000 0.000000 1.000000 /end COMPU_METHOD
/* Scalar measurable for DDE 'mpl_error_log_detailed[2].err_log.csa.upper.A11'. */
/begin MEASUREMENT mpl_error_log_detailed[2].err38 "CPU address register (aka return address" ULONG CU_MPL_ERROR_LOG_DETAILED[2].39 1 100 0.0 4294967295.0 ECU_ADDRESS 0xf0240674 BYTE_ORDER MSB_LAST /end MEASUREMENT
/begin COMPU_METHOD CU_MPL_ERROR_LOG_DETAILED[2].39 "Conversion method for mpl_error_log_detailed[2].err_log.csa.upper.A11" RAT_FUNC "%10.0" "(not defined)" COEFFS 0.000000 1.000000 -0.000000 0.000000 0.000000 1.000000 /end COMPU_METHOD
/* Scalar measurable for DDE 'mpl_error_log_detailed[2].err_log.csa.upper.A12'. */
/begin MEASUREMENT mpl_error_log_detailed[2].err32 "CPU address register" ULONG CU_MPL_ERROR_LOG_DETAILED[2].33 1 100 0.0 4294967295.0 ECU_ADDRESS 0xf0240688 BYTE_ORDER MSB_LAST /end MEASUREMENT
/begin COMPU_METHOD CU_MPL_ERROR_LOG_DETAILED[2].33 "Conversion method for mpl_error_log_detailed[2].err_log.csa.upper.A12" RAT_FUNC "%10.0" "(not defined)" COEFFS 0.000000 1.000000 -0.000000 0.000000 0.000000 1.000000 /end COMPU_METHOD
/* Scalar measurable for DDE 'mpl_error_log_detailed[2].err_log.csa.upper.A13'. */
/begin MEASUREMENT mpl_error_log_detailed[2].er003 "CPU address register" ULONG CU_MPL_ERROR_LOG_DETAILED[2]005 1 100 0.0 4294967295.0 ECU_ADDRESS 0xf024068c BYTE_ORDER MSB_LAST /end MEASUREMENT
/begin COMPU_METHOD CU_MPL_ERROR_LOG_DETAILED[2]005 "Conversion method for mpl_error_log_detailed[2].err_log.csa.upper.A13" RAT_FUNC "%10.0" "(not defined)" COEFFS 0.000000 1.000000 -0.000000 0.000000 0.000000 1.000000 /end COMPU_METHOD
/* Scalar measurable for DDE 'mpl_error_log_detailed[2].err_log.csa.upper.A14'. */
/begin MEASUREMENT mpl_error_log_detailed[2].err33 "CPU address register" ULONG CU_MPL_ERROR_LOG_DETAILED[2].34 1 100 0.0 4294967295.0 ECU_ADDRESS 0xf0240690 BYTE_ORDER MSB_LAST /end MEASUREMENT
/begin COMPU_METHOD CU_MPL_ERROR_LOG_DETAILED[2].34 "Conversion method for mpl_error_log_detailed[2].err_log.csa.upper.A14" RAT_FUNC "%10.0" "(not defined)" COEFFS 0.000000 1.000000 -0.000000 0.000000 0.000000 1.000000 /end COMPU_METHOD
/* Scalar measurable for DDE 'mpl_error_log_detailed[2].err_log.csa.upper.A15'. */
/begin MEASUREMENT mpl_error_log_detailed[2].err34 "CPU address register" ULONG CU_MPL_ERROR_LOG_DETAILED[2].35 1 100 0.0 4294967295.0 ECU_ADDRESS 0xf0240694 BYTE_ORDER MSB_LAST /end MEASUREMENT
/begin COMPU_METHOD CU_MPL_ERROR_LOG_DETAILED[2].35 "Conversion method for mpl_error_log_detailed[2].err_log.csa.upper.A15" RAT_FUNC "%10.0" "(not defined)" COEFFS 0.000000 1.000000 -0.000000 0.000000 0.000000 1.000000 /end COMPU_METHOD
/* Scalar measurable for DDE 'mpl_error_log_detailed[2].err_log.csa.upper.D10'. */
/begin MEASUREMENT mpl_error_log_detailed[2].err49 "CPU data register" ULONG CU_MPL_ERROR_LOG_DETAILED[2].50 1 100 0.0 4294967295.0 ECU_ADDRESS 0xf0240680 BYTE_ORDER MSB_LAST /end MEASUREMENT
/begin COMPU_METHOD CU_MPL_ERROR_LOG_DETAILED[2].50 "Conversion method for mpl_error_log_detailed[2].err_log.csa.upper.D10" RAT_FUNC "%10.0" "(not defined)" COEFFS 0.000000 1.000000 -0.000000 0.000000 0.000000 1.000000 /end COMPU_METHOD
/* Scalar measurable for DDE 'mpl_error_log_detailed[2].err_log.csa.upper.D11'. */
/begin MEASUREMENT mpl_error_log_detailed[2].err48 "CPU data register" ULONG CU_MPL_ERROR_LOG_DETAILED[2].49 1 100 0.0 4294967295.0 ECU_ADDRESS 0xf0240684 BYTE_ORDER MSB_LAST /end MEASUREMENT
/begin COMPU_METHOD CU_MPL_ERROR_LOG_DETAILED[2].49 "Conversion method for mpl_error_log_detailed[2].err_log.csa.upper.D11" RAT_FUNC "%10.0" "(not defined)" COEFFS 0.000000 1.000000 -0.000000 0.000000 0.000000 1.000000 /end COMPU_METHOD
/* Scalar measurable for DDE 'mpl_error_log_detailed[2].err_log.csa.upper.D12'. */
/begin MEASUREMENT mpl_error_log_detailed[2].err51 "CPU data register" ULONG CU_MPL_ERROR_LOG_DETAILED[2].52 1 100 0.0 4294967295.0 ECU_ADDRESS 0xf0240698 BYTE_ORDER MSB_LAST /end MEASUREMENT
/begin COMPU_METHOD CU_MPL_ERROR_LOG_DETAILED[2].52 "Conversion method for mpl_error_log_detailed[2].err_log.csa.upper.D12" RAT_FUNC "%10.0" "(not defined)" COEFFS 0.000000 1.000000 -0.000000 0.000000 0.000000 1.000000 /end COMPU_METHOD
/* Scalar measurable for DDE 'mpl_error_log_detailed[2].err_log.csa.upper.D13'. */
/begin MEASUREMENT mpl_error_log_detailed[2].err50 "CPU data register" ULONG CU_MPL_ERROR_LOG_DETAILED[2].51 1 100 0.0 4294967295.0 ECU_ADDRESS 0xf024069c BYTE_ORDER MSB_LAST /end MEASUREMENT
/begin COMPU_METHOD CU_MPL_ERROR_LOG_DETAILED[2].51 "Conversion method for mpl_error_log_detailed[2].err_log.csa.upper.D13" RAT_FUNC "%10.0" "(not defined)" COEFFS 0.000000 1.000000 -0.000000 0.000000 0.000000 1.000000 /end COMPU_METHOD
/* Scalar measurable for DDE 'mpl_error_log_detailed[2].err_log.csa.upper.D14'. */
/begin MEASUREMENT mpl_error_log_detailed[2].err36 "CPU data register" ULONG CU_MPL_ERROR_LOG_DETAILED[2].37 1 100 0.0 4294967295.0 ECU_ADDRESS 0xf02406a0 BYTE_ORDER MSB_LAST /end MEASUREMENT
/begin COMPU_METHOD CU_MPL_ERROR_LOG_DETAILED[2].37 "Conversion method for mpl_error_log_detailed[2].err_log.csa.upper.D14" RAT_FUNC "%10.0" "(not defined)" COEFFS 0.000000 1.000000 -0.000000 0.000000 0.000000 1.000000 /end COMPU_METHOD
/* Scalar measurable for DDE 'mpl_error_log_detailed[2].err_log.csa.upper.D15'. */
/begin MEASUREMENT mpl_error_log_detailed[2].err52 "CPU data register" ULONG CU_MPL_ERROR_LOG_DETAILED[2].53 1 100 0.0 4294967295.0 ECU_ADDRESS 0xf02406a4 BYTE_ORDER MSB_LAST /end MEASUREMENT
/begin COMPU_METHOD CU_MPL_ERROR_LOG_DETAILED[2].53 "Conversion method for mpl_error_log_detailed[2].err_log.csa.upper.D15" RAT_FUNC "%10.0" "(not defined)" COEFFS 0.000000 1.000000 -0.000000 0.000000 0.000000 1.000000 /end COMPU_METHOD
/* Scalar measurable for DDE 'mpl_error_log_detailed[2].err_log.csa.upper.D8'. */
/begin MEASUREMENT mpl_error_log_detailed[2].err66 "CPU data register" ULONG CU_MPL_ERROR_LOG_DETAILED[2].68 1 100 0.0 4294967295.0 ECU_ADDRESS 0xf0240678 BYTE_ORDER MSB_LAST /end MEASUREMENT
/begin COMPU_METHOD CU_MPL_ERROR_LOG_DETAILED[2].68 "Conversion method for mpl_error_log_detailed[2].err_log.csa.upper.D8" RAT_FUNC "%10.0" "(not defined)" COEFFS 0.000000 1.000000 -0.000000 0.000000 0.000000 1.000000 /end COMPU_METHOD
/* Scalar measurable for DDE 'mpl_error_log_detailed[2].err_log.csa.upper.D9'. */
/begin MEASUREMENT mpl_error_log_detailed[2].err72 "CPU data register" ULONG CU_MPL_ERROR_LOG_DETAILED[2].74 1 100 0.0 4294967295.0 ECU_ADDRESS 0xf024067c BYTE_ORDER MSB_LAST /end MEASUREMENT
/begin COMPU_METHOD CU_MPL_ERROR_LOG_DETAILED[2].74 "Conversion method for mpl_error_log_detailed[2].err_log.csa.upper.D9" RAT_FUNC "%10.0" "(not defined)" COEFFS 0.000000 1.000000 -0.000000 0.000000 0.000000 1.000000 /end COMPU_METHOD
/* Scalar measurable for DDE 'mpl_error_log_detailed[2].err_log.csa.upper.PSW'. */
/begin MEASUREMENT mpl_error_log_detailed[2].err98 "CPU program status word" ULONG CU_MPL_ERROR_LOG_DETAILED[2]000 1 100 0.0 4294967295.0 ECU_ADDRESS 0xf024066c BYTE_ORDER MSB_LAST /end MEASUREMENT
/begin COMPU_METHOD CU_MPL_ERROR_LOG_DETAILED[2]000 "Conversion method for mpl_error_log_detailed[2].err_log.csa.upper.PSW" RAT_FUNC "%10.0" "(not defined)" COEFFS 0.000000 1.000000 -0.000000 0.000000 0.000000 1.000000 /end COMPU_METHOD
/* Scalar measurable for DDE 'mpl_error_log_detailed[2].err_log.run_task_id'. */
/begin MEASUREMENT mpl_error_log_detailed[2].err_4 "Handle of PXROS task, zero if PXROS not started" ULONG CU_MPL_ERROR_LOG_DETAILED[2].E4 1 100 0.0 4294967295.0 ECU_ADDRESS 0xf0240664 BYTE_ORDER MSB_LAST /end MEASUREMENT
/begin COMPU_METHOD CU_MPL_ERROR_LOG_DETAILED[2].E4 "Conversion method for mpl_error_log_detailed[2].err_log.run_task_id" RAT_FUNC "%10.0" "handle" COEFFS 0.000000 1.000000 -0.000000 0.000000 0.000000 1.000000 /end COMPU_METHOD
/* Scalar measurable for DDE 'mpl_error_log_detailed[2].err_log.smu_alarms.smu_ad[0]'. */
/begin MEASUREMENT mpl_error_log_detailed[2].err19 "CPU SMU alarm debug register" ULONG CU_MPL_ERROR_LOG_DETAILED[2].19 1 100 0.0 4294967295.0 ECU_ADDRESS 0xf0240870 BYTE_ORDER MSB_LAST /end MEASUREMENT
/begin COMPU_METHOD CU_MPL_ERROR_LOG_DETAILED[2].19 "Conversion method for mpl_error_log_detailed[2].err_log.smu_alarms.smu_ad[0]" RAT_FUNC "%10.0" "(not defined)" COEFFS 0.000000 1.000000 -0.000000 0.000000 0.000000 1.000000 /end COMPU_METHOD
/* Scalar measurable for DDE 'mpl_error_log_detailed[2].err_log.smu_alarms.smu_ad[10]'. */
/begin MEASUREMENT mpl_error_log_detailed[2].err61 "CPU SMU alarm debug register" ULONG CU_MPL_ERROR_LOG_DETAILED[2].63 1 100 0.0 4294967295.0 ECU_ADDRESS 0xf0240898 BYTE_ORDER MSB_LAST /end MEASUREMENT
/begin COMPU_METHOD CU_MPL_ERROR_LOG_DETAILED[2].63 "Conversion method for mpl_error_log_detailed[2].err_log.smu_alarms.smu_ad[10]" RAT_FUNC "%10.0" "(not defined)" COEFFS 0.000000 1.000000 -0.000000 0.000000 0.000000 1.000000 /end COMPU_METHOD
/* Scalar measurable for DDE 'mpl_error_log_detailed[2].err_log.smu_alarms.smu_ad[11]'. */
/begin MEASUREMENT mpl_error_log_detailed[2].err44 "CPU SMU alarm debug register" ULONG CU_MPL_ERROR_LOG_DETAILED[2].45 1 100 0.0 4294967295.0 ECU_ADDRESS 0xf024089c BYTE_ORDER MSB_LAST /end MEASUREMENT
/begin COMPU_METHOD CU_MPL_ERROR_LOG_DETAILED[2].45 "Conversion method for mpl_error_log_detailed[2].err_log.smu_alarms.smu_ad[11]" RAT_FUNC "%10.0" "(not defined)" COEFFS 0.000000 1.000000 -0.000000 0.000000 0.000000 1.000000 /end COMPU_METHOD
/* Scalar measurable for DDE 'mpl_error_log_detailed[2].err_log.smu_alarms.smu_ad[1]'. */
/begin MEASUREMENT mpl_error_log_detailed[2].er021 "CPU SMU alarm debug register" ULONG CU_MPL_ERROR_LOG_DETAILED[2]024 1 100 0.0 4294967295.0 ECU_ADDRESS 0xf0240874 BYTE_ORDER MSB_LAST /end MEASUREMENT
/begin COMPU_METHOD CU_MPL_ERROR_LOG_DETAILED[2]024 "Conversion method for mpl_error_log_detailed[2].err_log.smu_alarms.smu_ad[1]" RAT_FUNC "%10.0" "(not defined)" COEFFS 0.000000 1.000000 -0.000000 0.000000 0.000000 1.000000 /end COMPU_METHOD
/* Scalar measurable for DDE 'mpl_error_log_detailed[2].err_log.smu_alarms.smu_ad[2]'. */
/begin MEASUREMENT mpl_error_log_detailed[2].er031 "CPU SMU alarm debug register" ULONG CU_MPL_ERROR_LOG_DETAILED[2]034 1 100 0.0 4294967295.0 ECU_ADDRESS 0xf0240878 BYTE_ORDER MSB_LAST /end MEASUREMENT
/begin COMPU_METHOD CU_MPL_ERROR_LOG_DETAILED[2]034 "Conversion method for mpl_error_log_detailed[2].err_log.smu_alarms.smu_ad[2]" RAT_FUNC "%10.0" "(not defined)" COEFFS 0.000000 1.000000 -0.000000 0.000000 0.000000 1.000000 /end COMPU_METHOD
/* Scalar measurable for DDE 'mpl_error_log_detailed[2].err_log.smu_alarms.smu_ad[3]'. */
/begin MEASUREMENT mpl_error_log_detailed[2].er037 "CPU SMU alarm debug register" ULONG CU_MPL_ERROR_LOG_DETAILED[2]040 1 100 0.0 4294967295.0 ECU_ADDRESS 0xf024087c BYTE_ORDER MSB_LAST /end MEASUREMENT
/begin COMPU_METHOD CU_MPL_ERROR_LOG_DETAILED[2]040 "Conversion method for mpl_error_log_detailed[2].err_log.smu_alarms.smu_ad[3]" RAT_FUNC "%10.0" "(not defined)" COEFFS 0.000000 1.000000 -0.000000 0.000000 0.000000 1.000000 /end COMPU_METHOD
/* Scalar measurable for DDE 'mpl_error_log_detailed[2].err_log.smu_alarms.smu_ad[4]'. */
/begin MEASUREMENT mpl_error_log_detailed[2].err_6 "CPU SMU alarm debug register" ULONG CU_MPL_ERROR_LOG_DETAILED[2].E6 1 100 0.0 4294967295.0 ECU_ADDRESS 0xf0240880 BYTE_ORDER MSB_LAST /end MEASUREMENT
/begin COMPU_METHOD CU_MPL_ERROR_LOG_DETAILED[2].E6 "Conversion method for mpl_error_log_detailed[2].err_log.smu_alarms.smu_ad[4]" RAT_FUNC "%10.0" "(not defined)" COEFFS 0.000000 1.000000 -0.000000 0.000000 0.000000 1.000000 /end COMPU_METHOD
/* Scalar measurable for DDE 'mpl_error_log_detailed[2].err_log.smu_alarms.smu_ad[5]'. */
/begin MEASUREMENT mpl_error_log_detailed[2].err85 "CPU SMU alarm debug register" ULONG CU_MPL_ERROR_LOG_DETAILED[2].87 1 100 0.0 4294967295.0 ECU_ADDRESS 0xf0240884 BYTE_ORDER MSB_LAST /end MEASUREMENT
/begin COMPU_METHOD CU_MPL_ERROR_LOG_DETAILED[2].87 "Conversion method for mpl_error_log_detailed[2].err_log.smu_alarms.smu_ad[5]" RAT_FUNC "%10.0" "(not defined)" COEFFS 0.000000 1.000000 -0.000000 0.000000 0.000000 1.000000 /end COMPU_METHOD
/* Scalar measurable for DDE 'mpl_error_log_detailed[2].err_log.smu_alarms.smu_ad[6]'. */
/begin MEASUREMENT mpl_error_log_detailed[2].err15 "CPU SMU alarm debug register" ULONG CU_MPL_ERROR_LOG_DETAILED[2].15 1 100 0.0 4294967295.0 ECU_ADDRESS 0xf0240888 BYTE_ORDER MSB_LAST /end MEASUREMENT
/begin COMPU_METHOD CU_MPL_ERROR_LOG_DETAILED[2].15 "Conversion method for mpl_error_log_detailed[2].err_log.smu_alarms.smu_ad[6]" RAT_FUNC "%10.0" "(not defined)" COEFFS 0.000000 1.000000 -0.000000 0.000000 0.000000 1.000000 /end COMPU_METHOD
/* Scalar measurable for DDE 'mpl_error_log_detailed[2].err_log.smu_alarms.smu_ad[7]'. */
/begin MEASUREMENT mpl_error_log_detailed[2].err24 "CPU SMU alarm debug register" ULONG CU_MPL_ERROR_LOG_DETAILED[2].24 1 100 0.0 4294967295.0 ECU_ADDRESS 0xf024088c BYTE_ORDER MSB_LAST /end MEASUREMENT
/begin COMPU_METHOD CU_MPL_ERROR_LOG_DETAILED[2].24 "Conversion method for mpl_error_log_detailed[2].err_log.smu_alarms.smu_ad[7]" RAT_FUNC "%10.0" "(not defined)" COEFFS 0.000000 1.000000 -0.000000 0.000000 0.000000 1.000000 /end COMPU_METHOD
/* Scalar measurable for DDE 'mpl_error_log_detailed[2].err_log.smu_alarms.smu_ad[8]'. */
/begin MEASUREMENT mpl_error_log_detailed[2].err39 "CPU SMU alarm debug register" ULONG CU_MPL_ERROR_LOG_DETAILED[2].40 1 100 0.0 4294967295.0 ECU_ADDRESS 0xf0240890 BYTE_ORDER MSB_LAST /end MEASUREMENT
/begin COMPU_METHOD CU_MPL_ERROR_LOG_DETAILED[2].40 "Conversion method for mpl_error_log_detailed[2].err_log.smu_alarms.smu_ad[8]" RAT_FUNC "%10.0" "(not defined)" COEFFS 0.000000 1.000000 -0.000000 0.000000 0.000000 1.000000 /end COMPU_METHOD
/* Scalar measurable for DDE 'mpl_error_log_detailed[2].err_log.smu_alarms.smu_ad[9]'. */
/begin MEASUREMENT mpl_error_log_detailed[2].err47 "CPU SMU alarm debug register" ULONG CU_MPL_ERROR_LOG_DETAILED[2].48 1 100 0.0 4294967295.0 ECU_ADDRESS 0xf0240894 BYTE_ORDER MSB_LAST /end MEASUREMENT
/begin COMPU_METHOD CU_MPL_ERROR_LOG_DETAILED[2].48 "Conversion method for mpl_error_log_detailed[2].err_log.smu_alarms.smu_ad[9]" RAT_FUNC "%10.0" "(not defined)" COEFFS 0.000000 1.000000 -0.000000 0.000000 0.000000 1.000000 /end COMPU_METHOD
/* Scalar measurable for DDE 'mpl_error_log_detailed[2].err_log.smu_alarms.smu_ag[0]'. */
/begin MEASUREMENT mpl_error_log_detailed[2].err67 "CPU SMU alarm status register" ULONG CU_MPL_ERROR_LOG_DETAILED[2].69 1 100 0.0 4294967295.0 ECU_ADDRESS 0xf0240840 BYTE_ORDER MSB_LAST /end MEASUREMENT
/begin COMPU_METHOD CU_MPL_ERROR_LOG_DETAILED[2].69 "Conversion method for mpl_error_log_detailed[2].err_log.smu_alarms.smu_ag[0]" RAT_FUNC "%10.0" "(not defined)" COEFFS 0.000000 1.000000 -0.000000 0.000000 0.000000 1.000000 /end COMPU_METHOD
/* Scalar measurable for DDE 'mpl_error_log_detailed[2].err_log.smu_alarms.smu_ag[10]'. */
/begin MEASUREMENT mpl_error_log_detailed[2].er030 "CPU SMU alarm status register" ULONG CU_MPL_ERROR_LOG_DETAILED[2]033 1 100 0.0 4294967295.0 ECU_ADDRESS 0xf0240868 BYTE_ORDER MSB_LAST /end MEASUREMENT
/begin COMPU_METHOD CU_MPL_ERROR_LOG_DETAILED[2]033 "Conversion method for mpl_error_log_detailed[2].err_log.smu_alarms.smu_ag[10]" RAT_FUNC "%10.0" "(not defined)" COEFFS 0.000000 1.000000 -0.000000 0.000000 0.000000 1.000000 /end COMPU_METHOD
/* Scalar measurable for DDE 'mpl_error_log_detailed[2].err_log.smu_alarms.smu_ag[11]'. */
/begin MEASUREMENT mpl_error_log_detailed[2].er036 "CPU SMU alarm status register" ULONG CU_MPL_ERROR_LOG_DETAILED[2]039 1 100 0.0 4294967295.0 ECU_ADDRESS 0xf024086c BYTE_ORDER MSB_LAST /end MEASUREMENT
/begin COMPU_METHOD CU_MPL_ERROR_LOG_DETAILED[2]039 "Conversion method for mpl_error_log_detailed[2].err_log.smu_alarms.smu_ag[11]" RAT_FUNC "%10.0" "(not defined)" COEFFS 0.000000 1.000000 -0.000000 0.000000 0.000000 1.000000 /end COMPU_METHOD
/* Scalar measurable for DDE 'mpl_error_log_detailed[2].err_log.smu_alarms.smu_ag[1]'. */
/begin MEASUREMENT mpl_error_log_detailed[2].err63 "CPU SMU alarm status register" ULONG CU_MPL_ERROR_LOG_DETAILED[2].65 1 100 0.0 4294967295.0 ECU_ADDRESS 0xf0240844 BYTE_ORDER MSB_LAST /end MEASUREMENT
/begin COMPU_METHOD CU_MPL_ERROR_LOG_DETAILED[2].65 "Conversion method for mpl_error_log_detailed[2].err_log.smu_alarms.smu_ag[1]" RAT_FUNC "%10.0" "(not defined)" COEFFS 0.000000 1.000000 -0.000000 0.000000 0.000000 1.000000 /end COMPU_METHOD
/* Scalar measurable for DDE 'mpl_error_log_detailed[2].err_log.smu_alarms.smu_ag[2]'. */
/begin MEASUREMENT mpl_error_log_detailed[2].err_7 "CPU SMU alarm status register" ULONG CU_MPL_ERROR_LOG_DETAILED[2].E7 1 100 0.0 4294967295.0 ECU_ADDRESS 0xf0240848 BYTE_ORDER MSB_LAST /end MEASUREMENT
/begin COMPU_METHOD CU_MPL_ERROR_LOG_DETAILED[2].E7 "Conversion method for mpl_error_log_detailed[2].err_log.smu_alarms.smu_ag[2]" RAT_FUNC "%10.0" "(not defined)" COEFFS 0.000000 1.000000 -0.000000 0.000000 0.000000 1.000000 /end COMPU_METHOD
/* Scalar measurable for DDE 'mpl_error_log_detailed[2].err_log.smu_alarms.smu_ag[3]'. */
/begin MEASUREMENT mpl_error_log_detailed[2].err18 "CPU SMU alarm status register" ULONG CU_MPL_ERROR_LOG_DETAILED[2].18 1 100 0.0 4294967295.0 ECU_ADDRESS 0xf024084c BYTE_ORDER MSB_LAST /end MEASUREMENT
/begin COMPU_METHOD CU_MPL_ERROR_LOG_DETAILED[2].18 "Conversion method for mpl_error_log_detailed[2].err_log.smu_alarms.smu_ag[3]" RAT_FUNC "%10.0" "(not defined)" COEFFS 0.000000 1.000000 -0.000000 0.000000 0.000000 1.000000 /end COMPU_METHOD
/* Scalar measurable for DDE 'mpl_error_log_detailed[2].err_log.smu_alarms.smu_ag[4]'. */
/begin MEASUREMENT mpl_error_log_detailed[2].err_9 "CPU SMU alarm status register" ULONG CU_MPL_ERROR_LOG_DETAILED[2].E9 1 100 0.0 4294967295.0 ECU_ADDRESS 0xf0240850 BYTE_ORDER MSB_LAST /end MEASUREMENT
/begin COMPU_METHOD CU_MPL_ERROR_LOG_DETAILED[2].E9 "Conversion method for mpl_error_log_detailed[2].err_log.smu_alarms.smu_ag[4]" RAT_FUNC "%10.0" "(not defined)" COEFFS 0.000000 1.000000 -0.000000 0.000000 0.000000 1.000000 /end COMPU_METHOD
/* Scalar measurable for DDE 'mpl_error_log_detailed[2].err_log.smu_alarms.smu_ag[5]'. */
/begin MEASUREMENT mpl_error_log_detailed[2].er015 "CPU SMU alarm status register" ULONG CU_MPL_ERROR_LOG_DETAILED[2]018 1 100 0.0 4294967295.0 ECU_ADDRESS 0xf0240854 BYTE_ORDER MSB_LAST /end MEASUREMENT
/begin COMPU_METHOD CU_MPL_ERROR_LOG_DETAILED[2]018 "Conversion method for mpl_error_log_detailed[2].err_log.smu_alarms.smu_ag[5]" RAT_FUNC "%10.0" "(not defined)" COEFFS 0.000000 1.000000 -0.000000 0.000000 0.000000 1.000000 /end COMPU_METHOD
/* Scalar measurable for DDE 'mpl_error_log_detailed[2].err_log.smu_alarms.smu_ag[6]'. */
/begin MEASUREMENT mpl_error_log_detailed[2].er004 "CPU SMU alarm status register" ULONG CU_MPL_ERROR_LOG_DETAILED[2]006 1 100 0.0 4294967295.0 ECU_ADDRESS 0xf0240858 BYTE_ORDER MSB_LAST /end MEASUREMENT
/begin COMPU_METHOD CU_MPL_ERROR_LOG_DETAILED[2]006 "Conversion method for mpl_error_log_detailed[2].err_log.smu_alarms.smu_ag[6]" RAT_FUNC "%10.0" "(not defined)" COEFFS 0.000000 1.000000 -0.000000 0.000000 0.000000 1.000000 /end COMPU_METHOD
/* Scalar measurable for DDE 'mpl_error_log_detailed[2].err_log.smu_alarms.smu_ag[7]'. */
/begin MEASUREMENT mpl_error_log_detailed[2].err94 "CPU SMU alarm status register" ULONG CU_MPL_ERROR_LOG_DETAILED[2].96 1 100 0.0 4294967295.0 ECU_ADDRESS 0xf024085c BYTE_ORDER MSB_LAST /end MEASUREMENT
/begin COMPU_METHOD CU_MPL_ERROR_LOG_DETAILED[2].96 "Conversion method for mpl_error_log_detailed[2].err_log.smu_alarms.smu_ag[7]" RAT_FUNC "%10.0" "(not defined)" COEFFS 0.000000 1.000000 -0.000000 0.000000 0.000000 1.000000 /end COMPU_METHOD
/* Scalar measurable for DDE 'mpl_error_log_detailed[2].err_log.smu_alarms.smu_ag[8]'. */
/begin MEASUREMENT mpl_error_log_detailed[2].err79 "CPU SMU alarm status register" ULONG CU_MPL_ERROR_LOG_DETAILED[2].81 1 100 0.0 4294967295.0 ECU_ADDRESS 0xf0240860 BYTE_ORDER MSB_LAST /end MEASUREMENT
/begin COMPU_METHOD CU_MPL_ERROR_LOG_DETAILED[2].81 "Conversion method for mpl_error_log_detailed[2].err_log.smu_alarms.smu_ag[8]" RAT_FUNC "%10.0" "(not defined)" COEFFS 0.000000 1.000000 -0.000000 0.000000 0.000000 1.000000 /end COMPU_METHOD
/* Scalar measurable for DDE 'mpl_error_log_detailed[2].err_log.smu_alarms.smu_ag[9]'. */
/begin MEASUREMENT mpl_error_log_detailed[2].err80 "CPU SMU alarm status register" ULONG CU_MPL_ERROR_LOG_DETAILED[2].82 1 100 0.0 4294967295.0 ECU_ADDRESS 0xf0240864 BYTE_ORDER MSB_LAST /end MEASUREMENT
/begin COMPU_METHOD CU_MPL_ERROR_LOG_DETAILED[2].82 "Conversion method for mpl_error_log_detailed[2].err_log.smu_alarms.smu_ag[9]" RAT_FUNC "%10.0" "(not defined)" COEFFS 0.000000 1.000000 -0.000000 0.000000 0.000000 1.000000 /end COMPU_METHOD
/* Scalar measurable for DDE 'mpl_error_log_detailed[3].err.id'. */
/begin MEASUREMENT mpl_error_log_detailed[3].err.1 "Error code of fault raised" SWORD CU_MPL_ERROR_LOG_DETAILED[3].09 1 100 0.0 32767.0 ECU_ADDRESS 0xf02408a0 BYTE_ORDER MSB_LAST /end MEASUREMENT
/begin COMPU_METHOD CU_MPL_ERROR_LOG_DETAILED[3].09 "Conversion method for mpl_error_log_detailed[3].err.id" TAB_VERB "%12.0" "code" COMPU_TAB_REF CT_MPL_ERROR_LOG_DETAILED[3].09 /end COMPU_METHOD
/begin COMPU_VTAB CT_MPL_ERROR_LOG_DETAILED[3].09 "Conversion method for mpl_error_log_detailed[3].err.id" TAB_VERB 464 0 "PIO_PSY_NO_ERROR" 1 "PIO_TRAP_0_TIN_0_VAF" 2 "PIO_TRAP_0_TIN_1_VAP" 3 "PIO_TRAP_0_TIN_UNKNOWN" 4 "PIO_TRAP_1_TIN_1_PRIV" 5 "PIO_TRAP_1_TIN_2_MPR" 6 "PIO_TRAP_1_TIN_3_MPW" 7 "PIO_TRAP_1_TIN_4_MPX" 8 "PIO_TRAP_1_TIN_5_MPP" 9 "PIO_TRAP_1_TIN_6_MPN" 10 "PIO_TRAP_1_TIN_7_GRWP" 11 "PIO_TRAP_1_TIN_UNKNOWN" 12 "PIO_TRAP_2_TIN_1_IOPC" 13 "PIO_TRAP_2_TIN_2_UOPC" 14 "PIO_TRAP_2_TIN_3_OPD" 15 "PIO_TRAP_2_TIN_4_ALN" 16 "PIO_TRAP_2_TIN_5_MEM" 17 "PIO_TRAP_2_TIN_UNKNOWN" 18 "PIO_TRAP_3_TIN_1_FCD" 19 "PIO_TRAP_3_TIN_2_FCD" 20 "PIO_TRAP_3_TIN_3_CDU" 21 "PIO_TRAP_3_TIN_4_FCU" 22 "PIO_TRAP_3_TIN_5_CSU" 23 "PIO_TRAP_3_TIN_6_CTYP" 24 "PIO_TRAP_3_TIN_7_NEST" 25 "PIO_TRAP_3_TIN_UNKNOWN" 26 "PIO_TRAP_4_TIN_1_PSE" 27 "PIO_TRAP_4_TIN_2_DSE" 28 "PIO_TRAP_4_TIN_3_DAE" 29 "PIO_TRAP_4_TIN_4_CAE" 30 "PIO_TRAP_4_TIN_4_CAE_UNEXPECTED" 31 "PIO_TRAP_4_TIN_4_CAE_UNEXPECTED_FW" 32 "PIO_TRAP_4_TIN_5_PIE" 33 "PIO_TRAP_4_TIN_6_DIE" 34 "PIO_TRAP_4_TIN_7_DIE" 35 "PIO_TRAP_4_TIN_5_6_UNEXPECTED" 36 "PIO_TRAP_4_TIN_UNKNOWN" 37 "PIO_TRAP_5_TIN_1_OVF" 38 "PIO_TRAP_5_TIN_2_SOVF" 39 "PIO_TRAP_5_TIN_UNKNOWN" 40 "PIO_TRAP_6_SYS_UNKNOWN" 41 "PIO_TRAP_7_TIN_0_NMI" 42 "PIO_TRAP_7_TIN_UNKNOWN" 43 "PIO_ISR_0_RESET" 44 "PIO_BSPI_FIRST" 45 "PIO_BSPI_TRANSFER_TIMEOUT" 46 "PIO_BSPI_TX_DMA_ERROR" 47 "PIO_BSPI_RX_DMA_ERROR" 48 "PIO_BSPI_DSPI_ERROR" 49 "PIO_BSPI_RX_FIFO_OVERFLOW" 50 "PIO_BSPI_TX_FIFO_UNDERFLOW" 51 "PIO_BSPI_TRANSFER_TERMINATED" 52 "PIO_BSPI_TRANSAC_FAILED" 53 "PIO_BSPI_INTERNAL_SOFTWARE_ERROR" 54 "PIO_BSPI_ISR_MINIMUM_DELAY_TIME_NOT_MET" 55 "PIO_BSPI_ISR_FALSE_INT" 56 "PIO_BSPI_DMA_SAFETY_ERROR" 57 "PIO_BSPI_LAST" 58 "PIO_P1WR_ISR_MINIMUM_DELAY_TIME_NOT_MET" 59 "PIO_PADC_BUFFER_INIT_FAILED" 60 "PIO_PAX_ADC_INPUT_INVALID_ARG" 61 "PIO_PAX_CHANNEL_INVALID" 62 "PIO_PAX_ADC_INPUT_CHANNEL_UNSUPPORTED" 63 "PIO_PAX_CC_OUTPUT_CHANNEL_UNSUPPORTED" 64 "PIO_PAX_AOT_OUTPUT_CHANNEL_UNSUPPORTED" 65 "PIO_PAX_ISR_MINIMUM_DELAY_TIME_NOT_MET" 66 "PIO_PCANOPEN_RESET" 67 "PIO_PCANOPEN_BUFFER_OUT_OF_RANGE" 68 "PIO_PCANOPEN_NULL_POINTER" 69 "PIO_PCCP_RESET" 70 "PIO_PCCU6_ISR_MINIMUM_DELAY_TIME_NOT_MET" 71 "PIO_PCFG_INTERNAL_SW_ERROR" 72 "PIO_PCX_ERR_BUS_ID_OUT_OF_RANGE" 73 "PIO_PCX_ERR_DATA_LENGTH_OUT_OF_RANGE" 74 "PIO_PCX_ERR_STD_ID_OUT_OF_RANGE" 75 "PIO_PCX_ERR_EXT_ID_OUT_OF_RANGE" 76 "PIO_PCX_ERR_SAME_TX_MSG_DIFFERING_ATTRIBS" 77 "PIO_PCX_ERR_TOO_MANY_TX_MSGS" 78 "PIO_PCX_ERR_DUPLICATE_RX_MSG" 79 "PIO_PCX_ERR_TOO_MANY_RX_MSGS" 80 "PIO_PCX_ERR_BIT_RATE_IN_CONFIG_DIFFERS" 81 "PIO_PCX_ERR_UNSUPPORTED_BIT_RATE" 82 "PIO_PCX_ERR_BUS_ID_IN_CONFIG" 83 "PIO_PCX_ERR_NO_BITRATE_TABLE_MATCH" 84 "PIO_PCX_ERR_PACK_MSG_INVALID_PARAM" 85 "PIO_PCX_ERR_PACK_MSG_FIELD_PARAM" 86 "PIO_PCX_ERR_UNPACK_MSG_INVALID_PARAM" 87 "PIO_PCX_ERR_UNPACK_MSG_FIELD_PARAM" 88 "PIO_PCX_ERR_PACK_VDB_MSG_INVALID_PARAM" 89 "PIO_PCX_ERR_UNPACK_VDB_MSG_INVALID_PARAM" 90 "PIO_PCX_ERR_SWITCHED_RATE_FOR_NONFD_BUS" 91 "PIO_PCX_ERR_RX_MSG_FOR_UNCONFIG_BUS_0" 92 "PIO_PCX_ERR_UNSUPPORTED_BUS_MODE" 93 "PIO_PCX_ERR_BUS_MODE_IN_CONFIG_DIFFERS" 94 "PIO_PCX_ERR_SAME_RX_MSG_DIFFERING_ATTRIBS" 95 "PIO_PCX_ERR_TX_MSG_FOR_UNCONFIG_BUS_0" 96 "PIO_PCX_ISR_MINIMUM_DELAY_TIME_NOT_MET" 97 "PIO_PDD_CHANNEL_INVALID" 98 "PIO_PDD_DIG_DATA_IN_CHANNEL_UNSUPPORTED" 99 "PIO_PDD_DIG_DATA_OUT_CHANNEL_UNSUPPORTED" 100 "PIO_PDG_ERR_FORCED_RESET" 101 "PIO_PDTC_UPDATE_INVALID_ARG" 102 "PIO_PDTC_CLEAR_ALL_INVALID_ARG" 103 "PIO_PDTC_CLEAR_ALL_IF_ACT_INVALID_ARG" 104 "PIO_PDTC_CLEAR_ALL_IF_INACT_INVALID_ARG" 105 "PIO_PDTC_GET_DTC_STATUS_INVALID_ARG" 106 "PIO_PDTC_MATCH_EXISTS_INVALID_ARG" 107 "PIO_PDTC_CLEAR_DTCS_INVALID_ARG" 108 "PIO_PDTC_BAD_LICENSE" 109 "PIO_PDX_DO_CHANNEL_UNSUPPORTED" 110 "PIO_PDX_DIG_IN_CHANNEL_UNSUPPORTED" 111 "PIO_PDX_FREQ_IN_CHANNEL_UNSUPPORTED" 112 "PIO_PDX_PERIOD_IN_CHANNEL_UNSUPPORTED" 113 "PIO_PDX_QDEC_FREQ_IN_INVALID_ARG" 114 "PIO_PDX_QDEC_FREQ_IN_CHANNEL_UNSUPPORTED" 115 "PIO_PDX_TPU_QFI_CHANNEL_DEVICE_ERROR" 116 "PIO_PDX_QDEC_IN_CHANNEL_UNSUPPORTED" 117 "PIO_PDX_TPU_QI_CHANNEL_DEVICE_ERROR" 118 "PIO_PDX_PWM_OUT_CHANNEL_UNSUPPORTED" 119 "PIO_PDX_PWM_IN_CHANNEL_UNSUPPORTED" 120 "PIO_PDX_CHANNEL_INVALID" 121 "PIO_PDX_HBRIDGE_INVALID_MODE" 122 "PIO_PDX_HBRIDGE_DECODE_ERROR" 123 "PIO_PDX_HBRIDGE_CHANNEL_GROUP_UNSUPPORTED" 124 "PIO_PEM_EXTERNAL_RAM_REQUIRED" 125 "PIO_PEM_MEM_CONFIG_UNKNOWN" 126 "PIO_PETH_ERR_DRIVER_INITIALIZATION_ERROR" 127 "PIO_PETH_ERR_NULL_CONFIGURATION_POINTER" 128 "PIO_PETH_ERR_DATA_LENGTH_OUT_OF_RANGE" 129 "PIO_PETH_ERR_TOO_MANY_TX_MSGS" 130 "PIO_PETH_ERR_NOT_SUPPORTED" 131 "PIO_PFF_HOLDING_ARRAY_INDEX_INVALID" 132 "PIO_PFF_HOLDING_ARRAY_STRT_END_INVALID" 133 "PIO_PFF_HOLDING_ARRAY_REC_DATA_INVALID" 134 "PIO_PFF_STORED_FF_DTC_INVALID" 135 "PIO_PFF_STORED_DTC_READ_FAILURE" 136 "PIO_PFF_CAPTURE_PID_DATA_FAILURE" 137 "PIO_PFF_STARTUP_FFNO_ERROR" 138 "PIO_PFF_NVM_ALLOCATION_EXCEEDED" 139 "PIO_PFS_ECC_ERROR_DURING_FLASH_OP" 140 "PIO_PFS_RUNTIME_CORRUPT_FILE_FOUND" 141 "PIO_PKN_ERR_KERNEL_STARTED_BELOW_KERNEL_LEVEL" 142 "PIO_PKN_ERR_INVALID_RESOURCE_HANDLE" 143 "PIO_PKN_ERR_TASK_NOT_DECLARED_AS_ACQUIRING_RESOURCE" 144 "PIO_PKN_ERR_INVALID_TASK_HANDLE" 145 "PIO_PKN_ERR_INVALID_PERIODIC_TASK_HANDLE" 146 "PIO_PKN_ERR_UNEXPECTED_EXCEPTION" 147 "PIO_PKN_ERR_TASK_RESOURCE_CORE_DIFFER" 148 "PIO_PKN_ERR_TASK_RELEASE_RESOURCE_FAIL" 149 "PIO_PKN_ERR_ACQUIRING_RESOURCE_PRIORITY_CHANGE_FAIL" 150 "PIO_PKN_ERR_RELEASING_RESOURCE_PRIORITY_CHANGE_FAIL" 151 "PIO_PKN_ERR_TASK_RELEASE_RESOURCE_NEVER_ACQ" 152 "PIO_PKN_ERR_CLEAR_RESOURCE_SET_TASK_PRIO" 153 "PIO_PKN_ERR_ACQUIRING_RESOURCE_ALREADY_ACQUIRED" 154 "PIO_PJ1939_INVALID_CHANNEL" 155 "PIO_PJ1939_PG_TRANSMIT_RING_DEQUEUE_FAIL" 156 "PIO_PJ1939_DM6_TRANSMIT_INVALID_ARG" 157 "PIO_PJ1939_DM12_TRANSMIT_INVALID_ARG" 158 "PIO_PJ1939_DM14_DECODE_INVALID_ARG" 159 "PIO_PJ1939_DM15_TRANSMIT_INVALID_ARG" 160 "PIO_PJ1939_DM16_DECODE_INVALID_ARG" 161 "PIO_PJ1939_DM23_TRANSMIT_INVALID_ARG" 162 "PIO_PJ1939_DM27_TRANSMIT_INVALID_ARG" 163 "PIO_PJ1939_DM28_TRANSMIT_INVALID_ARG" 164 "PIO_PJ1939_DM29_TRANSMIT_INVALID_ARG" 165 "PIO_PJ1939_DM31_TRANSMIT_INVALID_ARG" 166 "PIO_PJ1939_DM41_TRANSMIT_INVALID_ARG" 167 "PIO_PJ1939_DM42_TRANSMIT_INVALID_ARG" 168 "PIO_PJ1939_DM43_TRANSMIT_INVALID_ARG" 169 "PIO_PJ1939_DM44_TRANSMIT_INVALID_ARG" 170 "PIO_PJ1939_DM45_TRANSMIT_INVALID_ARG" 171 "PIO_PJ1939_DM46_TRANSMIT_INVALID_ARG" 172 "PIO_PJ1939_DM47_TRANSMIT_INVALID_ARG" 173 "PIO_PJ1939_DM48_TRANSMIT_INVALID_ARG" 174 "PIO_PJ1939_DM49_TRANSMIT_INVALID_ARG" 175 "PIO_PJ1939_DM50_TRANSMIT_INVALID_ARG" 176 "PIO_PJ1939_DM51_TRANSMIT_INVALID_ARG" 177 "PIO_PJ1939_DM52_TRANSMIT_INVALID_ARG" 178 "PIO_PJ1939_INVALID_RING_BUFFER_ARG" 179 "PIO_PJ1939_DM1_RECEIVE_INVALID_ARG" 180 "PIO_PJ1939_DM2_RECEIVE_INVALID_ARG" 181 "PIO_PMCAL_ADC_INIT_CHECK_ERROR" 182 "PIO_PSAF_ERROR_STANDBY_INIT" 183 "PIO_PSAF_ISR_MINIMUM_DELAY_TIME_NOT_MET" 184 "PIO_PSAF_ERROR_CLOCK_PLAUSIBILITY" 185 "PIO_PSC_DECODE_RESET_INVALID_ARG" 186 "PIO_PSC_ERR_FORCED_RESET" 187 "PIO_PSC_ERR_STANDY_ENTRY" 188 "PIO_PSC_ERR_VERSION_INVALID_PARAM" 189 "PIO_PSC_ERR_BUILD_DATE_INVALID_PARAM" 190 "PIO_PSC_ERR_PART_NUMBER_INVALID_PARAM" 191 "PIO_PSC_UNEXPECTED_CVN_CHANGE" 192 "PIO_PSC_ERR_HW_VERSION_UNKNOWN" 193 "PIO_PSENT_IN_CHANNEL_UNSUPPORTED" 194 "PIO_PSMC_INVALID_DATA" 195 "PIO_PSMC_INTERNAL_SW_ERROR" 196 "PIO_PSTP_SAFETPACK_INIT_FAILURE" 197 "PIO_PSTP_SMU_MODE_INVALID_DURING_INIT" 198 "PIO_PSTP_SMU_MODE_RUN_DURING_INIT" 199 "PIO_PSTP_SMU_FAIL_INIT" 200 "PIO_PSTP_SMU_FAIL_ALARM_CONFIG" 201 "PIO_PSTP_SMU_SW_ALARM_GROUP_0" 202 "PIO_PSTP_SMU_SW_ALARM_GROUP_1" 203 "PIO_PSTP_SMU_SW_ALARM_GROUP_2" 204 "PIO_PSTP_SMU_SW_ALARM_GROUP_3" 205 "PIO_PSTP_SMU_SW_ALARM_GROUP_4" 206 "PIO_PSTP_SMU_SW_ALARM_GROUP_5" 207 "PIO_PSTP_SMU_SW_ALARM_GROUP_6" 208 "PIO_PSTP_SMU_SW_ALARM_GROUP_7" 209 "PIO_PSTP_SMU_SW_ALARM_GROUP_8" 210 "PIO_PSTP_SMU_SW_ALARM_GROUP_9" 211 "PIO_PSTP_SMU_SW_ALARM_GROUP_10" 212 "PIO_PSTP_SMU_SW_ALARM_GROUP_11" 213 "PIO_PSTP_SMU_SW_ALARM_GROUP_12" 214 "PIO_PSTP_SMU_SW_ALARM_GROUP_13" 215 "PIO_PSTP_SMU_SW_ALARM_GROUP_14" 216 "PIO_PSTP_SMU_SW_ALARM_GROUP_15" 217 "PIO_PSTP_SWDGM_UNEXPECTED" 218 "PIO_PSTP_SWDGM_INIT_FAIL" 219 "PIO_PSTP_SWDGM_ACTIVATE_FAIL" 220 "PIO_PSTP_SWDGM_DEINIT_FAIL" 221 "PIO_PSTP_SWDGM_GETERRCNTR_FAIL" 222 "PIO_PSTP_SWDGM_GETINFO_FAIL" 223 "PIO_PSTP_SWDGM_GETSEED_FAIL" 224 "PIO_PSTP_SWDGM_USERREQ_FAIL" 225 "PIO_PSTP_SWDGM_SERVICE_FAIL" 226 "PIO_PSTP_TSTM_STARTUP_TEST_FAIL" 227 "PIO_PSTP_TSTM_RUNTIME_TEST_FAIL" 228 "PIO_PSTP_TSTM_INIT_FAIL" 229 "PIO_PSTP_TSTM_SWITCH_TO_RUN_FAIL" 230 "PIO_PSTP_TLF_TEST_FAIL" 231 "PIO_PSTP_TLF_MAXJOBS_FAIL" 232 "PIO_PSTP_SEID_INCORRECT" 233 "PIO_PSTP_CHECKPOINT_INCORRECT" 234 "PIO_PSTP_ERR_TASK_BUDGET_OVRRUN" 235 "PIO_PSTP_HTXTESTHND_INVALID_RESULT" 236 "PIO_PSTP_HTXTESTHND_TEST_NOT_EXECUTED" 237 "PIO_PSTP_HTXLBIST_CALLER_ADDR_ERR" 238 "PIO_PSTP_HTXLBIST_PORST_ERR" 239 "PIO_PSTP_HTXLBIST_TERMINATION_ERR" 240 "PIO_PSTP_HTXLBIST_DEFAULT_SIGNATURE_ERR" 241 "PIO_PSTP_HTXLBIST_CRC_ERR" 242 "PIO_PSTP_HTXLBIST_UNDEFINED_ERR" 243 "PIO_PSTP_HTXLBIST_INV_PARAM_ERR" 244 "PIO_PSTP_HTXSFRTST_CMP_INV_PARAM_ERR" 245 "PIO_PSTP_HTXSFRTST_CMP_OVERLOAD" 246 "PIO_PSTP_HTXSFRTST_CMP_VAL_ERR" 247 "PIO_PSTP_HTXSFRTST_CRC_INV_PARAM_ERR" 248 "PIO_PSTP_HTXSFRTST_CRC_DATAMISMATCH" 249 "PIO_PSTP_HTXREGMON_SMU_TIMEOUT" 250 "PIO_PSTP_HTXREGMON_ERR_UNDEFINED" 251 "PIO_PSTP_HTXREGMON_ERR_MTU_TIMEOUT_UND" 252 "PIO_PSTP_HTXREGMON_INV_PARAM_ERR" 253 "PIO_PSTP_HTXREGMON_ERR_MTU_FAILED" 254 "PIO_PSTP_HTXMONBIST_ERR_SMU_FLAG" 255 "PIO_PSTP_HTXMONBIST_ERR_PMS_FLAG" 256 "PIO_PSTP_HTXMONBIST_ERR_PMS_SMU_FLAG" 257 "PIO_PSTP_HTXMONBIST_ERR_TIMEOUT" 258 "PIO_PSTP_HTXMONBIST_ERR_UNSPECIFIED" 259 "PIO_PSTP_HTXMONBIST_ERR_SFR_CONFIG" 260 "PIO_PSTP_HTXDTSRESULT_A_FAILED_ERR_DIFF" 261 "PIO_PSTP_HTXDTSRESULT_B_FAILED_ERR_DIFF" 262 "PIO_PSTP_HTXSMUALIVEALARM_ERR_ALM_STS" 263 "PIO_PSTP_HTXSMUALIVEALARM_ERR_TRIG" 264 "PIO_PSTP_HTXSMUALIVEALARM_PREV_ALM_STS" 265 "PIO_PSTP_HTXSMUALIVEALARM_ERR_SMU_RUN" 266 "PIO_PSTP_HTXVMTMBIST_ERR_MTU_UNDEFINED" 267 "PIO_PSTP_HTXVMTMBIST_ERR_MTU_TIMEOUT_UND" 268 "PIO_PSTP_HTXVMTMBIST_INV_PARAM_ERR" 269 "PIO_PSTP_HTXFWCHECK_FAILED" 270 "PIO_PSTP_HTXFWCHECK_INV_PARAM_ERR" 271 "PIO_PSTP_HTXFWCHECK_RST_UNKNOWN" 272 "PIO_PSTP_HTXFWCHECK_SFR_NOT_CLEARED" 273 "PIO_PSTP_HTXFWCHECK_DATA_ERR" 274 "PIO_PSTP_HTXPFM_UNEXPECTED_ERROR" 275 "PIO_PSTP_HTXPFM_RAM_CORRUPTION" 276 "PIO_PSTP_HTXPFM_ILLEGAL_FUNCTION_ARGUMENT" 277 "PIO_PSTP_HTXPFM_SYSTEM_TIMER_READ_FAULT" 278 "PIO_PSTP_HTXPFM_ILLEGAL_REINIT" 279 "PIO_PSTP_HTXPFM_UNEXPECTED_SEID" 280 "PIO_PSTP_HTXPFM_LOGICAL_FAULT_DETECTED" 281 "PIO_PSTP_HTXPFM_DEADLINE_FAULT_DETECTED" 282 "PIO_PSTP_HTXPFM_TIMING_FAULT_DETECTED" 283 "PIO_PSTP_HTXPFM_ALIVENESS_FAULT_DETECTED" 284 "PIO_PSY_ERR_SMU_ASSERT" 285 "PIO_PTM_TIMER_ERROR" 286 "PIO_PUT_DEBOUNCE_BY_CYCLES_INVALID_ARG" 287 "PIO_PUT_LEAKY_BUCKET_INVALID_ARG" 288 "PIO_PUT_DEBOUNCE_BY_TIME_INVALID_ARG" 289 "PIO_PUT_DUTYCYCLE_PROCESSING_INVALID_ARG" 290 "PIO_PUT_STATE_PROCESSING_INVALID_ARG" 291 "PIO_PUT_ARRAY_SEARCH_INVALID_ARG" 292 "PIO_PUT_ERR_PACK_INVALID_PARAM" 293 "PIO_PUT_ERR_UNPACK_INVALID_PARAM" 294 "PIO_PXCP_RESET" 295 "PIO_PUART_MCAL_INIT_CHECK_ERROR" 296 "PIO_ALARM_0_TYPE_0_CPU" 297 "PIO_ALARM_0_TYPE_1_CPU" 298 "PIO_ALARM_0_TYPE_2_CPU" 299 "PIO_ALARM_0_TYPE_4_MTU" 300 "PIO_ALARM_0_TYPE_5_MTU" 301 "PIO_ALARM_0_TYPE_6_MTU" 302 "PIO_ALARM_0_TYPE_7_MTU" 303 "PIO_ALARM_0_TYPE_8_MTU" 304 "PIO_ALARM_0_TYPE_9_MTU" 305 "PIO_ALARM_0_TYPE_10_MTU" 306 "PIO_ALARM_0_TYPE_11_MTU" 307 "PIO_ALARM_0_TYPE_12_MTU" 308 "PIO_ALARM_0_TYPE_13_MTU" 309 "PIO_ALARM_0_TYPE_14_MTU" 310 "PIO_ALARM_0_TYPE_22_CPU" 311 "PIO_ALARM_0_TYPE_23_CPU" 312 "PIO_ALARM_0_TYPE_24_CPU" 313 "PIO_ALARM_1_TYPE_0_CPU" 314 "PIO_ALARM_1_TYPE_1_CPU" 315 "PIO_ALARM_1_TYPE_2_CPU" 316 "PIO_ALARM_1_TYPE_4_MTU" 317 "PIO_ALARM_1_TYPE_5_MTU" 318 "PIO_ALARM_1_TYPE_6_MTU" 319 "PIO_ALARM_1_TYPE_7_MTU" 320 "PIO_ALARM_1_TYPE_8_MTU" 321 "PIO_ALARM_1_TYPE_9_MTU" 322 "PIO_ALARM_1_TYPE_10_MTU" 323 "PIO_ALARM_1_TYPE_11_MTU" 324 "PIO_ALARM_1_TYPE_12_MTU" 325 "PIO_ALARM_1_TYPE_13_MTU" 326 "PIO_ALARM_1_TYPE_14_MTU" 327 "PIO_ALARM_1_TYPE_22_MTU" 328 "PIO_ALARM_1_TYPE_23_CPU" 329 "PIO_ALARM_1_TYPE_24_CPU" 330 "PIO_ALARM_6_TYPE_0_MTU" 331 "PIO_ALARM_6_TYPE_1_IOM" 332 "PIO_ALARM_6_TYPE_2_IR" 333 "PIO_ALARM_6_TYPE_4_SCU" 334 "PIO_ALARM_6_TYPE_5_PMS" 335 "PIO_ALARM_6_TYPE_6_DMA" 336 "PIO_ALARM_6_TYPE_7_SMU_CORE" 337 "PIO_ALARM_6_TYPE_8_CCU" 338 "PIO_ALARM_6_TYPE_10_GTM" 339 "PIO_ALARM_6_TYPE_11_GTM" 340 "PIO_ALARM_6_TYPE_12_GTM" 341 "PIO_ALARM_6_TYPE_13_ERAY" 342 "PIO_ALARM_6_TYPE_14_ERAY" 343 "PIO_ALARM_6_TYPE_15_SRAM" 344 "PIO_ALARM_6_TYPE_16_CAN" 345 "PIO_ALARM_6_TYPE_17_CAN" 346 "PIO_ALARM_6_TYPE_18_CAN" 347 "PIO_ALARM_6_TYPE_19_MISC" 348 "PIO_ALARM_6_TYPE_20_MISC" 349 "PIO_ALARM_6_TYPE_21_MISC" 350 "PIO_ALARM_6_TYPE_23_CBS" 351 "PIO_ALARM_6_TYPE_24_CCU" 352 "PIO_ALARM_6_TYPE_25_CCU" 353 "PIO_ALARM_7_TYPE_0_DAM0" 354 "PIO_ALARM_7_TYPE_1_LMU" 355 "PIO_ALARM_7_TYPE_2_LMU" 356 "PIO_ALARM_7_TYPE_17_XBAR0" 357 "PIO_ALARM_7_TYPE_20_SPB" 358 "PIO_ALARM_7_TYPE_22_FSI" 359 "PIO_ALARM_7_TYPE_23_FSI" 360 "PIO_ALARM_7_TYPE_24_FSI" 361 "PIO_ALARM_7_TYPE_25_FSI" 362 "PIO_ALARM_7_TYPE_26_FSI" 363 "PIO_ALARM_7_TYPE_27_FSI" 364 "PIO_ALARM_7_TYPE_28_FSI" 365 "PIO_ALARM_7_TYPE_29_FSI" 366 "PIO_ALARM_7_TYPE_30_FSI" 367 "PIO_ALARM_7_TYPE_31_FSI" 368 "PIO_ALARM_8_TYPE_0_SCU" 369 "PIO_ALARM_8_TYPE_1_CCU" 370 "PIO_ALARM_8_TYPE_2_CCU" 371 "PIO_ALARM_8_TYPE_3_SCU" 372 "PIO_ALARM_8_TYPE_4_SCU" 373 "PIO_ALARM_8_TYPE_5_SCU" 374 "PIO_ALARM_8_TYPE_6_SCU" 375 "PIO_ALARM_8_TYPE_7_SCU" 376 "PIO_ALARM_8_TYPE_8_SCU" 377 "PIO_ALARM_8_TYPE_9_SCU" 378 "PIO_ALARM_8_TYPE_10_SCU" 379 "PIO_ALARM_8_TYPE_11_SCU" 380 "PIO_ALARM_8_TYPE_16_SCU" 381 "PIO_ALARM_8_TYPE_17_SCU" 382 "PIO_ALARM_8_TYPE_18_SCU" 383 "PIO_ALARM_8_TYPE_19_SCU" 384 "PIO_ALARM_8_TYPE_20_SCU" 385 "PIO_ALARM_8_TYPE_21_SCU" 386 "PIO_ALARM_8_TYPE_22_IR" 387 "PIO_ALARM_8_TYPE_23_DMA" 388 "PIO_ALARM_8_TYPE_25_IOM" 389 "PIO_ALARM_8_TYPE_26_SCU" 390 "PIO_ALARM_8_TYPE_27_SCU" 391 "PIO_ALARM_8_TYPE_28_SCU" 392 "PIO_ALARM_8_TYPE_29_SCU" 393 "PIO_ALARM_8_TYPE_30_SCU" 394 "PIO_ALARM_8_TYPE_31_SCU" 395 "PIO_ALARM_9_TYPE_0_DTS" 396 "PIO_ALARM_9_TYPE_1_DTS" 397 "PIO_ALARM_9_TYPE_3_PMS" 398 "PIO_ALARM_9_TYPE_5_PMS" 399 "PIO_ALARM_9_TYPE_15_PMS" 400 "PIO_ALARM_9_TYPE_16_PMS" 401 "PIO_ALARM_9_TYPE_17_PMS" 402 "PIO_ALARM_10_TYPE_0_SW" 403 "PIO_ALARM_10_TYPE_1_SW" 404 "PIO_ALARM_10_TYPE_2_SW" 405 "PIO_ALARM_10_TYPE_3_SW" 406 "PIO_ALARM_10_TYPE_4_SW" 407 "PIO_ALARM_10_TYPE_5_SW" 408 "PIO_ALARM_10_TYPE_6_SW" 409 "PIO_ALARM_10_TYPE_7_SW" 410 "PIO_ALARM_10_TYPE_8_SW" 411 "PIO_ALARM_10_TYPE_9_SW" 412 "PIO_ALARM_10_TYPE_10_SW" 413 "PIO_ALARM_10_TYPE_11_SW" 414 "PIO_ALARM_10_TYPE_12_SW" 415 "PIO_ALARM_10_TYPE_13_SW" 416 "PIO_ALARM_10_TYPE_14_SW" 417 "PIO_ALARM_10_TYPE_15_SW" 418 "PIO_ALARM_10_TYPE_16_SMU_CORE" 419 "PIO_ALARM_10_TYPE_17_SMU_CORE" 420 "PIO_ALARM_10_TYPE_18_FSP" 421 "PIO_ALARM_10_TYPE_20_CCU" 422 "PIO_ALARM_10_TYPE_21_SFF" 423 "PIO_ALARM_10_TYPE_22_SFF" 424 "PIO_ALARM_11_TYPE_2_XBAR" 425 "PIO_ALARM_11_TYPE_3_XBAR" 426 "PIO_ALARM_11_TYPE_4_DMU" 427 "PIO_ALARM_11_TYPE_5_DMU" 428 "PIO_ALARM_11_TYPE_9_SFIBRIDGE1" 429 "PIO_ALARM_11_TYPE_10_HSSL" 430 "PIO_ALARM_11_TYPE_12_CONVERTER" 431 "PIO_ALARM_11_TYPE_13_XBAR" 432 "PIO_ALARM_20_TYPE_4_EVR" 433 "PIO_ALARM_20_TYPE_5_EVR" 434 "PIO_ALARM_20_TYPE_6_EVR" 435 "PIO_ALARM_20_TYPE_7_EVR" 436 "PIO_ALARM_20_TYPE_8_EVR" 437 "PIO_ALARM_20_TYPE_9_EVR" 438 "PIO_ALARM_20_TYPE_10_EVR" 439 "PIO_ALARM_20_TYPE_11_EVR" 440 "PIO_ALARM_20_TYPE_12_EVR" 441 "PIO_ALARM_20_TYPE_13_EVR" 442 "PIO_ALARM_20_TYPE_14_EVR" 443 "PIO_ALARM_20_TYPE_15_EVR" 444 "PIO_ALARM_21_TYPE_0_HSM" 445 "PIO_ALARM_21_TYPE_1_HSM" 446 "PIO_ALARM_21_TYPE_2_HSM" 447 "PIO_ALARM_21_TYPE_3_HSM" 448 "PIO_ALARM_21_TYPE_4_HSM" 449 "PIO_ALARM_21_TYPE_5_HSM" 450 "PIO_ALARM_21_TYPE_7_SMU" 451 "PIO_ALARM_21_TYPE_8_PMS" 452 "PIO_ALARM_21_TYPE_9_PMS" 453 "PIO_ALARM_21_TYPE_10_PMS" 454 "PIO_ALARM_21_TYPE_11_PMS" 455 "PIO_ALARM_21_TYPE_12_PMS" 456 "PIO_ALARM_21_TYPE_13_PMS" 457 "PIO_ALARM_21_TYPE_14_PMS" 458 "PIO_ALARM_21_TYPE_15_CCU" 459 "PIO_ALARM_21_TYPE_16_SMU_CORE" 460 "PIO_ALARM_MULTIPLE" 461 "PIO_ALARM_RESERVED" 462 "PIO_ALARM_UNEXPECTED" 463 "PIO_ERROR_ID_LAST" /end COMPU_VTAB
/* Scalar measurable for DDE 'mpl_error_log_detailed[3].err.mode'. */
/begin MEASUREMENT mpl_error_log_detailed[3].err.2 "Mode of the software when fault raised" SBYTE CU_MPL_ERROR_LOG_DETAILED[3].54 1 100 0.0 127.0 ECU_ADDRESS 0xf02408a2 BYTE_ORDER MSB_LAST /end MEASUREMENT
/begin COMPU_METHOD CU_MPL_ERROR_LOG_DETAILED[3].54 "Conversion method for mpl_error_log_detailed[3].err.mode" TAB_VERB "%12.0" "code" COMPU_TAB_REF CT_MPL_ERROR_LOG_DETAILED[3].54 /end COMPU_METHOD
/begin COMPU_VTAB CT_MPL_ERROR_LOG_DETAILED[3].54 "Conversion method for mpl_error_log_detailed[3].err.mode" TAB_VERB 4 0 "PIO_EXEC_MODE_UNKNOWN" 1 "PIO_EXEC_MODE_PRG" 2 "PIO_EXEC_MODE_APP" 3 "PIO_EXEC_MODE_LAST" /end COMPU_VTAB
/* Scalar measurable for DDE 'mpl_error_log_detailed[3].err.reaction'. */
/begin MEASUREMENT mpl_error_log_detailed[3].err.0 "Reaction to the fault raised" SBYTE CU_MPL_ERROR_LOG_DETAILED[3].E3 1 100 0.0 127.0 ECU_ADDRESS 0xf02408a3 BYTE_ORDER MSB_LAST /end MEASUREMENT
/begin COMPU_METHOD CU_MPL_ERROR_LOG_DETAILED[3].E3 "Conversion method for mpl_error_log_detailed[3].err.reaction" TAB_VERB "%12.0" "code" COMPU_TAB_REF CT_MPL_ERROR_LOG_DETAILED[3].E3 /end COMPU_METHOD
/begin COMPU_VTAB CT_MPL_ERROR_LOG_DETAILED[3].E3 "Conversion method for mpl_error_log_detailed[3].err.reaction" TAB_VERB 6 0 "PIO_CONTINUE" 1 "PIO_RESET" 2 "PIO_RECORD_AND_CONTINUE" 3 "PIO_RECORD_AND_RESET" 4 "PIO_RESET_AND_RECORD" 5 "PIO_FAULT_REACTION_LAST" /end COMPU_VTAB
/* Scalar measurable for DDE 'mpl_error_log_detailed[3].err_log.cpu_log.biv'. */
/begin MEASUREMENT mpl_error_log_detailed[3].er008 "CPU base address of interrupt vector table register" ULONG CU_MPL_ERROR_LOG_DETAILED[3]011 1 100 0.0 4294967295.0 ECU_ADDRESS 0xf0240a64 BYTE_ORDER MSB_LAST /end MEASUREMENT
/begin COMPU_METHOD CU_MPL_ERROR_LOG_DETAILED[3]011 "Conversion method for mpl_error_log_detailed[3].err_log.cpu_log.biv" RAT_FUNC "%10.0" "(not defined)" COEFFS 0.000000 1.000000 -0.000000 0.000000 0.000000 1.000000 /end COMPU_METHOD
/* Scalar measurable for DDE 'mpl_error_log_detailed[3].err_log.cpu_log.btv'. */
/begin MEASUREMENT mpl_error_log_detailed[3].er026 "CPU base address of trap vector table register" ULONG CU_MPL_ERROR_LOG_DETAILED[3]029 1 100 0.0 4294967295.0 ECU_ADDRESS 0xf0240a68 BYTE_ORDER MSB_LAST /end MEASUREMENT
/begin COMPU_METHOD CU_MPL_ERROR_LOG_DETAILED[3]029 "Conversion method for mpl_error_log_detailed[3].err_log.cpu_log.btv" RAT_FUNC "%10.0" "(not defined)" COEFFS 0.000000 1.000000 -0.000000 0.000000 0.000000 1.000000 /end COMPU_METHOD
/* Scalar measurable for DDE 'mpl_error_log_detailed[3].err_log.cpu_log.cpr_low[0]'. */
/begin MEASUREMENT mpl_error_log_detailed[3].err33 "CPU/MPU code segment protection register, lower" ULONG CU_MPL_ERROR_LOG_DETAILED[3].35 1 100 0.0 4294967295.0 ECU_ADDRESS 0xf02409b8 BYTE_ORDER MSB_LAST /end MEASUREMENT
/begin COMPU_METHOD CU_MPL_ERROR_LOG_DETAILED[3].35 "Conversion method for mpl_error_log_detailed[3].err_log.cpu_log.cpr_low[0]" RAT_FUNC "%10.0" "(not defined)" COEFFS 0.000000 1.000000 -0.000000 0.000000 0.000000 1.000000 /end COMPU_METHOD
/* Scalar measurable for DDE 'mpl_error_log_detailed[3].err_log.cpu_log.cpr_low[1]'. */
/begin MEASUREMENT mpl_error_log_detailed[3].err86 "CPU/MPU code segment protection register, lower" ULONG CU_MPL_ERROR_LOG_DETAILED[3].89 1 100 0.0 4294967295.0 ECU_ADDRESS 0xf02409bc BYTE_ORDER MSB_LAST /end MEASUREMENT
/begin COMPU_METHOD CU_MPL_ERROR_LOG_DETAILED[3].89 "Conversion method for mpl_error_log_detailed[3].err_log.cpu_log.cpr_low[1]" RAT_FUNC "%10.0" "(not defined)" COEFFS 0.000000 1.000000 -0.000000 0.000000 0.000000 1.000000 /end COMPU_METHOD
/* Scalar measurable for DDE 'mpl_error_log_detailed[3].err_log.cpu_log.cpr_low[2]'. */
/begin MEASUREMENT mpl_error_log_detailed[3].er010 "CPU/MPU code segment protection register, lower" ULONG CU_MPL_ERROR_LOG_DETAILED[3]013 1 100 0.0 4294967295.0 ECU_ADDRESS 0xf02409c0 BYTE_ORDER MSB_LAST /end MEASUREMENT
/begin COMPU_METHOD CU_MPL_ERROR_LOG_DETAILED[3]013 "Conversion method for mpl_error_log_detailed[3].err_log.cpu_log.cpr_low[2]" RAT_FUNC "%10.0" "(not defined)" COEFFS 0.000000 1.000000 -0.000000 0.000000 0.000000 1.000000 /end COMPU_METHOD
/* Scalar measurable for DDE 'mpl_error_log_detailed[3].err_log.cpu_log.cpr_low[3]'. */
/begin MEASUREMENT mpl_error_log_detailed[3].err43 "CPU/MPU code segment protection register, lower" ULONG CU_MPL_ERROR_LOG_DETAILED[3].45 1 100 0.0 4294967295.0 ECU_ADDRESS 0xf02409c4 BYTE_ORDER MSB_LAST /end MEASUREMENT
/begin COMPU_METHOD CU_MPL_ERROR_LOG_DETAILED[3].45 "Conversion method for mpl_error_log_detailed[3].err_log.cpu_log.cpr_low[3]" RAT_FUNC "%10.0" "(not defined)" COEFFS 0.000000 1.000000 -0.000000 0.000000 0.000000 1.000000 /end COMPU_METHOD
/* Scalar measurable for DDE 'mpl_error_log_detailed[3].err_log.cpu_log.cpr_low[4]'. */
/begin MEASUREMENT mpl_error_log_detailed[3].err_3 "CPU/MPU code segment protection register, lower" ULONG CU_MPL_ERROR_LOG_DETAILED[3].E4 1 100 0.0 4294967295.0 ECU_ADDRESS 0xf02409c8 BYTE_ORDER MSB_LAST /end MEASUREMENT
/begin COMPU_METHOD CU_MPL_ERROR_LOG_DETAILED[3].E4 "Conversion method for mpl_error_log_detailed[3].err_log.cpu_log.cpr_low[4]" RAT_FUNC "%10.0" "(not defined)" COEFFS 0.000000 1.000000 -0.000000 0.000000 0.000000 1.000000 /end COMPU_METHOD
/* Scalar measurable for DDE 'mpl_error_log_detailed[3].err_log.cpu_log.cpr_low[5]'. */
/begin MEASUREMENT mpl_error_log_detailed[3].er041 "CPU/MPU code segment protection register, lower" ULONG CU_MPL_ERROR_LOG_DETAILED[3]044 1 100 0.0 4294967295.0 ECU_ADDRESS 0xf02409cc BYTE_ORDER MSB_LAST /end MEASUREMENT
/begin COMPU_METHOD CU_MPL_ERROR_LOG_DETAILED[3]044 "Conversion method for mpl_error_log_detailed[3].err_log.cpu_log.cpr_low[5]" RAT_FUNC "%10.0" "(not defined)" COEFFS 0.000000 1.000000 -0.000000 0.000000 0.000000 1.000000 /end COMPU_METHOD
/* Scalar measurable for DDE 'mpl_error_log_detailed[3].err_log.cpu_log.cpr_low[6]'. */
/begin MEASUREMENT mpl_error_log_detailed[3].err07 "CPU/MPU code segment protection register, lower" ULONG CU_MPL_ERROR_LOG_DETAILED[3].08 1 100 0.0 4294967295.0 ECU_ADDRESS 0xf02409d0 BYTE_ORDER MSB_LAST /end MEASUREMENT
/begin COMPU_METHOD CU_MPL_ERROR_LOG_DETAILED[3].08 "Conversion method for mpl_error_log_detailed[3].err_log.cpu_log.cpr_low[6]" RAT_FUNC "%10.0" "(not defined)" COEFFS 0.000000 1.000000 -0.000000 0.000000 0.000000 1.000000 /end COMPU_METHOD
/* Scalar measurable for DDE 'mpl_error_log_detailed[3].err_log.cpu_log.cpr_low[7]'. */
/begin MEASUREMENT mpl_error_log_detailed[3].err71 "CPU/MPU code segment protection register, lower" ULONG CU_MPL_ERROR_LOG_DETAILED[3].74 1 100 0.0 4294967295.0 ECU_ADDRESS 0xf02409d4 BYTE_ORDER MSB_LAST /end MEASUREMENT
/begin COMPU_METHOD CU_MPL_ERROR_LOG_DETAILED[3].74 "Conversion method for mpl_error_log_detailed[3].err_log.cpu_log.cpr_low[7]" RAT_FUNC "%10.0" "(not defined)" COEFFS 0.000000 1.000000 -0.000000 0.000000 0.000000 1.000000 /end COMPU_METHOD
/* Scalar measurable for DDE 'mpl_error_log_detailed[3].err_log.cpu_log.cpr_low[8]'. */
/begin MEASUREMENT mpl_error_log_detailed[3].err50 "CPU/MPU code segment protection register, lower" ULONG CU_MPL_ERROR_LOG_DETAILED[3].52 1 100 0.0 4294967295.0 ECU_ADDRESS 0xf02409d8 BYTE_ORDER MSB_LAST /end MEASUREMENT
/begin COMPU_METHOD CU_MPL_ERROR_LOG_DETAILED[3].52 "Conversion method for mpl_error_log_detailed[3].err_log.cpu_log.cpr_low[8]" RAT_FUNC "%10.0" "(not defined)" COEFFS 0.000000 1.000000 -0.000000 0.000000 0.000000 1.000000 /end COMPU_METHOD
/* Scalar measurable for DDE 'mpl_error_log_detailed[3].err_log.cpu_log.cpr_low[9]'. */
/begin MEASUREMENT mpl_error_log_detailed[3].err87 "CPU/MPU code segment protection register, lower" ULONG CU_MPL_ERROR_LOG_DETAILED[3].90 1 100 0.0 4294967295.0 ECU_ADDRESS 0xf02409dc BYTE_ORDER MSB_LAST /end MEASUREMENT
/begin COMPU_METHOD CU_MPL_ERROR_LOG_DETAILED[3].90 "Conversion method for mpl_error_log_detailed[3].err_log.cpu_log.cpr_low[9]" RAT_FUNC "%10.0" "(not defined)" COEFFS 0.000000 1.000000 -0.000000 0.000000 0.000000 1.000000 /end COMPU_METHOD
/* Scalar measurable for DDE 'mpl_error_log_detailed[3].err_log.cpu_log.cpr_upr[0]'. */
/begin MEASUREMENT mpl_error_log_detailed[3].err70 "CPU/MPU code segment protection register, upper" ULONG CU_MPL_ERROR_LOG_DETAILED[3].73 1 100 0.0 4294967295.0 ECU_ADDRESS 0xf02409e0 BYTE_ORDER MSB_LAST /end MEASUREMENT
/begin COMPU_METHOD CU_MPL_ERROR_LOG_DETAILED[3].73 "Conversion method for mpl_error_log_detailed[3].err_log.cpu_log.cpr_upr[0]" RAT_FUNC "%10.0" "(not defined)" COEFFS 0.000000 1.000000 -0.000000 0.000000 0.000000 1.000000 /end COMPU_METHOD
/* Scalar measurable for DDE 'mpl_error_log_detailed[3].err_log.cpu_log.cpr_upr[1]'. */
/begin MEASUREMENT mpl_error_log_detailed[3].err82 "CPU/MPU code segment protection register, upper" ULONG CU_MPL_ERROR_LOG_DETAILED[3].85 1 100 0.0 4294967295.0 ECU_ADDRESS 0xf02409e4 BYTE_ORDER MSB_LAST /end MEASUREMENT
/begin COMPU_METHOD CU_MPL_ERROR_LOG_DETAILED[3].85 "Conversion method for mpl_error_log_detailed[3].err_log.cpu_log.cpr_upr[1]" RAT_FUNC "%10.0" "(not defined)" COEFFS 0.000000 1.000000 -0.000000 0.000000 0.000000 1.000000 /end COMPU_METHOD
/* Scalar measurable for DDE 'mpl_error_log_detailed[3].err_log.cpu_log.cpr_upr[2]'. */
/begin MEASUREMENT mpl_error_log_detailed[3].err46 "CPU/MPU code segment protection register, upper" ULONG CU_MPL_ERROR_LOG_DETAILED[3].48 1 100 0.0 4294967295.0 ECU_ADDRESS 0xf02409e8 BYTE_ORDER MSB_LAST /end MEASUREMENT
/begin COMPU_METHOD CU_MPL_ERROR_LOG_DETAILED[3].48 "Conversion method for mpl_error_log_detailed[3].err_log.cpu_log.cpr_upr[2]" RAT_FUNC "%10.0" "(not defined)" COEFFS 0.000000 1.000000 -0.000000 0.000000 0.000000 1.000000 /end COMPU_METHOD
/* Scalar measurable for DDE 'mpl_error_log_detailed[3].err_log.cpu_log.cpr_upr[3]'. */
/begin MEASUREMENT mpl_error_log_detailed[3].er006 "CPU/MPU code segment protection register, upper" ULONG CU_MPL_ERROR_LOG_DETAILED[3]009 1 100 0.0 4294967295.0 ECU_ADDRESS 0xf02409ec BYTE_ORDER MSB_LAST /end MEASUREMENT
/begin COMPU_METHOD CU_MPL_ERROR_LOG_DETAILED[3]009 "Conversion method for mpl_error_log_detailed[3].err_log.cpu_log.cpr_upr[3]" RAT_FUNC "%10.0" "(not defined)" COEFFS 0.000000 1.000000 -0.000000 0.000000 0.000000 1.000000 /end COMPU_METHOD
/* Scalar measurable for DDE 'mpl_error_log_detailed[3].err_log.cpu_log.cpr_upr[4]'. */
/begin MEASUREMENT mpl_error_log_detailed[3].er019 "CPU/MPU code segment protection register, upper" ULONG CU_MPL_ERROR_LOG_DETAILED[3]022 1 100 0.0 4294967295.0 ECU_ADDRESS 0xf02409f0 BYTE_ORDER MSB_LAST /end MEASUREMENT
/begin COMPU_METHOD CU_MPL_ERROR_LOG_DETAILED[3]022 "Conversion method for mpl_error_log_detailed[3].err_log.cpu_log.cpr_upr[4]" RAT_FUNC "%10.0" "(not defined)" COEFFS 0.000000 1.000000 -0.000000 0.000000 0.000000 1.000000 /end COMPU_METHOD
/* Scalar measurable for DDE 'mpl_error_log_detailed[3].err_log.cpu_log.cpr_upr[5]'. */
/begin MEASUREMENT mpl_error_log_detailed[3].err_2 "CPU/MPU code segment protection register, upper" ULONG CU_MPL_ERROR_LOG_DETAILED[3].E2 1 100 0.0 4294967295.0 ECU_ADDRESS 0xf02409f4 BYTE_ORDER MSB_LAST /end MEASUREMENT
/begin COMPU_METHOD CU_MPL_ERROR_LOG_DETAILED[3].E2 "Conversion method for mpl_error_log_detailed[3].err_log.cpu_log.cpr_upr[5]" RAT_FUNC "%10.0" "(not defined)" COEFFS 0.000000 1.000000 -0.000000 0.000000 0.000000 1.000000 /end COMPU_METHOD
/* Scalar measurable for DDE 'mpl_error_log_detailed[3].err_log.cpu_log.cpr_upr[6]'. */
/begin MEASUREMENT mpl_error_log_detailed[3].err01 "CPU/MPU code segment protection register, upper" ULONG CU_MPL_ERROR_LOG_DETAILED[3].02 1 100 0.0 4294967295.0 ECU_ADDRESS 0xf02409f8 BYTE_ORDER MSB_LAST /end MEASUREMENT
/begin COMPU_METHOD CU_MPL_ERROR_LOG_DETAILED[3].02 "Conversion method for mpl_error_log_detailed[3].err_log.cpu_log.cpr_upr[6]" RAT_FUNC "%10.0" "(not defined)" COEFFS 0.000000 1.000000 -0.000000 0.000000 0.000000 1.000000 /end COMPU_METHOD
/* Scalar measurable for DDE 'mpl_error_log_detailed[3].err_log.cpu_log.cpr_upr[7]'. */
/begin MEASUREMENT mpl_error_log_detailed[3].err_8 "CPU/MPU code segment protection register, upper" ULONG CU_MPL_ERROR_LOG_DETAILED[3].E9 1 100 0.0 4294967295.0 ECU_ADDRESS 0xf02409fc BYTE_ORDER MSB_LAST /end MEASUREMENT
/begin COMPU_METHOD CU_MPL_ERROR_LOG_DETAILED[3].E9 "Conversion method for mpl_error_log_detailed[3].err_log.cpu_log.cpr_upr[7]" RAT_FUNC "%10.0" "(not defined)" COEFFS 0.000000 1.000000 -0.000000 0.000000 0.000000 1.000000 /end COMPU_METHOD
/* Scalar measurable for DDE 'mpl_error_log_detailed[3].err_log.cpu_log.cpr_upr[8]'. */
/begin MEASUREMENT mpl_error_log_detailed[3].err_0 "CPU/MPU code segment protection register, upper" ULONG CU_MPL_ERROR_LOG_DETAILED[3].E0 1 100 0.0 4294967295.0 ECU_ADDRESS 0xf0240a00 BYTE_ORDER MSB_LAST /end MEASUREMENT
/begin COMPU_METHOD CU_MPL_ERROR_LOG_DETAILED[3].E0 "Conversion method for mpl_error_log_detailed[3].err_log.cpu_log.cpr_upr[8]" RAT_FUNC "%10.0" "(not defined)" COEFFS 0.000000 1.000000 -0.000000 0.000000 0.000000 1.000000 /end COMPU_METHOD
/* Scalar measurable for DDE 'mpl_error_log_detailed[3].err_log.cpu_log.cpr_upr[9]'. */
/begin MEASUREMENT mpl_error_log_detailed[3].err02 "CPU/MPU code segment protection register, upper" ULONG CU_MPL_ERROR_LOG_DETAILED[3].03 1 100 0.0 4294967295.0 ECU_ADDRESS 0xf0240a04 BYTE_ORDER MSB_LAST /end MEASUREMENT
/begin COMPU_METHOD CU_MPL_ERROR_LOG_DETAILED[3].03 "Conversion method for mpl_error_log_detailed[3].err_log.cpu_log.cpr_upr[9]" RAT_FUNC "%10.0" "(not defined)" COEFFS 0.000000 1.000000 -0.000000 0.000000 0.000000 1.000000 /end COMPU_METHOD
/* Scalar measurable for DDE 'mpl_error_log_detailed[3].err_log.cpu_log.cpxe[0]'. */
/begin MEASUREMENT mpl_error_log_detailed[3].err89 "CPU/MPU code protection execution enable configuration register" ULONG CU_MPL_ERROR_LOG_DETAILED[3].92 1 100 0.0 4294967295.0 ECU_ADDRESS 0xf0240a08 BYTE_ORDER MSB_LAST /end MEASUREMENT
/begin COMPU_METHOD CU_MPL_ERROR_LOG_DETAILED[3].92 "Conversion method for mpl_error_log_detailed[3].err_log.cpu_log.cpxe[0]" RAT_FUNC "%10.0" "(not defined)" COEFFS 0.000000 1.000000 -0.000000 0.000000 0.000000 1.000000 /end COMPU_METHOD
/* Scalar measurable for DDE 'mpl_error_log_detailed[3].err_log.cpu_log.cpxe[1]'. */
/begin MEASUREMENT mpl_error_log_detailed[3].err06 "CPU/MPU code protection execution enable configuration register" ULONG CU_MPL_ERROR_LOG_DETAILED[3].07 1 100 0.0 4294967295.0 ECU_ADDRESS 0xf0240a0c BYTE_ORDER MSB_LAST /end MEASUREMENT
/begin COMPU_METHOD CU_MPL_ERROR_LOG_DETAILED[3].07 "Conversion method for mpl_error_log_detailed[3].err_log.cpu_log.cpxe[1]" RAT_FUNC "%10.0" "(not defined)" COEFFS 0.000000 1.000000 -0.000000 0.000000 0.000000 1.000000 /end COMPU_METHOD
/* Scalar measurable for DDE 'mpl_error_log_detailed[3].err_log.cpu_log.cpxe[2]'. */
/begin MEASUREMENT mpl_error_log_detailed[3].err63 "CPU/MPU code protection execution enable configuration register" ULONG CU_MPL_ERROR_LOG_DETAILED[3].66 1 100 0.0 4294967295.0 ECU_ADDRESS 0xf0240a10 BYTE_ORDER MSB_LAST /end MEASUREMENT
/begin COMPU_METHOD CU_MPL_ERROR_LOG_DETAILED[3].66 "Conversion method for mpl_error_log_detailed[3].err_log.cpu_log.cpxe[2]" RAT_FUNC "%10.0" "(not defined)" COEFFS 0.000000 1.000000 -0.000000 0.000000 0.000000 1.000000 /end COMPU_METHOD
/* Scalar measurable for DDE 'mpl_error_log_detailed[3].err_log.cpu_log.cpxe[3]'. */
/begin MEASUREMENT mpl_error_log_detailed[3].err55 "CPU/MPU code protection execution enable configuration register" ULONG CU_MPL_ERROR_LOG_DETAILED[3].58 1 100 0.0 4294967295.0 ECU_ADDRESS 0xf0240a14 BYTE_ORDER MSB_LAST /end MEASUREMENT
/begin COMPU_METHOD CU_MPL_ERROR_LOG_DETAILED[3].58 "Conversion method for mpl_error_log_detailed[3].err_log.cpu_log.cpxe[3]" RAT_FUNC "%10.0" "(not defined)" COEFFS 0.000000 1.000000 -0.000000 0.000000 0.000000 1.000000 /end COMPU_METHOD
/* Scalar measurable for DDE 'mpl_error_log_detailed[3].err_log.cpu_log.cpxe[4]'. */
/begin MEASUREMENT mpl_error_log_detailed[3].err47 "CPU/MPU code protection execution enable configuration register" ULONG CU_MPL_ERROR_LOG_DETAILED[3].49 1 100 0.0 4294967295.0 ECU_ADDRESS 0xf0240a18 BYTE_ORDER MSB_LAST /end MEASUREMENT
/begin COMPU_METHOD CU_MPL_ERROR_LOG_DETAILED[3].49 "Conversion method for mpl_error_log_detailed[3].err_log.cpu_log.cpxe[4]" RAT_FUNC "%10.0" "(not defined)" COEFFS 0.000000 1.000000 -0.000000 0.000000 0.000000 1.000000 /end COMPU_METHOD
/* Scalar measurable for DDE 'mpl_error_log_detailed[3].err_log.cpu_log.cpxe[5]'. */
/begin MEASUREMENT mpl_error_log_detailed[3].err30 "CPU/MPU code protection execution enable configuration register" ULONG CU_MPL_ERROR_LOG_DETAILED[3].32 1 100 0.0 4294967295.0 ECU_ADDRESS 0xf0240a1c BYTE_ORDER MSB_LAST /end MEASUREMENT
/begin COMPU_METHOD CU_MPL_ERROR_LOG_DETAILED[3].32 "Conversion method for mpl_error_log_detailed[3].err_log.cpu_log.cpxe[5]" RAT_FUNC "%10.0" "(not defined)" COEFFS 0.000000 1.000000 -0.000000 0.000000 0.000000 1.000000 /end COMPU_METHOD
/* Scalar measurable for DDE 'mpl_error_log_detailed[3].err_log.cpu_log.datr'. */
/begin MEASUREMENT mpl_error_log_detailed[3].er021 "CPU data asynchronous error trap register" ULONG CU_MPL_ERROR_LOG_DETAILED[3]024 1 100 0.0 4294967295.0 ECU_ADDRESS 0xf02408ec BYTE_ORDER MSB_LAST /end MEASUREMENT
/begin COMPU_METHOD CU_MPL_ERROR_LOG_DETAILED[3]024 "Conversion method for mpl_error_log_detailed[3].err_log.cpu_log.datr" RAT_FUNC "%10.0" "(not defined)" COEFFS 0.000000 1.000000 -0.000000 0.000000 0.000000 1.000000 /end COMPU_METHOD
/* Scalar measurable for DDE 'mpl_error_log_detailed[3].err_log.cpu_log.deadd'. */
/begin MEASUREMENT mpl_error_log_detailed[3].err62 "CPU data error address register" ULONG CU_MPL_ERROR_LOG_DETAILED[3].65 1 100 0.0 4294967295.0 ECU_ADDRESS 0xf02408f0 BYTE_ORDER MSB_LAST /end MEASUREMENT
/begin COMPU_METHOD CU_MPL_ERROR_LOG_DETAILED[3].65 "Conversion method for mpl_error_log_detailed[3].err_log.cpu_log.deadd" RAT_FUNC "%10.0" "(not defined)" COEFFS 0.000000 1.000000 -0.000000 0.000000 0.000000 1.000000 /end COMPU_METHOD
/* Scalar measurable for DDE 'mpl_error_log_detailed[3].err_log.cpu_log.diear'. */
/begin MEASUREMENT mpl_error_log_detailed[3].er040 "CPU data integrity error address register" ULONG CU_MPL_ERROR_LOG_DETAILED[3]043 1 100 0.0 4294967295.0 ECU_ADDRESS 0xf02408f4 BYTE_ORDER MSB_LAST /end MEASUREMENT
/begin COMPU_METHOD CU_MPL_ERROR_LOG_DETAILED[3]043 "Conversion method for mpl_error_log_detailed[3].err_log.cpu_log.diear" RAT_FUNC "%10.0" "(not defined)" COEFFS 0.000000 1.000000 -0.000000 0.000000 0.000000 1.000000 /end COMPU_METHOD
/* Scalar measurable for DDE 'mpl_error_log_detailed[3].err_log.cpu_log.dietr'. */
/begin MEASUREMENT mpl_error_log_detailed[3].er023 "CPU data integrity error trap register" ULONG CU_MPL_ERROR_LOG_DETAILED[3]026 1 100 0.0 4294967295.0 ECU_ADDRESS 0xf02408f8 BYTE_ORDER MSB_LAST /end MEASUREMENT
/begin COMPU_METHOD CU_MPL_ERROR_LOG_DETAILED[3]026 "Conversion method for mpl_error_log_detailed[3].err_log.cpu_log.dietr" RAT_FUNC "%10.0" "(not defined)" COEFFS 0.000000 1.000000 -0.000000 0.000000 0.000000 1.000000 /end COMPU_METHOD
/* Scalar measurable for DDE 'mpl_error_log_detailed[3].err_log.cpu_log.dpr_low[0]'. */
/begin MEASUREMENT mpl_error_log_detailed[3].er042 "CPU/MPU data segment protection register, lower" ULONG CU_MPL_ERROR_LOG_DETAILED[3]045 1 100 0.0 4294967295.0 ECU_ADDRESS 0xf0240928 BYTE_ORDER MSB_LAST /end MEASUREMENT
/begin COMPU_METHOD CU_MPL_ERROR_LOG_DETAILED[3]045 "Conversion method for mpl_error_log_detailed[3].err_log.cpu_log.dpr_low[0]" RAT_FUNC "%10.0" "(not defined)" COEFFS 0.000000 1.000000 -0.000000 0.000000 0.000000 1.000000 /end COMPU_METHOD
/* Scalar measurable for DDE 'mpl_error_log_detailed[3].err_log.cpu_log.dpr_low[10]'. */
/begin MEASUREMENT mpl_error_log_detailed[3].err21 "CPU/MPU data segment protection register, lower" ULONG CU_MPL_ERROR_LOG_DETAILED[3].23 1 100 0.0 4294967295.0 ECU_ADDRESS 0xf0240950 BYTE_ORDER MSB_LAST /end MEASUREMENT
/begin COMPU_METHOD CU_MPL_ERROR_LOG_DETAILED[3].23 "Conversion method for mpl_error_log_detailed[3].err_log.cpu_log.dpr_low[10]" RAT_FUNC "%10.0" "(not defined)" COEFFS 0.000000 1.000000 -0.000000 0.000000 0.000000 1.000000 /end COMPU_METHOD
/* Scalar measurable for DDE 'mpl_error_log_detailed[3].err_log.cpu_log.dpr_low[11]'. */
/begin MEASUREMENT mpl_error_log_detailed[3].err92 "CPU/MPU data segment protection register, lower" ULONG CU_MPL_ERROR_LOG_DETAILED[3].95 1 100 0.0 4294967295.0 ECU_ADDRESS 0xf0240954 BYTE_ORDER MSB_LAST /end MEASUREMENT
/begin COMPU_METHOD CU_MPL_ERROR_LOG_DETAILED[3].95 "Conversion method for mpl_error_log_detailed[3].err_log.cpu_log.dpr_low[11]" RAT_FUNC "%10.0" "(not defined)" COEFFS 0.000000 1.000000 -0.000000 0.000000 0.000000 1.000000 /end COMPU_METHOD
/* Scalar measurable for DDE 'mpl_error_log_detailed[3].err_log.cpu_log.dpr_low[12]'. */
/begin MEASUREMENT mpl_error_log_detailed[3].err38 "CPU/MPU data segment protection register, lower" ULONG CU_MPL_ERROR_LOG_DETAILED[3].40 1 100 0.0 4294967295.0 ECU_ADDRESS 0xf0240958 BYTE_ORDER MSB_LAST /end MEASUREMENT
/begin COMPU_METHOD CU_MPL_ERROR_LOG_DETAILED[3].40 "Conversion method for mpl_error_log_detailed[3].err_log.cpu_log.dpr_low[12]" RAT_FUNC "%10.0" "(not defined)" COEFFS 0.000000 1.000000 -0.000000 0.000000 0.000000 1.000000 /end COMPU_METHOD
/* Scalar measurable for DDE 'mpl_error_log_detailed[3].err_log.cpu_log.dpr_low[13]'. */
/begin MEASUREMENT mpl_error_log_detailed[3].err24 "CPU/MPU data segment protection register, lower" ULONG CU_MPL_ERROR_LOG_DETAILED[3].26 1 100 0.0 4294967295.0 ECU_ADDRESS 0xf024095c BYTE_ORDER MSB_LAST /end MEASUREMENT
/begin COMPU_METHOD CU_MPL_ERROR_LOG_DETAILED[3].26 "Conversion method for mpl_error_log_detailed[3].err_log.cpu_log.dpr_low[13]" RAT_FUNC "%10.0" "(not defined)" COEFFS 0.000000 1.000000 -0.000000 0.000000 0.000000 1.000000 /end COMPU_METHOD
/* Scalar measurable for DDE 'mpl_error_log_detailed[3].err_log.cpu_log.dpr_low[14]'. */
/begin MEASUREMENT mpl_error_log_detailed[3].er022 "CPU/MPU data segment protection register, lower" ULONG CU_MPL_ERROR_LOG_DETAILED[3]025 1 100 0.0 4294967295.0 ECU_ADDRESS 0xf0240960 BYTE_ORDER MSB_LAST /end MEASUREMENT
/begin COMPU_METHOD CU_MPL_ERROR_LOG_DETAILED[3]025 "Conversion method for mpl_error_log_detailed[3].err_log.cpu_log.dpr_low[14]" RAT_FUNC "%10.0" "(not defined)" COEFFS 0.000000 1.000000 -0.000000 0.000000 0.000000 1.000000 /end COMPU_METHOD
/* Scalar measurable for DDE 'mpl_error_log_detailed[3].err_log.cpu_log.dpr_low[15]'. */
/begin MEASUREMENT mpl_error_log_detailed[3].er046 "CPU/MPU data segment protection register, lower" ULONG CU_MPL_ERROR_LOG_DETAILED[3]049 1 100 0.0 4294967295.0 ECU_ADDRESS 0xf0240964 BYTE_ORDER MSB_LAST /end MEASUREMENT
/begin COMPU_METHOD CU_MPL_ERROR_LOG_DETAILED[3]049 "Conversion method for mpl_error_log_detailed[3].err_log.cpu_log.dpr_low[15]" RAT_FUNC "%10.0" "(not defined)" COEFFS 0.000000 1.000000 -0.000000 0.000000 0.000000 1.000000 /end COMPU_METHOD
/* Scalar measurable for DDE 'mpl_error_log_detailed[3].err_log.cpu_log.dpr_low[16]'. */
/begin MEASUREMENT mpl_error_log_detailed[3].err_7 "CPU/MPU data segment protection register, lower" ULONG CU_MPL_ERROR_LOG_DETAILED[3].E8 1 100 0.0 4294967295.0 ECU_ADDRESS 0xf0240968 BYTE_ORDER MSB_LAST /end MEASUREMENT
/begin COMPU_METHOD CU_MPL_ERROR_LOG_DETAILED[3].E8 "Conversion method for mpl_error_log_detailed[3].err_log.cpu_log.dpr_low[16]" RAT_FUNC "%10.0" "(not defined)" COEFFS 0.000000 1.000000 -0.000000 0.000000 0.000000 1.000000 /end COMPU_METHOD
/* Scalar measurable for DDE 'mpl_error_log_detailed[3].err_log.cpu_log.dpr_low[17]'. */
/begin MEASUREMENT mpl_error_log_detailed[3].er043 "CPU/MPU data segment protection register, lower" ULONG CU_MPL_ERROR_LOG_DETAILED[3]046 1 100 0.0 4294967295.0 ECU_ADDRESS 0xf024096c BYTE_ORDER MSB_LAST /end MEASUREMENT
/begin COMPU_METHOD CU_MPL_ERROR_LOG_DETAILED[3]046 "Conversion method for mpl_error_log_detailed[3].err_log.cpu_log.dpr_low[17]" RAT_FUNC "%10.0" "(not defined)" COEFFS 0.000000 1.000000 -0.000000 0.000000 0.000000 1.000000 /end COMPU_METHOD
/* Scalar measurable for DDE 'mpl_error_log_detailed[3].err_log.cpu_log.dpr_low[1]'. */
/begin MEASUREMENT mpl_error_log_detailed[3].err_5 "CPU/MPU data segment protection register, lower" ULONG CU_MPL_ERROR_LOG_DETAILED[3].E6 1 100 0.0 4294967295.0 ECU_ADDRESS 0xf024092c BYTE_ORDER MSB_LAST /end MEASUREMENT
/begin COMPU_METHOD CU_MPL_ERROR_LOG_DETAILED[3].E6 "Conversion method for mpl_error_log_detailed[3].err_log.cpu_log.dpr_low[1]" RAT_FUNC "%10.0" "(not defined)" COEFFS 0.000000 1.000000 -0.000000 0.000000 0.000000 1.000000 /end COMPU_METHOD
/* Scalar measurable for DDE 'mpl_error_log_detailed[3].err_log.cpu_log.dpr_low[2]'. */
/begin MEASUREMENT mpl_error_log_detailed[3].er044 "CPU/MPU data segment protection register, lower" ULONG CU_MPL_ERROR_LOG_DETAILED[3]047 1 100 0.0 4294967295.0 ECU_ADDRESS 0xf0240930 BYTE_ORDER MSB_LAST /end MEASUREMENT
/begin COMPU_METHOD CU_MPL_ERROR_LOG_DETAILED[3]047 "Conversion method for mpl_error_log_detailed[3].err_log.cpu_log.dpr_low[2]" RAT_FUNC "%10.0" "(not defined)" COEFFS 0.000000 1.000000 -0.000000 0.000000 0.000000 1.000000 /end COMPU_METHOD
/* Scalar measurable for DDE 'mpl_error_log_detailed[3].err_log.cpu_log.dpr_low[3]'. */
/begin MEASUREMENT mpl_error_log_detailed[3].er024 "CPU/MPU data segment protection register, lower" ULONG CU_MPL_ERROR_LOG_DETAILED[3]027 1 100 0.0 4294967295.0 ECU_ADDRESS 0xf0240934 BYTE_ORDER MSB_LAST /end MEASUREMENT
/begin COMPU_METHOD CU_MPL_ERROR_LOG_DETAILED[3]027 "Conversion method for mpl_error_log_detailed[3].err_log.cpu_log.dpr_low[3]" RAT_FUNC "%10.0" "(not defined)" COEFFS 0.000000 1.000000 -0.000000 0.000000 0.000000 1.000000 /end COMPU_METHOD
/* Scalar measurable for DDE 'mpl_error_log_detailed[3].err_log.cpu_log.dpr_low[4]'. */
/begin MEASUREMENT mpl_error_log_detailed[3].err90 "CPU/MPU data segment protection register, lower" ULONG CU_MPL_ERROR_LOG_DETAILED[3].93 1 100 0.0 4294967295.0 ECU_ADDRESS 0xf0240938 BYTE_ORDER MSB_LAST /end MEASUREMENT
/begin COMPU_METHOD CU_MPL_ERROR_LOG_DETAILED[3].93 "Conversion method for mpl_error_log_detailed[3].err_log.cpu_log.dpr_low[4]" RAT_FUNC "%10.0" "(not defined)" COEFFS 0.000000 1.000000 -0.000000 0.000000 0.000000 1.000000 /end COMPU_METHOD
/* Scalar measurable for DDE 'mpl_error_log_detailed[3].err_log.cpu_log.dpr_low[5]'. */
/begin MEASUREMENT mpl_error_log_detailed[3].er004 "CPU/MPU data segment protection register, lower" ULONG CU_MPL_ERROR_LOG_DETAILED[3]007 1 100 0.0 4294967295.0 ECU_ADDRESS 0xf024093c BYTE_ORDER MSB_LAST /end MEASUREMENT
/begin COMPU_METHOD CU_MPL_ERROR_LOG_DETAILED[3]007 "Conversion method for mpl_error_log_detailed[3].err_log.cpu_log.dpr_low[5]" RAT_FUNC "%10.0" "(not defined)" COEFFS 0.000000 1.000000 -0.000000 0.000000 0.000000 1.000000 /end COMPU_METHOD
/* Scalar measurable for DDE 'mpl_error_log_detailed[3].err_log.cpu_log.dpr_low[6]'. */
/begin MEASUREMENT mpl_error_log_detailed[3].err32 "CPU/MPU data segment protection register, lower" ULONG CU_MPL_ERROR_LOG_DETAILED[3].34 1 100 0.0 4294967295.0 ECU_ADDRESS 0xf0240940 BYTE_ORDER MSB_LAST /end MEASUREMENT
/begin COMPU_METHOD CU_MPL_ERROR_LOG_DETAILED[3].34 "Conversion method for mpl_error_log_detailed[3].err_log.cpu_log.dpr_low[6]" RAT_FUNC "%10.0" "(not defined)" COEFFS 0.000000 1.000000 -0.000000 0.000000 0.000000 1.000000 /end COMPU_METHOD
/* Scalar measurable for DDE 'mpl_error_log_detailed[3].err_log.cpu_log.dpr_low[7]'. */
/begin MEASUREMENT mpl_error_log_detailed[3].err79 "CPU/MPU data segment protection register, lower" ULONG CU_MPL_ERROR_LOG_DETAILED[3].82 1 100 0.0 4294967295.0 ECU_ADDRESS 0xf0240944 BYTE_ORDER MSB_LAST /end MEASUREMENT
/begin COMPU_METHOD CU_MPL_ERROR_LOG_DETAILED[3].82 "Conversion method for mpl_error_log_detailed[3].err_log.cpu_log.dpr_low[7]" RAT_FUNC "%10.0" "(not defined)" COEFFS 0.000000 1.000000 -0.000000 0.000000 0.000000 1.000000 /end COMPU_METHOD
/* Scalar measurable for DDE 'mpl_error_log_detailed[3].err_log.cpu_log.dpr_low[8]'. */
/begin MEASUREMENT mpl_error_log_detailed[3].err49 "CPU/MPU data segment protection register, lower" ULONG CU_MPL_ERROR_LOG_DETAILED[3].51 1 100 0.0 4294967295.0 ECU_ADDRESS 0xf0240948 BYTE_ORDER MSB_LAST /end MEASUREMENT
/begin COMPU_METHOD CU_MPL_ERROR_LOG_DETAILED[3].51 "Conversion method for mpl_error_log_detailed[3].err_log.cpu_log.dpr_low[8]" RAT_FUNC "%10.0" "(not defined)" COEFFS 0.000000 1.000000 -0.000000 0.000000 0.000000 1.000000 /end COMPU_METHOD
/* Scalar measurable for DDE 'mpl_error_log_detailed[3].err_log.cpu_log.dpr_low[9]'. */
/begin MEASUREMENT mpl_error_log_detailed[3].err59 "CPU/MPU data segment protection register, lower" ULONG CU_MPL_ERROR_LOG_DETAILED[3].62 1 100 0.0 4294967295.0 ECU_ADDRESS 0xf024094c BYTE_ORDER MSB_LAST /end MEASUREMENT
/begin COMPU_METHOD CU_MPL_ERROR_LOG_DETAILED[3].62 "Conversion method for mpl_error_log_detailed[3].err_log.cpu_log.dpr_low[9]" RAT_FUNC "%10.0" "(not defined)" COEFFS 0.000000 1.000000 -0.000000 0.000000 0.000000 1.000000 /end COMPU_METHOD
/* Scalar measurable for DDE 'mpl_error_log_detailed[3].err_log.cpu_log.dpr_upr[0]'. */
/begin MEASUREMENT mpl_error_log_detailed[3].err20 "CPU/MPU data segment protection register, upper" ULONG CU_MPL_ERROR_LOG_DETAILED[3].22 1 100 0.0 4294967295.0 ECU_ADDRESS 0xf0240970 BYTE_ORDER MSB_LAST /end MEASUREMENT
/begin COMPU_METHOD CU_MPL_ERROR_LOG_DETAILED[3].22 "Conversion method for mpl_error_log_detailed[3].err_log.cpu_log.dpr_upr[0]" RAT_FUNC "%10.0" "(not defined)" COEFFS 0.000000 1.000000 -0.000000 0.000000 0.000000 1.000000 /end COMPU_METHOD
/* Scalar measurable for DDE 'mpl_error_log_detailed[3].err_log.cpu_log.dpr_upr[10]'. */
/begin MEASUREMENT mpl_error_log_detailed[3].err18 "CPU/MPU data segment protection register, upper" ULONG CU_MPL_ERROR_LOG_DETAILED[3].20 1 100 0.0 4294967295.0 ECU_ADDRESS 0xf0240998 BYTE_ORDER MSB_LAST /end MEASUREMENT
/begin COMPU_METHOD CU_MPL_ERROR_LOG_DETAILED[3].20 "Conversion method for mpl_error_log_detailed[3].err_log.cpu_log.dpr_upr[10]" RAT_FUNC "%10.0" "(not defined)" COEFFS 0.000000 1.000000 -0.000000 0.000000 0.000000 1.000000 /end COMPU_METHOD
/* Scalar measurable for DDE 'mpl_error_log_detailed[3].err_log.cpu_log.dpr_upr[11]'. */
/begin MEASUREMENT mpl_error_log_detailed[3].err68 "CPU/MPU data segment protection register, upper" ULONG CU_MPL_ERROR_LOG_DETAILED[3].71 1 100 0.0 4294967295.0 ECU_ADDRESS 0xf024099c BYTE_ORDER MSB_LAST /end MEASUREMENT
/begin COMPU_METHOD CU_MPL_ERROR_LOG_DETAILED[3].71 "Conversion method for mpl_error_log_detailed[3].err_log.cpu_log.dpr_upr[11]" RAT_FUNC "%10.0" "(not defined)" COEFFS 0.000000 1.000000 -0.000000 0.000000 0.000000 1.000000 /end COMPU_METHOD
/* Scalar measurable for DDE 'mpl_error_log_detailed[3].err_log.cpu_log.dpr_upr[12]'. */
/begin MEASUREMENT mpl_error_log_detailed[3].err45 "CPU/MPU data segment protection register, upper" ULONG CU_MPL_ERROR_LOG_DETAILED[3].47 1 100 0.0 4294967295.0 ECU_ADDRESS 0xf02409a0 BYTE_ORDER MSB_LAST /end MEASUREMENT
/begin COMPU_METHOD CU_MPL_ERROR_LOG_DETAILED[3].47 "Conversion method for mpl_error_log_detailed[3].err_log.cpu_log.dpr_upr[12]" RAT_FUNC "%10.0" "(not defined)" COEFFS 0.000000 1.000000 -0.000000 0.000000 0.000000 1.000000 /end COMPU_METHOD
/* Scalar measurable for DDE 'mpl_error_log_detailed[3].err_log.cpu_log.dpr_upr[13]'. */
/begin MEASUREMENT mpl_error_log_detailed[3].err83 "CPU/MPU data segment protection register, upper" ULONG CU_MPL_ERROR_LOG_DETAILED[3].86 1 100 0.0 4294967295.0 ECU_ADDRESS 0xf02409a4 BYTE_ORDER MSB_LAST /end MEASUREMENT
/begin COMPU_METHOD CU_MPL_ERROR_LOG_DETAILED[3].86 "Conversion method for mpl_error_log_detailed[3].err_log.cpu_log.dpr_upr[13]" RAT_FUNC "%10.0" "(not defined)" COEFFS 0.000000 1.000000 -0.000000 0.000000 0.000000 1.000000 /end COMPU_METHOD
/* Scalar measurable for DDE 'mpl_error_log_detailed[3].err_log.cpu_log.dpr_upr[14]'. */
/begin MEASUREMENT mpl_error_log_detailed[3].err00 "CPU/MPU data segment protection register, upper" ULONG CU_MPL_ERROR_LOG_DETAILED[3].01 1 100 0.0 4294967295.0 ECU_ADDRESS 0xf02409a8 BYTE_ORDER MSB_LAST /end MEASUREMENT
/begin COMPU_METHOD CU_MPL_ERROR_LOG_DETAILED[3].01 "Conversion method for mpl_error_log_detailed[3].err_log.cpu_log.dpr_upr[14]" RAT_FUNC "%10.0" "(not defined)" COEFFS 0.000000 1.000000 -0.000000 0.000000 0.000000 1.000000 /end COMPU_METHOD
/* Scalar measurable for DDE 'mpl_error_log_detailed[3].err_log.cpu_log.dpr_upr[15]'. */
/begin MEASUREMENT mpl_error_log_detailed[3].er018 "CPU/MPU data segment protection register, upper" ULONG CU_MPL_ERROR_LOG_DETAILED[3]021 1 100 0.0 4294967295.0 ECU_ADDRESS 0xf02409ac BYTE_ORDER MSB_LAST /end MEASUREMENT
/begin COMPU_METHOD CU_MPL_ERROR_LOG_DETAILED[3]021 "Conversion method for mpl_error_log_detailed[3].err_log.cpu_log.dpr_upr[15]" RAT_FUNC "%10.0" "(not defined)" COEFFS 0.000000 1.000000 -0.000000 0.000000 0.000000 1.000000 /end COMPU_METHOD
/* Scalar measurable for DDE 'mpl_error_log_detailed[3].err_log.cpu_log.dpr_upr[16]'. */
/begin MEASUREMENT mpl_error_log_detailed[3].err85 "CPU/MPU data segment protection register, upper" ULONG CU_MPL_ERROR_LOG_DETAILED[3].88 1 100 0.0 4294967295.0 ECU_ADDRESS 0xf02409b0 BYTE_ORDER MSB_LAST /end MEASUREMENT
/begin COMPU_METHOD CU_MPL_ERROR_LOG_DETAILED[3].88 "Conversion method for mpl_error_log_detailed[3].err_log.cpu_log.dpr_upr[16]" RAT_FUNC "%10.0" "(not defined)" COEFFS 0.000000 1.000000 -0.000000 0.000000 0.000000 1.000000 /end COMPU_METHOD
/* Scalar measurable for DDE 'mpl_error_log_detailed[3].err_log.cpu_log.dpr_upr[17]'. */
/begin MEASUREMENT mpl_error_log_detailed[3].err57 "CPU/MPU data segment protection register, upper" ULONG CU_MPL_ERROR_LOG_DETAILED[3].60 1 100 0.0 4294967295.0 ECU_ADDRESS 0xf02409b4 BYTE_ORDER MSB_LAST /end MEASUREMENT
/begin COMPU_METHOD CU_MPL_ERROR_LOG_DETAILED[3].60 "Conversion method for mpl_error_log_detailed[3].err_log.cpu_log.dpr_upr[17]" RAT_FUNC "%10.0" "(not defined)" COEFFS 0.000000 1.000000 -0.000000 0.000000 0.000000 1.000000 /end COMPU_METHOD
/* Scalar measurable for DDE 'mpl_error_log_detailed[3].err_log.cpu_log.dpr_upr[1]'. */
/begin MEASUREMENT mpl_error_log_detailed[3].err_6 "CPU/MPU data segment protection register, upper" ULONG CU_MPL_ERROR_LOG_DETAILED[3].E7 1 100 0.0 4294967295.0 ECU_ADDRESS 0xf0240974 BYTE_ORDER MSB_LAST /end MEASUREMENT
/begin COMPU_METHOD CU_MPL_ERROR_LOG_DETAILED[3].E7 "Conversion method for mpl_error_log_detailed[3].err_log.cpu_log.dpr_upr[1]" RAT_FUNC "%10.0" "(not defined)" COEFFS 0.000000 1.000000 -0.000000 0.000000 0.000000 1.000000 /end COMPU_METHOD
/* Scalar measurable for DDE 'mpl_error_log_detailed[3].err_log.cpu_log.dpr_upr[2]'. */
/begin MEASUREMENT mpl_error_log_detailed[3].err_4 "CPU/MPU data segment protection register, upper" ULONG CU_MPL_ERROR_LOG_DETAILED[3].E5 1 100 0.0 4294967295.0 ECU_ADDRESS 0xf0240978 BYTE_ORDER MSB_LAST /end MEASUREMENT
/begin COMPU_METHOD CU_MPL_ERROR_LOG_DETAILED[3].E5 "Conversion method for mpl_error_log_detailed[3].err_log.cpu_log.dpr_upr[2]" RAT_FUNC "%10.0" "(not defined)" COEFFS 0.000000 1.000000 -0.000000 0.000000 0.000000 1.000000 /end COMPU_METHOD
/* Scalar measurable for DDE 'mpl_error_log_detailed[3].err_log.cpu_log.dpr_upr[3]'. */
/begin MEASUREMENT mpl_error_log_detailed[3].err09 "CPU/MPU data segment protection register, upper" ULONG CU_MPL_ERROR_LOG_DETAILED[3].11 1 100 0.0 4294967295.0 ECU_ADDRESS 0xf024097c BYTE_ORDER MSB_LAST /end MEASUREMENT
/begin COMPU_METHOD CU_MPL_ERROR_LOG_DETAILED[3].11 "Conversion method for mpl_error_log_detailed[3].err_log.cpu_log.dpr_upr[3]" RAT_FUNC "%10.0" "(not defined)" COEFFS 0.000000 1.000000 -0.000000 0.000000 0.000000 1.000000 /end COMPU_METHOD
/* Scalar measurable for DDE 'mpl_error_log_detailed[3].err_log.cpu_log.dpr_upr[4]'. */
/begin MEASUREMENT mpl_error_log_detailed[3].err52 "CPU/MPU data segment protection register, upper" ULONG CU_MPL_ERROR_LOG_DETAILED[3].55 1 100 0.0 4294967295.0 ECU_ADDRESS 0xf0240980 BYTE_ORDER MSB_LAST /end MEASUREMENT
/begin COMPU_METHOD CU_MPL_ERROR_LOG_DETAILED[3].55 "Conversion method for mpl_error_log_detailed[3].err_log.cpu_log.dpr_upr[4]" RAT_FUNC "%10.0" "(not defined)" COEFFS 0.000000 1.000000 -0.000000 0.000000 0.000000 1.000000 /end COMPU_METHOD
/* Scalar measurable for DDE 'mpl_error_log_detailed[3].err_log.cpu_log.dpr_upr[5]'. */
/begin MEASUREMENT mpl_error_log_detailed[3].err31 "CPU/MPU data segment protection register, upper" ULONG CU_MPL_ERROR_LOG_DETAILED[3].33 1 100 0.0 4294967295.0 ECU_ADDRESS 0xf0240984 BYTE_ORDER MSB_LAST /end MEASUREMENT
/begin COMPU_METHOD CU_MPL_ERROR_LOG_DETAILED[3].33 "Conversion method for mpl_error_log_detailed[3].err_log.cpu_log.dpr_upr[5]" RAT_FUNC "%10.0" "(not defined)" COEFFS 0.000000 1.000000 -0.000000 0.000000 0.000000 1.000000 /end COMPU_METHOD
/* Scalar measurable for DDE 'mpl_error_log_detailed[3].err_log.cpu_log.dpr_upr[6]'. */
/begin MEASUREMENT mpl_error_log_detailed[3].err72 "CPU/MPU data segment protection register, upper" ULONG CU_MPL_ERROR_LOG_DETAILED[3].75 1 100 0.0 4294967295.0 ECU_ADDRESS 0xf0240988 BYTE_ORDER MSB_LAST /end MEASUREMENT
/begin COMPU_METHOD CU_MPL_ERROR_LOG_DETAILED[3].75 "Conversion method for mpl_error_log_detailed[3].err_log.cpu_log.dpr_upr[6]" RAT_FUNC "%10.0" "(not defined)" COEFFS 0.000000 1.000000 -0.000000 0.000000 0.000000 1.000000 /end COMPU_METHOD
/* Scalar measurable for DDE 'mpl_error_log_detailed[3].err_log.cpu_log.dpr_upr[7]'. */
/begin MEASUREMENT mpl_error_log_detailed[3].err27 "CPU/MPU data segment protection register, upper" ULONG CU_MPL_ERROR_LOG_DETAILED[3].29 1 100 0.0 4294967295.0 ECU_ADDRESS 0xf024098c BYTE_ORDER MSB_LAST /end MEASUREMENT
/begin COMPU_METHOD CU_MPL_ERROR_LOG_DETAILED[3].29 "Conversion method for mpl_error_log_detailed[3].err_log.cpu_log.dpr_upr[7]" RAT_FUNC "%10.0" "(not defined)" COEFFS 0.000000 1.000000 -0.000000 0.000000 0.000000 1.000000 /end COMPU_METHOD
/* Scalar measurable for DDE 'mpl_error_log_detailed[3].err_log.cpu_log.dpr_upr[8]'. */
/begin MEASUREMENT mpl_error_log_detailed[3].err84 "CPU/MPU data segment protection register, upper" ULONG CU_MPL_ERROR_LOG_DETAILED[3].87 1 100 0.0 4294967295.0 ECU_ADDRESS 0xf0240990 BYTE_ORDER MSB_LAST /end MEASUREMENT
/begin COMPU_METHOD CU_MPL_ERROR_LOG_DETAILED[3].87 "Conversion method for mpl_error_log_detailed[3].err_log.cpu_log.dpr_upr[8]" RAT_FUNC "%10.0" "(not defined)" COEFFS 0.000000 1.000000 -0.000000 0.000000 0.000000 1.000000 /end COMPU_METHOD
/* Scalar measurable for DDE 'mpl_error_log_detailed[3].err_log.cpu_log.dpr_upr[9]'. */
/begin MEASUREMENT mpl_error_log_detailed[3].err23 "CPU/MPU data segment protection register, upper" ULONG CU_MPL_ERROR_LOG_DETAILED[3].25 1 100 0.0 4294967295.0 ECU_ADDRESS 0xf0240994 BYTE_ORDER MSB_LAST /end MEASUREMENT
/begin COMPU_METHOD CU_MPL_ERROR_LOG_DETAILED[3].25 "Conversion method for mpl_error_log_detailed[3].err_log.cpu_log.dpr_upr[9]" RAT_FUNC "%10.0" "(not defined)" COEFFS 0.000000 1.000000 -0.000000 0.000000 0.000000 1.000000 /end COMPU_METHOD
/* Scalar measurable for DDE 'mpl_error_log_detailed[3].err_log.cpu_log.dpre[0]'. */
/begin MEASUREMENT mpl_error_log_detailed[3].er009 "CPU/MPU data protection read enable configuration register" ULONG CU_MPL_ERROR_LOG_DETAILED[3]012 1 100 0.0 4294967295.0 ECU_ADDRESS 0xf0240a20 BYTE_ORDER MSB_LAST /end MEASUREMENT
/begin COMPU_METHOD CU_MPL_ERROR_LOG_DETAILED[3]012 "Conversion method for mpl_error_log_detailed[3].err_log.cpu_log.dpre[0]" RAT_FUNC "%10.0" "(not defined)" COEFFS 0.000000 1.000000 -0.000000 0.000000 0.000000 1.000000 /end COMPU_METHOD
/* Scalar measurable for DDE 'mpl_error_log_detailed[3].err_log.cpu_log.dpre[1]'. */
/begin MEASUREMENT mpl_error_log_detailed[3].err34 "CPU/MPU data protection read enable configuration register" ULONG CU_MPL_ERROR_LOG_DETAILED[3].36 1 100 0.0 4294967295.0 ECU_ADDRESS 0xf0240a24 BYTE_ORDER MSB_LAST /end MEASUREMENT
/begin COMPU_METHOD CU_MPL_ERROR_LOG_DETAILED[3].36 "Conversion method for mpl_error_log_detailed[3].err_log.cpu_log.dpre[1]" RAT_FUNC "%10.0" "(not defined)" COEFFS 0.000000 1.000000 -0.000000 0.000000 0.000000 1.000000 /end COMPU_METHOD
/* Scalar measurable for DDE 'mpl_error_log_detailed[3].err_log.cpu_log.dpre[2]'. */
/begin MEASUREMENT mpl_error_log_detailed[3].er034 "CPU/MPU data protection read enable configuration register" ULONG CU_MPL_ERROR_LOG_DETAILED[3]037 1 100 0.0 4294967295.0 ECU_ADDRESS 0xf0240a28 BYTE_ORDER MSB_LAST /end MEASUREMENT
/begin COMPU_METHOD CU_MPL_ERROR_LOG_DETAILED[3]037 "Conversion method for mpl_error_log_detailed[3].err_log.cpu_log.dpre[2]" RAT_FUNC "%10.0" "(not defined)" COEFFS 0.000000 1.000000 -0.000000 0.000000 0.000000 1.000000 /end COMPU_METHOD
/begin FUNCTION Automatic "Group /ByType/Automatic"
 /begin LOC_MEASUREMENT mpl_error_log_detailed[1].err00 mpl_error_log_detailed[1].err_9 mpl_error_log_detailed[1].err_8 mpl_error_log_detailed[1].err_7 mpl_error_log_detailed[1].err_6 mpl_error_log_detailed[1].err62 mpl_error_log_detailed[1].err_5 mpl_error_log_detailed[1].err26 mpl_error_log_detailed[1].err10 mpl_error_log_detailed[1].err08 mpl_error_log_detailed[1].er013 mpl_error_log_detailed[1].err46 mpl_error_log_detailed[1].err45 mpl_error_log_detailed[1].err44 mpl_error_log_detailed[1].err18 mpl_error_log_detailed[1].er022 mpl_error_log_detailed[1].er023 mpl_error_log_detailed[1].er039 mpl_error_log_detailed[1].err16 mpl_error_log_detailed[1].err17 mpl_error_log_detailed[1].er004 mpl_error_log_detailed[1].er005 mpl_error_log_detailed[1].err54 mpl_error_log_detailed[1].err_2 mpl_error_log_detailed[1].err33 mpl_error_log_detailed[1].err63 mpl_error_log_detailed[1].err56 mpl_error_log_detailed[1].err95 mpl_error_log_detailed[1].err65 mpl_error_log_detailed[1].err41 mpl_error_log_detailed[1].er045 mpl_error_log_detailed[1].er032 mpl_error_log_detailed[1].err15 mpl_error_log_detailed[1].er037 mpl_error_log_detailed[1].er008 mpl_error_log_detailed[1].err82 mpl_error_log_detailed[1].err69 mpl_error_log_detailed[1].err87 mpl_error_log_detailed[1].err76 mpl_error_log_detailed[1].er031 mpl_error_log_detailed[1].err12 mpl_error_log_detailed[1].err22 mpl_error_log_detailed[1].err75 mpl_error_log_detailed[1].err86 mpl_error_log_detailed[1].err51 mpl_error_log_detailed[1].err60 mpl_error_log_detailed[1].err97 mpl_error_log_detailed[1].er030 mpl_error_log_detailed[2].err.2 mpl_error_log_detailed[2].err.0 mpl_error_log_detailed[2].err.1 mpl_error_log_detailed[2].err21 mpl_error_log_detailed[2].err_1 mpl_error_log_detailed[2].err_3 mpl_error_log_detailed[2].er007 mpl_error_log_detailed[2].err45 mpl_error_log_detailed[2].er029 mpl_error_log_detailed[2].err75 mpl_error_log_detailed[2].er022 mpl_error_log_detailed[2].err87 mpl_error_log_detailed[2].er002 mpl_error_log_detailed[2].er005 mpl_error_log_detailed[2].err99 mpl_error_log_detailed[2].err77 mpl_error_log_detailed[2].err73 mpl_error_log_detailed[2].err57 mpl_error_log_detailed[2].err41 mpl_error_log_detailed[2].err28 mpl_error_log_detailed[2].err35 mpl_error_log_detailed[2].err07 mpl_error_log_detailed[2].err65 mpl_error_log_detailed[2].er046 mpl_error_log_detailed[2].err42 mpl_error_log_detailed[2].err43 mpl_error_log_detailed[2].err60 mpl_error_log_detailed[2].err23 mpl_error_log_detailed[2].err30 mpl_error_log_detailed[2].err01 mpl_error_log_detailed[2].err08 mpl_error_log_detailed[2].er026 mpl_error_log_detailed[2].er006 mpl_error_log_detailed[2].err58 mpl_error_log_detailed[2].err12 mpl_error_log_detailed[2].er038 mpl_error_log_detailed[2].er032 mpl_error_log_detailed[2].err62 mpl_error_log_detailed[2].er010 mpl_error_log_detailed[2].err20 mpl_error_log_detailed[2].err25 mpl_error_log_detailed[2].er018 mpl_error_log_detailed[2].er024 mpl_error_log_detailed[2].er034 mpl_error_log_detailed[2].er027 mpl_error_log_detailed[2].err04 mpl_error_log_detailed[2].err_5 mpl_error_log_detailed[2].er000 mpl_error_log_detailed[2].err83 mpl_error_log_detailed[2].err22 mpl_error_log_detailed[2].er028 mpl_error_log_detailed[2].err74 mpl_error_log_detailed[2].er020 mpl_error_log_detailed[2].err68 mpl_error_log_detailed[2].err00 mpl_error_log_detailed[2].er017 mpl_error_log_detailed[2].er012 mpl_error_log_detailed[2].err96 mpl_error_log_detailed[2].err76 mpl_error_log_detailed[2].err_8 mpl_error_log_detailed[2].er045 mpl_error_log_detailed[2].er035 mpl_error_log_detailed[2].err78 mpl_error_log_detailed[2].err86 mpl_error_log_detailed[2].err16 mpl_error_log_detailed[2].err59 mpl_error_log_detailed[2].err81 mpl_error_log_detailed[2].er033 mpl_error_log_detailed[2].er039 mpl_error_log_detailed[2].err40 mpl_error_log_detailed[2].er013 mpl_error_log_detailed[2].err13 mpl_error_log_detailed[2].err05 mpl_error_log_detailed[2].err37 mpl_error_log_detailed[2].err71 mpl_error_log_detailed[2].err64 mpl_error_log_detailed[2].err56 mpl_error_log_detailed[2].err82 mpl_error_log_detailed[2].err97 mpl_error_log_detailed[2].err11 mpl_error_log_detailed[2].err06 mpl_error_log_detailed[2].er016 mpl_error_log_detailed[2].err46 mpl_error_log_detailed[2].err69 mpl_error_log_detailed[2].err03 mpl_error_log_detailed[2].err53 mpl_error_log_detailed[2].err54 mpl_error_log_detailed[2].err55 mpl_error_log_detailed[2].err93 mpl_error_log_detailed[2].er001 mpl_error_log_detailed[2].err09 mpl_error_log_detailed[2].err17 mpl_error_log_detailed[2].err_0 mpl_error_log_detailed[2].er019 mpl_error_log_detailed[2].er014 mpl_error_log_detailed[2].err14 mpl_error_log_detailed[2].err27 mpl_error_log_detailed[2].err02 mpl_error_log_detailed[2].err10 mpl_error_log_detailed[2].er009 mpl_error_log_detailed[2].er008 mpl_error_log_detailed[2].err26 mpl_error_log_detailed[2].err_2 mpl_error_log_detailed[2].er025 mpl_error_log_detailed[2].err95 mpl_error_log_detailed[2].er041 mpl_error_log_detailed[2].er040 mpl_error_log_detailed[2].er044 mpl_error_log_detailed[2].er023 mpl_error_log_detailed[2].er043 mpl_error_log_detailed[2].er042 mpl_error_log_detailed[2].er011 mpl_error_log_detailed[2].err88 mpl_error_log_detailed[2].err29 mpl_error_log_detailed[2].err89 mpl_error_log_detailed[2].err90 mpl_error_log_detailed[2].err91 mpl_error_log_detailed[2].err70 mpl_error_log_detailed[2].err92 mpl_error_log_detailed[2].err84 mpl_error_log_detailed[2].err31 mpl_error_log_detailed[2].err38 mpl_error_log_detailed[2].err32 mpl_error_log_detailed[2].er003 mpl_error_log_detailed[2].err33 mpl_error_log_detailed[2].err34 mpl_error_log_detailed[2].err49 mpl_error_log_detailed[2].err48 mpl_error_log_detailed[2].err51 mpl_error_log_detailed[2].err50 mpl_error_log_detailed[2].err36 mpl_error_log_detailed[2].err52 mpl_error_log_detailed[2].err66 mpl_error_log_detailed[2].err72 mpl_error_log_detailed[2].err98 mpl_error_log_detailed[2].err_4 mpl_error_log_detailed[2].err19 mpl_error_log_detailed[2].err61 mpl_error_log_detailed[2].err44 mpl_error_log_detailed[2].er021 mpl_error_log_detailed[2].er031 mpl_error_log_detailed[2].er037 mpl_error_log_detailed[2].err_6 mpl_error_log_detailed[2].err85 mpl_error_log_detailed[2].err15 mpl_error_log_detailed[2].err24 mpl_error_log_detailed[2].err39 mpl_error_log_detailed[2].err47 mpl_error_log_detailed[2].err67 mpl_error_log_detailed[2].er030 mpl_error_log_detailed[2].er036 mpl_error_log_detailed[2].err63 mpl_error_log_detailed[2].err_7 mpl_error_log_detailed[2].err18 mpl_error_log_detailed[2].err_9 mpl_error_log_detailed[2].er015 mpl_error_log_detailed[2].er004 mpl_error_log_detailed[2].err94 mpl_error_log_detailed[2].err79 mpl_error_log_detailed[2].err80 mpl_error_log_detailed[3].err.1 mpl_error_log_detailed[3].err.2 mpl_error_log_detailed[3].err.0 mpl_error_log_detailed[3].er008 mpl_error_log_detailed[3].er026 mpl_error_log_detailed[3].err33 mpl_error_log_detailed[3].err86 mpl_error_log_detailed[3].er010 mpl_error_log_detailed[3].err43 mpl_error_log_detailed[3].err_3 mpl_error_log_detailed[3].er041 mpl_error_log_detailed[3].err07 mpl_error_log_detailed[3].err71 mpl_error_log_detailed[3].err50 mpl_error_log_detailed[3].err87 mpl_error_log_detailed[3].err70 mpl_error_log_detailed[3].err82 mpl_error_log_detailed[3].err46 mpl_error_log_detailed[3].er006 mpl_error_log_detailed[3].er019 mpl_error_log_detailed[3].err_2 mpl_error_log_detailed[3].err01 mpl_error_log_detailed[3].err_8 mpl_error_log_detailed[3].err_0 mpl_error_log_detailed[3].err02 mpl_error_log_detailed[3].err89 mpl_error_log_detailed[3].err06 mpl_error_log_detailed[3].err63 mpl_error_log_detailed[3].err55 mpl_error_log_detailed[3].err47 mpl_error_log_detailed[3].err30 mpl_error_log_detailed[3].er021 mpl_error_log_detailed[3].err62 mpl_error_log_detailed[3].er040 mpl_error_log_detailed[3].er023 mpl_error_log_detailed[3].er042 mpl_error_log_detailed[3].err21 mpl_error_log_detailed[3].err92 mpl_error_log_detailed[3].err38 mpl_error_log_detailed[3].err24 mpl_error_log_detailed[3].er022 mpl_error_log_detailed[3].er046 mpl_error_log_detailed[3].err_7 mpl_error_log_detailed[3].er043 mpl_error_log_detailed[3].err_5 mpl_error_log_detailed[3].er044 mpl_error_log_detailed[3].er024 mpl_error_log_detailed[3].err90 mpl_error_log_detailed[3].er004 mpl_error_log_detailed[3].err32 mpl_error_log_detailed[3].err79 mpl_error_log_detailed[3].err49 mpl_error_log_detailed[3].err59 mpl_error_log_detailed[3].err20 mpl_error_log_detailed[3].err18 mpl_error_log_detailed[3].err68 mpl_error_log_detailed[3].err45 mpl_error_log_detailed[3].err83 mpl_error_log_detailed[3].err00 mpl_error_log_detailed[3].er018 mpl_error_log_detailed[3].err85 mpl_error_log_detailed[3].err57 mpl_error_log_detailed[3].err_6 mpl_error_log_detailed[3].err_4 mpl_error_log_detailed[3].err09 mpl_error_log_detailed[3].err52 mpl_error_log_detailed[3].err31 mpl_error_log_detailed[3].err72 mpl_error_log_detailed[3].err27 mpl_error_log_detailed[3].err84 mpl_error_log_detailed[3].err23 mpl_error_log_detailed[3].er009 mpl_error_log_detailed[3].err34 mpl_error_log_detailed[3].er034 /end LOC_MEASUREMENT
/end FUNCTION
/end MODULE
/end PROJECT
