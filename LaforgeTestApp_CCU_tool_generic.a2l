ASAP2_VERSION 1 31
/begin PROJECT LaForge_CCU_TestApp "Test Application for LaForge TC367"
/begin HEADER "Dana" VERSION "0_3_1" /end HEADER
/begin MODULE OpenECU_TC367_001 ""
/* Scalar measurable for DDE 'DinSesStopRxTrg'. */
/begin MEASUREMENT DinSesStopRxTrg "Trigger falg that on a rising edge indicates the event for receiving the PLC (V2G) message response 10b from EVSE" UBYTE CU_DINSESSTOPRXTRG 1 100 0.0 1.0 ECU_ADDRESS 0x700183b7 BYTE_ORDER MSB_LAST /end MEASUREMENT
/begin COMPU_METHOD CU_DINSESSTOPRXTRG "Conversion method for DinSesStopRxTrg" RAT_FUNC "%10.0" "b" COEFFS 0.000000 1.000000 -0.000000 0.000000 0.000000 1.000000 /end COMPU_METHOD
/* Scalar measurable for DDE 'DinSvcDiscFreeSvc'. */
/begin MEASUREMENT DinSvcDiscFreeSvc "Indicates a list of booleans that denote if a service at a index is free of charge or not." UBYTE CU_DINSVCDISCFREESVC 1 100 0.0 1.0 ECU_ADDRESS 0x70017ec3 BYTE_ORDER MSB_LAST /end MEASUREMENT
/begin COMPU_METHOD CU_DINSVCDISCFREESVC "Conversion method for DinSvcDiscFreeSvc" RAT_FUNC "%10.0" "1" COEFFS 0.000000 1.000000 -0.000000 0.000000 0.000000 1.000000 /end COMPU_METHOD
/* Scalar measurable for DDE 'DinSvcDiscResponseCode'. */
/begin MEASUREMENT DinSvcDiscResponseCode "for message 2b: indicates the acknowledgment status of  this V2G messages received by the SECC." UBYTE CU_DINSVCDISCRESPONSECODE 1 100 0.0 255.0 ECU_ADDRESS 0x70018323 BYTE_ORDER MSB_LAST /end MEASUREMENT
/begin COMPU_METHOD CU_DINSVCDISCRESPONSECODE "Conversion method for DinSvcDiscResponseCode" RAT_FUNC "%10.0" "1" COEFFS 0.000000 1.000000 -0.000000 0.000000 0.000000 1.000000 /end COMPU_METHOD
/* Scalar measurable for DDE 'DinSvcDiscRxTrg'. */
/begin MEASUREMENT DinSvcDiscRxTrg "Trigger falg that on a rising edge indicates the event for receiving the PLC (V2G) message response 2b from EVSE" UBYTE CU_DINSVCDISCRXTRG 1 100 0.0 1.0 ECU_ADDRESS 0x70017e27 BYTE_ORDER MSB_LAST /end MEASUREMENT
/begin COMPU_METHOD CU_DINSVCDISCRXTRG "Conversion method for DinSvcDiscRxTrg" RAT_FUNC "%10.0" "b" COEFFS 0.000000 1.000000 -0.000000 0.000000 0.000000 1.000000 /end COMPU_METHOD
/* Scalar measurable for DDE 'DinSvcDiscSvcCategory'. */
/begin MEASUREMENT DinSvcDiscSvcCategory "The Service Category parameter in the received message from EVSE" UBYTE CU_DINSVCDISCSVCCATEGORY 1 100 0.0 4.0 ECU_ADDRESS 0x70018278 BYTE_ORDER MSB_LAST /end MEASUREMENT
/begin COMPU_METHOD CU_DINSVCDISCSVCCATEGORY "Conversion method for DinSvcDiscSvcCategory" RAT_FUNC "%10.0" "1" COEFFS 0.000000 1.000000 -0.000000 0.000000 0.000000 1.000000 /end COMPU_METHOD
/* Scalar measurable for DDE 'DinSvcDiscSvcId'. */
/begin MEASUREMENT DinSvcDiscSvcId "Identifies a service which has been offered by the SECC in the ServiceDiscoveryRes message" UWORD CU_DINSVCDISCSVCID 1 100 0.0 65535.0 ECU_ADDRESS 0x70017d8c BYTE_ORDER MSB_LAST /end MEASUREMENT
/begin COMPU_METHOD CU_DINSVCDISCSVCID "Conversion method for DinSvcDiscSvcId" RAT_FUNC "%10.0" "1" COEFFS 0.000000 1.000000 -0.000000 0.000000 0.000000 1.000000 /end COMPU_METHOD
/* Scalar measurable for DDE 'DinWeldDetResponseCode'. */
/begin MEASUREMENT DinWeldDetResponseCode "for message 9b: indicates the acknowledgment status of  this V2G messages received by the SECC." UBYTE CU_DINWELDDETRESPONSECODE 1 100 0.0 255.0 ECU_ADDRESS 0x700181b7 BYTE_ORDER MSB_LAST /end MEASUREMENT
/begin COMPU_METHOD CU_DINWELDDETRESPONSECODE "Conversion method for DinWeldDetResponseCode" RAT_FUNC "%10.0" "1" COEFFS 0.000000 1.000000 -0.000000 0.000000 0.000000 1.000000 /end COMPU_METHOD
/* Scalar measurable for DDE 'DynamicModeEn'. */
/begin MEASUREMENT DynamicModeEn "Flag that indicated whether dynamic mode is enabled from the Service Discovery and Detail Parser" UBYTE CU_DYNAMICMODEEN 1 100 0.0 1.0 ECU_ADDRESS 0x70017c97 BYTE_ORDER MSB_LAST /end MEASUREMENT
/begin COMPU_METHOD CU_DYNAMICMODEEN "Conversion method for DynamicModeEn" RAT_FUNC "%10.0" "b" COEFFS 0.000000 1.000000 -0.000000 0.000000 0.000000 1.000000 /end COMPU_METHOD
/* Scalar measurable for DDE 'EcuRunning'. */
/begin MEASUREMENT EcuRunning "Signal for ECU running flag." UBYTE CU_ECURUNNING 1 100 0.0 1.0 ECU_ADDRESS 0x70019ecd BYTE_ORDER MSB_LAST /end MEASUREMENT
/begin COMPU_METHOD CU_ECURUNNING "Conversion method for EcuRunning" RAT_FUNC "%10.0" "(not defined)" COEFFS 0.000000 1.000000 -0.000000 0.000000 0.000000 1.000000 /end COMPU_METHOD
/* Scalar measurable for DDE 'F2_LedA_MaxFlt'. */
/begin MEASUREMENT F2_LedA_MaxFlt "LEDA above max threshold latched after debounce (CCU pin F2)" UBYTE CU_F2_LEDA_MAXFLT 1 100 0.0 1.0 ECU_ADDRESS 0x7001a152 BYTE_ORDER MSB_LAST /end MEASUREMENT
/begin COMPU_METHOD CU_F2_LEDA_MAXFLT "Conversion method for F2_LedA_MaxFlt" RAT_FUNC "%10.0" "(not defined)" COEFFS 0.000000 1.000000 -0.000000 0.000000 0.000000 1.000000 /end COMPU_METHOD
/* Scalar measurable for DDE 'F2_LedA_MaxFltActv'. */
/begin MEASUREMENT F2_LedA_MaxFltActv "Active fault high F2 (Max fault no latch or debounce)" UBYTE CU_F2_LEDA_MAXFLTACTV 1 100 0.0 1.0 ECU_ADDRESS 0x7001a0d0 BYTE_ORDER MSB_LAST /end MEASUREMENT
/begin COMPU_METHOD CU_F2_LEDA_MAXFLTACTV "Conversion method for F2_LedA_MaxFltActv" RAT_FUNC "%10.0" "(not defined)" COEFFS 0.000000 1.000000 -0.000000 0.000000 0.000000 1.000000 /end COMPU_METHOD
/* Scalar measurable for DDE 'F2_LedA_MinFlt'. */
/begin MEASUREMENT F2_LedA_MinFlt "LEDA below min threshold latched after debounce (CCU pin F2)" UBYTE CU_F2_LEDA_MINFLT 1 100 0.0 1.0 ECU_ADDRESS 0x7001a04d BYTE_ORDER MSB_LAST /end MEASUREMENT
/begin COMPU_METHOD CU_F2_LEDA_MINFLT "Conversion method for F2_LedA_MinFlt" RAT_FUNC "%10.0" "(not defined)" COEFFS 0.000000 1.000000 -0.000000 0.000000 0.000000 1.000000 /end COMPU_METHOD
/* Scalar measurable for DDE 'F2_LedA_MinFltActv'. */
/begin MEASUREMENT F2_LedA_MinFltActv "Active fault low F2 (Min fault no latch or debounce)" UBYTE CU_F2_LEDA_MINFLTACTV 1 100 0.0 1.0 ECU_ADDRESS 0x70019fbd BYTE_ORDER MSB_LAST /end MEASUREMENT
/begin COMPU_METHOD CU_F2_LEDA_MINFLTACTV "Conversion method for F2_LedA_MinFltActv" RAT_FUNC "%10.0" "(not defined)" COEFFS 0.000000 1.000000 -0.000000 0.000000 0.000000 1.000000 /end COMPU_METHOD
/* Scalar measurable for DDE 'F3_LedB_MaxFlt'. */
/begin MEASUREMENT F3_LedB_MaxFlt "LEDB above max threshold latched after debounce (CCU pin F3)" UBYTE CU_F3_LEDB_MAXFLT 1 100 0.0 1.0 ECU_ADDRESS 0x70019f40 BYTE_ORDER MSB_LAST /end MEASUREMENT
/begin COMPU_METHOD CU_F3_LEDB_MAXFLT "Conversion method for F3_LedB_MaxFlt" RAT_FUNC "%10.0" "(not defined)" COEFFS 0.000000 1.000000 -0.000000 0.000000 0.000000 1.000000 /end COMPU_METHOD
/* Scalar measurable for DDE 'F3_LedB_MaxFltActv'. */
/begin MEASUREMENT F3_LedB_MaxFltActv "Active fault high F3 (Max fault no latch or debounce)" UBYTE CU_F3_LEDB_MAXFLTACTV 1 100 0.0 1.0 ECU_ADDRESS 0x70019ec7 BYTE_ORDER MSB_LAST /end MEASUREMENT
/begin COMPU_METHOD CU_F3_LEDB_MAXFLTACTV "Conversion method for F3_LedB_MaxFltActv" RAT_FUNC "%10.0" "(not defined)" COEFFS 0.000000 1.000000 -0.000000 0.000000 0.000000 1.000000 /end COMPU_METHOD
/* Scalar measurable for DDE 'F3_LedB_MinFlt'. */
/begin MEASUREMENT F3_LedB_MinFlt "LEDB below min threshold latched after debounce (CCU pin F3)" UBYTE CU_F3_LEDB_MINFLT 1 100 0.0 1.0 ECU_ADDRESS 0x7001a14f BYTE_ORDER MSB_LAST /end MEASUREMENT
/begin COMPU_METHOD CU_F3_LEDB_MINFLT "Conversion method for F3_LedB_MinFlt" RAT_FUNC "%10.0" "(not defined)" COEFFS 0.000000 1.000000 -0.000000 0.000000 0.000000 1.000000 /end COMPU_METHOD
/* Scalar measurable for DDE 'F3_LedB_MinFltActv'. */
/begin MEASUREMENT F3_LedB_MinFltActv "Active fault low F3 (Min fault no latch or debounce)" UBYTE CU_F3_LEDB_MINFLTACTV 1 100 0.0 1.0 ECU_ADDRESS 0x7001a0c5 BYTE_ORDER MSB_LAST /end MEASUREMENT
/begin COMPU_METHOD CU_F3_LEDB_MINFLTACTV "Conversion method for F3_LedB_MinFltActv" RAT_FUNC "%10.0" "(not defined)" COEFFS 0.000000 1.000000 -0.000000 0.000000 0.000000 1.000000 /end COMPU_METHOD
/* Scalar measurable for DDE 'F4_LedC_MaxFlt'. */
/begin MEASUREMENT F4_LedC_MaxFlt "LEDC above max threshold latched after debounce (CCU pin F4)" UBYTE CU_F4_LEDC_MAXFLT 1 100 0.0 1.0 ECU_ADDRESS 0x7001a045 BYTE_ORDER MSB_LAST /end MEASUREMENT
/begin COMPU_METHOD CU_F4_LEDC_MAXFLT "Conversion method for F4_LedC_MaxFlt" RAT_FUNC "%10.0" "(not defined)" COEFFS 0.000000 1.000000 -0.000000 0.000000 0.000000 1.000000 /end COMPU_METHOD
/* Scalar measurable for DDE 'F4_LedC_MaxFltActv'. */
/begin MEASUREMENT F4_LedC_MaxFltActv "Active fault high F4 (Max fault no latch or debounce)" UBYTE CU_F4_LEDC_MAXFLTACTV 1 100 0.0 1.0 ECU_ADDRESS 0x70019fb5 BYTE_ORDER MSB_LAST /end MEASUREMENT
/begin COMPU_METHOD CU_F4_LEDC_MAXFLTACTV "Conversion method for F4_LedC_MaxFltActv" RAT_FUNC "%10.0" "(not defined)" COEFFS 0.000000 1.000000 -0.000000 0.000000 0.000000 1.000000 /end COMPU_METHOD
/* Scalar measurable for DDE 'F4_LedC_MinFlt'. */
/begin MEASUREMENT F4_LedC_MinFlt "LEDC below min threshold latched after debounce (CCU pin F4)" UBYTE CU_F4_LEDC_MINFLT 1 100 0.0 1.0 ECU_ADDRESS 0x70019f39 BYTE_ORDER MSB_LAST /end MEASUREMENT
/begin COMPU_METHOD CU_F4_LEDC_MINFLT "Conversion method for F4_LedC_MinFlt" RAT_FUNC "%10.0" "(not defined)" COEFFS 0.000000 1.000000 -0.000000 0.000000 0.000000 1.000000 /end COMPU_METHOD
/* Scalar measurable for DDE 'F4_LedC_MinFltActv'. */
/begin MEASUREMENT F4_LedC_MinFltActv "Active fault low F4 (Min fault no latch or debounce)" UBYTE CU_F4_LEDC_MINFLTACTV 1 100 0.0 1.0 ECU_ADDRESS 0x70019ec4 BYTE_ORDER MSB_LAST /end MEASUREMENT
/begin COMPU_METHOD CU_F4_LEDC_MINFLTACTV "Conversion method for F4_LedC_MinFltActv" RAT_FUNC "%10.0" "(not defined)" COEFFS 0.000000 1.000000 -0.000000 0.000000 0.000000 1.000000 /end COMPU_METHOD
/* Scalar measurable for DDE 'HostAcCrntPresAtPortEn'. */
/begin MEASUREMENT HostAcCrntPresAtPortEn "Exported global for inlet AC Current (post-override)." UBYTE CU_HOSTACCRNTPRESATPORTEN 1 100 0.0 1.0 ECU_ADDRESS 0x700180eb BYTE_ORDER MSB_LAST /end MEASUREMENT
/begin COMPU_METHOD CU_HOSTACCRNTPRESATPORTEN "Conversion method for HostAcCrntPresAtPortEn" RAT_FUNC "%10.0" "b" COEFFS 0.000000 1.000000 -0.000000 0.000000 0.000000 1.000000 /end COMPU_METHOD
/* Scalar measurable for DDE 'HostAcCrntPresentAtPort'. */
/begin MEASUREMENT HostAcCrntPresentAtPort "Instantaneous current at port" UBYTE CU_HOSTACCRNTPRESENTATPORT 1 100 0.0 1.0 ECU_ADDRESS 0x70017c14 BYTE_ORDER MSB_LAST /end MEASUREMENT
/begin COMPU_METHOD CU_HOSTACCRNTPRESENTATPORT "Conversion method for HostAcCrntPresentAtPort" RAT_FUNC "%10.0" "b" COEFFS 0.000000 1.000000 -0.000000 0.000000 0.000000 1.000000 /end COMPU_METHOD
/* Scalar measurable for DDE 'HostAcVltPresAtPortEn'. */
/begin MEASUREMENT HostAcVltPresAtPortEn "Exported global for inlet AC Voltage (post-override)." UBYTE CU_HOSTACVLTPRESATPORTEN 1 100 0.0 1.0 ECU_ADDRESS 0x70017fb8 BYTE_ORDER MSB_LAST /end MEASUREMENT
/begin COMPU_METHOD CU_HOSTACVLTPRESATPORTEN "Conversion method for HostAcVltPresAtPortEn" RAT_FUNC "%10.0" "b" COEFFS 0.000000 1.000000 -0.000000 0.000000 0.000000 1.000000 /end COMPU_METHOD
/* Scalar measurable for DDE 'HostAcVoltPresentAtPort'. */
/begin MEASUREMENT HostAcVoltPresentAtPort "Port AC voltage is present" UBYTE CU_HOSTACVOLTPRESENTATPORT 1 100 0.0 1.0 ECU_ADDRESS 0x70018434 BYTE_ORDER MSB_LAST /end MEASUREMENT
/begin COMPU_METHOD CU_HOSTACVOLTPRESENTATPORT "Conversion method for HostAcVoltPresentAtPort" RAT_FUNC "%10.0" "b" COEFFS 0.000000 1.000000 -0.000000 0.000000 0.000000 1.000000 /end COMPU_METHOD
/* Scalar measurable for DDE 'HostAinEvsePilotVoltPeakRaw'. */
/begin MEASUREMENT HostAinEvsePilotVoltPeakRaw "Raw Peak voltage value of charging interface Pilot signal" FLOAT32_IEEE CU_HOSTAINEVSEPILOTVOLTPEAKRAW 1 100 -50.0 100.0 ECU_ADDRESS 0x70017f00 BYTE_ORDER MSB_LAST /end MEASUREMENT
/begin COMPU_METHOD CU_HOSTAINEVSEPILOTVOLTPEAKRAW "Conversion method for HostAinEvsePilotVoltPeakRaw" RAT_FUNC "%10.0" "V" COEFFS 0.000000 1.000000 -0.000000 0.000000 0.000000 1.000000 /end COMPU_METHOD
/* Scalar measurable for DDE 'HostAinEvsePilotVoltRaw'. */
/begin MEASUREMENT HostAinEvsePilotVoltRaw "Raw voltage value of charging interface Pilot signal" FLOAT32_IEEE CU_HOSTAINEVSEPILOTVOLTRAW 1 100 -50.0 100.0 ECU_ADDRESS 0x70018374 BYTE_ORDER MSB_LAST /end MEASUREMENT
/begin COMPU_METHOD CU_HOSTAINEVSEPILOTVOLTRAW "Conversion method for HostAinEvsePilotVoltRaw" RAT_FUNC "%10.0" "V" COEFFS 0.000000 1.000000 -0.000000 0.000000 0.000000 1.000000 /end COMPU_METHOD
/* Scalar measurable for DDE 'HostAinEvseProximityVoltRaw'. */
/begin MEASUREMENT HostAinEvseProximityVoltRaw "Raw voltage value of charging interface Proximity signal" FLOAT32_IEEE CU_HOSTAINEVSEPROXIMITYVOLTRAW1 1 100 -50.0 100.0 ECU_ADDRESS 0x70017e74 BYTE_ORDER MSB_LAST /end MEASUREMENT
/begin COMPU_METHOD CU_HOSTAINEVSEPROXIMITYVOLTRAW1 "Conversion method for HostAinEvseProximityVoltRaw" RAT_FUNC "%10.0" "V" COEFFS 0.000000 1.000000 -0.000000 0.000000 0.000000 1.000000 /end COMPU_METHOD
/* Scalar measurable for DDE 'HostAinProximitySupplyFdbk'. */
/begin MEASUREMENT HostAinProximitySupplyFdbk "raw internal feedback form the 5V supply voltage output used for powring up the proximity  signal circuit in an EV-EVSE interface" FLOAT32_IEEE CU_HOSTAINPROXIMITYSUPPLYFDBK 1 100 -50.0 100.0 ECU_ADDRESS 0x700182bc BYTE_ORDER MSB_LAST /end MEASUREMENT
/begin COMPU_METHOD CU_HOSTAINPROXIMITYSUPPLYFDBK "Conversion method for HostAinProximitySupplyFdbk" RAT_FUNC "%10.0" "V" COEFFS 0.000000 1.000000 -0.000000 0.000000 0.000000 1.000000 /end COMPU_METHOD
/* Scalar measurable for DDE 'HostAllChargeRelaysClosed'. */
/begin MEASUREMENT HostAllChargeRelaysClosed "(not defined)" UBYTE CU_HOSTALLCHARGERELAYSCLOSED 1 100 0.0 1.0 ECU_ADDRESS 0x70017dcd BYTE_ORDER MSB_LAST /end MEASUREMENT
/begin COMPU_METHOD CU_HOSTALLCHARGERELAYSCLOSED "Conversion method for HostAllChargeRelaysClosed" RAT_FUNC "%10.0" "b" COEFFS 0.000000 1.000000 -0.000000 0.000000 0.000000 1.000000 /end COMPU_METHOD
/* Scalar measurable for DDE 'HostAllChgRelaysClosed'. */
/begin MEASUREMENT HostAllChgRelaysClosed "(not defined)" UBYTE CU_HOSTALLCHGRELAYSCLOSED 1 100 0.0 1.0 ECU_ADDRESS 0x7001820b BYTE_ORDER MSB_LAST /end MEASUREMENT
/begin COMPU_METHOD CU_HOSTALLCHGRELAYSCLOSED "Conversion method for HostAllChgRelaysClosed" RAT_FUNC "%10.0" "b" COEFFS 0.000000 1.000000 -0.000000 0.000000 0.000000 1.000000 /end COMPU_METHOD
/* Scalar measurable for DDE 'HostBptModePriority'. */
/begin MEASUREMENT HostBptModePriority "Exported global for BPT mode priority from Host (post-override)." UBYTE CU_HOSTBPTMODEPRIORITY 1 100 0.0 255.0 ECU_ADDRESS 0x70017d27 BYTE_ORDER MSB_LAST /end MEASUREMENT
/begin COMPU_METHOD CU_HOSTBPTMODEPRIORITY "Conversion method for HostBptModePriority" RAT_FUNC "%10.0" "e" COEFFS 0.000000 1.000000 -0.000000 0.000000 0.000000 1.000000 /end COMPU_METHOD
/* Scalar measurable for DDE 'HostChargeEmergencyStop'. */
/begin MEASUREMENT HostChargeEmergencyStop "(not defined)" UBYTE CU_HOSTCHARGEEMERGENCYSTOP 1 100 0.0 1.0 ECU_ADDRESS 0x7001817f BYTE_ORDER MSB_LAST /end MEASUREMENT
/begin COMPU_METHOD CU_HOSTCHARGEEMERGENCYSTOP "Conversion method for HostChargeEmergencyStop" RAT_FUNC "%10.0" "b" COEFFS 0.000000 1.000000 -0.000000 0.000000 0.000000 1.000000 /end COMPU_METHOD
/* Scalar measurable for DDE 'HostChargeInletLockStatus'. */
/begin MEASUREMENT HostChargeInletLockStatus "(not defined)" UBYTE CU_HOSTCHARGEINLETLOCKSTATUS 1 100 0.0 1.0 ECU_ADDRESS 0x70017c53 BYTE_ORDER MSB_LAST /end MEASUREMENT
/begin COMPU_METHOD CU_HOSTCHARGEINLETLOCKSTATUS "Conversion method for HostChargeInletLockStatus" RAT_FUNC "%10.0" "b" COEFFS 0.000000 1.000000 -0.000000 0.000000 0.000000 1.000000 /end COMPU_METHOD
/* Scalar measurable for DDE 'HostChargeNormalStop'. */
/begin MEASUREMENT HostChargeNormalStop "(not defined)" UBYTE CU_HOSTCHARGENORMALSTOP 1 100 0.0 1.0 ECU_ADDRESS 0x70018019 BYTE_ORDER MSB_LAST /end MEASUREMENT
/begin COMPU_METHOD CU_HOSTCHARGENORMALSTOP "Conversion method for HostChargeNormalStop" RAT_FUNC "%10.0" "b" COEFFS 0.000000 1.000000 -0.000000 0.000000 0.000000 1.000000 /end COMPU_METHOD
/* Scalar measurable for DDE 'HostChgInletLockStatus'. */
/begin MEASUREMENT HostChgInletLockStatus "(not defined)" UBYTE CU_HOSTCHGINLETLOCKSTATUS 1 100 0.0 1.0 ECU_ADDRESS 0x70018478 BYTE_ORDER MSB_LAST /end MEASUREMENT
/begin COMPU_METHOD CU_HOSTCHGINLETLOCKSTATUS "Conversion method for HostChgInletLockStatus" RAT_FUNC "%10.0" "b" COEFFS 0.000000 1.000000 -0.000000 0.000000 0.000000 1.000000 /end COMPU_METHOD
/* Scalar measurable for DDE 'HostChgPortCrntDc'. */
/begin MEASUREMENT HostChgPortCrntDc "Instantaneous current at port" FLOAT32_IEEE CU_HOSTCHGPORTCRNTDC 1 100 0.0 196605.0 ECU_ADDRESS 0x70017f74 BYTE_ORDER MSB_LAST /end MEASUREMENT
/begin COMPU_METHOD CU_HOSTCHGPORTCRNTDC "Conversion method for HostChgPortCrntDc" RAT_FUNC "%10.0" "A" COEFFS 0.000000 1.000000 -0.000000 0.000000 0.000000 1.000000 /end COMPU_METHOD
/* Scalar measurable for DDE 'HostChgPortCrntDcValid'. */
/begin MEASUREMENT HostChgPortCrntDcValid "(not defined)" UBYTE CU_HOSTCHGPORTCRNTDCVALID 1 100 0.0 1.0 ECU_ADDRESS 0x700183b8 BYTE_ORDER MSB_LAST /end MEASUREMENT
/begin COMPU_METHOD CU_HOSTCHGPORTCRNTDCVALID "Conversion method for HostChgPortCrntDcValid" RAT_FUNC "%10.0" "b" COEFFS 0.000000 1.000000 -0.000000 0.000000 0.000000 1.000000 /end COMPU_METHOD
/* Scalar measurable for DDE 'HostChgPortVoltDc'. */
/begin MEASUREMENT HostChgPortVoltDc "Port voltage" FLOAT32_IEEE CU_HOSTCHGPORTVOLTDC 1 100 0.0 196605.0 ECU_ADDRESS 0x70017ec4 BYTE_ORDER MSB_LAST /end MEASUREMENT
/begin COMPU_METHOD CU_HOSTCHGPORTVOLTDC "Conversion method for HostChgPortVoltDc" RAT_FUNC "%10.0" "V" COEFFS 0.000000 1.000000 -0.000000 0.000000 0.000000 1.000000 /end COMPU_METHOD
/* Scalar measurable for DDE 'HostChgPortVoltDcValid'. */
/begin MEASUREMENT HostChgPortVoltDcValid "(not defined)" UBYTE CU_HOSTCHGPORTVOLTDCVALID 1 100 0.0 1.0 ECU_ADDRESS 0x70018324 BYTE_ORDER MSB_LAST /end MEASUREMENT
/begin COMPU_METHOD CU_HOSTCHGPORTVOLTDCVALID "Conversion method for HostChgPortVoltDcValid" RAT_FUNC "%10.0" "b" COEFFS 0.000000 1.000000 -0.000000 0.000000 0.000000 1.000000 /end COMPU_METHOD
/* Scalar measurable for DDE 'HostChgRlyWeldCheckDone'. */
/begin MEASUREMENT HostChgRlyWeldCheckDone "(not defined)" UBYTE CU_HOSTCHGRLYWELDCHECKDONE 1 100 0.0 1.0 ECU_ADDRESS 0x70017e28 BYTE_ORDER MSB_LAST /end MEASUREMENT
/begin COMPU_METHOD CU_HOSTCHGRLYWELDCHECKDONE "Conversion method for HostChgRlyWeldCheckDone" RAT_FUNC "%10.0" "b" COEFFS 0.000000 1.000000 -0.000000 0.000000 0.000000 1.000000 /end COMPU_METHOD
/* Scalar measurable for DDE 'HostDepartureTime'. */
/begin MEASUREMENT HostDepartureTime "Departure time provided by the host" FLOAT32_IEEE CU_HOSTDEPARTURETIME 1 100 -3.40282346639e+38 3.40282346639e+38 ECU_ADDRESS 0x7001827c BYTE_ORDER MSB_LAST /end MEASUREMENT
/begin COMPU_METHOD CU_HOSTDEPARTURETIME "Conversion method for HostDepartureTime" RAT_FUNC "%10.0" "s" COEFFS 0.000000 1.000000 -0.000000 0.000000 0.000000 1.000000 /end COMPU_METHOD
/* Scalar measurable for DDE 'HostDesiredEgyTrnsfrMde'. */
/begin MEASUREMENT HostDesiredEgyTrnsfrMde "Exported global for desired energy transfer mode priority from Host (post-override)." UBYTE CU_HOSTDESIREDEGYTRNSFRMDE 1 100 0.0 255.0 ECU_ADDRESS 0x70017d8e BYTE_ORDER MSB_LAST /end MEASUREMENT
/begin COMPU_METHOD CU_HOSTDESIREDEGYTRNSFRMDE "Conversion method for HostDesiredEgyTrnsfrMde" RAT_FUNC "%10.0" "e" COEFFS 0.000000 1.000000 -0.000000 0.000000 0.000000 1.000000 /end COMPU_METHOD
/* Scalar measurable for DDE 'HostDynamicModePriority'. */
/begin MEASUREMENT HostDynamicModePriority "Exported global for dynamic mode priority from Host (post-override)." UBYTE CU_HOSTDYNAMICMODEPRIORITY 1 100 0.0 255.0 ECU_ADDRESS 0x700181b8 BYTE_ORDER MSB_LAST /end MEASUREMENT
/begin COMPU_METHOD CU_HOSTDYNAMICMODEPRIORITY "Conversion method for HostDynamicModePriority" RAT_FUNC "%10.0" "e" COEFFS 0.000000 1.000000 -0.000000 0.000000 0.000000 1.000000 /end COMPU_METHOD
/* Scalar measurable for DDE 'HostEvCurrMaxLim'. */
/begin MEASUREMENT HostEvCurrMaxLim "Maximum current supported by the vehicle." FLOAT32_IEEE CU_HOSTEVCURRMAXLIM 1 100 0.0 196605.0 ECU_ADDRESS 0x70017c98 BYTE_ORDER MSB_LAST /end MEASUREMENT
/begin COMPU_METHOD CU_HOSTEVCURRMAXLIM "Conversion method for HostEvCurrMaxLim" RAT_FUNC "%10.0" "A" COEFFS 0.000000 1.000000 -0.000000 0.000000 0.000000 1.000000 /end COMPU_METHOD
/* Scalar measurable for DDE 'HostEvCurrMinLim'. */
/begin MEASUREMENT HostEvCurrMinLim "Minimum current supported by the vehicle." FLOAT32_IEEE CU_HOSTEVCURRMINLIM 1 100 0.0 196605.0 ECU_ADDRESS 0x700180ec BYTE_ORDER MSB_LAST /end MEASUREMENT
/begin COMPU_METHOD CU_HOSTEVCURRMINLIM "Conversion method for HostEvCurrMinLim" RAT_FUNC "%10.0" "A" COEFFS 0.000000 1.000000 -0.000000 0.000000 0.000000 1.000000 /end COMPU_METHOD
/* Scalar measurable for DDE 'HostEvDisChgCurrMaxLim'. */
/begin MEASUREMENT HostEvDisChgCurrMaxLim "Maximum discharge current supported by the vehicle." FLOAT32_IEEE CU_HOSTEVDISCHGCURRMAXLIM 1 100 0.0 196605.0 ECU_ADDRESS 0x70017c18 BYTE_ORDER MSB_LAST /end MEASUREMENT
/begin COMPU_METHOD CU_HOSTEVDISCHGCURRMAXLIM "Conversion method for HostEvDisChgCurrMaxLim" RAT_FUNC "%10.0" "Wh" COEFFS 0.000000 1.000000 -0.000000 0.000000 0.000000 1.000000 /end COMPU_METHOD
/* Scalar measurable for DDE 'HostEvDisChgCurrMinLim'. */
/begin MEASUREMENT HostEvDisChgCurrMinLim "Minimum discharge current supported by the vehicle." FLOAT32_IEEE CU_HOSTEVDISCHGCURRMINLIM 1 100 0.0 196605.0 ECU_ADDRESS 0x70017fbc BYTE_ORDER MSB_LAST /end MEASUREMENT
/begin COMPU_METHOD CU_HOSTEVDISCHGCURRMINLIM "Conversion method for HostEvDisChgCurrMinLim" RAT_FUNC "%10.0" "Wh" COEFFS 0.000000 1.000000 -0.000000 0.000000 0.000000 1.000000 /end COMPU_METHOD
/* Scalar measurable for DDE 'HostEvDisChgPwrMaxLim'. */
/begin MEASUREMENT HostEvDisChgPwrMaxLim "Maximum discharge power supported by the vehicle." FLOAT32_IEEE CU_HOSTEVDISCHGPWRMAXLIM 1 100 0.0 196605.0 ECU_ADDRESS 0x70018438 BYTE_ORDER MSB_LAST /end MEASUREMENT
/begin COMPU_METHOD CU_HOSTEVDISCHGPWRMAXLIM "Conversion method for HostEvDisChgPwrMaxLim" RAT_FUNC "%10.0" "Wh" COEFFS 0.000000 1.000000 -0.000000 0.000000 0.000000 1.000000 /end COMPU_METHOD
/* Scalar measurable for DDE 'HostEvDisChgPwrMinLim'. */
/begin MEASUREMENT HostEvDisChgPwrMinLim "Minimum discharge power supported by the vehicle." FLOAT32_IEEE CU_HOSTEVDISCHGPWRMINLIM 1 100 0.0 196605.0 ECU_ADDRESS 0x70017f04 BYTE_ORDER MSB_LAST /end MEASUREMENT
/begin COMPU_METHOD CU_HOSTEVDISCHGPWRMINLIM "Conversion method for HostEvDisChgPwrMinLim" RAT_FUNC "%10.0" "Wh" COEFFS 0.000000 1.000000 -0.000000 0.000000 0.000000 1.000000 /end COMPU_METHOD
/* Scalar measurable for DDE 'HostEvEgyCapacity'. */
/begin MEASUREMENT HostEvEgyCapacity "Maximum energy capacity supported by the vehicle" FLOAT32_IEEE CU_HOSTEVEGYCAPACITY 1 100 0.0 196605.0 ECU_ADDRESS 0x70018378 BYTE_ORDER MSB_LAST /end MEASUREMENT
/begin COMPU_METHOD CU_HOSTEVEGYCAPACITY "Conversion method for HostEvEgyCapacity" RAT_FUNC "%10.0" "Wh" COEFFS 0.000000 1.000000 -0.000000 0.000000 0.000000 1.000000 /end COMPU_METHOD
/* Scalar measurable for DDE 'HostEvEgyReqAmount'. */
/begin MEASUREMENT HostEvEgyReqAmount "Amount of energy requested by the vehicle" FLOAT32_IEEE CU_HOSTEVEGYREQAMOUNT 1 100 0.0 196605.0 ECU_ADDRESS 0x70017e78 BYTE_ORDER MSB_LAST /end MEASUREMENT
/begin COMPU_METHOD CU_HOSTEVEGYREQAMOUNT "Conversion method for HostEvEgyReqAmount" RAT_FUNC "%10.0" "Wh" COEFFS 0.000000 1.000000 -0.000000 0.000000 0.000000 1.000000 /end COMPU_METHOD
/* Scalar measurable for DDE 'HostEvIsolCheckDisabled'. */
/begin MEASUREMENT HostEvIsolCheckDisabled "(not defined)" UBYTE CU_HOSTEVISOLCHECKDISABLED 1 100 0.0 1.0 ECU_ADDRESS 0x700182c0 BYTE_ORDER MSB_LAST /end MEASUREMENT
/begin COMPU_METHOD CU_HOSTEVISOLCHECKDISABLED "Conversion method for HostEvIsolCheckDisabled" RAT_FUNC "%10.0" "b" COEFFS 0.000000 1.000000 -0.000000 0.000000 0.000000 1.000000 /end COMPU_METHOD
/* Scalar measurable for DDE 'HostEvMaxEgy'. */
/begin MEASUREMENT HostEvMaxEgy "Maximum level of energy accepted by the EV" FLOAT32_IEEE CU_HOSTEVMAXEGY 1 100 0.0 196605.0 ECU_ADDRESS 0x70017dd0 BYTE_ORDER MSB_LAST /end MEASUREMENT
/begin COMPU_METHOD CU_HOSTEVMAXEGY "Conversion method for HostEvMaxEgy" RAT_FUNC "%10.0" "Wh" COEFFS 0.000000 1.000000 -0.000000 0.000000 0.000000 1.000000 /end COMPU_METHOD
/* Scalar measurable for DDE 'HostEvMinEgy'. */
/begin MEASUREMENT HostEvMinEgy "Minimum level of energy requested by the EV as soon as possible" FLOAT32_IEEE CU_HOSTEVMINEGY 1 100 0.0 196605.0 ECU_ADDRESS 0x7001820c BYTE_ORDER MSB_LAST /end MEASUREMENT
/begin COMPU_METHOD CU_HOSTEVMINEGY "Conversion method for HostEvMinEgy" RAT_FUNC "%10.0" "Wh" COEFFS 0.000000 1.000000 -0.000000 0.000000 0.000000 1.000000 /end COMPU_METHOD
/* Scalar measurable for DDE 'HostEvPwrMaxLim'. */
/begin MEASUREMENT HostEvPwrMaxLim "Maximum power supported by the vehicle." FLOAT32_IEEE CU_HOSTEVPWRMAXLIM 1 100 0.0 196605.0 ECU_ADDRESS 0x70017d28 BYTE_ORDER MSB_LAST /end MEASUREMENT
/begin COMPU_METHOD CU_HOSTEVPWRMAXLIM "Conversion method for HostEvPwrMaxLim" RAT_FUNC "%10.0" "W" COEFFS 0.000000 1.000000 -0.000000 0.000000 0.000000 1.000000 /end COMPU_METHOD
/* Scalar measurable for DDE 'HostEvPwrMinLim'. */
/begin MEASUREMENT HostEvPwrMinLim "Minimum power supported by the vehicle." FLOAT32_IEEE CU_HOSTEVPWRMINLIM 1 100 0.0 196605.0 ECU_ADDRESS 0x70018180 BYTE_ORDER MSB_LAST /end MEASUREMENT
/begin COMPU_METHOD CU_HOSTEVPWRMINLIM "Conversion method for HostEvPwrMinLim" RAT_FUNC "%10.0" "W" COEFFS 0.000000 1.000000 -0.000000 0.000000 0.000000 1.000000 /end COMPU_METHOD
/* Scalar measurable for DDE 'HostEvTargetCrnt'. */
/begin MEASUREMENT HostEvTargetCrnt "Instantaneous current requested by the vehicle" FLOAT32_IEEE CU_HOSTEVTARGETCRNT 1 100 0.0 196605.0 ECU_ADDRESS 0x70017c54 BYTE_ORDER MSB_LAST /end MEASUREMENT
/begin COMPU_METHOD CU_HOSTEVTARGETCRNT "Conversion method for HostEvTargetCrnt" RAT_FUNC "%10.0" "A" COEFFS 0.000000 1.000000 -0.000000 0.000000 0.000000 1.000000 /end COMPU_METHOD
/* Scalar measurable for DDE 'HostEvTargetVolt'. */
/begin MEASUREMENT HostEvTargetVolt "Target Voltage requested by EV" FLOAT32_IEEE CU_HOSTEVTARGETVOLT 1 100 0.0 196605.0 ECU_ADDRESS 0x7001801c BYTE_ORDER MSB_LAST /end MEASUREMENT
/begin COMPU_METHOD CU_HOSTEVTARGETVOLT "Conversion method for HostEvTargetVolt" RAT_FUNC "%10.0" "V" COEFFS 0.000000 1.000000 -0.000000 0.000000 0.000000 1.000000 /end COMPU_METHOD
/* Scalar measurable for DDE 'HostEvVoltMaxLim'. */
/begin MEASUREMENT HostEvVoltMaxLim "Maximum voltage supported by the vehicle." FLOAT32_IEEE CU_HOSTEVVOLTMAXLIM 1 100 0.0 196605.0 ECU_ADDRESS 0x7001847c BYTE_ORDER MSB_LAST /end MEASUREMENT
/begin COMPU_METHOD CU_HOSTEVVOLTMAXLIM "Conversion method for HostEvVoltMaxLim" RAT_FUNC "%10.0" "V" COEFFS 0.000000 1.000000 -0.000000 0.000000 0.000000 1.000000 /end COMPU_METHOD
/* Scalar measurable for DDE 'HostEvVoltMinLim'. */
/begin MEASUREMENT HostEvVoltMinLim "Minimum voltage supported by the vehicle." FLOAT32_IEEE CU_HOSTEVVOLTMINLIM 1 100 0.0 196605.0 ECU_ADDRESS 0x70017f78 BYTE_ORDER MSB_LAST /end MEASUREMENT
/begin COMPU_METHOD CU_HOSTEVVOLTMINLIM "Conversion method for HostEvVoltMinLim" RAT_FUNC "%10.0" "V" COEFFS 0.000000 1.000000 -0.000000 0.000000 0.000000 1.000000 /end COMPU_METHOD
/* Scalar measurable for DDE 'HostIgnoreIsolWarning'. */
/begin MEASUREMENT HostIgnoreIsolWarning "(not defined)" UBYTE CU_HOSTIGNOREISOLWARNING 1 100 0.0 1.0 ECU_ADDRESS 0x700183b9 BYTE_ORDER MSB_LAST /end MEASUREMENT
/begin COMPU_METHOD CU_HOSTIGNOREISOLWARNING "Conversion method for HostIgnoreIsolWarning" RAT_FUNC "%10.0" "b" COEFFS 0.000000 1.000000 -0.000000 0.000000 0.000000 1.000000 /end COMPU_METHOD
/* Scalar measurable for DDE 'HostPriorityDin'. */
/begin MEASUREMENT HostPriorityDin "Exported global for DIN70121 priority from Host (post-override)." UBYTE CU_HOSTPRIORITYDIN 1 100 0.0 255.0 ECU_ADDRESS 0x70017ec8 BYTE_ORDER MSB_LAST /end MEASUREMENT
/begin COMPU_METHOD CU_HOSTPRIORITYDIN "Conversion method for HostPriorityDin" RAT_FUNC "%10.0" "e" COEFFS 0.000000 1.000000 -0.000000 0.000000 0.000000 1.000000 /end COMPU_METHOD
/* Scalar measurable for DDE 'HostPriorityIsoV1'. */
/begin MEASUREMENT HostPriorityIsoV1 "Exported global for ISO15118-2 priority from Host (post-override)." UBYTE CU_HOSTPRIORITYISOV1 1 100 0.0 255.0 ECU_ADDRESS 0x70018325 BYTE_ORDER MSB_LAST /end MEASUREMENT
/begin COMPU_METHOD CU_HOSTPRIORITYISOV1 "Conversion method for HostPriorityIsoV1" RAT_FUNC "%10.0" "e" COEFFS 0.000000 1.000000 -0.000000 0.000000 0.000000 1.000000 /end COMPU_METHOD
/* Scalar measurable for DDE 'HostPriorityIsoV2'. */
/begin MEASUREMENT HostPriorityIsoV2 "Exported global for ISO15118-20 priority from Host (post-override)." UBYTE CU_HOSTPRIORITYISOV2 1 100 0.0 255.0 ECU_ADDRESS 0x70017e29 BYTE_ORDER MSB_LAST /end MEASUREMENT
/begin COMPU_METHOD CU_HOSTPRIORITYISOV2 "Conversion method for HostPriorityIsoV2" RAT_FUNC "%10.0" "e" COEFFS 0.000000 1.000000 -0.000000 0.000000 0.000000 1.000000 /end COMPU_METHOD
/* Scalar measurable for DDE 'HostProtocolDinEnbl'. */
/begin MEASUREMENT HostProtocolDinEnbl "Exported global for DIN70121 enable (post-override)." UBYTE CU_HOSTPROTOCOLDINENBL 1 100 0.0 1.0 ECU_ADDRESS 0x70018280 BYTE_ORDER MSB_LAST /end MEASUREMENT
/begin COMPU_METHOD CU_HOSTPROTOCOLDINENBL "Conversion method for HostProtocolDinEnbl" RAT_FUNC "%10.0" "b" COEFFS 0.000000 1.000000 -0.000000 0.000000 0.000000 1.000000 /end COMPU_METHOD
/* Scalar measurable for DDE 'HostProtocolIsoV1Enbl'. */
/begin MEASUREMENT HostProtocolIsoV1Enbl "Exported global for ISO15118-2 enable (post-override)." UBYTE CU_HOSTPROTOCOLISOV1ENBL 1 100 0.0 1.0 ECU_ADDRESS 0x70017d8f BYTE_ORDER MSB_LAST /end MEASUREMENT
/begin COMPU_METHOD CU_HOSTPROTOCOLISOV1ENBL "Conversion method for HostProtocolIsoV1Enbl" RAT_FUNC "%10.0" "b" COEFFS 0.000000 1.000000 -0.000000 0.000000 0.000000 1.000000 /end COMPU_METHOD
/* Scalar measurable for DDE 'HostProtocolIsoV2Enbl'. */
/begin MEASUREMENT HostProtocolIsoV2Enbl "Exported global for ISO15118-20 enable (post-override)." UBYTE CU_HOSTPROTOCOLISOV2ENBL 1 100 0.0 1.0 ECU_ADDRESS 0x700181b9 BYTE_ORDER MSB_LAST /end MEASUREMENT
/begin COMPU_METHOD CU_HOSTPROTOCOLISOV2ENBL "Conversion method for HostProtocolIsoV2Enbl" RAT_FUNC "%10.0" "b" COEFFS 0.000000 1.000000 -0.000000 0.000000 0.000000 1.000000 /end COMPU_METHOD
/* Scalar measurable for DDE 'HostPwminEvsePilotDutcyc'. */
/begin MEASUREMENT HostPwminEvsePilotDutcyc "duty_cycle percent feature for PWM Input of EVSE Pilot." FLOAT32_IEEE CU_HOSTPWMINEVSEPILOTDUTCYC 1 100 0.0 100.0 ECU_ADDRESS 0x70017c9c BYTE_ORDER MSB_LAST /end MEASUREMENT
/begin COMPU_METHOD CU_HOSTPWMINEVSEPILOTDUTCYC "Conversion method for HostPwminEvsePilotDutcyc" RAT_FUNC "%10.0" "%" COEFFS 0.000000 1.000000 -0.000000 0.000000 0.000000 1.000000 /end COMPU_METHOD
/* Scalar measurable for DDE 'HostPwminEvsePilotFreq'. */
/begin MEASUREMENT HostPwminEvsePilotFreq "Frequency of the last measured period for the PWM Input of EVSE Pilot" FLOAT32_IEEE CU_HOSTPWMINEVSEPILOTFREQ 1 100 0.0 10000000.0 ECU_ADDRESS 0x700180f0 BYTE_ORDER MSB_LAST /end MEASUREMENT
/begin COMPU_METHOD CU_HOSTPWMINEVSEPILOTFREQ "Conversion method for HostPwminEvsePilotFreq" RAT_FUNC "%10.0" "Hz" COEFFS 0.000000 1.000000 -0.000000 0.000000 0.000000 1.000000 /end COMPU_METHOD
/* Scalar measurable for DDE 'HostPwminEvsePilotTimeout'. */
/begin MEASUREMENT HostPwminEvsePilotTimeout "Timeout feature for PWM Input of EVSE Pilot (True if a complete period has not been measured for the timeout given by the mask parameter Time out, zero otherwise)." UBYTE CU_HOSTPWMINEVSEPILOTTIMEOUT 1 100 0.0 1.0 ECU_ADDRESS 0x70017c1c BYTE_ORDER MSB_LAST /end MEASUREMENT
/begin COMPU_METHOD CU_HOSTPWMINEVSEPILOTTIMEOUT "Conversion method for HostPwminEvsePilotTimeout" RAT_FUNC "%10.0" "b" COEFFS 0.000000 1.000000 -0.000000 0.000000 0.000000 1.000000 /end COMPU_METHOD
/* Scalar measurable for DDE 'HostRelayWeldCheckEnable'. */
/begin MEASUREMENT HostRelayWeldCheckEnable "(not defined)" UBYTE CU_HOSTRELAYWELDCHECKENABLE 1 100 0.0 1.0 ECU_ADDRESS 0x70017fc0 BYTE_ORDER MSB_LAST /end MEASUREMENT
/begin COMPU_METHOD CU_HOSTRELAYWELDCHECKENABLE "Conversion method for HostRelayWeldCheckEnable" RAT_FUNC "%10.0" "b" COEFFS 0.000000 1.000000 -0.000000 0.000000 0.000000 1.000000 /end COMPU_METHOD
/* Scalar measurable for DDE 'HostRemainTimeToFullSoc'. */
/begin MEASUREMENT HostRemainTimeToFullSoc "Estimated or calculated time until full charge is complete. For displaying on EVSE for user only." FLOAT32_IEEE CU_HOSTREMAINTIMETOFULLSOC 1 100 0.0 196605.0 ECU_ADDRESS 0x7001843c BYTE_ORDER MSB_LAST /end MEASUREMENT
/begin COMPU_METHOD CU_HOSTREMAINTIMETOFULLSOC "Conversion method for HostRemainTimeToFullSoc" RAT_FUNC "%10.0" "s" COEFFS 0.000000 1.000000 -0.000000 0.000000 0.000000 1.000000 /end COMPU_METHOD
/* Scalar measurable for DDE 'HostRemainTimetoBulkSoc'. */
/begin MEASUREMENT HostRemainTimetoBulkSoc "Estimated or calculated time until bulk charge is complete. For displaying on EVSE for user only." FLOAT32_IEEE CU_HOSTREMAINTIMETOBULKSOC 1 100 0.0 196605.0 ECU_ADDRESS 0x70017f08 BYTE_ORDER MSB_LAST /end MEASUREMENT
/begin COMPU_METHOD CU_HOSTREMAINTIMETOBULKSOC "Conversion method for HostRemainTimetoBulkSoc" RAT_FUNC "%10.0" "s" COEFFS 0.000000 1.000000 -0.000000 0.000000 0.000000 1.000000 /end COMPU_METHOD
/* Scalar measurable for DDE 'HostRessBulkSoc'. */
/begin MEASUREMENT HostRessBulkSoc "(not defined)" FLOAT32_IEEE CU_HOSTRESSBULKSOC 1 100 0.0 100.0 ECU_ADDRESS 0x7001837c BYTE_ORDER MSB_LAST /end MEASUREMENT
/begin COMPU_METHOD CU_HOSTRESSBULKSOC "Conversion method for HostRessBulkSoc" RAT_FUNC "%10.0" "%" COEFFS 0.000000 1.000000 -0.000000 0.000000 0.000000 1.000000 /end COMPU_METHOD
/* Scalar measurable for DDE 'HostRessSoc'. */
/begin MEASUREMENT HostRessSoc "(not defined)" FLOAT32_IEEE CU_HOSTRESSSOC 1 100 0.0 100.0 ECU_ADDRESS 0x70017e7c BYTE_ORDER MSB_LAST /end MEASUREMENT
/begin COMPU_METHOD CU_HOSTRESSSOC "Conversion method for HostRessSoc" RAT_FUNC "%10.0" "%" COEFFS 0.000000 1.000000 -0.000000 0.000000 0.000000 1.000000 /end COMPU_METHOD
/* Scalar measurable for DDE 'HostRessTargetSoc'. */
/begin MEASUREMENT HostRessTargetSoc "The state of charge desired by the EV" FLOAT32_IEEE CU_HOSTRESSTARGETSOC 1 100 0.0 196605.0 ECU_ADDRESS 0x700182c4 BYTE_ORDER MSB_LAST /end MEASUREMENT
/begin COMPU_METHOD CU_HOSTRESSTARGETSOC "Conversion method for HostRessTargetSoc" RAT_FUNC "%10.0" "Wh" COEFFS 0.000000 1.000000 -0.000000 0.000000 0.000000 1.000000 /end COMPU_METHOD
/* Scalar measurable for DDE 'HostRessVolt'. */
/begin MEASUREMENT HostRessVolt "Battery voltage" FLOAT32_IEEE CU_HOSTRESSVOLT 1 100 0.0 196605.0 ECU_ADDRESS 0x70017dd4 BYTE_ORDER MSB_LAST /end MEASUREMENT
/begin COMPU_METHOD CU_HOSTRESSVOLT "Conversion method for HostRessVolt" RAT_FUNC "%10.0" "V" COEFFS 0.000000 1.000000 -0.000000 0.000000 0.000000 1.000000 /end COMPU_METHOD
/* Scalar measurable for DDE 'Iso1CblChkEvseIsolStatus'. */
/begin MEASUREMENT Iso1CblChkEvseIsolStatus "Indicates the isolation condition" UBYTE CU_ISO1CBLCHKEVSEISOLSTATUS 1 100 0.0 255.0 ECU_ADDRESS 0x70018210 BYTE_ORDER MSB_LAST /end MEASUREMENT
/begin COMPU_METHOD CU_ISO1CBLCHKEVSEISOLSTATUS "Conversion method for Iso1CblChkEvseIsolStatus" RAT_FUNC "%10.0" "enum" COEFFS 0.000000 1.000000 -0.000000 0.000000 0.000000 1.000000 /end COMPU_METHOD
/* Scalar measurable for DDE 'Iso1CblChkEvseProcessing'. */
/begin MEASUREMENT Iso1CblChkEvseProcessing "Message 4b: Parameter indicating that the EVSE has finished the processing that was initiated after the ContractAuthenticationReq or that the EVSE is still processing at the time the response message was sent." UBYTE CU_ISO1CBLCHKEVSEPROCESSING 1 100 0.0 255.0 ECU_ADDRESS 0x70017d2c BYTE_ORDER MSB_LAST /end MEASUREMENT
/begin COMPU_METHOD CU_ISO1CBLCHKEVSEPROCESSING "Conversion method for Iso1CblChkEvseProcessing" RAT_FUNC "%10.0" "enum" COEFFS 0.000000 1.000000 -0.000000 0.000000 0.000000 1.000000 /end COMPU_METHOD
/* Scalar measurable for DDE 'Iso1CblChkRescode'. */
/begin MEASUREMENT Iso1CblChkRescode "for message 4b: indicates the acknowledgment status of  this V2G messages received by the SECC." UBYTE CU_ISO1CBLCHKRESCODE 1 100 0.0 255.0 ECU_ADDRESS 0x70018184 BYTE_ORDER MSB_LAST /end MEASUREMENT
/begin COMPU_METHOD CU_ISO1CBLCHKRESCODE "Conversion method for Iso1CblChkRescode" RAT_FUNC "%10.0" "1" COEFFS 0.000000 1.000000 -0.000000 0.000000 0.000000 1.000000 /end COMPU_METHOD
/* Scalar measurable for DDE 'Iso1CrntDmdEvseCrntLimitAchieved'. */
/begin MEASUREMENT Iso1CrntDmdEvseCrntLimitAchiev0 "If set to TRUE, the EVSE has reached its current limit." UBYTE CU_ISO1CRNTDMDEVSECRNTLIMITACH0 1 100 0.0 1.0 ECU_ADDRESS 0x70017c58 BYTE_ORDER MSB_LAST /end MEASUREMENT
/begin COMPU_METHOD CU_ISO1CRNTDMDEVSECRNTLIMITACH0 "Conversion method for Iso1CrntDmdEvseCrntLimitAchieved" RAT_FUNC "%10.0" "b" COEFFS 0.000000 1.000000 -0.000000 0.000000 0.000000 1.000000 /end COMPU_METHOD
/* Scalar measurable for DDE 'Iso1CrntDmdEvseIdLen'. */
/begin MEASUREMENT Iso1CrntDmdEvseIdLen "Number of bytes in EVSE ID" UBYTE CU_ISO1CRNTDMDEVSEIDLEN 1 100 0.0 37.0 ECU_ADDRESS 0x70018480 BYTE_ORDER MSB_LAST /end MEASUREMENT
/begin COMPU_METHOD CU_ISO1CRNTDMDEVSEIDLEN "Conversion method for Iso1CrntDmdEvseIdLen" RAT_FUNC "%10.0" "1" COEFFS 0.000000 1.000000 -0.000000 0.000000 0.000000 1.000000 /end COMPU_METHOD
/* Scalar measurable for DDE 'Iso1CrntDmdEvseId[0]'. */
/begin MEASUREMENT Iso1CrntDmdEvseId[0] "The ID that uniquely identifies the EVSE. Format is defined in DIN SPEC 91286" UBYTE CU_ISO1CRNTDMDEVSEID[0] 1 100 0.0 255.0 ECU_ADDRESS 0x70018020 BYTE_ORDER MSB_LAST /end MEASUREMENT
/begin COMPU_METHOD CU_ISO1CRNTDMDEVSEID[0] "Conversion method for Iso1CrntDmdEvseId[0]" RAT_FUNC "%10.0" "1" COEFFS 0.000000 1.000000 -0.000000 0.000000 0.000000 1.000000 /end COMPU_METHOD
/* Scalar measurable for DDE 'Iso1CrntDmdEvseId[10]'. */
/begin MEASUREMENT Iso1CrntDmdEvseId[10] "The ID that uniquely identifies the EVSE. Format is defined in DIN SPEC 91286" UBYTE CU_ISO1CRNTDMDEVSEID[10] 1 100 0.0 255.0 ECU_ADDRESS 0x7001802a BYTE_ORDER MSB_LAST /end MEASUREMENT
/begin COMPU_METHOD CU_ISO1CRNTDMDEVSEID[10] "Conversion method for Iso1CrntDmdEvseId[10]" RAT_FUNC "%10.0" "1" COEFFS 0.000000 1.000000 -0.000000 0.000000 0.000000 1.000000 /end COMPU_METHOD
/* Scalar measurable for DDE 'Iso1CrntDmdEvseId[11]'. */
/begin MEASUREMENT Iso1CrntDmdEvseId[11] "The ID that uniquely identifies the EVSE. Format is defined in DIN SPEC 91286" UBYTE CU_ISO1CRNTDMDEVSEID[11] 1 100 0.0 255.0 ECU_ADDRESS 0x7001802b BYTE_ORDER MSB_LAST /end MEASUREMENT
/begin COMPU_METHOD CU_ISO1CRNTDMDEVSEID[11] "Conversion method for Iso1CrntDmdEvseId[11]" RAT_FUNC "%10.0" "1" COEFFS 0.000000 1.000000 -0.000000 0.000000 0.000000 1.000000 /end COMPU_METHOD
/* Scalar measurable for DDE 'Iso1CrntDmdEvseId[12]'. */
/begin MEASUREMENT Iso1CrntDmdEvseId[12] "The ID that uniquely identifies the EVSE. Format is defined in DIN SPEC 91286" UBYTE CU_ISO1CRNTDMDEVSEID[12] 1 100 0.0 255.0 ECU_ADDRESS 0x7001802c BYTE_ORDER MSB_LAST /end MEASUREMENT
/begin COMPU_METHOD CU_ISO1CRNTDMDEVSEID[12] "Conversion method for Iso1CrntDmdEvseId[12]" RAT_FUNC "%10.0" "1" COEFFS 0.000000 1.000000 -0.000000 0.000000 0.000000 1.000000 /end COMPU_METHOD
/* Scalar measurable for DDE 'Iso1CrntDmdEvseId[13]'. */
/begin MEASUREMENT Iso1CrntDmdEvseId[13] "The ID that uniquely identifies the EVSE. Format is defined in DIN SPEC 91286" UBYTE CU_ISO1CRNTDMDEVSEID[13] 1 100 0.0 255.0 ECU_ADDRESS 0x7001802d BYTE_ORDER MSB_LAST /end MEASUREMENT
/begin COMPU_METHOD CU_ISO1CRNTDMDEVSEID[13] "Conversion method for Iso1CrntDmdEvseId[13]" RAT_FUNC "%10.0" "1" COEFFS 0.000000 1.000000 -0.000000 0.000000 0.000000 1.000000 /end COMPU_METHOD
/* Scalar measurable for DDE 'Iso1CrntDmdEvseId[14]'. */
/begin MEASUREMENT Iso1CrntDmdEvseId[14] "The ID that uniquely identifies the EVSE. Format is defined in DIN SPEC 91286" UBYTE CU_ISO1CRNTDMDEVSEID[14] 1 100 0.0 255.0 ECU_ADDRESS 0x7001802e BYTE_ORDER MSB_LAST /end MEASUREMENT
/begin COMPU_METHOD CU_ISO1CRNTDMDEVSEID[14] "Conversion method for Iso1CrntDmdEvseId[14]" RAT_FUNC "%10.0" "1" COEFFS 0.000000 1.000000 -0.000000 0.000000 0.000000 1.000000 /end COMPU_METHOD
/* Scalar measurable for DDE 'Iso1CrntDmdEvseId[15]'. */
/begin MEASUREMENT Iso1CrntDmdEvseId[15] "The ID that uniquely identifies the EVSE. Format is defined in DIN SPEC 91286" UBYTE CU_ISO1CRNTDMDEVSEID[15] 1 100 0.0 255.0 ECU_ADDRESS 0x7001802f BYTE_ORDER MSB_LAST /end MEASUREMENT
/begin COMPU_METHOD CU_ISO1CRNTDMDEVSEID[15] "Conversion method for Iso1CrntDmdEvseId[15]" RAT_FUNC "%10.0" "1" COEFFS 0.000000 1.000000 -0.000000 0.000000 0.000000 1.000000 /end COMPU_METHOD
/* Scalar measurable for DDE 'Iso1CrntDmdEvseId[16]'. */
/begin MEASUREMENT Iso1CrntDmdEvseId[16] "The ID that uniquely identifies the EVSE. Format is defined in DIN SPEC 91286" UBYTE CU_ISO1CRNTDMDEVSEID[16] 1 100 0.0 255.0 ECU_ADDRESS 0x70018030 BYTE_ORDER MSB_LAST /end MEASUREMENT
/begin COMPU_METHOD CU_ISO1CRNTDMDEVSEID[16] "Conversion method for Iso1CrntDmdEvseId[16]" RAT_FUNC "%10.0" "1" COEFFS 0.000000 1.000000 -0.000000 0.000000 0.000000 1.000000 /end COMPU_METHOD
/* Scalar measurable for DDE 'Iso1CrntDmdEvseId[17]'. */
/begin MEASUREMENT Iso1CrntDmdEvseId[17] "The ID that uniquely identifies the EVSE. Format is defined in DIN SPEC 91286" UBYTE CU_ISO1CRNTDMDEVSEID[17] 1 100 0.0 255.0 ECU_ADDRESS 0x70018031 BYTE_ORDER MSB_LAST /end MEASUREMENT
/begin COMPU_METHOD CU_ISO1CRNTDMDEVSEID[17] "Conversion method for Iso1CrntDmdEvseId[17]" RAT_FUNC "%10.0" "1" COEFFS 0.000000 1.000000 -0.000000 0.000000 0.000000 1.000000 /end COMPU_METHOD
/* Scalar measurable for DDE 'Iso1CrntDmdEvseId[18]'. */
/begin MEASUREMENT Iso1CrntDmdEvseId[18] "The ID that uniquely identifies the EVSE. Format is defined in DIN SPEC 91286" UBYTE CU_ISO1CRNTDMDEVSEID[18] 1 100 0.0 255.0 ECU_ADDRESS 0x70018032 BYTE_ORDER MSB_LAST /end MEASUREMENT
/begin COMPU_METHOD CU_ISO1CRNTDMDEVSEID[18] "Conversion method for Iso1CrntDmdEvseId[18]" RAT_FUNC "%10.0" "1" COEFFS 0.000000 1.000000 -0.000000 0.000000 0.000000 1.000000 /end COMPU_METHOD
/* Scalar measurable for DDE 'Iso1CrntDmdEvseId[19]'. */
/begin MEASUREMENT Iso1CrntDmdEvseId[19] "The ID that uniquely identifies the EVSE. Format is defined in DIN SPEC 91286" UBYTE CU_ISO1CRNTDMDEVSEID[19] 1 100 0.0 255.0 ECU_ADDRESS 0x70018033 BYTE_ORDER MSB_LAST /end MEASUREMENT
/begin COMPU_METHOD CU_ISO1CRNTDMDEVSEID[19] "Conversion method for Iso1CrntDmdEvseId[19]" RAT_FUNC "%10.0" "1" COEFFS 0.000000 1.000000 -0.000000 0.000000 0.000000 1.000000 /end COMPU_METHOD
/* Scalar measurable for DDE 'Iso1CrntDmdEvseId[1]'. */
/begin MEASUREMENT Iso1CrntDmdEvseId[1] "The ID that uniquely identifies the EVSE. Format is defined in DIN SPEC 91286" UBYTE CU_ISO1CRNTDMDEVSEID[1] 1 100 0.0 255.0 ECU_ADDRESS 0x70018021 BYTE_ORDER MSB_LAST /end MEASUREMENT
/begin COMPU_METHOD CU_ISO1CRNTDMDEVSEID[1] "Conversion method for Iso1CrntDmdEvseId[1]" RAT_FUNC "%10.0" "1" COEFFS 0.000000 1.000000 -0.000000 0.000000 0.000000 1.000000 /end COMPU_METHOD
/* Scalar measurable for DDE 'Iso1CrntDmdEvseId[20]'. */
/begin MEASUREMENT Iso1CrntDmdEvseId[20] "The ID that uniquely identifies the EVSE. Format is defined in DIN SPEC 91286" UBYTE CU_ISO1CRNTDMDEVSEID[20] 1 100 0.0 255.0 ECU_ADDRESS 0x70018034 BYTE_ORDER MSB_LAST /end MEASUREMENT
/begin COMPU_METHOD CU_ISO1CRNTDMDEVSEID[20] "Conversion method for Iso1CrntDmdEvseId[20]" RAT_FUNC "%10.0" "1" COEFFS 0.000000 1.000000 -0.000000 0.000000 0.000000 1.000000 /end COMPU_METHOD
/* Scalar measurable for DDE 'Iso1CrntDmdEvseId[21]'. */
/begin MEASUREMENT Iso1CrntDmdEvseId[21] "The ID that uniquely identifies the EVSE. Format is defined in DIN SPEC 91286" UBYTE CU_ISO1CRNTDMDEVSEID[21] 1 100 0.0 255.0 ECU_ADDRESS 0x70018035 BYTE_ORDER MSB_LAST /end MEASUREMENT
/begin COMPU_METHOD CU_ISO1CRNTDMDEVSEID[21] "Conversion method for Iso1CrntDmdEvseId[21]" RAT_FUNC "%10.0" "1" COEFFS 0.000000 1.000000 -0.000000 0.000000 0.000000 1.000000 /end COMPU_METHOD
/* Scalar measurable for DDE 'Iso1CrntDmdEvseId[22]'. */
/begin MEASUREMENT Iso1CrntDmdEvseId[22] "The ID that uniquely identifies the EVSE. Format is defined in DIN SPEC 91286" UBYTE CU_ISO1CRNTDMDEVSEID[22] 1 100 0.0 255.0 ECU_ADDRESS 0x70018036 BYTE_ORDER MSB_LAST /end MEASUREMENT
/begin COMPU_METHOD CU_ISO1CRNTDMDEVSEID[22] "Conversion method for Iso1CrntDmdEvseId[22]" RAT_FUNC "%10.0" "1" COEFFS 0.000000 1.000000 -0.000000 0.000000 0.000000 1.000000 /end COMPU_METHOD
/* Scalar measurable for DDE 'Iso1CrntDmdEvseId[23]'. */
/begin MEASUREMENT Iso1CrntDmdEvseId[23] "The ID that uniquely identifies the EVSE. Format is defined in DIN SPEC 91286" UBYTE CU_ISO1CRNTDMDEVSEID[23] 1 100 0.0 255.0 ECU_ADDRESS 0x70018037 BYTE_ORDER MSB_LAST /end MEASUREMENT
/begin COMPU_METHOD CU_ISO1CRNTDMDEVSEID[23] "Conversion method for Iso1CrntDmdEvseId[23]" RAT_FUNC "%10.0" "1" COEFFS 0.000000 1.000000 -0.000000 0.000000 0.000000 1.000000 /end COMPU_METHOD
/* Scalar measurable for DDE 'Iso1CrntDmdEvseId[24]'. */
/begin MEASUREMENT Iso1CrntDmdEvseId[24] "The ID that uniquely identifies the EVSE. Format is defined in DIN SPEC 91286" UBYTE CU_ISO1CRNTDMDEVSEID[24] 1 100 0.0 255.0 ECU_ADDRESS 0x70018038 BYTE_ORDER MSB_LAST /end MEASUREMENT
/begin COMPU_METHOD CU_ISO1CRNTDMDEVSEID[24] "Conversion method for Iso1CrntDmdEvseId[24]" RAT_FUNC "%10.0" "1" COEFFS 0.000000 1.000000 -0.000000 0.000000 0.000000 1.000000 /end COMPU_METHOD
/* Scalar measurable for DDE 'Iso1CrntDmdEvseId[25]'. */
/begin MEASUREMENT Iso1CrntDmdEvseId[25] "The ID that uniquely identifies the EVSE. Format is defined in DIN SPEC 91286" UBYTE CU_ISO1CRNTDMDEVSEID[25] 1 100 0.0 255.0 ECU_ADDRESS 0x70018039 BYTE_ORDER MSB_LAST /end MEASUREMENT
/begin COMPU_METHOD CU_ISO1CRNTDMDEVSEID[25] "Conversion method for Iso1CrntDmdEvseId[25]" RAT_FUNC "%10.0" "1" COEFFS 0.000000 1.000000 -0.000000 0.000000 0.000000 1.000000 /end COMPU_METHOD
/* Scalar measurable for DDE 'Iso1CrntDmdEvseId[26]'. */
/begin MEASUREMENT Iso1CrntDmdEvseId[26] "The ID that uniquely identifies the EVSE. Format is defined in DIN SPEC 91286" UBYTE CU_ISO1CRNTDMDEVSEID[26] 1 100 0.0 255.0 ECU_ADDRESS 0x7001803a BYTE_ORDER MSB_LAST /end MEASUREMENT
/begin COMPU_METHOD CU_ISO1CRNTDMDEVSEID[26] "Conversion method for Iso1CrntDmdEvseId[26]" RAT_FUNC "%10.0" "1" COEFFS 0.000000 1.000000 -0.000000 0.000000 0.000000 1.000000 /end COMPU_METHOD
/* Scalar measurable for DDE 'Iso1CrntDmdEvseId[27]'. */
/begin MEASUREMENT Iso1CrntDmdEvseId[27] "The ID that uniquely identifies the EVSE. Format is defined in DIN SPEC 91286" UBYTE CU_ISO1CRNTDMDEVSEID[27] 1 100 0.0 255.0 ECU_ADDRESS 0x7001803b BYTE_ORDER MSB_LAST /end MEASUREMENT
/begin COMPU_METHOD CU_ISO1CRNTDMDEVSEID[27] "Conversion method for Iso1CrntDmdEvseId[27]" RAT_FUNC "%10.0" "1" COEFFS 0.000000 1.000000 -0.000000 0.000000 0.000000 1.000000 /end COMPU_METHOD
/* Scalar measurable for DDE 'Iso1CrntDmdEvseId[28]'. */
/begin MEASUREMENT Iso1CrntDmdEvseId[28] "The ID that uniquely identifies the EVSE. Format is defined in DIN SPEC 91286" UBYTE CU_ISO1CRNTDMDEVSEID[28] 1 100 0.0 255.0 ECU_ADDRESS 0x7001803c BYTE_ORDER MSB_LAST /end MEASUREMENT
/begin COMPU_METHOD CU_ISO1CRNTDMDEVSEID[28] "Conversion method for Iso1CrntDmdEvseId[28]" RAT_FUNC "%10.0" "1" COEFFS 0.000000 1.000000 -0.000000 0.000000 0.000000 1.000000 /end COMPU_METHOD
/* Scalar measurable for DDE 'Iso1CrntDmdEvseId[29]'. */
/begin MEASUREMENT Iso1CrntDmdEvseId[29] "The ID that uniquely identifies the EVSE. Format is defined in DIN SPEC 91286" UBYTE CU_ISO1CRNTDMDEVSEID[29] 1 100 0.0 255.0 ECU_ADDRESS 0x7001803d BYTE_ORDER MSB_LAST /end MEASUREMENT
/begin COMPU_METHOD CU_ISO1CRNTDMDEVSEID[29] "Conversion method for Iso1CrntDmdEvseId[29]" RAT_FUNC "%10.0" "1" COEFFS 0.000000 1.000000 -0.000000 0.000000 0.000000 1.000000 /end COMPU_METHOD
/* Scalar measurable for DDE 'Iso1CrntDmdEvseId[2]'. */
/begin MEASUREMENT Iso1CrntDmdEvseId[2] "The ID that uniquely identifies the EVSE. Format is defined in DIN SPEC 91286" UBYTE CU_ISO1CRNTDMDEVSEID[2] 1 100 0.0 255.0 ECU_ADDRESS 0x70018022 BYTE_ORDER MSB_LAST /end MEASUREMENT
/begin COMPU_METHOD CU_ISO1CRNTDMDEVSEID[2] "Conversion method for Iso1CrntDmdEvseId[2]" RAT_FUNC "%10.0" "1" COEFFS 0.000000 1.000000 -0.000000 0.000000 0.000000 1.000000 /end COMPU_METHOD
/* Scalar measurable for DDE 'Iso1CrntDmdEvseId[30]'. */
/begin MEASUREMENT Iso1CrntDmdEvseId[30] "The ID that uniquely identifies the EVSE. Format is defined in DIN SPEC 91286" UBYTE CU_ISO1CRNTDMDEVSEID[30] 1 100 0.0 255.0 ECU_ADDRESS 0x7001803e BYTE_ORDER MSB_LAST /end MEASUREMENT
/begin COMPU_METHOD CU_ISO1CRNTDMDEVSEID[30] "Conversion method for Iso1CrntDmdEvseId[30]" RAT_FUNC "%10.0" "1" COEFFS 0.000000 1.000000 -0.000000 0.000000 0.000000 1.000000 /end COMPU_METHOD
/* Scalar measurable for DDE 'Iso1CrntDmdEvseId[31]'. */
/begin MEASUREMENT Iso1CrntDmdEvseId[31] "The ID that uniquely identifies the EVSE. Format is defined in DIN SPEC 91286" UBYTE CU_ISO1CRNTDMDEVSEID[31] 1 100 0.0 255.0 ECU_ADDRESS 0x7001803f BYTE_ORDER MSB_LAST /end MEASUREMENT
/begin COMPU_METHOD CU_ISO1CRNTDMDEVSEID[31] "Conversion method for Iso1CrntDmdEvseId[31]" RAT_FUNC "%10.0" "1" COEFFS 0.000000 1.000000 -0.000000 0.000000 0.000000 1.000000 /end COMPU_METHOD
/* Scalar measurable for DDE 'Iso1CrntDmdEvseId[32]'. */
/begin MEASUREMENT Iso1CrntDmdEvseId[32] "The ID that uniquely identifies the EVSE. Format is defined in DIN SPEC 91286" UBYTE CU_ISO1CRNTDMDEVSEID[32] 1 100 0.0 255.0 ECU_ADDRESS 0x70018040 BYTE_ORDER MSB_LAST /end MEASUREMENT
/begin COMPU_METHOD CU_ISO1CRNTDMDEVSEID[32] "Conversion method for Iso1CrntDmdEvseId[32]" RAT_FUNC "%10.0" "1" COEFFS 0.000000 1.000000 -0.000000 0.000000 0.000000 1.000000 /end COMPU_METHOD
/* Scalar measurable for DDE 'Iso1CrntDmdEvseId[33]'. */
/begin MEASUREMENT Iso1CrntDmdEvseId[33] "The ID that uniquely identifies the EVSE. Format is defined in DIN SPEC 91286" UBYTE CU_ISO1CRNTDMDEVSEID[33] 1 100 0.0 255.0 ECU_ADDRESS 0x70018041 BYTE_ORDER MSB_LAST /end MEASUREMENT
/begin COMPU_METHOD CU_ISO1CRNTDMDEVSEID[33] "Conversion method for Iso1CrntDmdEvseId[33]" RAT_FUNC "%10.0" "1" COEFFS 0.000000 1.000000 -0.000000 0.000000 0.000000 1.000000 /end COMPU_METHOD
/* Scalar measurable for DDE 'Iso1CrntDmdEvseId[34]'. */
/begin MEASUREMENT Iso1CrntDmdEvseId[34] "The ID that uniquely identifies the EVSE. Format is defined in DIN SPEC 91286" UBYTE CU_ISO1CRNTDMDEVSEID[34] 1 100 0.0 255.0 ECU_ADDRESS 0x70018042 BYTE_ORDER MSB_LAST /end MEASUREMENT
/begin COMPU_METHOD CU_ISO1CRNTDMDEVSEID[34] "Conversion method for Iso1CrntDmdEvseId[34]" RAT_FUNC "%10.0" "1" COEFFS 0.000000 1.000000 -0.000000 0.000000 0.000000 1.000000 /end COMPU_METHOD
/* Scalar measurable for DDE 'Iso1CrntDmdEvseId[35]'. */
/begin MEASUREMENT Iso1CrntDmdEvseId[35] "The ID that uniquely identifies the EVSE. Format is defined in DIN SPEC 91286" UBYTE CU_ISO1CRNTDMDEVSEID[35] 1 100 0.0 255.0 ECU_ADDRESS 0x70018043 BYTE_ORDER MSB_LAST /end MEASUREMENT
/begin COMPU_METHOD CU_ISO1CRNTDMDEVSEID[35] "Conversion method for Iso1CrntDmdEvseId[35]" RAT_FUNC "%10.0" "1" COEFFS 0.000000 1.000000 -0.000000 0.000000 0.000000 1.000000 /end COMPU_METHOD
/* Scalar measurable for DDE 'Iso1CrntDmdEvseId[36]'. */
/begin MEASUREMENT Iso1CrntDmdEvseId[36] "The ID that uniquely identifies the EVSE. Format is defined in DIN SPEC 91286" UBYTE CU_ISO1CRNTDMDEVSEID[36] 1 100 0.0 255.0 ECU_ADDRESS 0x70018044 BYTE_ORDER MSB_LAST /end MEASUREMENT
/begin COMPU_METHOD CU_ISO1CRNTDMDEVSEID[36] "Conversion method for Iso1CrntDmdEvseId[36]" RAT_FUNC "%10.0" "1" COEFFS 0.000000 1.000000 -0.000000 0.000000 0.000000 1.000000 /end COMPU_METHOD
/* Scalar measurable for DDE 'Iso1CrntDmdEvseId[37]'. */
/begin MEASUREMENT Iso1CrntDmdEvseId[37] "The ID that uniquely identifies the EVSE. Format is defined in DIN SPEC 91286" UBYTE CU_ISO1CRNTDMDEVSEID[37] 1 100 0.0 255.0 ECU_ADDRESS 0x70018045 BYTE_ORDER MSB_LAST /end MEASUREMENT
/begin COMPU_METHOD CU_ISO1CRNTDMDEVSEID[37] "Conversion method for Iso1CrntDmdEvseId[37]" RAT_FUNC "%10.0" "1" COEFFS 0.000000 1.000000 -0.000000 0.000000 0.000000 1.000000 /end COMPU_METHOD
/* Scalar measurable for DDE 'Iso1CrntDmdEvseId[3]'. */
/begin MEASUREMENT Iso1CrntDmdEvseId[3] "The ID that uniquely identifies the EVSE. Format is defined in DIN SPEC 91286" UBYTE CU_ISO1CRNTDMDEVSEID[3] 1 100 0.0 255.0 ECU_ADDRESS 0x70018023 BYTE_ORDER MSB_LAST /end MEASUREMENT
/begin COMPU_METHOD CU_ISO1CRNTDMDEVSEID[3] "Conversion method for Iso1CrntDmdEvseId[3]" RAT_FUNC "%10.0" "1" COEFFS 0.000000 1.000000 -0.000000 0.000000 0.000000 1.000000 /end COMPU_METHOD
/* Scalar measurable for DDE 'Iso1CrntDmdEvseId[4]'. */
/begin MEASUREMENT Iso1CrntDmdEvseId[4] "The ID that uniquely identifies the EVSE. Format is defined in DIN SPEC 91286" UBYTE CU_ISO1CRNTDMDEVSEID[4] 1 100 0.0 255.0 ECU_ADDRESS 0x70018024 BYTE_ORDER MSB_LAST /end MEASUREMENT
/begin COMPU_METHOD CU_ISO1CRNTDMDEVSEID[4] "Conversion method for Iso1CrntDmdEvseId[4]" RAT_FUNC "%10.0" "1" COEFFS 0.000000 1.000000 -0.000000 0.000000 0.000000 1.000000 /end COMPU_METHOD
/* Scalar measurable for DDE 'Iso1CrntDmdEvseId[5]'. */
/begin MEASUREMENT Iso1CrntDmdEvseId[5] "The ID that uniquely identifies the EVSE. Format is defined in DIN SPEC 91286" UBYTE CU_ISO1CRNTDMDEVSEID[5] 1 100 0.0 255.0 ECU_ADDRESS 0x70018025 BYTE_ORDER MSB_LAST /end MEASUREMENT
/begin COMPU_METHOD CU_ISO1CRNTDMDEVSEID[5] "Conversion method for Iso1CrntDmdEvseId[5]" RAT_FUNC "%10.0" "1" COEFFS 0.000000 1.000000 -0.000000 0.000000 0.000000 1.000000 /end COMPU_METHOD
/* Scalar measurable for DDE 'Iso1CrntDmdEvseId[6]'. */
/begin MEASUREMENT Iso1CrntDmdEvseId[6] "The ID that uniquely identifies the EVSE. Format is defined in DIN SPEC 91286" UBYTE CU_ISO1CRNTDMDEVSEID[6] 1 100 0.0 255.0 ECU_ADDRESS 0x70018026 BYTE_ORDER MSB_LAST /end MEASUREMENT
/begin COMPU_METHOD CU_ISO1CRNTDMDEVSEID[6] "Conversion method for Iso1CrntDmdEvseId[6]" RAT_FUNC "%10.0" "1" COEFFS 0.000000 1.000000 -0.000000 0.000000 0.000000 1.000000 /end COMPU_METHOD
/* Scalar measurable for DDE 'Iso1CrntDmdEvseId[7]'. */
/begin MEASUREMENT Iso1CrntDmdEvseId[7] "The ID that uniquely identifies the EVSE. Format is defined in DIN SPEC 91286" UBYTE CU_ISO1CRNTDMDEVSEID[7] 1 100 0.0 255.0 ECU_ADDRESS 0x70018027 BYTE_ORDER MSB_LAST /end MEASUREMENT
/begin COMPU_METHOD CU_ISO1CRNTDMDEVSEID[7] "Conversion method for Iso1CrntDmdEvseId[7]" RAT_FUNC "%10.0" "1" COEFFS 0.000000 1.000000 -0.000000 0.000000 0.000000 1.000000 /end COMPU_METHOD
/* Scalar measurable for DDE 'Iso1CrntDmdEvseId[8]'. */
/begin MEASUREMENT Iso1CrntDmdEvseId[8] "The ID that uniquely identifies the EVSE. Format is defined in DIN SPEC 91286" UBYTE CU_ISO1CRNTDMDEVSEID[8] 1 100 0.0 255.0 ECU_ADDRESS 0x70018028 BYTE_ORDER MSB_LAST /end MEASUREMENT
/begin COMPU_METHOD CU_ISO1CRNTDMDEVSEID[8] "Conversion method for Iso1CrntDmdEvseId[8]" RAT_FUNC "%10.0" "1" COEFFS 0.000000 1.000000 -0.000000 0.000000 0.000000 1.000000 /end COMPU_METHOD
/* Scalar measurable for DDE 'Iso1CrntDmdEvseId[9]'. */
/begin MEASUREMENT Iso1CrntDmdEvseId[9] "The ID that uniquely identifies the EVSE. Format is defined in DIN SPEC 91286" UBYTE CU_ISO1CRNTDMDEVSEID[9] 1 100 0.0 255.0 ECU_ADDRESS 0x70018029 BYTE_ORDER MSB_LAST /end MEASUREMENT
/begin COMPU_METHOD CU_ISO1CRNTDMDEVSEID[9] "Conversion method for Iso1CrntDmdEvseId[9]" RAT_FUNC "%10.0" "1" COEFFS 0.000000 1.000000 -0.000000 0.000000 0.000000 1.000000 /end COMPU_METHOD
/* Scalar measurable for DDE 'Iso1CrntDmdEvseMaxVoltLimitPresent'. */
/begin MEASUREMENT Iso1CrntDmdEvseMaxVoltLimitPre0 "Indicates that the EVSEMaximumVoltageLimit parameter is available." UBYTE CU_ISO1CRNTDMDEVSEMAXVOLTLIMIT0 1 100 0.0 1.0 ECU_ADDRESS 0x70017f7c BYTE_ORDER MSB_LAST /end MEASUREMENT
/begin COMPU_METHOD CU_ISO1CRNTDMDEVSEMAXVOLTLIMIT0 "Conversion method for Iso1CrntDmdEvseMaxVoltLimitPresent" RAT_FUNC "%10.0" "b" COEFFS 0.000000 1.000000 -0.000000 0.000000 0.000000 1.000000 /end COMPU_METHOD
/* Scalar measurable for DDE 'Iso1CrntDmdEvseVoltLimitAchieved'. */
/begin MEASUREMENT Iso1CrntDmdEvseVoltLimitAchiev0 "f set to TRUE, the EVSE has reached its voltage limit." UBYTE CU_ISO1CRNTDMDEVSEVOLTLIMITACH0 1 100 0.0 1.0 ECU_ADDRESS 0x700183ba BYTE_ORDER MSB_LAST /end MEASUREMENT
/begin COMPU_METHOD CU_ISO1CRNTDMDEVSEVOLTLIMITACH0 "Conversion method for Iso1CrntDmdEvseVoltLimitAchieved" RAT_FUNC "%10.0" "b" COEFFS 0.000000 1.000000 -0.000000 0.000000 0.000000 1.000000 /end COMPU_METHOD
/* Scalar measurable for DDE 'Iso1CrntDmdNotifMaxDelay'. */
/begin MEASUREMENT Iso1CrntDmdNotifMaxDelay "The Notification Max Delay parameter in the received message from EVSE" UWORD CU_ISO1CRNTDMDNOTIFMAXDELAY 1 100 0.0 65535.0 ECU_ADDRESS 0x70017eca BYTE_ORDER MSB_LAST /end MEASUREMENT
/begin COMPU_METHOD CU_ISO1CRNTDMDNOTIFMAXDELAY "Conversion method for Iso1CrntDmdNotifMaxDelay" RAT_FUNC "%10.0" "s" COEFFS 0.000000 1.000000 -0.000000 0.000000 0.000000 1.000000 /end COMPU_METHOD
/* Scalar measurable for DDE 'Iso1CrntDmdRescode'. */
/begin MEASUREMENT Iso1CrntDmdRescode "for message 7b: indicates the acknowledgment status of  this V2G messages received by the SECC." UBYTE CU_ISO1CRNTDMDRESCODE 1 100 0.0 255.0 ECU_ADDRESS 0x70018326 BYTE_ORDER MSB_LAST /end MEASUREMENT
/begin COMPU_METHOD CU_ISO1CRNTDMDRESCODE "Conversion method for Iso1CrntDmdRescode" RAT_FUNC "%10.0" "1" COEFFS 0.000000 1.000000 -0.000000 0.000000 0.000000 1.000000 /end COMPU_METHOD
/* Scalar measurable for DDE 'Iso1DcChgParCrntRegTol'. */
/begin MEASUREMENT Iso1DcChgParCrntRegTol "Absolute magnitude of the regulation tolerance of the EVSE." FLOAT32_IEEE CU_ISO1DCCHGPARCRNTREGTOL 1 100 0.0 196605.0 ECU_ADDRESS 0x70017e2c BYTE_ORDER MSB_LAST /end MEASUREMENT
/begin COMPU_METHOD CU_ISO1DCCHGPARCRNTREGTOL "Conversion method for Iso1DcChgParCrntRegTol" RAT_FUNC "%10.0" "A" COEFFS 0.000000 1.000000 -0.000000 0.000000 0.000000 1.000000 /end COMPU_METHOD
/* Scalar measurable for DDE 'Iso1DcChgParIsolStatus'. */
/begin MEASUREMENT Iso1DcChgParIsolStatus "Indicates the isolation condition" UBYTE CU_ISO1DCCHGPARISOLSTATUS 1 100 0.0 255.0 ECU_ADDRESS 0x70018281 BYTE_ORDER MSB_LAST /end MEASUREMENT
/begin COMPU_METHOD CU_ISO1DCCHGPARISOLSTATUS "Conversion method for Iso1DcChgParIsolStatus" RAT_FUNC "%10.0" "enum" COEFFS 0.000000 1.000000 -0.000000 0.000000 0.000000 1.000000 /end COMPU_METHOD
/* Scalar measurable for DDE 'Iso1DcChgParMaxVoltLim'. */
/begin MEASUREMENT Iso1DcChgParMaxVoltLim "Maximum voltage the EVSE can deliver" FLOAT32_IEEE CU_ISO1DCCHGPARMAXVOLTLIM 1 100 0.0 196605.0 ECU_ADDRESS 0x70017d90 BYTE_ORDER MSB_LAST /end MEASUREMENT
/begin COMPU_METHOD CU_ISO1DCCHGPARMAXVOLTLIM "Conversion method for Iso1DcChgParMaxVoltLim" RAT_FUNC "%10.0" "V" COEFFS 0.000000 1.000000 -0.000000 0.000000 0.000000 1.000000 /end COMPU_METHOD
/* Scalar measurable for DDE 'Iso1DcChgParMinCrntLim'. */
/begin MEASUREMENT Iso1DcChgParMinCrntLim "Minimum current the EVSE can deliver with the expected accuracy" FLOAT32_IEEE CU_ISO1DCCHGPARMINCRNTLIM 1 100 0.0 196605.0 ECU_ADDRESS 0x700181bc BYTE_ORDER MSB_LAST /end MEASUREMENT
/begin COMPU_METHOD CU_ISO1DCCHGPARMINCRNTLIM "Conversion method for Iso1DcChgParMinCrntLim" RAT_FUNC "%10.0" "A" COEFFS 0.000000 1.000000 -0.000000 0.000000 0.000000 1.000000 /end COMPU_METHOD
/* Scalar measurable for DDE 'Iso1DcChgParPeakCrntRipple'. */
/begin MEASUREMENT Iso1DcChgParPeakCrntRipple "Peak-to-peak magnitude of the current ripple of the EVSE." FLOAT32_IEEE CU_ISO1DCCHGPARPEAKCRNTRIPPLE 1 100 0.0 196605.0 ECU_ADDRESS 0x70017ca0 BYTE_ORDER MSB_LAST /end MEASUREMENT
/begin COMPU_METHOD CU_ISO1DCCHGPARPEAKCRNTRIPPLE "Conversion method for Iso1DcChgParPeakCrntRipple" RAT_FUNC "%10.0" "A" COEFFS 0.000000 1.000000 -0.000000 0.000000 0.000000 1.000000 /end COMPU_METHOD
/* Scalar measurable for DDE 'Iso1PmtSelRescode'. */
/begin MEASUREMENT Iso1PmtSelRescode "for ISOv1 PaymentServiceSelection  message: indicates the acknowledgment status of this V2G messages received by the SECC." UBYTE CU_ISO1PMTSELRESCODE 1 100 0.0 255.0 ECU_ADDRESS 0x700180f4 BYTE_ORDER MSB_LAST /end MEASUREMENT
/begin COMPU_METHOD CU_ISO1PMTSELRESCODE "Conversion method for Iso1PmtSelRescode" RAT_FUNC "%10.0" "1" COEFFS 0.000000 1.000000 -0.000000 0.000000 0.000000 1.000000 /end COMPU_METHOD
/* Scalar measurable for DDE 'Iso1PreChgEvseIsolStatusPres'. */
/begin MEASUREMENT Iso1PreChgEvseIsolStatusPres "Identifies the presence of the EVSEIsolationStatus parameter." UBYTE CU_ISO1PRECHGEVSEISOLSTATUSPRES 1 100 0.0 1.0 ECU_ADDRESS 0x70017c1d BYTE_ORDER MSB_LAST /end MEASUREMENT
/begin COMPU_METHOD CU_ISO1PRECHGEVSEISOLSTATUSPRES "Conversion method for Iso1PreChgEvseIsolStatusPres" RAT_FUNC "%10.0" "b" COEFFS 0.000000 1.000000 -0.000000 0.000000 0.000000 1.000000 /end COMPU_METHOD
/* Scalar measurable for DDE 'Iso1PreChgEvseNotifMaxDelay'. */
/begin MEASUREMENT Iso1PreChgEvseNotifMaxDelay "The Notification Max Delay parameter in the received message from EVSE" UWORD CU_ISO1PRECHGEVSENOTIFMAXDELAY 1 100 0.0 65535.0 ECU_ADDRESS 0x70017fc2 BYTE_ORDER MSB_LAST /end MEASUREMENT
/begin COMPU_METHOD CU_ISO1PRECHGEVSENOTIFMAXDELAY "Conversion method for Iso1PreChgEvseNotifMaxDelay" RAT_FUNC "%10.0" "s" COEFFS 0.000000 1.000000 -0.000000 0.000000 0.000000 1.000000 /end COMPU_METHOD
/* Scalar measurable for DDE 'Iso1PreChgEvsePresVolt'. */
/begin MEASUREMENT Iso1PreChgEvsePresVolt "Present voltage of EVSE" FLOAT32_IEEE CU_ISO1PRECHGEVSEPRESVOLT 1 100 0.0 196605.0 ECU_ADDRESS 0x70018440 BYTE_ORDER MSB_LAST /end MEASUREMENT
/begin COMPU_METHOD CU_ISO1PRECHGEVSEPRESVOLT "Conversion method for Iso1PreChgEvsePresVolt" RAT_FUNC "%10.0" "V" COEFFS 0.000000 1.000000 -0.000000 0.000000 0.000000 1.000000 /end COMPU_METHOD
/* Scalar measurable for DDE 'Iso1PreChgRxTrg'. */
/begin MEASUREMENT Iso1PreChgRxTrg "Trigger falg that on a rising edge indicates the event for receiving the PLC (V2G) message response 5b from EVSE" UBYTE CU_ISO1PRECHGRXTRG 1 100 0.0 1.0 ECU_ADDRESS 0x70017f0c BYTE_ORDER MSB_LAST /end MEASUREMENT
/begin COMPU_METHOD CU_ISO1PRECHGRXTRG "Conversion method for Iso1PreChgRxTrg" RAT_FUNC "%10.0" "b" COEFFS 0.000000 1.000000 -0.000000 0.000000 0.000000 1.000000 /end COMPU_METHOD
/* Scalar measurable for DDE 'Iso1PwrDelivEvseIsolStatusPres'. */
/begin MEASUREMENT Iso1PwrDelivEvseIsolStatusPres "Identifies the presence of the EVSEIsolationStatus_present, EVSEIsolationStatus" UBYTE CU_ISO1PWRDELIVEVSEISOLSTATUSP0 1 100 0.0 1.0 ECU_ADDRESS 0x70018380 BYTE_ORDER MSB_LAST /end MEASUREMENT
/begin COMPU_METHOD CU_ISO1PWRDELIVEVSEISOLSTATUSP0 "Conversion method for Iso1PwrDelivEvseIsolStatusPres" RAT_FUNC "%10.0" "b" COEFFS 0.000000 1.000000 -0.000000 0.000000 0.000000 1.000000 /end COMPU_METHOD
/* Scalar measurable for DDE 'Iso1PwrDelivEvseStatusCode'. */
/begin MEASUREMENT Iso1PwrDelivEvseStatusCode "Indicates the internal state of the EVSE." UBYTE CU_ISO1PWRDELIVEVSESTATUSCODE 1 100 0.0 255.0 ECU_ADDRESS 0x70017e80 BYTE_ORDER MSB_LAST /end MEASUREMENT
/begin COMPU_METHOD CU_ISO1PWRDELIVEVSESTATUSCODE "Conversion method for Iso1PwrDelivEvseStatusCode" RAT_FUNC "%10.0" "enum" COEFFS 0.000000 1.000000 -0.000000 0.000000 0.000000 1.000000 /end COMPU_METHOD
/* Scalar measurable for DDE 'Iso1PwrDelivEvseStatusPresent'. */
/begin MEASUREMENT Iso1PwrDelivEvseStatusPresent "Identifies the presence of the EVSEStatusCode_present, and EVSEStatusCode parameters." UBYTE CU_ISO1PWRDELIVEVSESTATUSPRESE0 1 100 0.0 1.0 ECU_ADDRESS 0x700182c8 BYTE_ORDER MSB_LAST /end MEASUREMENT
/begin COMPU_METHOD CU_ISO1PWRDELIVEVSESTATUSPRESE0 "Conversion method for Iso1PwrDelivEvseStatusPresent" RAT_FUNC "%10.0" "b" COEFFS 0.000000 1.000000 -0.000000 0.000000 0.000000 1.000000 /end COMPU_METHOD
/* Scalar measurable for DDE 'Iso1PwrDelivNotifMaxDelay'. */
/begin MEASUREMENT Iso1PwrDelivNotifMaxDelay "The Notification Max Delay parameter in the received message from EVSE" UWORD CU_ISO1PWRDELIVNOTIFMAXDELAY 1 100 0.0 65535.0 ECU_ADDRESS 0x70017dd8 BYTE_ORDER MSB_LAST /end MEASUREMENT
/begin COMPU_METHOD CU_ISO1PWRDELIVNOTIFMAXDELAY "Conversion method for Iso1PwrDelivNotifMaxDelay" RAT_FUNC "%10.0" "s" COEFFS 0.000000 1.000000 -0.000000 0.000000 0.000000 1.000000 /end COMPU_METHOD
/* Scalar measurable for DDE 'Iso1SesSetupEvseId[0]'. */
/begin MEASUREMENT Iso1SesSetupEvseId[0] "The ID that uniquely identifies the EVSE. Format is defined in the ISO 15118 ED2 Spec Annex H" UBYTE CU_ISO1SESSETUPEVSEID[0] 1 100 0.0 255.0 ECU_ADDRESS 0x70018211 BYTE_ORDER MSB_LAST /end MEASUREMENT
/begin COMPU_METHOD CU_ISO1SESSETUPEVSEID[0] "Conversion method for Iso1SesSetupEvseId[0]" RAT_FUNC "%10.0" "1" COEFFS 0.000000 1.000000 -0.000000 0.000000 0.000000 1.000000 /end COMPU_METHOD
/* Scalar measurable for DDE 'Iso1SesSetupEvseId[10]'. */
/begin MEASUREMENT Iso1SesSetupEvseId[10] "The ID that uniquely identifies the EVSE. Format is defined in the ISO 15118 ED2 Spec Annex H" UBYTE CU_ISO1SESSETUPEVSEID[10] 1 100 0.0 255.0 ECU_ADDRESS 0x7001821b BYTE_ORDER MSB_LAST /end MEASUREMENT
/begin COMPU_METHOD CU_ISO1SESSETUPEVSEID[10] "Conversion method for Iso1SesSetupEvseId[10]" RAT_FUNC "%10.0" "1" COEFFS 0.000000 1.000000 -0.000000 0.000000 0.000000 1.000000 /end COMPU_METHOD
/* Scalar measurable for DDE 'Iso1SesSetupEvseId[11]'. */
/begin MEASUREMENT Iso1SesSetupEvseId[11] "The ID that uniquely identifies the EVSE. Format is defined in the ISO 15118 ED2 Spec Annex H" UBYTE CU_ISO1SESSETUPEVSEID[11] 1 100 0.0 255.0 ECU_ADDRESS 0x7001821c BYTE_ORDER MSB_LAST /end MEASUREMENT
/begin COMPU_METHOD CU_ISO1SESSETUPEVSEID[11] "Conversion method for Iso1SesSetupEvseId[11]" RAT_FUNC "%10.0" "1" COEFFS 0.000000 1.000000 -0.000000 0.000000 0.000000 1.000000 /end COMPU_METHOD
/* Scalar measurable for DDE 'Iso1SesSetupEvseId[12]'. */
/begin MEASUREMENT Iso1SesSetupEvseId[12] "The ID that uniquely identifies the EVSE. Format is defined in the ISO 15118 ED2 Spec Annex H" UBYTE CU_ISO1SESSETUPEVSEID[12] 1 100 0.0 255.0 ECU_ADDRESS 0x7001821d BYTE_ORDER MSB_LAST /end MEASUREMENT
/begin COMPU_METHOD CU_ISO1SESSETUPEVSEID[12] "Conversion method for Iso1SesSetupEvseId[12]" RAT_FUNC "%10.0" "1" COEFFS 0.000000 1.000000 -0.000000 0.000000 0.000000 1.000000 /end COMPU_METHOD
/* Scalar measurable for DDE 'Iso1SesSetupEvseId[13]'. */
/begin MEASUREMENT Iso1SesSetupEvseId[13] "The ID that uniquely identifies the EVSE. Format is defined in the ISO 15118 ED2 Spec Annex H" UBYTE CU_ISO1SESSETUPEVSEID[13] 1 100 0.0 255.0 ECU_ADDRESS 0x7001821e BYTE_ORDER MSB_LAST /end MEASUREMENT
/begin COMPU_METHOD CU_ISO1SESSETUPEVSEID[13] "Conversion method for Iso1SesSetupEvseId[13]" RAT_FUNC "%10.0" "1" COEFFS 0.000000 1.000000 -0.000000 0.000000 0.000000 1.000000 /end COMPU_METHOD
/* Scalar measurable for DDE 'Iso1SesSetupEvseId[14]'. */
/begin MEASUREMENT Iso1SesSetupEvseId[14] "The ID that uniquely identifies the EVSE. Format is defined in the ISO 15118 ED2 Spec Annex H" UBYTE CU_ISO1SESSETUPEVSEID[14] 1 100 0.0 255.0 ECU_ADDRESS 0x7001821f BYTE_ORDER MSB_LAST /end MEASUREMENT
/begin COMPU_METHOD CU_ISO1SESSETUPEVSEID[14] "Conversion method for Iso1SesSetupEvseId[14]" RAT_FUNC "%10.0" "1" COEFFS 0.000000 1.000000 -0.000000 0.000000 0.000000 1.000000 /end COMPU_METHOD
/* Scalar measurable for DDE 'Iso1SesSetupEvseId[15]'. */
/begin MEASUREMENT Iso1SesSetupEvseId[15] "The ID that uniquely identifies the EVSE. Format is defined in the ISO 15118 ED2 Spec Annex H" UBYTE CU_ISO1SESSETUPEVSEID[15] 1 100 0.0 255.0 ECU_ADDRESS 0x70018220 BYTE_ORDER MSB_LAST /end MEASUREMENT
/begin COMPU_METHOD CU_ISO1SESSETUPEVSEID[15] "Conversion method for Iso1SesSetupEvseId[15]" RAT_FUNC "%10.0" "1" COEFFS 0.000000 1.000000 -0.000000 0.000000 0.000000 1.000000 /end COMPU_METHOD
/* Scalar measurable for DDE 'Iso1SesSetupEvseId[16]'. */
/begin MEASUREMENT Iso1SesSetupEvseId[16] "The ID that uniquely identifies the EVSE. Format is defined in the ISO 15118 ED2 Spec Annex H" UBYTE CU_ISO1SESSETUPEVSEID[16] 1 100 0.0 255.0 ECU_ADDRESS 0x70018221 BYTE_ORDER MSB_LAST /end MEASUREMENT
/begin COMPU_METHOD CU_ISO1SESSETUPEVSEID[16] "Conversion method for Iso1SesSetupEvseId[16]" RAT_FUNC "%10.0" "1" COEFFS 0.000000 1.000000 -0.000000 0.000000 0.000000 1.000000 /end COMPU_METHOD
/* Scalar measurable for DDE 'Iso1SesSetupEvseId[17]'. */
/begin MEASUREMENT Iso1SesSetupEvseId[17] "The ID that uniquely identifies the EVSE. Format is defined in the ISO 15118 ED2 Spec Annex H" UBYTE CU_ISO1SESSETUPEVSEID[17] 1 100 0.0 255.0 ECU_ADDRESS 0x70018222 BYTE_ORDER MSB_LAST /end MEASUREMENT
/begin COMPU_METHOD CU_ISO1SESSETUPEVSEID[17] "Conversion method for Iso1SesSetupEvseId[17]" RAT_FUNC "%10.0" "1" COEFFS 0.000000 1.000000 -0.000000 0.000000 0.000000 1.000000 /end COMPU_METHOD
/* Scalar measurable for DDE 'Iso1SesSetupEvseId[18]'. */
/begin MEASUREMENT Iso1SesSetupEvseId[18] "The ID that uniquely identifies the EVSE. Format is defined in the ISO 15118 ED2 Spec Annex H" UBYTE CU_ISO1SESSETUPEVSEID[18] 1 100 0.0 255.0 ECU_ADDRESS 0x70018223 BYTE_ORDER MSB_LAST /end MEASUREMENT
/begin COMPU_METHOD CU_ISO1SESSETUPEVSEID[18] "Conversion method for Iso1SesSetupEvseId[18]" RAT_FUNC "%10.0" "1" COEFFS 0.000000 1.000000 -0.000000 0.000000 0.000000 1.000000 /end COMPU_METHOD
/* Scalar measurable for DDE 'Iso1SesSetupEvseId[19]'. */
/begin MEASUREMENT Iso1SesSetupEvseId[19] "The ID that uniquely identifies the EVSE. Format is defined in the ISO 15118 ED2 Spec Annex H" UBYTE CU_ISO1SESSETUPEVSEID[19] 1 100 0.0 255.0 ECU_ADDRESS 0x70018224 BYTE_ORDER MSB_LAST /end MEASUREMENT
/begin COMPU_METHOD CU_ISO1SESSETUPEVSEID[19] "Conversion method for Iso1SesSetupEvseId[19]" RAT_FUNC "%10.0" "1" COEFFS 0.000000 1.000000 -0.000000 0.000000 0.000000 1.000000 /end COMPU_METHOD
/* Scalar measurable for DDE 'Iso1SesSetupEvseId[1]'. */
/begin MEASUREMENT Iso1SesSetupEvseId[1] "The ID that uniquely identifies the EVSE. Format is defined in the ISO 15118 ED2 Spec Annex H" UBYTE CU_ISO1SESSETUPEVSEID[1] 1 100 0.0 255.0 ECU_ADDRESS 0x70018212 BYTE_ORDER MSB_LAST /end MEASUREMENT
/begin COMPU_METHOD CU_ISO1SESSETUPEVSEID[1] "Conversion method for Iso1SesSetupEvseId[1]" RAT_FUNC "%10.0" "1" COEFFS 0.000000 1.000000 -0.000000 0.000000 0.000000 1.000000 /end COMPU_METHOD
/* Scalar measurable for DDE 'Iso1SesSetupEvseId[20]'. */
/begin MEASUREMENT Iso1SesSetupEvseId[20] "The ID that uniquely identifies the EVSE. Format is defined in the ISO 15118 ED2 Spec Annex H" UBYTE CU_ISO1SESSETUPEVSEID[20] 1 100 0.0 255.0 ECU_ADDRESS 0x70018225 BYTE_ORDER MSB_LAST /end MEASUREMENT
/begin COMPU_METHOD CU_ISO1SESSETUPEVSEID[20] "Conversion method for Iso1SesSetupEvseId[20]" RAT_FUNC "%10.0" "1" COEFFS 0.000000 1.000000 -0.000000 0.000000 0.000000 1.000000 /end COMPU_METHOD
/* Scalar measurable for DDE 'Iso1SesSetupEvseId[21]'. */
/begin MEASUREMENT Iso1SesSetupEvseId[21] "The ID that uniquely identifies the EVSE. Format is defined in the ISO 15118 ED2 Spec Annex H" UBYTE CU_ISO1SESSETUPEVSEID[21] 1 100 0.0 255.0 ECU_ADDRESS 0x70018226 BYTE_ORDER MSB_LAST /end MEASUREMENT
/begin COMPU_METHOD CU_ISO1SESSETUPEVSEID[21] "Conversion method for Iso1SesSetupEvseId[21]" RAT_FUNC "%10.0" "1" COEFFS 0.000000 1.000000 -0.000000 0.000000 0.000000 1.000000 /end COMPU_METHOD
/* Scalar measurable for DDE 'Iso1SesSetupEvseId[22]'. */
/begin MEASUREMENT Iso1SesSetupEvseId[22] "The ID that uniquely identifies the EVSE. Format is defined in the ISO 15118 ED2 Spec Annex H" UBYTE CU_ISO1SESSETUPEVSEID[22] 1 100 0.0 255.0 ECU_ADDRESS 0x70018227 BYTE_ORDER MSB_LAST /end MEASUREMENT
/begin COMPU_METHOD CU_ISO1SESSETUPEVSEID[22] "Conversion method for Iso1SesSetupEvseId[22]" RAT_FUNC "%10.0" "1" COEFFS 0.000000 1.000000 -0.000000 0.000000 0.000000 1.000000 /end COMPU_METHOD
/* Scalar measurable for DDE 'Iso1SesSetupEvseId[23]'. */
/begin MEASUREMENT Iso1SesSetupEvseId[23] "The ID that uniquely identifies the EVSE. Format is defined in the ISO 15118 ED2 Spec Annex H" UBYTE CU_ISO1SESSETUPEVSEID[23] 1 100 0.0 255.0 ECU_ADDRESS 0x70018228 BYTE_ORDER MSB_LAST /end MEASUREMENT
/begin COMPU_METHOD CU_ISO1SESSETUPEVSEID[23] "Conversion method for Iso1SesSetupEvseId[23]" RAT_FUNC "%10.0" "1" COEFFS 0.000000 1.000000 -0.000000 0.000000 0.000000 1.000000 /end COMPU_METHOD
/* Scalar measurable for DDE 'Iso1SesSetupEvseId[24]'. */
/begin MEASUREMENT Iso1SesSetupEvseId[24] "The ID that uniquely identifies the EVSE. Format is defined in the ISO 15118 ED2 Spec Annex H" UBYTE CU_ISO1SESSETUPEVSEID[24] 1 100 0.0 255.0 ECU_ADDRESS 0x70018229 BYTE_ORDER MSB_LAST /end MEASUREMENT
/begin COMPU_METHOD CU_ISO1SESSETUPEVSEID[24] "Conversion method for Iso1SesSetupEvseId[24]" RAT_FUNC "%10.0" "1" COEFFS 0.000000 1.000000 -0.000000 0.000000 0.000000 1.000000 /end COMPU_METHOD
/* Scalar measurable for DDE 'Iso1SesSetupEvseId[25]'. */
/begin MEASUREMENT Iso1SesSetupEvseId[25] "The ID that uniquely identifies the EVSE. Format is defined in the ISO 15118 ED2 Spec Annex H" UBYTE CU_ISO1SESSETUPEVSEID[25] 1 100 0.0 255.0 ECU_ADDRESS 0x7001822a BYTE_ORDER MSB_LAST /end MEASUREMENT
/begin COMPU_METHOD CU_ISO1SESSETUPEVSEID[25] "Conversion method for Iso1SesSetupEvseId[25]" RAT_FUNC "%10.0" "1" COEFFS 0.000000 1.000000 -0.000000 0.000000 0.000000 1.000000 /end COMPU_METHOD
/* Scalar measurable for DDE 'Iso1SesSetupEvseId[26]'. */
/begin MEASUREMENT Iso1SesSetupEvseId[26] "The ID that uniquely identifies the EVSE. Format is defined in the ISO 15118 ED2 Spec Annex H" UBYTE CU_ISO1SESSETUPEVSEID[26] 1 100 0.0 255.0 ECU_ADDRESS 0x7001822b BYTE_ORDER MSB_LAST /end MEASUREMENT
/begin COMPU_METHOD CU_ISO1SESSETUPEVSEID[26] "Conversion method for Iso1SesSetupEvseId[26]" RAT_FUNC "%10.0" "1" COEFFS 0.000000 1.000000 -0.000000 0.000000 0.000000 1.000000 /end COMPU_METHOD
/* Scalar measurable for DDE 'Iso1SesSetupEvseId[27]'. */
/begin MEASUREMENT Iso1SesSetupEvseId[27] "The ID that uniquely identifies the EVSE. Format is defined in the ISO 15118 ED2 Spec Annex H" UBYTE CU_ISO1SESSETUPEVSEID[27] 1 100 0.0 255.0 ECU_ADDRESS 0x7001822c BYTE_ORDER MSB_LAST /end MEASUREMENT
/begin COMPU_METHOD CU_ISO1SESSETUPEVSEID[27] "Conversion method for Iso1SesSetupEvseId[27]" RAT_FUNC "%10.0" "1" COEFFS 0.000000 1.000000 -0.000000 0.000000 0.000000 1.000000 /end COMPU_METHOD
/* Scalar measurable for DDE 'Iso1SesSetupEvseId[28]'. */
/begin MEASUREMENT Iso1SesSetupEvseId[28] "The ID that uniquely identifies the EVSE. Format is defined in the ISO 15118 ED2 Spec Annex H" UBYTE CU_ISO1SESSETUPEVSEID[28] 1 100 0.0 255.0 ECU_ADDRESS 0x7001822d BYTE_ORDER MSB_LAST /end MEASUREMENT
/begin COMPU_METHOD CU_ISO1SESSETUPEVSEID[28] "Conversion method for Iso1SesSetupEvseId[28]" RAT_FUNC "%10.0" "1" COEFFS 0.000000 1.000000 -0.000000 0.000000 0.000000 1.000000 /end COMPU_METHOD
/* Scalar measurable for DDE 'Iso1SesSetupEvseId[29]'. */
/begin MEASUREMENT Iso1SesSetupEvseId[29] "The ID that uniquely identifies the EVSE. Format is defined in the ISO 15118 ED2 Spec Annex H" UBYTE CU_ISO1SESSETUPEVSEID[29] 1 100 0.0 255.0 ECU_ADDRESS 0x7001822e BYTE_ORDER MSB_LAST /end MEASUREMENT
/begin COMPU_METHOD CU_ISO1SESSETUPEVSEID[29] "Conversion method for Iso1SesSetupEvseId[29]" RAT_FUNC "%10.0" "1" COEFFS 0.000000 1.000000 -0.000000 0.000000 0.000000 1.000000 /end COMPU_METHOD
/* Scalar measurable for DDE 'Iso1SesSetupEvseId[2]'. */
/begin MEASUREMENT Iso1SesSetupEvseId[2] "The ID that uniquely identifies the EVSE. Format is defined in the ISO 15118 ED2 Spec Annex H" UBYTE CU_ISO1SESSETUPEVSEID[2] 1 100 0.0 255.0 ECU_ADDRESS 0x70018213 BYTE_ORDER MSB_LAST /end MEASUREMENT
/begin COMPU_METHOD CU_ISO1SESSETUPEVSEID[2] "Conversion method for Iso1SesSetupEvseId[2]" RAT_FUNC "%10.0" "1" COEFFS 0.000000 1.000000 -0.000000 0.000000 0.000000 1.000000 /end COMPU_METHOD
/* Scalar measurable for DDE 'Iso1SesSetupEvseId[30]'. */
/begin MEASUREMENT Iso1SesSetupEvseId[30] "The ID that uniquely identifies the EVSE. Format is defined in the ISO 15118 ED2 Spec Annex H" UBYTE CU_ISO1SESSETUPEVSEID[30] 1 100 0.0 255.0 ECU_ADDRESS 0x7001822f BYTE_ORDER MSB_LAST /end MEASUREMENT
/begin COMPU_METHOD CU_ISO1SESSETUPEVSEID[30] "Conversion method for Iso1SesSetupEvseId[30]" RAT_FUNC "%10.0" "1" COEFFS 0.000000 1.000000 -0.000000 0.000000 0.000000 1.000000 /end COMPU_METHOD
/* Scalar measurable for DDE 'Iso1SesSetupEvseId[31]'. */
/begin MEASUREMENT Iso1SesSetupEvseId[31] "The ID that uniquely identifies the EVSE. Format is defined in the ISO 15118 ED2 Spec Annex H" UBYTE CU_ISO1SESSETUPEVSEID[31] 1 100 0.0 255.0 ECU_ADDRESS 0x70018230 BYTE_ORDER MSB_LAST /end MEASUREMENT
/begin COMPU_METHOD CU_ISO1SESSETUPEVSEID[31] "Conversion method for Iso1SesSetupEvseId[31]" RAT_FUNC "%10.0" "1" COEFFS 0.000000 1.000000 -0.000000 0.000000 0.000000 1.000000 /end COMPU_METHOD
/* Scalar measurable for DDE 'Iso1SesSetupEvseId[32]'. */
/begin MEASUREMENT Iso1SesSetupEvseId[32] "The ID that uniquely identifies the EVSE. Format is defined in the ISO 15118 ED2 Spec Annex H" UBYTE CU_ISO1SESSETUPEVSEID[32] 1 100 0.0 255.0 ECU_ADDRESS 0x70018231 BYTE_ORDER MSB_LAST /end MEASUREMENT
/begin COMPU_METHOD CU_ISO1SESSETUPEVSEID[32] "Conversion method for Iso1SesSetupEvseId[32]" RAT_FUNC "%10.0" "1" COEFFS 0.000000 1.000000 -0.000000 0.000000 0.000000 1.000000 /end COMPU_METHOD
/* Scalar measurable for DDE 'Iso1SesSetupEvseId[33]'. */
/begin MEASUREMENT Iso1SesSetupEvseId[33] "The ID that uniquely identifies the EVSE. Format is defined in the ISO 15118 ED2 Spec Annex H" UBYTE CU_ISO1SESSETUPEVSEID[33] 1 100 0.0 255.0 ECU_ADDRESS 0x70018232 BYTE_ORDER MSB_LAST /end MEASUREMENT
/begin COMPU_METHOD CU_ISO1SESSETUPEVSEID[33] "Conversion method for Iso1SesSetupEvseId[33]" RAT_FUNC "%10.0" "1" COEFFS 0.000000 1.000000 -0.000000 0.000000 0.000000 1.000000 /end COMPU_METHOD
/* Scalar measurable for DDE 'Iso1SesSetupEvseId[34]'. */
/begin MEASUREMENT Iso1SesSetupEvseId[34] "The ID that uniquely identifies the EVSE. Format is defined in the ISO 15118 ED2 Spec Annex H" UBYTE CU_ISO1SESSETUPEVSEID[34] 1 100 0.0 255.0 ECU_ADDRESS 0x70018233 BYTE_ORDER MSB_LAST /end MEASUREMENT
/begin COMPU_METHOD CU_ISO1SESSETUPEVSEID[34] "Conversion method for Iso1SesSetupEvseId[34]" RAT_FUNC "%10.0" "1" COEFFS 0.000000 1.000000 -0.000000 0.000000 0.000000 1.000000 /end COMPU_METHOD
/* Scalar measurable for DDE 'Iso1SesSetupEvseId[35]'. */
/begin MEASUREMENT Iso1SesSetupEvseId[35] "The ID that uniquely identifies the EVSE. Format is defined in the ISO 15118 ED2 Spec Annex H" UBYTE CU_ISO1SESSETUPEVSEID[35] 1 100 0.0 255.0 ECU_ADDRESS 0x70018234 BYTE_ORDER MSB_LAST /end MEASUREMENT
/begin COMPU_METHOD CU_ISO1SESSETUPEVSEID[35] "Conversion method for Iso1SesSetupEvseId[35]" RAT_FUNC "%10.0" "1" COEFFS 0.000000 1.000000 -0.000000 0.000000 0.000000 1.000000 /end COMPU_METHOD
/* Scalar measurable for DDE 'Iso1SesSetupEvseId[36]'. */
/begin MEASUREMENT Iso1SesSetupEvseId[36] "The ID that uniquely identifies the EVSE. Format is defined in the ISO 15118 ED2 Spec Annex H" UBYTE CU_ISO1SESSETUPEVSEID[36] 1 100 0.0 255.0 ECU_ADDRESS 0x70018235 BYTE_ORDER MSB_LAST /end MEASUREMENT
/begin COMPU_METHOD CU_ISO1SESSETUPEVSEID[36] "Conversion method for Iso1SesSetupEvseId[36]" RAT_FUNC "%10.0" "1" COEFFS 0.000000 1.000000 -0.000000 0.000000 0.000000 1.000000 /end COMPU_METHOD
/* Scalar measurable for DDE 'Iso1SesSetupEvseId[37]'. */
/begin MEASUREMENT Iso1SesSetupEvseId[37] "The ID that uniquely identifies the EVSE. Format is defined in the ISO 15118 ED2 Spec Annex H" UBYTE CU_ISO1SESSETUPEVSEID[37] 1 100 0.0 255.0 ECU_ADDRESS 0x70018236 BYTE_ORDER MSB_LAST /end MEASUREMENT
/begin COMPU_METHOD CU_ISO1SESSETUPEVSEID[37] "Conversion method for Iso1SesSetupEvseId[37]" RAT_FUNC "%10.0" "1" COEFFS 0.000000 1.000000 -0.000000 0.000000 0.000000 1.000000 /end COMPU_METHOD
/* Scalar measurable for DDE 'Iso1SesSetupEvseId[3]'. */
/begin MEASUREMENT Iso1SesSetupEvseId[3] "The ID that uniquely identifies the EVSE. Format is defined in the ISO 15118 ED2 Spec Annex H" UBYTE CU_ISO1SESSETUPEVSEID[3] 1 100 0.0 255.0 ECU_ADDRESS 0x70018214 BYTE_ORDER MSB_LAST /end MEASUREMENT
/begin COMPU_METHOD CU_ISO1SESSETUPEVSEID[3] "Conversion method for Iso1SesSetupEvseId[3]" RAT_FUNC "%10.0" "1" COEFFS 0.000000 1.000000 -0.000000 0.000000 0.000000 1.000000 /end COMPU_METHOD
/* Scalar measurable for DDE 'Iso1SesSetupEvseId[4]'. */
/begin MEASUREMENT Iso1SesSetupEvseId[4] "The ID that uniquely identifies the EVSE. Format is defined in the ISO 15118 ED2 Spec Annex H" UBYTE CU_ISO1SESSETUPEVSEID[4] 1 100 0.0 255.0 ECU_ADDRESS 0x70018215 BYTE_ORDER MSB_LAST /end MEASUREMENT
/begin COMPU_METHOD CU_ISO1SESSETUPEVSEID[4] "Conversion method for Iso1SesSetupEvseId[4]" RAT_FUNC "%10.0" "1" COEFFS 0.000000 1.000000 -0.000000 0.000000 0.000000 1.000000 /end COMPU_METHOD
/* Scalar measurable for DDE 'Iso1SesSetupEvseId[5]'. */
/begin MEASUREMENT Iso1SesSetupEvseId[5] "The ID that uniquely identifies the EVSE. Format is defined in the ISO 15118 ED2 Spec Annex H" UBYTE CU_ISO1SESSETUPEVSEID[5] 1 100 0.0 255.0 ECU_ADDRESS 0x70018216 BYTE_ORDER MSB_LAST /end MEASUREMENT
/begin COMPU_METHOD CU_ISO1SESSETUPEVSEID[5] "Conversion method for Iso1SesSetupEvseId[5]" RAT_FUNC "%10.0" "1" COEFFS 0.000000 1.000000 -0.000000 0.000000 0.000000 1.000000 /end COMPU_METHOD
/* Scalar measurable for DDE 'Iso1SesSetupEvseId[6]'. */
/begin MEASUREMENT Iso1SesSetupEvseId[6] "The ID that uniquely identifies the EVSE. Format is defined in the ISO 15118 ED2 Spec Annex H" UBYTE CU_ISO1SESSETUPEVSEID[6] 1 100 0.0 255.0 ECU_ADDRESS 0x70018217 BYTE_ORDER MSB_LAST /end MEASUREMENT
/begin COMPU_METHOD CU_ISO1SESSETUPEVSEID[6] "Conversion method for Iso1SesSetupEvseId[6]" RAT_FUNC "%10.0" "1" COEFFS 0.000000 1.000000 -0.000000 0.000000 0.000000 1.000000 /end COMPU_METHOD
/* Scalar measurable for DDE 'Iso1SesSetupEvseId[7]'. */
/begin MEASUREMENT Iso1SesSetupEvseId[7] "The ID that uniquely identifies the EVSE. Format is defined in the ISO 15118 ED2 Spec Annex H" UBYTE CU_ISO1SESSETUPEVSEID[7] 1 100 0.0 255.0 ECU_ADDRESS 0x70018218 BYTE_ORDER MSB_LAST /end MEASUREMENT
/begin COMPU_METHOD CU_ISO1SESSETUPEVSEID[7] "Conversion method for Iso1SesSetupEvseId[7]" RAT_FUNC "%10.0" "1" COEFFS 0.000000 1.000000 -0.000000 0.000000 0.000000 1.000000 /end COMPU_METHOD
/* Scalar measurable for DDE 'Iso1SesSetupEvseId[8]'. */
/begin MEASUREMENT Iso1SesSetupEvseId[8] "The ID that uniquely identifies the EVSE. Format is defined in the ISO 15118 ED2 Spec Annex H" UBYTE CU_ISO1SESSETUPEVSEID[8] 1 100 0.0 255.0 ECU_ADDRESS 0x70018219 BYTE_ORDER MSB_LAST /end MEASUREMENT
/begin COMPU_METHOD CU_ISO1SESSETUPEVSEID[8] "Conversion method for Iso1SesSetupEvseId[8]" RAT_FUNC "%10.0" "1" COEFFS 0.000000 1.000000 -0.000000 0.000000 0.000000 1.000000 /end COMPU_METHOD
/* Scalar measurable for DDE 'Iso1SesSetupEvseId[9]'. */
/begin MEASUREMENT Iso1SesSetupEvseId[9] "The ID that uniquely identifies the EVSE. Format is defined in the ISO 15118 ED2 Spec Annex H" UBYTE CU_ISO1SESSETUPEVSEID[9] 1 100 0.0 255.0 ECU_ADDRESS 0x7001821a BYTE_ORDER MSB_LAST /end MEASUREMENT
/begin COMPU_METHOD CU_ISO1SESSETUPEVSEID[9] "Conversion method for Iso1SesSetupEvseId[9]" RAT_FUNC "%10.0" "1" COEFFS 0.000000 1.000000 -0.000000 0.000000 0.000000 1.000000 /end COMPU_METHOD
/* Scalar measurable for DDE 'Iso1SesSetupTimestamp'. */
/begin MEASUREMENT Iso1SesSetupTimestamp "Timestamp of the current SECC time using the Unix Time Stamp format." SLONG CU_ISO1SESSETUPTIMESTAMP 1 100 0.0 2147483647.0 ECU_ADDRESS 0x70017d30 BYTE_ORDER MSB_LAST /end MEASUREMENT
/begin COMPU_METHOD CU_ISO1SESSETUPTIMESTAMP "Conversion method for Iso1SesSetupTimestamp" RAT_FUNC "%10.0" "1" COEFFS 0.000000 1.000000 -0.000000 0.000000 0.000000 1.000000 /end COMPU_METHOD
/* Scalar measurable for DDE 'Iso1SvcDetailRxTrg'. */
/begin MEASUREMENT Iso1SvcDetailRxTrg "Trigger flag that on a rising edge indicates the event for receiving the PLC (V2G) ServiceDetailRes message from the EVSE" UBYTE CU_ISO1SVCDETAILRXTRG 1 100 0.0 1.0 ECU_ADDRESS 0x70018185 BYTE_ORDER MSB_LAST /end MEASUREMENT
/begin COMPU_METHOD CU_ISO1SVCDETAILRXTRG "Conversion method for Iso1SvcDetailRxTrg" RAT_FUNC "%10.0" "b" COEFFS 0.000000 1.000000 -0.000000 0.000000 0.000000 1.000000 /end COMPU_METHOD
/* Scalar measurable for DDE 'Iso1SvcDiscFreeSvc'. */
/begin MEASUREMENT Iso1SvcDiscFreeSvc "If true, indicates that the service can be used free of charge." UBYTE CU_ISO1SVCDISCFREESVC 1 100 0.0 1.0 ECU_ADDRESS 0x70017c59 BYTE_ORDER MSB_LAST /end MEASUREMENT
/begin COMPU_METHOD CU_ISO1SVCDISCFREESVC "Conversion method for Iso1SvcDiscFreeSvc" RAT_FUNC "%10.0" "b" COEFFS 0.000000 1.000000 -0.000000 0.000000 0.000000 1.000000 /end COMPU_METHOD
/* Scalar measurable for DDE 'Iso1SvcDiscRescode'. */
/begin MEASUREMENT Iso1SvcDiscRescode "for ISOv1 ServiceDiscoveryRes  message: indicates the acknowledgment status of this V2G messages received by the SECC." UBYTE CU_ISO1SVCDISCRESCODE 1 100 0.0 255.0 ECU_ADDRESS 0x70018046 BYTE_ORDER MSB_LAST /end MEASUREMENT
/begin COMPU_METHOD CU_ISO1SVCDISCRESCODE "Conversion method for Iso1SvcDiscRescode" RAT_FUNC "%10.0" "1" COEFFS 0.000000 1.000000 -0.000000 0.000000 0.000000 1.000000 /end COMPU_METHOD
/* Scalar measurable for DDE 'Iso1SvcDiscSvcListSize'. */
/begin MEASUREMENT Iso1SvcDiscSvcListSize "The Service List Size parameter in the received message from EVSE" UBYTE CU_ISO1SVCDISCSVCLISTSIZE 1 100 0.0 255.0 ECU_ADDRESS 0x70018481 BYTE_ORDER MSB_LAST /end MEASUREMENT
/begin COMPU_METHOD CU_ISO1SVCDISCSVCLISTSIZE "Conversion method for Iso1SvcDiscSvcListSize" RAT_FUNC "%10.0" "1" COEFFS 0.000000 1.000000 -0.000000 0.000000 0.000000 1.000000 /end COMPU_METHOD
/* Scalar measurable for DDE 'Iso1WeldDetNotifMaxDelay'. */
/begin MEASUREMENT Iso1WeldDetNotifMaxDelay "The Notification Max Delay parameter in the received message from EVSE" UWORD CU_ISO1WELDDETNOTIFMAXDELAY 1 100 0.0 65535.0 ECU_ADDRESS 0x70017f7e BYTE_ORDER MSB_LAST /end MEASUREMENT
/begin COMPU_METHOD CU_ISO1WELDDETNOTIFMAXDELAY "Conversion method for Iso1WeldDetNotifMaxDelay" RAT_FUNC "%10.0" "s" COEFFS 0.000000 1.000000 -0.000000 0.000000 0.000000 1.000000 /end COMPU_METHOD
/* Scalar measurable for DDE 'Iso1WeldDetRxTrg'. */
/begin MEASUREMENT Iso1WeldDetRxTrg "Trigger falg that on a rising edge indicates the event for receiving the PLC (V2G) message response 9b from EVSE" UBYTE CU_ISO1WELDDETRXTRG 1 100 0.0 1.0 ECU_ADDRESS 0x700183bb BYTE_ORDER MSB_LAST /end MEASUREMENT
/begin COMPU_METHOD CU_ISO1WELDDETRXTRG "Conversion method for Iso1WeldDetRxTrg" RAT_FUNC "%10.0" "b" COEFFS 0.000000 1.000000 -0.000000 0.000000 0.000000 1.000000 /end COMPU_METHOD
/* Scalar measurable for DDE 'Iso2AuthEvseProcessing'. */
/begin MEASUREMENT Iso2AuthEvseProcessing "Indicates that the EVSE has either finished or still in process of finishing the processing that was started after the AuthorizationReq message" UBYTE CU_ISO2AUTHEVSEPROCESSING 1 100 0.0 255.0 ECU_ADDRESS 0x70017ecc BYTE_ORDER MSB_LAST /end MEASUREMENT
/begin COMPU_METHOD CU_ISO2AUTHEVSEPROCESSING "Conversion method for Iso2AuthEvseProcessing" RAT_FUNC "%10.0" "1" COEFFS 0.000000 1.000000 -0.000000 0.000000 0.000000 1.000000 /end COMPU_METHOD
/* Scalar measurable for DDE 'Iso2AuthEvseStatPres'. */
/begin MEASUREMENT Iso2AuthEvseStatPres "Indicates the presence of the EVSENotificationMaxDelay and EVSENotification parameters in the AuthorizationRes message" UBYTE CU_ISO2AUTHEVSESTATPRES 1 100 0.0 1.0 ECU_ADDRESS 0x70018327 BYTE_ORDER MSB_LAST /end MEASUREMENT
/begin COMPU_METHOD CU_ISO2AUTHEVSESTATPRES "Conversion method for Iso2AuthEvseStatPres" RAT_FUNC "%10.0" "b" COEFFS 0.000000 1.000000 -0.000000 0.000000 0.000000 1.000000 /end COMPU_METHOD
/* Scalar measurable for DDE 'Iso2AuthNotif'. */
/begin MEASUREMENT Iso2AuthNotif "Indicates action SECC wants the EVSE to perform in the Authorization message" UBYTE CU_ISO2AUTHNOTIF 1 100 0.0 255.0 ECU_ADDRESS 0x70017e30 BYTE_ORDER MSB_LAST /end MEASUREMENT
/begin COMPU_METHOD CU_ISO2AUTHNOTIF "Conversion method for Iso2AuthNotif" RAT_FUNC "%10.0" "1" COEFFS 0.000000 1.000000 -0.000000 0.000000 0.000000 1.000000 /end COMPU_METHOD
/* Scalar measurable for DDE 'Iso2AuthNotifMaxDelay'. */
/begin MEASUREMENT Iso2AuthNotifMaxDelay "Indicates the time until the SECC expects the EVCC to react on the EVSENotification action set in the AuthorizationRes message" UWORD CU_ISO2AUTHNOTIFMAXDELAY 1 100 0.0 65535.0 ECU_ADDRESS 0x70018282 BYTE_ORDER MSB_LAST /end MEASUREMENT
/begin COMPU_METHOD CU_ISO2AUTHNOTIFMAXDELAY "Conversion method for Iso2AuthNotifMaxDelay" RAT_FUNC "%10.0" "1" COEFFS 0.000000 1.000000 -0.000000 0.000000 0.000000 1.000000 /end COMPU_METHOD
/* Scalar measurable for DDE 'Iso2AuthRescode'. */
/begin MEASUREMENT Iso2AuthRescode "for ISOv2 AuthorizationRes message: indicates the acknowledgment status of this V2G messages received by the SECC." UBYTE CU_ISO2AUTHRESCODE 1 100 0.0 255.0 ECU_ADDRESS 0x70017d94 BYTE_ORDER MSB_LAST /end MEASUREMENT
/begin COMPU_METHOD CU_ISO2AUTHRESCODE "Conversion method for Iso2AuthRescode" RAT_FUNC "%10.0" "1" COEFFS 0.000000 1.000000 -0.000000 0.000000 0.000000 1.000000 /end COMPU_METHOD
/* Scalar measurable for DDE 'Iso2AuthRxTrg'. */
/begin MEASUREMENT Iso2AuthRxTrg "Trigger flag that on a rising edge indicates the event for receiving the PLC (V2G) AuthorizationRes message from the EVSE" UBYTE CU_ISO2AUTHRXTRG 1 100 0.0 1.0 ECU_ADDRESS 0x700181c0 BYTE_ORDER MSB_LAST /end MEASUREMENT
/begin COMPU_METHOD CU_ISO2AUTHRXTRG "Conversion method for Iso2AuthRxTrg" RAT_FUNC "%10.0" "b" COEFFS 0.000000 1.000000 -0.000000 0.000000 0.000000 1.000000 /end COMPU_METHOD
/* Scalar measurable for DDE 'Iso2BPTCtrlEvseCrntLimAchvd'. */
/begin MEASUREMENT Iso2BPTCtrlEvseCrntLimAchvd "for ISOv2 DC_BPTControlRes message: Indicates that the charger is at its current limit" UBYTE CU_ISO2BPTCTRLEVSECRNTLIMACHVD 1 100 0.0 1.0 ECU_ADDRESS 0x70017ca4 BYTE_ORDER MSB_LAST /end MEASUREMENT
/begin COMPU_METHOD CU_ISO2BPTCTRLEVSECRNTLIMACHVD "Conversion method for Iso2BPTCtrlEvseCrntLimAchvd" RAT_FUNC "%10.0" "b" COEFFS 0.000000 1.000000 -0.000000 0.000000 0.000000 1.000000 /end COMPU_METHOD
/* Scalar measurable for DDE 'Iso2BPTCtrlEvseIdLen'. */
/begin MEASUREMENT Iso2BPTCtrlEvseIdLen "for ISOv2 DC_BPTControlRes message: Actual number of characters in the EVSE ID" UBYTE CU_ISO2BPTCTRLEVSEIDLEN 1 100 0.0 255.0 ECU_ADDRESS 0x70017c1e BYTE_ORDER MSB_LAST /end MEASUREMENT
/begin COMPU_METHOD CU_ISO2BPTCTRLEVSEIDLEN "Conversion method for Iso2BPTCtrlEvseIdLen" RAT_FUNC "%10.0" "1" COEFFS 0.000000 1.000000 -0.000000 0.000000 0.000000 1.000000 /end COMPU_METHOD
/* Scalar measurable for DDE 'Iso2BPTCtrlEvseId[0]'. */
/begin MEASUREMENT Iso2BPTCtrlEvseId[0] "for ISOv2 DC_BPTControlRes message: The ID that uniquely identifies the EVSE. Format is defined in the ISO 15118 ED2 Spec Annex H" UBYTE CU_ISO2BPTCTRLEVSEID[0] 1 100 0.0 255.0 ECU_ADDRESS 0x700180f5 BYTE_ORDER MSB_LAST /end MEASUREMENT
/begin COMPU_METHOD CU_ISO2BPTCTRLEVSEID[0] "Conversion method for Iso2BPTCtrlEvseId[0]" RAT_FUNC "%10.0" "1" COEFFS 0.000000 1.000000 -0.000000 0.000000 0.000000 1.000000 /end COMPU_METHOD
/* Scalar measurable for DDE 'Iso2BPTCtrlEvseId[10]'. */
/begin MEASUREMENT Iso2BPTCtrlEvseId[10] "for ISOv2 DC_BPTControlRes message: The ID that uniquely identifies the EVSE. Format is defined in the ISO 15118 ED2 Spec Annex H" UBYTE CU_ISO2BPTCTRLEVSEID[10] 1 100 0.0 255.0 ECU_ADDRESS 0x700180ff BYTE_ORDER MSB_LAST /end MEASUREMENT
/begin COMPU_METHOD CU_ISO2BPTCTRLEVSEID[10] "Conversion method for Iso2BPTCtrlEvseId[10]" RAT_FUNC "%10.0" "1" COEFFS 0.000000 1.000000 -0.000000 0.000000 0.000000 1.000000 /end COMPU_METHOD
/* Scalar measurable for DDE 'Iso2BPTCtrlEvseId[11]'. */
/begin MEASUREMENT Iso2BPTCtrlEvseId[11] "for ISOv2 DC_BPTControlRes message: The ID that uniquely identifies the EVSE. Format is defined in the ISO 15118 ED2 Spec Annex H" UBYTE CU_ISO2BPTCTRLEVSEID[11] 1 100 0.0 255.0 ECU_ADDRESS 0x70018100 BYTE_ORDER MSB_LAST /end MEASUREMENT
/begin COMPU_METHOD CU_ISO2BPTCTRLEVSEID[11] "Conversion method for Iso2BPTCtrlEvseId[11]" RAT_FUNC "%10.0" "1" COEFFS 0.000000 1.000000 -0.000000 0.000000 0.000000 1.000000 /end COMPU_METHOD
/* Scalar measurable for DDE 'Iso2BPTCtrlEvseId[12]'. */
/begin MEASUREMENT Iso2BPTCtrlEvseId[12] "for ISOv2 DC_BPTControlRes message: The ID that uniquely identifies the EVSE. Format is defined in the ISO 15118 ED2 Spec Annex H" UBYTE CU_ISO2BPTCTRLEVSEID[12] 1 100 0.0 255.0 ECU_ADDRESS 0x70018101 BYTE_ORDER MSB_LAST /end MEASUREMENT
/begin COMPU_METHOD CU_ISO2BPTCTRLEVSEID[12] "Conversion method for Iso2BPTCtrlEvseId[12]" RAT_FUNC "%10.0" "1" COEFFS 0.000000 1.000000 -0.000000 0.000000 0.000000 1.000000 /end COMPU_METHOD
/* Scalar measurable for DDE 'Iso2BPTCtrlEvseId[13]'. */
/begin MEASUREMENT Iso2BPTCtrlEvseId[13] "for ISOv2 DC_BPTControlRes message: The ID that uniquely identifies the EVSE. Format is defined in the ISO 15118 ED2 Spec Annex H" UBYTE CU_ISO2BPTCTRLEVSEID[13] 1 100 0.0 255.0 ECU_ADDRESS 0x70018102 BYTE_ORDER MSB_LAST /end MEASUREMENT
/begin COMPU_METHOD CU_ISO2BPTCTRLEVSEID[13] "Conversion method for Iso2BPTCtrlEvseId[13]" RAT_FUNC "%10.0" "1" COEFFS 0.000000 1.000000 -0.000000 0.000000 0.000000 1.000000 /end COMPU_METHOD
/* Scalar measurable for DDE 'Iso2BPTCtrlEvseId[14]'. */
/begin MEASUREMENT Iso2BPTCtrlEvseId[14] "for ISOv2 DC_BPTControlRes message: The ID that uniquely identifies the EVSE. Format is defined in the ISO 15118 ED2 Spec Annex H" UBYTE CU_ISO2BPTCTRLEVSEID[14] 1 100 0.0 255.0 ECU_ADDRESS 0x70018103 BYTE_ORDER MSB_LAST /end MEASUREMENT
/begin COMPU_METHOD CU_ISO2BPTCTRLEVSEID[14] "Conversion method for Iso2BPTCtrlEvseId[14]" RAT_FUNC "%10.0" "1" COEFFS 0.000000 1.000000 -0.000000 0.000000 0.000000 1.000000 /end COMPU_METHOD
/* Scalar measurable for DDE 'Iso2BPTCtrlEvseId[15]'. */
/begin MEASUREMENT Iso2BPTCtrlEvseId[15] "for ISOv2 DC_BPTControlRes message: The ID that uniquely identifies the EVSE. Format is defined in the ISO 15118 ED2 Spec Annex H" UBYTE CU_ISO2BPTCTRLEVSEID[15] 1 100 0.0 255.0 ECU_ADDRESS 0x70018104 BYTE_ORDER MSB_LAST /end MEASUREMENT
/begin COMPU_METHOD CU_ISO2BPTCTRLEVSEID[15] "Conversion method for Iso2BPTCtrlEvseId[15]" RAT_FUNC "%10.0" "1" COEFFS 0.000000 1.000000 -0.000000 0.000000 0.000000 1.000000 /end COMPU_METHOD
/* Scalar measurable for DDE 'Iso2BPTCtrlEvseId[16]'. */
/begin MEASUREMENT Iso2BPTCtrlEvseId[16] "for ISOv2 DC_BPTControlRes message: The ID that uniquely identifies the EVSE. Format is defined in the ISO 15118 ED2 Spec Annex H" UBYTE CU_ISO2BPTCTRLEVSEID[16] 1 100 0.0 255.0 ECU_ADDRESS 0x70018105 BYTE_ORDER MSB_LAST /end MEASUREMENT
/begin COMPU_METHOD CU_ISO2BPTCTRLEVSEID[16] "Conversion method for Iso2BPTCtrlEvseId[16]" RAT_FUNC "%10.0" "1" COEFFS 0.000000 1.000000 -0.000000 0.000000 0.000000 1.000000 /end COMPU_METHOD
/* Scalar measurable for DDE 'Iso2BPTCtrlEvseId[17]'. */
/begin MEASUREMENT Iso2BPTCtrlEvseId[17] "for ISOv2 DC_BPTControlRes message: The ID that uniquely identifies the EVSE. Format is defined in the ISO 15118 ED2 Spec Annex H" UBYTE CU_ISO2BPTCTRLEVSEID[17] 1 100 0.0 255.0 ECU_ADDRESS 0x70018106 BYTE_ORDER MSB_LAST /end MEASUREMENT
/begin COMPU_METHOD CU_ISO2BPTCTRLEVSEID[17] "Conversion method for Iso2BPTCtrlEvseId[17]" RAT_FUNC "%10.0" "1" COEFFS 0.000000 1.000000 -0.000000 0.000000 0.000000 1.000000 /end COMPU_METHOD
/* Scalar measurable for DDE 'Iso2BPTCtrlEvseId[18]'. */
/begin MEASUREMENT Iso2BPTCtrlEvseId[18] "for ISOv2 DC_BPTControlRes message: The ID that uniquely identifies the EVSE. Format is defined in the ISO 15118 ED2 Spec Annex H" UBYTE CU_ISO2BPTCTRLEVSEID[18] 1 100 0.0 255.0 ECU_ADDRESS 0x70018107 BYTE_ORDER MSB_LAST /end MEASUREMENT
/begin COMPU_METHOD CU_ISO2BPTCTRLEVSEID[18] "Conversion method for Iso2BPTCtrlEvseId[18]" RAT_FUNC "%10.0" "1" COEFFS 0.000000 1.000000 -0.000000 0.000000 0.000000 1.000000 /end COMPU_METHOD
/* Scalar measurable for DDE 'Iso2BPTCtrlEvseId[19]'. */
/begin MEASUREMENT Iso2BPTCtrlEvseId[19] "for ISOv2 DC_BPTControlRes message: The ID that uniquely identifies the EVSE. Format is defined in the ISO 15118 ED2 Spec Annex H" UBYTE CU_ISO2BPTCTRLEVSEID[19] 1 100 0.0 255.0 ECU_ADDRESS 0x70018108 BYTE_ORDER MSB_LAST /end MEASUREMENT
/begin COMPU_METHOD CU_ISO2BPTCTRLEVSEID[19] "Conversion method for Iso2BPTCtrlEvseId[19]" RAT_FUNC "%10.0" "1" COEFFS 0.000000 1.000000 -0.000000 0.000000 0.000000 1.000000 /end COMPU_METHOD
/* Scalar measurable for DDE 'Iso2BPTCtrlEvseId[1]'. */
/begin MEASUREMENT Iso2BPTCtrlEvseId[1] "for ISOv2 DC_BPTControlRes message: The ID that uniquely identifies the EVSE. Format is defined in the ISO 15118 ED2 Spec Annex H" UBYTE CU_ISO2BPTCTRLEVSEID[1] 1 100 0.0 255.0 ECU_ADDRESS 0x700180f6 BYTE_ORDER MSB_LAST /end MEASUREMENT
/begin COMPU_METHOD CU_ISO2BPTCTRLEVSEID[1] "Conversion method for Iso2BPTCtrlEvseId[1]" RAT_FUNC "%10.0" "1" COEFFS 0.000000 1.000000 -0.000000 0.000000 0.000000 1.000000 /end COMPU_METHOD
/* Scalar measurable for DDE 'Iso2BPTCtrlEvseId[20]'. */
/begin MEASUREMENT Iso2BPTCtrlEvseId[20] "for ISOv2 DC_BPTControlRes message: The ID that uniquely identifies the EVSE. Format is defined in the ISO 15118 ED2 Spec Annex H" UBYTE CU_ISO2BPTCTRLEVSEID[20] 1 100 0.0 255.0 ECU_ADDRESS 0x70018109 BYTE_ORDER MSB_LAST /end MEASUREMENT
/begin COMPU_METHOD CU_ISO2BPTCTRLEVSEID[20] "Conversion method for Iso2BPTCtrlEvseId[20]" RAT_FUNC "%10.0" "1" COEFFS 0.000000 1.000000 -0.000000 0.000000 0.000000 1.000000 /end COMPU_METHOD
/* Scalar measurable for DDE 'Iso2BPTCtrlEvseId[21]'. */
/begin MEASUREMENT Iso2BPTCtrlEvseId[21] "for ISOv2 DC_BPTControlRes message: The ID that uniquely identifies the EVSE. Format is defined in the ISO 15118 ED2 Spec Annex H" UBYTE CU_ISO2BPTCTRLEVSEID[21] 1 100 0.0 255.0 ECU_ADDRESS 0x7001810a BYTE_ORDER MSB_LAST /end MEASUREMENT
/begin COMPU_METHOD CU_ISO2BPTCTRLEVSEID[21] "Conversion method for Iso2BPTCtrlEvseId[21]" RAT_FUNC "%10.0" "1" COEFFS 0.000000 1.000000 -0.000000 0.000000 0.000000 1.000000 /end COMPU_METHOD
/* Scalar measurable for DDE 'Iso2BPTCtrlEvseId[22]'. */
/begin MEASUREMENT Iso2BPTCtrlEvseId[22] "for ISOv2 DC_BPTControlRes message: The ID that uniquely identifies the EVSE. Format is defined in the ISO 15118 ED2 Spec Annex H" UBYTE CU_ISO2BPTCTRLEVSEID[22] 1 100 0.0 255.0 ECU_ADDRESS 0x7001810b BYTE_ORDER MSB_LAST /end MEASUREMENT
/begin COMPU_METHOD CU_ISO2BPTCTRLEVSEID[22] "Conversion method for Iso2BPTCtrlEvseId[22]" RAT_FUNC "%10.0" "1" COEFFS 0.000000 1.000000 -0.000000 0.000000 0.000000 1.000000 /end COMPU_METHOD
/* Scalar measurable for DDE 'Iso2BPTCtrlEvseId[23]'. */
/begin MEASUREMENT Iso2BPTCtrlEvseId[23] "for ISOv2 DC_BPTControlRes message: The ID that uniquely identifies the EVSE. Format is defined in the ISO 15118 ED2 Spec Annex H" UBYTE CU_ISO2BPTCTRLEVSEID[23] 1 100 0.0 255.0 ECU_ADDRESS 0x7001810c BYTE_ORDER MSB_LAST /end MEASUREMENT
/begin COMPU_METHOD CU_ISO2BPTCTRLEVSEID[23] "Conversion method for Iso2BPTCtrlEvseId[23]" RAT_FUNC "%10.0" "1" COEFFS 0.000000 1.000000 -0.000000 0.000000 0.000000 1.000000 /end COMPU_METHOD
/* Scalar measurable for DDE 'Iso2BPTCtrlEvseId[24]'. */
/begin MEASUREMENT Iso2BPTCtrlEvseId[24] "for ISOv2 DC_BPTControlRes message: The ID that uniquely identifies the EVSE. Format is defined in the ISO 15118 ED2 Spec Annex H" UBYTE CU_ISO2BPTCTRLEVSEID[24] 1 100 0.0 255.0 ECU_ADDRESS 0x7001810d BYTE_ORDER MSB_LAST /end MEASUREMENT
/begin COMPU_METHOD CU_ISO2BPTCTRLEVSEID[24] "Conversion method for Iso2BPTCtrlEvseId[24]" RAT_FUNC "%10.0" "1" COEFFS 0.000000 1.000000 -0.000000 0.000000 0.000000 1.000000 /end COMPU_METHOD
/* Scalar measurable for DDE 'Iso2BPTCtrlEvseId[25]'. */
/begin MEASUREMENT Iso2BPTCtrlEvseId[25] "for ISOv2 DC_BPTControlRes message: The ID that uniquely identifies the EVSE. Format is defined in the ISO 15118 ED2 Spec Annex H" UBYTE CU_ISO2BPTCTRLEVSEID[25] 1 100 0.0 255.0 ECU_ADDRESS 0x7001810e BYTE_ORDER MSB_LAST /end MEASUREMENT
/begin COMPU_METHOD CU_ISO2BPTCTRLEVSEID[25] "Conversion method for Iso2BPTCtrlEvseId[25]" RAT_FUNC "%10.0" "1" COEFFS 0.000000 1.000000 -0.000000 0.000000 0.000000 1.000000 /end COMPU_METHOD
/* Scalar measurable for DDE 'Iso2BPTCtrlEvseId[26]'. */
/begin MEASUREMENT Iso2BPTCtrlEvseId[26] "for ISOv2 DC_BPTControlRes message: The ID that uniquely identifies the EVSE. Format is defined in the ISO 15118 ED2 Spec Annex H" UBYTE CU_ISO2BPTCTRLEVSEID[26] 1 100 0.0 255.0 ECU_ADDRESS 0x7001810f BYTE_ORDER MSB_LAST /end MEASUREMENT
/begin COMPU_METHOD CU_ISO2BPTCTRLEVSEID[26] "Conversion method for Iso2BPTCtrlEvseId[26]" RAT_FUNC "%10.0" "1" COEFFS 0.000000 1.000000 -0.000000 0.000000 0.000000 1.000000 /end COMPU_METHOD
/* Scalar measurable for DDE 'Iso2BPTCtrlEvseId[27]'. */
/begin MEASUREMENT Iso2BPTCtrlEvseId[27] "for ISOv2 DC_BPTControlRes message: The ID that uniquely identifies the EVSE. Format is defined in the ISO 15118 ED2 Spec Annex H" UBYTE CU_ISO2BPTCTRLEVSEID[27] 1 100 0.0 255.0 ECU_ADDRESS 0x70018110 BYTE_ORDER MSB_LAST /end MEASUREMENT
/begin COMPU_METHOD CU_ISO2BPTCTRLEVSEID[27] "Conversion method for Iso2BPTCtrlEvseId[27]" RAT_FUNC "%10.0" "1" COEFFS 0.000000 1.000000 -0.000000 0.000000 0.000000 1.000000 /end COMPU_METHOD
/* Scalar measurable for DDE 'Iso2BPTCtrlEvseId[28]'. */
/begin MEASUREMENT Iso2BPTCtrlEvseId[28] "for ISOv2 DC_BPTControlRes message: The ID that uniquely identifies the EVSE. Format is defined in the ISO 15118 ED2 Spec Annex H" UBYTE CU_ISO2BPTCTRLEVSEID[28] 1 100 0.0 255.0 ECU_ADDRESS 0x70018111 BYTE_ORDER MSB_LAST /end MEASUREMENT
/begin COMPU_METHOD CU_ISO2BPTCTRLEVSEID[28] "Conversion method for Iso2BPTCtrlEvseId[28]" RAT_FUNC "%10.0" "1" COEFFS 0.000000 1.000000 -0.000000 0.000000 0.000000 1.000000 /end COMPU_METHOD
/* Scalar measurable for DDE 'Iso2BPTCtrlEvseId[29]'. */
/begin MEASUREMENT Iso2BPTCtrlEvseId[29] "for ISOv2 DC_BPTControlRes message: The ID that uniquely identifies the EVSE. Format is defined in the ISO 15118 ED2 Spec Annex H" UBYTE CU_ISO2BPTCTRLEVSEID[29] 1 100 0.0 255.0 ECU_ADDRESS 0x70018112 BYTE_ORDER MSB_LAST /end MEASUREMENT
/begin COMPU_METHOD CU_ISO2BPTCTRLEVSEID[29] "Conversion method for Iso2BPTCtrlEvseId[29]" RAT_FUNC "%10.0" "1" COEFFS 0.000000 1.000000 -0.000000 0.000000 0.000000 1.000000 /end COMPU_METHOD
/* Scalar measurable for DDE 'Iso2BPTCtrlEvseId[2]'. */
/begin MEASUREMENT Iso2BPTCtrlEvseId[2] "for ISOv2 DC_BPTControlRes message: The ID that uniquely identifies the EVSE. Format is defined in the ISO 15118 ED2 Spec Annex H" UBYTE CU_ISO2BPTCTRLEVSEID[2] 1 100 0.0 255.0 ECU_ADDRESS 0x700180f7 BYTE_ORDER MSB_LAST /end MEASUREMENT
/begin COMPU_METHOD CU_ISO2BPTCTRLEVSEID[2] "Conversion method for Iso2BPTCtrlEvseId[2]" RAT_FUNC "%10.0" "1" COEFFS 0.000000 1.000000 -0.000000 0.000000 0.000000 1.000000 /end COMPU_METHOD
/* Scalar measurable for DDE 'Iso2BPTCtrlEvseId[30]'. */
/begin MEASUREMENT Iso2BPTCtrlEvseId[30] "for ISOv2 DC_BPTControlRes message: The ID that uniquely identifies the EVSE. Format is defined in the ISO 15118 ED2 Spec Annex H" UBYTE CU_ISO2BPTCTRLEVSEID[30] 1 100 0.0 255.0 ECU_ADDRESS 0x70018113 BYTE_ORDER MSB_LAST /end MEASUREMENT
/begin COMPU_METHOD CU_ISO2BPTCTRLEVSEID[30] "Conversion method for Iso2BPTCtrlEvseId[30]" RAT_FUNC "%10.0" "1" COEFFS 0.000000 1.000000 -0.000000 0.000000 0.000000 1.000000 /end COMPU_METHOD
/* Scalar measurable for DDE 'Iso2BPTCtrlEvseId[31]'. */
/begin MEASUREMENT Iso2BPTCtrlEvseId[31] "for ISOv2 DC_BPTControlRes message: The ID that uniquely identifies the EVSE. Format is defined in the ISO 15118 ED2 Spec Annex H" UBYTE CU_ISO2BPTCTRLEVSEID[31] 1 100 0.0 255.0 ECU_ADDRESS 0x70018114 BYTE_ORDER MSB_LAST /end MEASUREMENT
/begin COMPU_METHOD CU_ISO2BPTCTRLEVSEID[31] "Conversion method for Iso2BPTCtrlEvseId[31]" RAT_FUNC "%10.0" "1" COEFFS 0.000000 1.000000 -0.000000 0.000000 0.000000 1.000000 /end COMPU_METHOD
/* Scalar measurable for DDE 'Iso2BPTCtrlEvseId[32]'. */
/begin MEASUREMENT Iso2BPTCtrlEvseId[32] "for ISOv2 DC_BPTControlRes message: The ID that uniquely identifies the EVSE. Format is defined in the ISO 15118 ED2 Spec Annex H" UBYTE CU_ISO2BPTCTRLEVSEID[32] 1 100 0.0 255.0 ECU_ADDRESS 0x70018115 BYTE_ORDER MSB_LAST /end MEASUREMENT
/begin COMPU_METHOD CU_ISO2BPTCTRLEVSEID[32] "Conversion method for Iso2BPTCtrlEvseId[32]" RAT_FUNC "%10.0" "1" COEFFS 0.000000 1.000000 -0.000000 0.000000 0.000000 1.000000 /end COMPU_METHOD
/* Scalar measurable for DDE 'Iso2BPTCtrlEvseId[33]'. */
/begin MEASUREMENT Iso2BPTCtrlEvseId[33] "for ISOv2 DC_BPTControlRes message: The ID that uniquely identifies the EVSE. Format is defined in the ISO 15118 ED2 Spec Annex H" UBYTE CU_ISO2BPTCTRLEVSEID[33] 1 100 0.0 255.0 ECU_ADDRESS 0x70018116 BYTE_ORDER MSB_LAST /end MEASUREMENT
/begin COMPU_METHOD CU_ISO2BPTCTRLEVSEID[33] "Conversion method for Iso2BPTCtrlEvseId[33]" RAT_FUNC "%10.0" "1" COEFFS 0.000000 1.000000 -0.000000 0.000000 0.000000 1.000000 /end COMPU_METHOD
/* Scalar measurable for DDE 'Iso2BPTCtrlEvseId[34]'. */
/begin MEASUREMENT Iso2BPTCtrlEvseId[34] "for ISOv2 DC_BPTControlRes message: The ID that uniquely identifies the EVSE. Format is defined in the ISO 15118 ED2 Spec Annex H" UBYTE CU_ISO2BPTCTRLEVSEID[34] 1 100 0.0 255.0 ECU_ADDRESS 0x70018117 BYTE_ORDER MSB_LAST /end MEASUREMENT
/begin COMPU_METHOD CU_ISO2BPTCTRLEVSEID[34] "Conversion method for Iso2BPTCtrlEvseId[34]" RAT_FUNC "%10.0" "1" COEFFS 0.000000 1.000000 -0.000000 0.000000 0.000000 1.000000 /end COMPU_METHOD
/* Scalar measurable for DDE 'Iso2BPTCtrlEvseId[35]'. */
/begin MEASUREMENT Iso2BPTCtrlEvseId[35] "for ISOv2 DC_BPTControlRes message: The ID that uniquely identifies the EVSE. Format is defined in the ISO 15118 ED2 Spec Annex H" UBYTE CU_ISO2BPTCTRLEVSEID[35] 1 100 0.0 255.0 ECU_ADDRESS 0x70018118 BYTE_ORDER MSB_LAST /end MEASUREMENT
/begin COMPU_METHOD CU_ISO2BPTCTRLEVSEID[35] "Conversion method for Iso2BPTCtrlEvseId[35]" RAT_FUNC "%10.0" "1" COEFFS 0.000000 1.000000 -0.000000 0.000000 0.000000 1.000000 /end COMPU_METHOD
/* Scalar measurable for DDE 'Iso2BPTCtrlEvseId[36]'. */
/begin MEASUREMENT Iso2BPTCtrlEvseId[36] "for ISOv2 DC_BPTControlRes message: The ID that uniquely identifies the EVSE. Format is defined in the ISO 15118 ED2 Spec Annex H" UBYTE CU_ISO2BPTCTRLEVSEID[36] 1 100 0.0 255.0 ECU_ADDRESS 0x70018119 BYTE_ORDER MSB_LAST /end MEASUREMENT
/begin COMPU_METHOD CU_ISO2BPTCTRLEVSEID[36] "Conversion method for Iso2BPTCtrlEvseId[36]" RAT_FUNC "%10.0" "1" COEFFS 0.000000 1.000000 -0.000000 0.000000 0.000000 1.000000 /end COMPU_METHOD
/* Scalar measurable for DDE 'Iso2BPTCtrlEvseId[37]'. */
/begin MEASUREMENT Iso2BPTCtrlEvseId[37] "for ISOv2 DC_BPTControlRes message: The ID that uniquely identifies the EVSE. Format is defined in the ISO 15118 ED2 Spec Annex H" UBYTE CU_ISO2BPTCTRLEVSEID[37] 1 100 0.0 255.0 ECU_ADDRESS 0x7001811a BYTE_ORDER MSB_LAST /end MEASUREMENT
/begin COMPU_METHOD CU_ISO2BPTCTRLEVSEID[37] "Conversion method for Iso2BPTCtrlEvseId[37]" RAT_FUNC "%10.0" "1" COEFFS 0.000000 1.000000 -0.000000 0.000000 0.000000 1.000000 /end COMPU_METHOD
/* Scalar measurable for DDE 'Iso2BPTCtrlEvseId[3]'. */
/begin MEASUREMENT Iso2BPTCtrlEvseId[3] "for ISOv2 DC_BPTControlRes message: The ID that uniquely identifies the EVSE. Format is defined in the ISO 15118 ED2 Spec Annex H" UBYTE CU_ISO2BPTCTRLEVSEID[3] 1 100 0.0 255.0 ECU_ADDRESS 0x700180f8 BYTE_ORDER MSB_LAST /end MEASUREMENT
/begin COMPU_METHOD CU_ISO2BPTCTRLEVSEID[3] "Conversion method for Iso2BPTCtrlEvseId[3]" RAT_FUNC "%10.0" "1" COEFFS 0.000000 1.000000 -0.000000 0.000000 0.000000 1.000000 /end COMPU_METHOD
/* Scalar measurable for DDE 'Iso2BPTCtrlEvseId[4]'. */
/begin MEASUREMENT Iso2BPTCtrlEvseId[4] "for ISOv2 DC_BPTControlRes message: The ID that uniquely identifies the EVSE. Format is defined in the ISO 15118 ED2 Spec Annex H" UBYTE CU_ISO2BPTCTRLEVSEID[4] 1 100 0.0 255.0 ECU_ADDRESS 0x700180f9 BYTE_ORDER MSB_LAST /end MEASUREMENT
/begin COMPU_METHOD CU_ISO2BPTCTRLEVSEID[4] "Conversion method for Iso2BPTCtrlEvseId[4]" RAT_FUNC "%10.0" "1" COEFFS 0.000000 1.000000 -0.000000 0.000000 0.000000 1.000000 /end COMPU_METHOD
/* Scalar measurable for DDE 'Iso2BPTCtrlEvseId[5]'. */
/begin MEASUREMENT Iso2BPTCtrlEvseId[5] "for ISOv2 DC_BPTControlRes message: The ID that uniquely identifies the EVSE. Format is defined in the ISO 15118 ED2 Spec Annex H" UBYTE CU_ISO2BPTCTRLEVSEID[5] 1 100 0.0 255.0 ECU_ADDRESS 0x700180fa BYTE_ORDER MSB_LAST /end MEASUREMENT
/begin COMPU_METHOD CU_ISO2BPTCTRLEVSEID[5] "Conversion method for Iso2BPTCtrlEvseId[5]" RAT_FUNC "%10.0" "1" COEFFS 0.000000 1.000000 -0.000000 0.000000 0.000000 1.000000 /end COMPU_METHOD
/* Scalar measurable for DDE 'Iso2BPTCtrlEvseId[6]'. */
/begin MEASUREMENT Iso2BPTCtrlEvseId[6] "for ISOv2 DC_BPTControlRes message: The ID that uniquely identifies the EVSE. Format is defined in the ISO 15118 ED2 Spec Annex H" UBYTE CU_ISO2BPTCTRLEVSEID[6] 1 100 0.0 255.0 ECU_ADDRESS 0x700180fb BYTE_ORDER MSB_LAST /end MEASUREMENT
/begin COMPU_METHOD CU_ISO2BPTCTRLEVSEID[6] "Conversion method for Iso2BPTCtrlEvseId[6]" RAT_FUNC "%10.0" "1" COEFFS 0.000000 1.000000 -0.000000 0.000000 0.000000 1.000000 /end COMPU_METHOD
/* Scalar measurable for DDE 'Iso2BPTCtrlEvseId[7]'. */
/begin MEASUREMENT Iso2BPTCtrlEvseId[7] "for ISOv2 DC_BPTControlRes message: The ID that uniquely identifies the EVSE. Format is defined in the ISO 15118 ED2 Spec Annex H" UBYTE CU_ISO2BPTCTRLEVSEID[7] 1 100 0.0 255.0 ECU_ADDRESS 0x700180fc BYTE_ORDER MSB_LAST /end MEASUREMENT
/begin COMPU_METHOD CU_ISO2BPTCTRLEVSEID[7] "Conversion method for Iso2BPTCtrlEvseId[7]" RAT_FUNC "%10.0" "1" COEFFS 0.000000 1.000000 -0.000000 0.000000 0.000000 1.000000 /end COMPU_METHOD
/* Scalar measurable for DDE 'Iso2BPTCtrlEvseId[8]'. */
/begin MEASUREMENT Iso2BPTCtrlEvseId[8] "for ISOv2 DC_BPTControlRes message: The ID that uniquely identifies the EVSE. Format is defined in the ISO 15118 ED2 Spec Annex H" UBYTE CU_ISO2BPTCTRLEVSEID[8] 1 100 0.0 255.0 ECU_ADDRESS 0x700180fd BYTE_ORDER MSB_LAST /end MEASUREMENT
/begin COMPU_METHOD CU_ISO2BPTCTRLEVSEID[8] "Conversion method for Iso2BPTCtrlEvseId[8]" RAT_FUNC "%10.0" "1" COEFFS 0.000000 1.000000 -0.000000 0.000000 0.000000 1.000000 /end COMPU_METHOD
/* Scalar measurable for DDE 'Iso2BPTCtrlEvseId[9]'. */
/begin MEASUREMENT Iso2BPTCtrlEvseId[9] "for ISOv2 DC_BPTControlRes message: The ID that uniquely identifies the EVSE. Format is defined in the ISO 15118 ED2 Spec Annex H" UBYTE CU_ISO2BPTCTRLEVSEID[9] 1 100 0.0 255.0 ECU_ADDRESS 0x700180fe BYTE_ORDER MSB_LAST /end MEASUREMENT
/begin COMPU_METHOD CU_ISO2BPTCTRLEVSEID[9] "Conversion method for Iso2BPTCtrlEvseId[9]" RAT_FUNC "%10.0" "1" COEFFS 0.000000 1.000000 -0.000000 0.000000 0.000000 1.000000 /end COMPU_METHOD
/* Scalar measurable for DDE 'Iso2BPTCtrlEvseMaxChgCrnt'. */
/begin MEASUREMENT Iso2BPTCtrlEvseMaxChgCrnt "for ISOv2 DC_BPTControlRes message: Indicates the maximum charge current the EVSE can deliver" FLOAT32_IEEE CU_ISO2BPTCTRLEVSEMAXCHGCRNT 1 100 -3.40282346639e+38 3.40282346639e+38 ECU_ADDRESS 0x70017fc4 BYTE_ORDER MSB_LAST /end MEASUREMENT
/begin COMPU_METHOD CU_ISO2BPTCTRLEVSEMAXCHGCRNT "Conversion method for Iso2BPTCtrlEvseMaxChgCrnt" RAT_FUNC "%10.0" "%" COEFFS 0.000000 1.000000 -0.000000 0.000000 0.000000 1.000000 /end COMPU_METHOD
/* Scalar measurable for DDE 'Iso2BPTCtrlEvseMaxChgCrntPres'. */
/begin MEASUREMENT Iso2BPTCtrlEvseMaxChgCrntPres "for ISOv2 DC_BPTControlRes message: Indicates the presence of the Iso2BPTCtrlEvseMaxChgCrnt parameter." UBYTE CU_ISO2BPTCTRLEVSEMAXCHGCRNTPR0 1 100 0.0 1.0 ECU_ADDRESS 0x70018444 BYTE_ORDER MSB_LAST /end MEASUREMENT
/begin COMPU_METHOD CU_ISO2BPTCTRLEVSEMAXCHGCRNTPR0 "Conversion method for Iso2BPTCtrlEvseMaxChgCrntPres" RAT_FUNC "%10.0" "b" COEFFS 0.000000 1.000000 -0.000000 0.000000 0.000000 1.000000 /end COMPU_METHOD
/* Scalar measurable for DDE 'Iso2BPTCtrlEvseMaxChgPwr'. */
/begin MEASUREMENT Iso2BPTCtrlEvseMaxChgPwr "for ISOv2 DC_BPTControlRes message: Indicates the maximum charge power the EVSE can deliver." FLOAT32_IEEE CU_ISO2BPTCTRLEVSEMAXCHGPWR 1 100 -3.40282346639e+38 3.40282346639e+38 ECU_ADDRESS 0x70017f10 BYTE_ORDER MSB_LAST /end MEASUREMENT
/begin COMPU_METHOD CU_ISO2BPTCTRLEVSEMAXCHGPWR "Conversion method for Iso2BPTCtrlEvseMaxChgPwr" RAT_FUNC "%10.0" "%" COEFFS 0.000000 1.000000 -0.000000 0.000000 0.000000 1.000000 /end COMPU_METHOD
/* Scalar measurable for DDE 'Iso2BPTCtrlEvseMaxChgPwrPres'. */
/begin MEASUREMENT Iso2BPTCtrlEvseMaxChgPwrPres "for ISOv2 DC_BPTControlRes message: Indicates the presence of the Iso2BPTCtrlEvseMaxChgPwr parameter." UBYTE CU_ISO2BPTCTRLEVSEMAXCHGPWRPRES 1 100 0.0 1.0 ECU_ADDRESS 0x70018381 BYTE_ORDER MSB_LAST /end MEASUREMENT
/begin COMPU_METHOD CU_ISO2BPTCTRLEVSEMAXCHGPWRPRES "Conversion method for Iso2BPTCtrlEvseMaxChgPwrPres" RAT_FUNC "%10.0" "b" COEFFS 0.000000 1.000000 -0.000000 0.000000 0.000000 1.000000 /end COMPU_METHOD
/* Scalar measurable for DDE 'Iso2BPTCtrlEvseMaxDisChgCrnt'. */
/begin MEASUREMENT Iso2BPTCtrlEvseMaxDisChgCrnt "for ISOv2 DC_BPTControlRes message: Indicates the maximum discharge current the EVSE can deliver." FLOAT32_IEEE CU_ISO2BPTCTRLEVSEMAXDISCHGCRNT 1 100 -3.40282346639e+38 3.40282346639e+38 ECU_ADDRESS 0x70017e84 BYTE_ORDER MSB_LAST /end MEASUREMENT
/begin COMPU_METHOD CU_ISO2BPTCTRLEVSEMAXDISCHGCRNT "Conversion method for Iso2BPTCtrlEvseMaxDisChgCrnt" RAT_FUNC "%10.0" "%" COEFFS 0.000000 1.000000 -0.000000 0.000000 0.000000 1.000000 /end COMPU_METHOD
/* Scalar measurable for DDE 'Iso2BPTCtrlEvseMaxDisChgPwr'. */
/begin MEASUREMENT Iso2BPTCtrlEvseMaxDisChgPwr "for ISOv2 DC_BPTControlRes message: Indicates the maximum discharge power the EVSE can deliver." FLOAT32_IEEE CU_ISO2BPTCTRLEVSEMAXDISCHGPWR 1 100 -3.40282346639e+38 3.40282346639e+38 ECU_ADDRESS 0x700182cc BYTE_ORDER MSB_LAST /end MEASUREMENT
/begin COMPU_METHOD CU_ISO2BPTCTRLEVSEMAXDISCHGPWR "Conversion method for Iso2BPTCtrlEvseMaxDisChgPwr" RAT_FUNC "%10.0" "%" COEFFS 0.000000 1.000000 -0.000000 0.000000 0.000000 1.000000 /end COMPU_METHOD
/* Scalar measurable for DDE 'Iso2BPTCtrlEvseMaxVolt'. */
/begin MEASUREMENT Iso2BPTCtrlEvseMaxVolt "for ISOv2 DC_BPTControlRes message: Indicates the maximum voltage the EVSE can deliver" FLOAT32_IEEE CU_ISO2BPTCTRLEVSEMAXVOLT 1 100 -3.40282346639e+38 3.40282346639e+38 ECU_ADDRESS 0x70017ddc BYTE_ORDER MSB_LAST /end MEASUREMENT
/begin COMPU_METHOD CU_ISO2BPTCTRLEVSEMAXVOLT "Conversion method for Iso2BPTCtrlEvseMaxVolt" RAT_FUNC "%10.0" "%" COEFFS 0.000000 1.000000 -0.000000 0.000000 0.000000 1.000000 /end COMPU_METHOD
/* Scalar measurable for DDE 'Iso2BPTCtrlEvseMaxVoltPres'. */
/begin MEASUREMENT Iso2BPTCtrlEvseMaxVoltPres "for ISOv2 DC_BPTControlRes message: Indicates the presence of the Iso2BPTCtrlEvseMaxVolt parameter" UBYTE CU_ISO2BPTCTRLEVSEMAXVOLTPRES 1 100 0.0 1.0 ECU_ADDRESS 0x70018237 BYTE_ORDER MSB_LAST /end MEASUREMENT
/begin COMPU_METHOD CU_ISO2BPTCTRLEVSEMAXVOLTPRES "Conversion method for Iso2BPTCtrlEvseMaxVoltPres" RAT_FUNC "%10.0" "b" COEFFS 0.000000 1.000000 -0.000000 0.000000 0.000000 1.000000 /end COMPU_METHOD
/* Scalar measurable for DDE 'Iso2BPTCtrlEvseMinVolt'. */
/begin MEASUREMENT Iso2BPTCtrlEvseMinVolt "for ISOv2 DC_BPTControlRes message: Indicates the minimum voltage the EVSE can deliver." FLOAT32_IEEE CU_ISO2BPTCTRLEVSEMINVOLT 1 100 -3.40282346639e+38 3.40282346639e+38 ECU_ADDRESS 0x70017d34 BYTE_ORDER MSB_LAST /end MEASUREMENT
/begin COMPU_METHOD CU_ISO2BPTCTRLEVSEMINVOLT "Conversion method for Iso2BPTCtrlEvseMinVolt" RAT_FUNC "%10.0" "%" COEFFS 0.000000 1.000000 -0.000000 0.000000 0.000000 1.000000 /end COMPU_METHOD
/* Scalar measurable for DDE 'Iso2BPTCtrlEvseMinVoltPres'. */
/begin MEASUREMENT Iso2BPTCtrlEvseMinVoltPres "for ISOv2 DC_BPTControlRes message: Indicates the presence of the Iso2BPTCtrlEvseMinVolt parameter" UBYTE CU_ISO2BPTCTRLEVSEMINVOLTPRES 1 100 0.0 1.0 ECU_ADDRESS 0x70018186 BYTE_ORDER MSB_LAST /end MEASUREMENT
/begin COMPU_METHOD CU_ISO2BPTCTRLEVSEMINVOLTPRES "Conversion method for Iso2BPTCtrlEvseMinVoltPres" RAT_FUNC "%10.0" "b" COEFFS 0.000000 1.000000 -0.000000 0.000000 0.000000 1.000000 /end COMPU_METHOD
/* Scalar measurable for DDE 'Iso2BPTCtrlEvsePresCrnt'. */
/begin MEASUREMENT Iso2BPTCtrlEvsePresCrnt "for ISOv2 DC_BPTControlRes message: Indicates the measured High Voltage DC (HVDC) current at the output of the DC Supply through the charge coupler" FLOAT32_IEEE CU_ISO2BPTCTRLEVSEPRESCRNT 1 100 -3.40282346639e+38 3.40282346639e+38 ECU_ADDRESS 0x70017c5c BYTE_ORDER MSB_LAST /end MEASUREMENT
/begin COMPU_METHOD CU_ISO2BPTCTRLEVSEPRESCRNT "Conversion method for Iso2BPTCtrlEvsePresCrnt" RAT_FUNC "%10.0" "%" COEFFS 0.000000 1.000000 -0.000000 0.000000 0.000000 1.000000 /end COMPU_METHOD
/* Scalar measurable for DDE 'Iso2BPTCtrlEvsePresVolt'. */
/begin MEASUREMENT Iso2BPTCtrlEvsePresVolt "for ISOv2 DC_BPTControlRes message: Indicates the measured High Voltage DC (HVDC) voltage at the output of the DC Supply" FLOAT32_IEEE CU_ISO2BPTCTRLEVSEPRESVOLT 1 100 -3.40282346639e+38 3.40282346639e+38 ECU_ADDRESS 0x70018048 BYTE_ORDER MSB_LAST /end MEASUREMENT
/begin COMPU_METHOD CU_ISO2BPTCTRLEVSEPRESVOLT "Conversion method for Iso2BPTCtrlEvsePresVolt" RAT_FUNC "%10.0" "%" COEFFS 0.000000 1.000000 -0.000000 0.000000 0.000000 1.000000 /end COMPU_METHOD
/* Scalar measurable for DDE 'Iso2BPTCtrlEvseStatPres'. */
/begin MEASUREMENT Iso2BPTCtrlEvseStatPres "Indicates the presence of the EVSENotificationMaxDelay and EVSENotification parameters in the DC_BPTControlRes message" UBYTE CU_ISO2BPTCTRLEVSESTATPRES 1 100 0.0 1.0 ECU_ADDRESS 0x70018482 BYTE_ORDER MSB_LAST /end MEASUREMENT
/begin COMPU_METHOD CU_ISO2BPTCTRLEVSESTATPRES "Conversion method for Iso2BPTCtrlEvseStatPres" RAT_FUNC "%10.0" "b" COEFFS 0.000000 1.000000 -0.000000 0.000000 0.000000 1.000000 /end COMPU_METHOD
/* Scalar measurable for DDE 'Iso2BPTCtrlEvseVoltLimAchvd'. */
/begin MEASUREMENT Iso2BPTCtrlEvseVoltLimAchvd "for ISOv2 DC_BPTControlRes message: Indicates hat the charger is at its voltage limit" UBYTE CU_ISO2BPTCTRLEVSEVOLTLIMACHVD 1 100 0.0 1.0 ECU_ADDRESS 0x70017f80 BYTE_ORDER MSB_LAST /end MEASUREMENT
/begin COMPU_METHOD CU_ISO2BPTCTRLEVSEVOLTLIMACHVD "Conversion method for Iso2BPTCtrlEvseVoltLimAchvd" RAT_FUNC "%10.0" "b" COEFFS 0.000000 1.000000 -0.000000 0.000000 0.000000 1.000000 /end COMPU_METHOD
/* Scalar measurable for DDE 'Iso2BPTCtrlMaxDisChgCrntPres'. */
/begin MEASUREMENT Iso2BPTCtrlMaxDisChgCrntPres "for ISOv2 DC_BPTControlRes message: Indicates the presence of the Iso2BPTCtrlEvseMaxDisChgCrnt parameter." UBYTE CU_ISO2BPTCTRLMAXDISCHGCRNTPRES 1 100 0.0 1.0 ECU_ADDRESS 0x700183bc BYTE_ORDER MSB_LAST /end MEASUREMENT
/begin COMPU_METHOD CU_ISO2BPTCTRLMAXDISCHGCRNTPRES "Conversion method for Iso2BPTCtrlMaxDisChgCrntPres" RAT_FUNC "%10.0" "b" COEFFS 0.000000 1.000000 -0.000000 0.000000 0.000000 1.000000 /end COMPU_METHOD
/* Scalar measurable for DDE 'Iso2BPTCtrlMaxDisChgPwrPres'. */
/begin MEASUREMENT Iso2BPTCtrlMaxDisChgPwrPres "for ISOv2 DC_BPTControlRes message: Indicates the presence of the Iso2BPTCtrlEvseMaxDisChgPwr parameter." UBYTE CU_ISO2BPTCTRLMAXDISCHGPWRPRES 1 100 0.0 1.0 ECU_ADDRESS 0x70017ecd BYTE_ORDER MSB_LAST /end MEASUREMENT
/begin COMPU_METHOD CU_ISO2BPTCTRLMAXDISCHGPWRPRES "Conversion method for Iso2BPTCtrlMaxDisChgPwrPres" RAT_FUNC "%10.0" "b" COEFFS 0.000000 1.000000 -0.000000 0.000000 0.000000 1.000000 /end COMPU_METHOD
/* Scalar measurable for DDE 'Iso2BPTCtrlNotif'. */
/begin MEASUREMENT Iso2BPTCtrlNotif "Indicates action SECC wants the EVSE to perform in the DC_BPTControlRes message" UBYTE CU_ISO2BPTCTRLNOTIF 1 100 0.0 255.0 ECU_ADDRESS 0x70018328 BYTE_ORDER MSB_LAST /end MEASUREMENT
/begin COMPU_METHOD CU_ISO2BPTCTRLNOTIF "Conversion method for Iso2BPTCtrlNotif" RAT_FUNC "%10.0" "1" COEFFS 0.000000 1.000000 -0.000000 0.000000 0.000000 1.000000 /end COMPU_METHOD
/* Scalar measurable for DDE 'Iso2BPTCtrlNotifMaxDelay'. */
/begin MEASUREMENT Iso2BPTCtrlNotifMaxDelay "Indicates the time until the SECC expects the EVCC to react on the EVSENotification action set in the DC_BPTControlRes message" UWORD CU_ISO2BPTCTRLNOTIFMAXDELAY 1 100 0.0 65535.0 ECU_ADDRESS 0x70017e32 BYTE_ORDER MSB_LAST /end MEASUREMENT
/begin COMPU_METHOD CU_ISO2BPTCTRLNOTIFMAXDELAY "Conversion method for Iso2BPTCtrlNotifMaxDelay" RAT_FUNC "%10.0" "1" COEFFS 0.000000 1.000000 -0.000000 0.000000 0.000000 1.000000 /end COMPU_METHOD
/* Scalar measurable for DDE 'Iso2BPTCtrlRescode'. */
/begin MEASUREMENT Iso2BPTCtrlRescode "for ISOv2 DC_BPTControlRes message: indicates the acknowledgment status of this V2G messages received by the SECC." UBYTE CU_ISO2BPTCTRLRESCODE 1 100 0.0 255.0 ECU_ADDRESS 0x70018284 BYTE_ORDER MSB_LAST /end MEASUREMENT
/begin COMPU_METHOD CU_ISO2BPTCTRLRESCODE "Conversion method for Iso2BPTCtrlRescode" RAT_FUNC "%10.0" "1" COEFFS 0.000000 1.000000 -0.000000 0.000000 0.000000 1.000000 /end COMPU_METHOD
/* Scalar measurable for DDE 'Iso2BPTCtrlRxTrg'. */
/begin MEASUREMENT Iso2BPTCtrlRxTrg "Trigger flag that on a rising edge indicates the event for receiving the PLC (V2G) DC_BPTControlRes message from the EVSE" UBYTE CU_ISO2BPTCTRLRXTRG 1 100 0.0 1.0 ECU_ADDRESS 0x70017d95 BYTE_ORDER MSB_LAST /end MEASUREMENT
/begin COMPU_METHOD CU_ISO2BPTCTRLRXTRG "Conversion method for Iso2BPTCtrlRxTrg" RAT_FUNC "%10.0" "b" COEFFS 0.000000 1.000000 -0.000000 0.000000 0.000000 1.000000 /end COMPU_METHOD
/* Scalar measurable for DDE 'Iso2BPTCtrlSaSchTupId'. */
/begin MEASUREMENT Iso2BPTCtrlSaSchTupId "for ISOv2 DC_BPTControlRes message: Represents the unique identifier within a charging session for a SAScheduleTuple element" UBYTE CU_ISO2BPTCTRLSASCHTUPID 1 100 0.0 255.0 ECU_ADDRESS 0x700181c1 BYTE_ORDER MSB_LAST /end MEASUREMENT
/begin COMPU_METHOD CU_ISO2BPTCTRLSASCHTUPID "Conversion method for Iso2BPTCtrlSaSchTupId" RAT_FUNC "%10.0" "1" COEFFS 0.000000 1.000000 -0.000000 0.000000 0.000000 1.000000 /end COMPU_METHOD
/* Scalar measurable for DDE 'Iso2BPTCtrlSaSchTupIdPres'. */
/begin MEASUREMENT Iso2BPTCtrlSaSchTupIdPres "for ISOv2 DC_BPTControlRes message: Indicates the presence of the SA Schedule Tuple ID parameter." UBYTE CU_ISO2BPTCTRLSASCHTUPIDPRES 1 100 0.0 1.0 ECU_ADDRESS 0x70017ca5 BYTE_ORDER MSB_LAST /end MEASUREMENT
/begin COMPU_METHOD CU_ISO2BPTCTRLSASCHTUPIDPRES "Conversion method for Iso2BPTCtrlSaSchTupIdPres" RAT_FUNC "%10.0" "b" COEFFS 0.000000 1.000000 -0.000000 0.000000 0.000000 1.000000 /end COMPU_METHOD
/* Scalar measurable for DDE 'Iso2CblChkEvseProcessing'. */
/begin MEASUREMENT Iso2CblChkEvseProcessing "Indicates that the EVSE has either finished or still in process of finishing the processing that was started after the AuthorizationReq message" UBYTE CU_ISO2CBLCHKEVSEPROCESSING 1 100 0.0 255.0 ECU_ADDRESS 0x7001811b BYTE_ORDER MSB_LAST /end MEASUREMENT
/begin COMPU_METHOD CU_ISO2CBLCHKEVSEPROCESSING "Conversion method for Iso2CblChkEvseProcessing" RAT_FUNC "%10.0" "1" COEFFS 0.000000 1.000000 -0.000000 0.000000 0.000000 1.000000 /end COMPU_METHOD
/* Scalar measurable for DDE 'Iso2CblChkEvseStatPres'. */
/begin MEASUREMENT Iso2CblChkEvseStatPres "Indicates the presence of the EVSENotificationMaxDelay and EVSENotification parameters in the CableCheckRes message" UBYTE CU_ISO2CBLCHKEVSESTATPRES 1 100 0.0 1.0 ECU_ADDRESS 0x70017c1f BYTE_ORDER MSB_LAST /end MEASUREMENT
/begin COMPU_METHOD CU_ISO2CBLCHKEVSESTATPRES "Conversion method for Iso2CblChkEvseStatPres" RAT_FUNC "%10.0" "b" COEFFS 0.000000 1.000000 -0.000000 0.000000 0.000000 1.000000 /end COMPU_METHOD
/* Scalar measurable for DDE 'Iso2CblChkNotif'. */
/begin MEASUREMENT Iso2CblChkNotif "Indicates action SECC wants the EVSE to perform in the CableCheckRes message" UBYTE CU_ISO2CBLCHKNOTIF 1 100 0.0 255.0 ECU_ADDRESS 0x70017fc8 BYTE_ORDER MSB_LAST /end MEASUREMENT
/begin COMPU_METHOD CU_ISO2CBLCHKNOTIF "Conversion method for Iso2CblChkNotif" RAT_FUNC "%10.0" "1" COEFFS 0.000000 1.000000 -0.000000 0.000000 0.000000 1.000000 /end COMPU_METHOD
/* Scalar measurable for DDE 'Iso2CblChkNotifMaxDelay'. */
/begin MEASUREMENT Iso2CblChkNotifMaxDelay "Indicates the time until the SECC expects the EVCC to react on the EVSENotification action set in the CableCheckRes message" UWORD CU_ISO2CBLCHKNOTIFMAXDELAY 1 100 0.0 65535.0 ECU_ADDRESS 0x70018446 BYTE_ORDER MSB_LAST /end MEASUREMENT
/begin COMPU_METHOD CU_ISO2CBLCHKNOTIFMAXDELAY "Conversion method for Iso2CblChkNotifMaxDelay" RAT_FUNC "%10.0" "1" COEFFS 0.000000 1.000000 -0.000000 0.000000 0.000000 1.000000 /end COMPU_METHOD
/* Scalar measurable for DDE 'Iso2CblChkRescode'. */
/begin MEASUREMENT Iso2CblChkRescode "for ISOv2 CableCheckRes message: indicates the acknowledgment status of this V2G messages received by the SECC." UBYTE CU_ISO2CBLCHKRESCODE 1 100 0.0 255.0 ECU_ADDRESS 0x70017f14 BYTE_ORDER MSB_LAST /end MEASUREMENT
/begin COMPU_METHOD CU_ISO2CBLCHKRESCODE "Conversion method for Iso2CblChkRescode" RAT_FUNC "%10.0" "1" COEFFS 0.000000 1.000000 -0.000000 0.000000 0.000000 1.000000 /end COMPU_METHOD
/* Scalar measurable for DDE 'Iso2CblChkRxTrg'. */
/begin MEASUREMENT Iso2CblChkRxTrg "Trigger flag that on a rising edge indicates the event for receiving the PLC (V2G) CableCheckRes message from the EVSE" UBYTE CU_ISO2CBLCHKRXTRG 1 100 0.0 1.0 ECU_ADDRESS 0x70018382 BYTE_ORDER MSB_LAST /end MEASUREMENT
/begin COMPU_METHOD CU_ISO2CBLCHKRXTRG "Conversion method for Iso2CblChkRxTrg" RAT_FUNC "%10.0" "b" COEFFS 0.000000 1.000000 -0.000000 0.000000 0.000000 1.000000 /end COMPU_METHOD
/* Scalar measurable for DDE 'Iso2ChgParDiscDcBptParPres'. */
/begin MEASUREMENT Iso2ChgParDiscDcBptParPres "Indicates the presence of the element that is used by the SECC for initiating the target setting process for DC BPT charging" UBYTE CU_ISO2CHGPARDISCDCBPTPARPRES 1 100 0.0 1.0 ECU_ADDRESS 0x70017e88 BYTE_ORDER MSB_LAST /end MEASUREMENT
/begin COMPU_METHOD CU_ISO2CHGPARDISCDCBPTPARPRES "Conversion method for Iso2ChgParDiscDcBptParPres" RAT_FUNC "%10.0" "b" COEFFS 0.000000 1.000000 -0.000000 0.000000 0.000000 1.000000 /end COMPU_METHOD
/* Scalar measurable for DDE 'Iso2ChgParDiscDcChgParPres'. */
/begin MEASUREMENT Iso2ChgParDiscDcChgParPres "Indicates the presence of the element that is used by the SECC for initiating the target setting process for DC charging" UBYTE CU_ISO2CHGPARDISCDCCHGPARPRES 1 100 0.0 1.0 ECU_ADDRESS 0x700182d0 BYTE_ORDER MSB_LAST /end MEASUREMENT
/begin COMPU_METHOD CU_ISO2CHGPARDISCDCCHGPARPRES "Conversion method for Iso2ChgParDiscDcChgParPres" RAT_FUNC "%10.0" "b" COEFFS 0.000000 1.000000 -0.000000 0.000000 0.000000 1.000000 /end COMPU_METHOD
/* Scalar measurable for DDE 'Iso2ChgParDiscEvseProcessing'. */
/begin MEASUREMENT Iso2ChgParDiscEvseProcessing "Indicates that the EVSE has either finished or still in process of finishing the processing that was started after the ChargeParameterDiscovery message" UBYTE CU_ISO2CHGPARDISCEVSEPROCESSING 1 100 0.0 255.0 ECU_ADDRESS 0x70017de0 BYTE_ORDER MSB_LAST /end MEASUREMENT
/begin COMPU_METHOD CU_ISO2CHGPARDISCEVSEPROCESSING "Conversion method for Iso2ChgParDiscEvseProcessing" RAT_FUNC "%10.0" "1" COEFFS 0.000000 1.000000 -0.000000 0.000000 0.000000 1.000000 /end COMPU_METHOD
/* Scalar measurable for DDE 'Iso2ChgParDiscEvseStatPres'. */
/begin MEASUREMENT Iso2ChgParDiscEvseStatPres "Indicates the presence of the EVSENotificationMaxDelay and EVSENotification parameters in the ChargeParameterDiscovery message" UBYTE CU_ISO2CHGPARDISCEVSESTATPRES 1 100 0.0 1.0 ECU_ADDRESS 0x70018238 BYTE_ORDER MSB_LAST /end MEASUREMENT
/begin COMPU_METHOD CU_ISO2CHGPARDISCEVSESTATPRES "Conversion method for Iso2ChgParDiscEvseStatPres" RAT_FUNC "%10.0" "b" COEFFS 0.000000 1.000000 -0.000000 0.000000 0.000000 1.000000 /end COMPU_METHOD
/* Scalar measurable for DDE 'Iso2ChgParDiscNotif'. */
/begin MEASUREMENT Iso2ChgParDiscNotif "Indicates action SECC wants the EVSE to perform in the ChargeParameterDiscovery message" UBYTE CU_ISO2CHGPARDISCNOTIF 1 100 0.0 255.0 ECU_ADDRESS 0x70017d38 BYTE_ORDER MSB_LAST /end MEASUREMENT
/begin COMPU_METHOD CU_ISO2CHGPARDISCNOTIF "Conversion method for Iso2ChgParDiscNotif" RAT_FUNC "%10.0" "1" COEFFS 0.000000 1.000000 -0.000000 0.000000 0.000000 1.000000 /end COMPU_METHOD
/* Scalar measurable for DDE 'Iso2ChgParDiscNotifMaxDelay'. */
/begin MEASUREMENT Iso2ChgParDiscNotifMaxDelay "Indicates the time until the SECC expects the EVCC to react on the EVSENotification action set in the ChargeParameterDiscovery message" UWORD CU_ISO2CHGPARDISCNOTIFMAXDELAY 1 100 0.0 65535.0 ECU_ADDRESS 0x70018188 BYTE_ORDER MSB_LAST /end MEASUREMENT
/begin COMPU_METHOD CU_ISO2CHGPARDISCNOTIFMAXDELAY "Conversion method for Iso2ChgParDiscNotifMaxDelay" RAT_FUNC "%10.0" "1" COEFFS 0.000000 1.000000 -0.000000 0.000000 0.000000 1.000000 /end COMPU_METHOD
/* Scalar measurable for DDE 'Iso2ChgParDiscRescode'. */
/begin MEASUREMENT Iso2ChgParDiscRescode "for ISOv2 ChargeParameterDiscovery message: indicates the acknowledgment status of this V2G messages received by the SECC." UBYTE CU_ISO2CHGPARDISCRESCODE 1 100 0.0 255.0 ECU_ADDRESS 0x70017c60 BYTE_ORDER MSB_LAST /end MEASUREMENT
/begin COMPU_METHOD CU_ISO2CHGPARDISCRESCODE "Conversion method for Iso2ChgParDiscRescode" RAT_FUNC "%10.0" "1" COEFFS 0.000000 1.000000 -0.000000 0.000000 0.000000 1.000000 /end COMPU_METHOD
/* Scalar measurable for DDE 'Iso2ChgParDiscRxTrg'. */
/begin MEASUREMENT Iso2ChgParDiscRxTrg "Trigger flag that on a rising edge indicates the event for receiving the PLC (V2G) ChargeParameterDiscovery message from the EVSE" UBYTE CU_ISO2CHGPARDISCRXTRG 1 100 0.0 1.0 ECU_ADDRESS 0x7001804c BYTE_ORDER MSB_LAST /end MEASUREMENT
/begin COMPU_METHOD CU_ISO2CHGPARDISCRXTRG "Conversion method for Iso2ChgParDiscRxTrg" RAT_FUNC "%10.0" "b" COEFFS 0.000000 1.000000 -0.000000 0.000000 0.000000 1.000000 /end COMPU_METHOD
/* Scalar measurable for DDE 'Iso2ChgParDiscSaSchListSize'. */
/begin MEASUREMENT Iso2ChgParDiscSaSchListSize "Indicates the number of SAScheduleTuple elements that have been received by the EV" UBYTE CU_ISO2CHGPARDISCSASCHLISTSIZE 1 100 0.0 255.0 ECU_ADDRESS 0x70018483 BYTE_ORDER MSB_LAST /end MEASUREMENT
/begin COMPU_METHOD CU_ISO2CHGPARDISCSASCHLISTSIZE "Conversion method for Iso2ChgParDiscSaSchListSize" RAT_FUNC "%10.0" "1" COEFFS 0.000000 1.000000 -0.000000 0.000000 0.000000 1.000000 /end COMPU_METHOD
/* Scalar measurable for DDE 'Iso2CrntDmdEvseCrntLimAchvd'. */
/begin MEASUREMENT Iso2CrntDmdEvseCrntLimAchvd "Indicates that the charger is at its current limit" UBYTE CU_ISO2CRNTDMDEVSECRNTLIMACHVD 1 100 0.0 1.0 ECU_ADDRESS 0x70017f81 BYTE_ORDER MSB_LAST /end MEASUREMENT
/begin COMPU_METHOD CU_ISO2CRNTDMDEVSECRNTLIMACHVD "Conversion method for Iso2CrntDmdEvseCrntLimAchvd" RAT_FUNC "%10.0" "b" COEFFS 0.000000 1.000000 -0.000000 0.000000 0.000000 1.000000 /end COMPU_METHOD
/* Scalar measurable for DDE 'Iso2CrntDmdEvseIdLen'. */
/begin MEASUREMENT Iso2CrntDmdEvseIdLen "Actual number of characters in the EVSE ID" UBYTE CU_ISO2CRNTDMDEVSEIDLEN 1 100 0.0 255.0 ECU_ADDRESS 0x700183fd BYTE_ORDER MSB_LAST /end MEASUREMENT
/begin COMPU_METHOD CU_ISO2CRNTDMDEVSEIDLEN "Conversion method for Iso2CrntDmdEvseIdLen" RAT_FUNC "%10.0" "1" COEFFS 0.000000 1.000000 -0.000000 0.000000 0.000000 1.000000 /end COMPU_METHOD
/* Scalar measurable for DDE 'Iso2CrntDmdEvseId[0]'. */
/begin MEASUREMENT Iso2CrntDmdEvseId[0] "The ID that uniquely identifies the EVSE. Format is defined in the ISO 15118 ED2 Spec Annex H" UBYTE CU_ISO2CRNTDMDEVSEID[0] 1 100 0.0 255.0 ECU_ADDRESS 0x70017cbd BYTE_ORDER MSB_LAST /end MEASUREMENT
/begin COMPU_METHOD CU_ISO2CRNTDMDEVSEID[0] "Conversion method for Iso2CrntDmdEvseId[0]" RAT_FUNC "%10.0" "1" COEFFS 0.000000 1.000000 -0.000000 0.000000 0.000000 1.000000 /end COMPU_METHOD
/* Scalar measurable for DDE 'Iso2CrntDmdEvseId[10]'. */
/begin MEASUREMENT Iso2CrntDmdEvseId[10] "The ID that uniquely identifies the EVSE. Format is defined in the ISO 15118 ED2 Spec Annex H" UBYTE CU_ISO2CRNTDMDEVSEID[10] 1 100 0.0 255.0 ECU_ADDRESS 0x70017cc7 BYTE_ORDER MSB_LAST /end MEASUREMENT
/begin COMPU_METHOD CU_ISO2CRNTDMDEVSEID[10] "Conversion method for Iso2CrntDmdEvseId[10]" RAT_FUNC "%10.0" "1" COEFFS 0.000000 1.000000 -0.000000 0.000000 0.000000 1.000000 /end COMPU_METHOD
/* Scalar measurable for DDE 'Iso2CrntDmdEvseId[11]'. */
/begin MEASUREMENT Iso2CrntDmdEvseId[11] "The ID that uniquely identifies the EVSE. Format is defined in the ISO 15118 ED2 Spec Annex H" UBYTE CU_ISO2CRNTDMDEVSEID[11] 1 100 0.0 255.0 ECU_ADDRESS 0x70017cc8 BYTE_ORDER MSB_LAST /end MEASUREMENT
/begin COMPU_METHOD CU_ISO2CRNTDMDEVSEID[11] "Conversion method for Iso2CrntDmdEvseId[11]" RAT_FUNC "%10.0" "1" COEFFS 0.000000 1.000000 -0.000000 0.000000 0.000000 1.000000 /end COMPU_METHOD
/* Scalar measurable for DDE 'Iso2CrntDmdEvseId[12]'. */
/begin MEASUREMENT Iso2CrntDmdEvseId[12] "The ID that uniquely identifies the EVSE. Format is defined in the ISO 15118 ED2 Spec Annex H" UBYTE CU_ISO2CRNTDMDEVSEID[12] 1 100 0.0 255.0 ECU_ADDRESS 0x70017cc9 BYTE_ORDER MSB_LAST /end MEASUREMENT
/begin COMPU_METHOD CU_ISO2CRNTDMDEVSEID[12] "Conversion method for Iso2CrntDmdEvseId[12]" RAT_FUNC "%10.0" "1" COEFFS 0.000000 1.000000 -0.000000 0.000000 0.000000 1.000000 /end COMPU_METHOD
/* Scalar measurable for DDE 'Iso2CrntDmdEvseId[13]'. */
/begin MEASUREMENT Iso2CrntDmdEvseId[13] "The ID that uniquely identifies the EVSE. Format is defined in the ISO 15118 ED2 Spec Annex H" UBYTE CU_ISO2CRNTDMDEVSEID[13] 1 100 0.0 255.0 ECU_ADDRESS 0x70017cca BYTE_ORDER MSB_LAST /end MEASUREMENT
/begin COMPU_METHOD CU_ISO2CRNTDMDEVSEID[13] "Conversion method for Iso2CrntDmdEvseId[13]" RAT_FUNC "%10.0" "1" COEFFS 0.000000 1.000000 -0.000000 0.000000 0.000000 1.000000 /end COMPU_METHOD
/* Scalar measurable for DDE 'Iso2CrntDmdEvseId[14]'. */
/begin MEASUREMENT Iso2CrntDmdEvseId[14] "The ID that uniquely identifies the EVSE. Format is defined in the ISO 15118 ED2 Spec Annex H" UBYTE CU_ISO2CRNTDMDEVSEID[14] 1 100 0.0 255.0 ECU_ADDRESS 0x70017ccb BYTE_ORDER MSB_LAST /end MEASUREMENT
/begin COMPU_METHOD CU_ISO2CRNTDMDEVSEID[14] "Conversion method for Iso2CrntDmdEvseId[14]" RAT_FUNC "%10.0" "1" COEFFS 0.000000 1.000000 -0.000000 0.000000 0.000000 1.000000 /end COMPU_METHOD
/* Scalar measurable for DDE 'Iso2CrntDmdEvseId[15]'. */
/begin MEASUREMENT Iso2CrntDmdEvseId[15] "The ID that uniquely identifies the EVSE. Format is defined in the ISO 15118 ED2 Spec Annex H" UBYTE CU_ISO2CRNTDMDEVSEID[15] 1 100 0.0 255.0 ECU_ADDRESS 0x70017ccc BYTE_ORDER MSB_LAST /end MEASUREMENT
/begin COMPU_METHOD CU_ISO2CRNTDMDEVSEID[15] "Conversion method for Iso2CrntDmdEvseId[15]" RAT_FUNC "%10.0" "1" COEFFS 0.000000 1.000000 -0.000000 0.000000 0.000000 1.000000 /end COMPU_METHOD
/* Scalar measurable for DDE 'Iso2CrntDmdEvseId[16]'. */
/begin MEASUREMENT Iso2CrntDmdEvseId[16] "The ID that uniquely identifies the EVSE. Format is defined in the ISO 15118 ED2 Spec Annex H" UBYTE CU_ISO2CRNTDMDEVSEID[16] 1 100 0.0 255.0 ECU_ADDRESS 0x70017ccd BYTE_ORDER MSB_LAST /end MEASUREMENT
/begin COMPU_METHOD CU_ISO2CRNTDMDEVSEID[16] "Conversion method for Iso2CrntDmdEvseId[16]" RAT_FUNC "%10.0" "1" COEFFS 0.000000 1.000000 -0.000000 0.000000 0.000000 1.000000 /end COMPU_METHOD
/* Scalar measurable for DDE 'Iso2CrntDmdEvseId[17]'. */
/begin MEASUREMENT Iso2CrntDmdEvseId[17] "The ID that uniquely identifies the EVSE. Format is defined in the ISO 15118 ED2 Spec Annex H" UBYTE CU_ISO2CRNTDMDEVSEID[17] 1 100 0.0 255.0 ECU_ADDRESS 0x70017cce BYTE_ORDER MSB_LAST /end MEASUREMENT
/begin COMPU_METHOD CU_ISO2CRNTDMDEVSEID[17] "Conversion method for Iso2CrntDmdEvseId[17]" RAT_FUNC "%10.0" "1" COEFFS 0.000000 1.000000 -0.000000 0.000000 0.000000 1.000000 /end COMPU_METHOD
/* Scalar measurable for DDE 'Iso2CrntDmdEvseId[18]'. */
/begin MEASUREMENT Iso2CrntDmdEvseId[18] "The ID that uniquely identifies the EVSE. Format is defined in the ISO 15118 ED2 Spec Annex H" UBYTE CU_ISO2CRNTDMDEVSEID[18] 1 100 0.0 255.0 ECU_ADDRESS 0x70017ccf BYTE_ORDER MSB_LAST /end MEASUREMENT
/begin COMPU_METHOD CU_ISO2CRNTDMDEVSEID[18] "Conversion method for Iso2CrntDmdEvseId[18]" RAT_FUNC "%10.0" "1" COEFFS 0.000000 1.000000 -0.000000 0.000000 0.000000 1.000000 /end COMPU_METHOD
/* Scalar measurable for DDE 'Iso2CrntDmdEvseId[19]'. */
/begin MEASUREMENT Iso2CrntDmdEvseId[19] "The ID that uniquely identifies the EVSE. Format is defined in the ISO 15118 ED2 Spec Annex H" UBYTE CU_ISO2CRNTDMDEVSEID[19] 1 100 0.0 255.0 ECU_ADDRESS 0x70017cd0 BYTE_ORDER MSB_LAST /end MEASUREMENT
/begin COMPU_METHOD CU_ISO2CRNTDMDEVSEID[19] "Conversion method for Iso2CrntDmdEvseId[19]" RAT_FUNC "%10.0" "1" COEFFS 0.000000 1.000000 -0.000000 0.000000 0.000000 1.000000 /end COMPU_METHOD
/* Scalar measurable for DDE 'Iso2CrntDmdEvseId[1]'. */
/begin MEASUREMENT Iso2CrntDmdEvseId[1] "The ID that uniquely identifies the EVSE. Format is defined in the ISO 15118 ED2 Spec Annex H" UBYTE CU_ISO2CRNTDMDEVSEID[1] 1 100 0.0 255.0 ECU_ADDRESS 0x70017cbe BYTE_ORDER MSB_LAST /end MEASUREMENT
/begin COMPU_METHOD CU_ISO2CRNTDMDEVSEID[1] "Conversion method for Iso2CrntDmdEvseId[1]" RAT_FUNC "%10.0" "1" COEFFS 0.000000 1.000000 -0.000000 0.000000 0.000000 1.000000 /end COMPU_METHOD
/* Scalar measurable for DDE 'Iso2CrntDmdEvseId[20]'. */
/begin MEASUREMENT Iso2CrntDmdEvseId[20] "The ID that uniquely identifies the EVSE. Format is defined in the ISO 15118 ED2 Spec Annex H" UBYTE CU_ISO2CRNTDMDEVSEID[20] 1 100 0.0 255.0 ECU_ADDRESS 0x70017cd1 BYTE_ORDER MSB_LAST /end MEASUREMENT
/begin COMPU_METHOD CU_ISO2CRNTDMDEVSEID[20] "Conversion method for Iso2CrntDmdEvseId[20]" RAT_FUNC "%10.0" "1" COEFFS 0.000000 1.000000 -0.000000 0.000000 0.000000 1.000000 /end COMPU_METHOD
/* Scalar measurable for DDE 'Iso2CrntDmdEvseId[21]'. */
/begin MEASUREMENT Iso2CrntDmdEvseId[21] "The ID that uniquely identifies the EVSE. Format is defined in the ISO 15118 ED2 Spec Annex H" UBYTE CU_ISO2CRNTDMDEVSEID[21] 1 100 0.0 255.0 ECU_ADDRESS 0x70017cd2 BYTE_ORDER MSB_LAST /end MEASUREMENT
/begin COMPU_METHOD CU_ISO2CRNTDMDEVSEID[21] "Conversion method for Iso2CrntDmdEvseId[21]" RAT_FUNC "%10.0" "1" COEFFS 0.000000 1.000000 -0.000000 0.000000 0.000000 1.000000 /end COMPU_METHOD
/* Scalar measurable for DDE 'Iso2CrntDmdEvseId[22]'. */
/begin MEASUREMENT Iso2CrntDmdEvseId[22] "The ID that uniquely identifies the EVSE. Format is defined in the ISO 15118 ED2 Spec Annex H" UBYTE CU_ISO2CRNTDMDEVSEID[22] 1 100 0.0 255.0 ECU_ADDRESS 0x70017cd3 BYTE_ORDER MSB_LAST /end MEASUREMENT
/begin COMPU_METHOD CU_ISO2CRNTDMDEVSEID[22] "Conversion method for Iso2CrntDmdEvseId[22]" RAT_FUNC "%10.0" "1" COEFFS 0.000000 1.000000 -0.000000 0.000000 0.000000 1.000000 /end COMPU_METHOD
/* Scalar measurable for DDE 'Iso2CrntDmdEvseId[23]'. */
/begin MEASUREMENT Iso2CrntDmdEvseId[23] "The ID that uniquely identifies the EVSE. Format is defined in the ISO 15118 ED2 Spec Annex H" UBYTE CU_ISO2CRNTDMDEVSEID[23] 1 100 0.0 255.0 ECU_ADDRESS 0x70017cd4 BYTE_ORDER MSB_LAST /end MEASUREMENT
/begin COMPU_METHOD CU_ISO2CRNTDMDEVSEID[23] "Conversion method for Iso2CrntDmdEvseId[23]" RAT_FUNC "%10.0" "1" COEFFS 0.000000 1.000000 -0.000000 0.000000 0.000000 1.000000 /end COMPU_METHOD
/* Scalar measurable for DDE 'Iso2CrntDmdEvseId[24]'. */
/begin MEASUREMENT Iso2CrntDmdEvseId[24] "The ID that uniquely identifies the EVSE. Format is defined in the ISO 15118 ED2 Spec Annex H" UBYTE CU_ISO2CRNTDMDEVSEID[24] 1 100 0.0 255.0 ECU_ADDRESS 0x70017cd5 BYTE_ORDER MSB_LAST /end MEASUREMENT
/begin COMPU_METHOD CU_ISO2CRNTDMDEVSEID[24] "Conversion method for Iso2CrntDmdEvseId[24]" RAT_FUNC "%10.0" "1" COEFFS 0.000000 1.000000 -0.000000 0.000000 0.000000 1.000000 /end COMPU_METHOD
/* Scalar measurable for DDE 'Iso2CrntDmdEvseId[25]'. */
/begin MEASUREMENT Iso2CrntDmdEvseId[25] "The ID that uniquely identifies the EVSE. Format is defined in the ISO 15118 ED2 Spec Annex H" UBYTE CU_ISO2CRNTDMDEVSEID[25] 1 100 0.0 255.0 ECU_ADDRESS 0x70017cd6 BYTE_ORDER MSB_LAST /end MEASUREMENT
/begin COMPU_METHOD CU_ISO2CRNTDMDEVSEID[25] "Conversion method for Iso2CrntDmdEvseId[25]" RAT_FUNC "%10.0" "1" COEFFS 0.000000 1.000000 -0.000000 0.000000 0.000000 1.000000 /end COMPU_METHOD
/* Scalar measurable for DDE 'Iso2CrntDmdEvseId[26]'. */
/begin MEASUREMENT Iso2CrntDmdEvseId[26] "The ID that uniquely identifies the EVSE. Format is defined in the ISO 15118 ED2 Spec Annex H" UBYTE CU_ISO2CRNTDMDEVSEID[26] 1 100 0.0 255.0 ECU_ADDRESS 0x70017cd7 BYTE_ORDER MSB_LAST /end MEASUREMENT
/begin COMPU_METHOD CU_ISO2CRNTDMDEVSEID[26] "Conversion method for Iso2CrntDmdEvseId[26]" RAT_FUNC "%10.0" "1" COEFFS 0.000000 1.000000 -0.000000 0.000000 0.000000 1.000000 /end COMPU_METHOD
/* Scalar measurable for DDE 'Iso2CrntDmdEvseId[27]'. */
/begin MEASUREMENT Iso2CrntDmdEvseId[27] "The ID that uniquely identifies the EVSE. Format is defined in the ISO 15118 ED2 Spec Annex H" UBYTE CU_ISO2CRNTDMDEVSEID[27] 1 100 0.0 255.0 ECU_ADDRESS 0x70017cd8 BYTE_ORDER MSB_LAST /end MEASUREMENT
/begin COMPU_METHOD CU_ISO2CRNTDMDEVSEID[27] "Conversion method for Iso2CrntDmdEvseId[27]" RAT_FUNC "%10.0" "1" COEFFS 0.000000 1.000000 -0.000000 0.000000 0.000000 1.000000 /end COMPU_METHOD
/* Scalar measurable for DDE 'Iso2CrntDmdEvseId[28]'. */
/begin MEASUREMENT Iso2CrntDmdEvseId[28] "The ID that uniquely identifies the EVSE. Format is defined in the ISO 15118 ED2 Spec Annex H" UBYTE CU_ISO2CRNTDMDEVSEID[28] 1 100 0.0 255.0 ECU_ADDRESS 0x70017cd9 BYTE_ORDER MSB_LAST /end MEASUREMENT
/begin COMPU_METHOD CU_ISO2CRNTDMDEVSEID[28] "Conversion method for Iso2CrntDmdEvseId[28]" RAT_FUNC "%10.0" "1" COEFFS 0.000000 1.000000 -0.000000 0.000000 0.000000 1.000000 /end COMPU_METHOD
/* Scalar measurable for DDE 'Iso2CrntDmdEvseId[29]'. */
/begin MEASUREMENT Iso2CrntDmdEvseId[29] "The ID that uniquely identifies the EVSE. Format is defined in the ISO 15118 ED2 Spec Annex H" UBYTE CU_ISO2CRNTDMDEVSEID[29] 1 100 0.0 255.0 ECU_ADDRESS 0x70017cda BYTE_ORDER MSB_LAST /end MEASUREMENT
/begin COMPU_METHOD CU_ISO2CRNTDMDEVSEID[29] "Conversion method for Iso2CrntDmdEvseId[29]" RAT_FUNC "%10.0" "1" COEFFS 0.000000 1.000000 -0.000000 0.000000 0.000000 1.000000 /end COMPU_METHOD
/* Scalar measurable for DDE 'Iso2CrntDmdEvseId[2]'. */
/begin MEASUREMENT Iso2CrntDmdEvseId[2] "The ID that uniquely identifies the EVSE. Format is defined in the ISO 15118 ED2 Spec Annex H" UBYTE CU_ISO2CRNTDMDEVSEID[2] 1 100 0.0 255.0 ECU_ADDRESS 0x70017cbf BYTE_ORDER MSB_LAST /end MEASUREMENT
/begin COMPU_METHOD CU_ISO2CRNTDMDEVSEID[2] "Conversion method for Iso2CrntDmdEvseId[2]" RAT_FUNC "%10.0" "1" COEFFS 0.000000 1.000000 -0.000000 0.000000 0.000000 1.000000 /end COMPU_METHOD
/* Scalar measurable for DDE 'Iso2CrntDmdEvseId[30]'. */
/begin MEASUREMENT Iso2CrntDmdEvseId[30] "The ID that uniquely identifies the EVSE. Format is defined in the ISO 15118 ED2 Spec Annex H" UBYTE CU_ISO2CRNTDMDEVSEID[30] 1 100 0.0 255.0 ECU_ADDRESS 0x70017cdb BYTE_ORDER MSB_LAST /end MEASUREMENT
/begin COMPU_METHOD CU_ISO2CRNTDMDEVSEID[30] "Conversion method for Iso2CrntDmdEvseId[30]" RAT_FUNC "%10.0" "1" COEFFS 0.000000 1.000000 -0.000000 0.000000 0.000000 1.000000 /end COMPU_METHOD
/* Scalar measurable for DDE 'Iso2CrntDmdEvseId[31]'. */
/begin MEASUREMENT Iso2CrntDmdEvseId[31] "The ID that uniquely identifies the EVSE. Format is defined in the ISO 15118 ED2 Spec Annex H" UBYTE CU_ISO2CRNTDMDEVSEID[31] 1 100 0.0 255.0 ECU_ADDRESS 0x70017cdc BYTE_ORDER MSB_LAST /end MEASUREMENT
/begin COMPU_METHOD CU_ISO2CRNTDMDEVSEID[31] "Conversion method for Iso2CrntDmdEvseId[31]" RAT_FUNC "%10.0" "1" COEFFS 0.000000 1.000000 -0.000000 0.000000 0.000000 1.000000 /end COMPU_METHOD
/* Scalar measurable for DDE 'Iso2CrntDmdEvseId[32]'. */
/begin MEASUREMENT Iso2CrntDmdEvseId[32] "The ID that uniquely identifies the EVSE. Format is defined in the ISO 15118 ED2 Spec Annex H" UBYTE CU_ISO2CRNTDMDEVSEID[32] 1 100 0.0 255.0 ECU_ADDRESS 0x70017cdd BYTE_ORDER MSB_LAST /end MEASUREMENT
/begin COMPU_METHOD CU_ISO2CRNTDMDEVSEID[32] "Conversion method for Iso2CrntDmdEvseId[32]" RAT_FUNC "%10.0" "1" COEFFS 0.000000 1.000000 -0.000000 0.000000 0.000000 1.000000 /end COMPU_METHOD
/* Scalar measurable for DDE 'Iso2CrntDmdEvseId[33]'. */
/begin MEASUREMENT Iso2CrntDmdEvseId[33] "The ID that uniquely identifies the EVSE. Format is defined in the ISO 15118 ED2 Spec Annex H" UBYTE CU_ISO2CRNTDMDEVSEID[33] 1 100 0.0 255.0 ECU_ADDRESS 0x70017cde BYTE_ORDER MSB_LAST /end MEASUREMENT
/begin COMPU_METHOD CU_ISO2CRNTDMDEVSEID[33] "Conversion method for Iso2CrntDmdEvseId[33]" RAT_FUNC "%10.0" "1" COEFFS 0.000000 1.000000 -0.000000 0.000000 0.000000 1.000000 /end COMPU_METHOD
/* Scalar measurable for DDE 'Iso2CrntDmdEvseId[34]'. */
/begin MEASUREMENT Iso2CrntDmdEvseId[34] "The ID that uniquely identifies the EVSE. Format is defined in the ISO 15118 ED2 Spec Annex H" UBYTE CU_ISO2CRNTDMDEVSEID[34] 1 100 0.0 255.0 ECU_ADDRESS 0x70017cdf BYTE_ORDER MSB_LAST /end MEASUREMENT
/begin COMPU_METHOD CU_ISO2CRNTDMDEVSEID[34] "Conversion method for Iso2CrntDmdEvseId[34]" RAT_FUNC "%10.0" "1" COEFFS 0.000000 1.000000 -0.000000 0.000000 0.000000 1.000000 /end COMPU_METHOD
/* Scalar measurable for DDE 'Iso2CrntDmdEvseId[35]'. */
/begin MEASUREMENT Iso2CrntDmdEvseId[35] "The ID that uniquely identifies the EVSE. Format is defined in the ISO 15118 ED2 Spec Annex H" UBYTE CU_ISO2CRNTDMDEVSEID[35] 1 100 0.0 255.0 ECU_ADDRESS 0x70017ce0 BYTE_ORDER MSB_LAST /end MEASUREMENT
/begin COMPU_METHOD CU_ISO2CRNTDMDEVSEID[35] "Conversion method for Iso2CrntDmdEvseId[35]" RAT_FUNC "%10.0" "1" COEFFS 0.000000 1.000000 -0.000000 0.000000 0.000000 1.000000 /end COMPU_METHOD
/* Scalar measurable for DDE 'Iso2CrntDmdEvseId[36]'. */
/begin MEASUREMENT Iso2CrntDmdEvseId[36] "The ID that uniquely identifies the EVSE. Format is defined in the ISO 15118 ED2 Spec Annex H" UBYTE CU_ISO2CRNTDMDEVSEID[36] 1 100 0.0 255.0 ECU_ADDRESS 0x70017ce1 BYTE_ORDER MSB_LAST /end MEASUREMENT
/begin COMPU_METHOD CU_ISO2CRNTDMDEVSEID[36] "Conversion method for Iso2CrntDmdEvseId[36]" RAT_FUNC "%10.0" "1" COEFFS 0.000000 1.000000 -0.000000 0.000000 0.000000 1.000000 /end COMPU_METHOD
/* Scalar measurable for DDE 'Iso2CrntDmdEvseId[37]'. */
/begin MEASUREMENT Iso2CrntDmdEvseId[37] "The ID that uniquely identifies the EVSE. Format is defined in the ISO 15118 ED2 Spec Annex H" UBYTE CU_ISO2CRNTDMDEVSEID[37] 1 100 0.0 255.0 ECU_ADDRESS 0x70017ce2 BYTE_ORDER MSB_LAST /end MEASUREMENT
/begin COMPU_METHOD CU_ISO2CRNTDMDEVSEID[37] "Conversion method for Iso2CrntDmdEvseId[37]" RAT_FUNC "%10.0" "1" COEFFS 0.000000 1.000000 -0.000000 0.000000 0.000000 1.000000 /end COMPU_METHOD
/* Scalar measurable for DDE 'Iso2CrntDmdEvseId[3]'. */
/begin MEASUREMENT Iso2CrntDmdEvseId[3] "The ID that uniquely identifies the EVSE. Format is defined in the ISO 15118 ED2 Spec Annex H" UBYTE CU_ISO2CRNTDMDEVSEID[3] 1 100 0.0 255.0 ECU_ADDRESS 0x70017cc0 BYTE_ORDER MSB_LAST /end MEASUREMENT
/begin COMPU_METHOD CU_ISO2CRNTDMDEVSEID[3] "Conversion method for Iso2CrntDmdEvseId[3]" RAT_FUNC "%10.0" "1" COEFFS 0.000000 1.000000 -0.000000 0.000000 0.000000 1.000000 /end COMPU_METHOD
/* Scalar measurable for DDE 'Iso2CrntDmdEvseId[4]'. */
/begin MEASUREMENT Iso2CrntDmdEvseId[4] "The ID that uniquely identifies the EVSE. Format is defined in the ISO 15118 ED2 Spec Annex H" UBYTE CU_ISO2CRNTDMDEVSEID[4] 1 100 0.0 255.0 ECU_ADDRESS 0x70017cc1 BYTE_ORDER MSB_LAST /end MEASUREMENT
/begin COMPU_METHOD CU_ISO2CRNTDMDEVSEID[4] "Conversion method for Iso2CrntDmdEvseId[4]" RAT_FUNC "%10.0" "1" COEFFS 0.000000 1.000000 -0.000000 0.000000 0.000000 1.000000 /end COMPU_METHOD
/* Scalar measurable for DDE 'Iso2CrntDmdEvseId[5]'. */
/begin MEASUREMENT Iso2CrntDmdEvseId[5] "The ID that uniquely identifies the EVSE. Format is defined in the ISO 15118 ED2 Spec Annex H" UBYTE CU_ISO2CRNTDMDEVSEID[5] 1 100 0.0 255.0 ECU_ADDRESS 0x70017cc2 BYTE_ORDER MSB_LAST /end MEASUREMENT
/begin COMPU_METHOD CU_ISO2CRNTDMDEVSEID[5] "Conversion method for Iso2CrntDmdEvseId[5]" RAT_FUNC "%10.0" "1" COEFFS 0.000000 1.000000 -0.000000 0.000000 0.000000 1.000000 /end COMPU_METHOD
/* Scalar measurable for DDE 'Iso2CrntDmdEvseId[6]'. */
/begin MEASUREMENT Iso2CrntDmdEvseId[6] "The ID that uniquely identifies the EVSE. Format is defined in the ISO 15118 ED2 Spec Annex H" UBYTE CU_ISO2CRNTDMDEVSEID[6] 1 100 0.0 255.0 ECU_ADDRESS 0x70017cc3 BYTE_ORDER MSB_LAST /end MEASUREMENT
/begin COMPU_METHOD CU_ISO2CRNTDMDEVSEID[6] "Conversion method for Iso2CrntDmdEvseId[6]" RAT_FUNC "%10.0" "1" COEFFS 0.000000 1.000000 -0.000000 0.000000 0.000000 1.000000 /end COMPU_METHOD
/* Scalar measurable for DDE 'Iso2CrntDmdEvseId[7]'. */
/begin MEASUREMENT Iso2CrntDmdEvseId[7] "The ID that uniquely identifies the EVSE. Format is defined in the ISO 15118 ED2 Spec Annex H" UBYTE CU_ISO2CRNTDMDEVSEID[7] 1 100 0.0 255.0 ECU_ADDRESS 0x70017cc4 BYTE_ORDER MSB_LAST /end MEASUREMENT
/begin COMPU_METHOD CU_ISO2CRNTDMDEVSEID[7] "Conversion method for Iso2CrntDmdEvseId[7]" RAT_FUNC "%10.0" "1" COEFFS 0.000000 1.000000 -0.000000 0.000000 0.000000 1.000000 /end COMPU_METHOD
/* Scalar measurable for DDE 'Iso2CrntDmdEvseId[8]'. */
/begin MEASUREMENT Iso2CrntDmdEvseId[8] "The ID that uniquely identifies the EVSE. Format is defined in the ISO 15118 ED2 Spec Annex H" UBYTE CU_ISO2CRNTDMDEVSEID[8] 1 100 0.0 255.0 ECU_ADDRESS 0x70017cc5 BYTE_ORDER MSB_LAST /end MEASUREMENT
/begin COMPU_METHOD CU_ISO2CRNTDMDEVSEID[8] "Conversion method for Iso2CrntDmdEvseId[8]" RAT_FUNC "%10.0" "1" COEFFS 0.000000 1.000000 -0.000000 0.000000 0.000000 1.000000 /end COMPU_METHOD
/* Scalar measurable for DDE 'Iso2CrntDmdEvseId[9]'. */
/begin MEASUREMENT Iso2CrntDmdEvseId[9] "The ID that uniquely identifies the EVSE. Format is defined in the ISO 15118 ED2 Spec Annex H" UBYTE CU_ISO2CRNTDMDEVSEID[9] 1 100 0.0 255.0 ECU_ADDRESS 0x70017cc6 BYTE_ORDER MSB_LAST /end MEASUREMENT
/begin COMPU_METHOD CU_ISO2CRNTDMDEVSEID[9] "Conversion method for Iso2CrntDmdEvseId[9]" RAT_FUNC "%10.0" "1" COEFFS 0.000000 1.000000 -0.000000 0.000000 0.000000 1.000000 /end COMPU_METHOD
/* Scalar measurable for DDE 'Iso2CrntDmdEvseMaxCrntLim'. */
/begin MEASUREMENT Iso2CrntDmdEvseMaxCrntLim "Indicates the maximum current the EVSE can deliver." FLOAT32_IEEE CU_ISO2CRNTDMDEVSEMAXCRNTLIM 1 100 -3.40282346639e+38 3.40282346639e+38 ECU_ADDRESS 0x70018268 BYTE_ORDER MSB_LAST /end MEASUREMENT
/begin COMPU_METHOD CU_ISO2CRNTDMDEVSEMAXCRNTLIM "Conversion method for Iso2CrntDmdEvseMaxCrntLim" RAT_FUNC "%10.0" "%" COEFFS 0.000000 1.000000 -0.000000 0.000000 0.000000 1.000000 /end COMPU_METHOD
/* Scalar measurable for DDE 'Iso2CrntDmdEvseMaxCrntLimPres'. */
/begin MEASUREMENT Iso2CrntDmdEvseMaxCrntLimPres "Indicates the presence of the EvseMaxCrntLimit parameter." UBYTE CU_ISO2CRNTDMDEVSEMAXCRNTLIMPR0 1 100 0.0 1.0 ECU_ADDRESS 0x70017f15 BYTE_ORDER MSB_LAST /end MEASUREMENT
/begin COMPU_METHOD CU_ISO2CRNTDMDEVSEMAXCRNTLIMPR0 "Conversion method for Iso2CrntDmdEvseMaxCrntLimPres" RAT_FUNC "%10.0" "b" COEFFS 0.000000 1.000000 -0.000000 0.000000 0.000000 1.000000 /end COMPU_METHOD
/* Scalar measurable for DDE 'Iso2CrntDmdEvseMaxPwrLim'. */
/begin MEASUREMENT Iso2CrntDmdEvseMaxPwrLim "Indicates the maximum power the EVSE can deliver." FLOAT32_IEEE CU_ISO2CRNTDMDEVSEMAXPWRLIM 1 100 -3.40282346639e+38 3.40282346639e+38 ECU_ADDRESS 0x70018290 BYTE_ORDER MSB_LAST /end MEASUREMENT
/begin COMPU_METHOD CU_ISO2CRNTDMDEVSEMAXPWRLIM "Conversion method for Iso2CrntDmdEvseMaxPwrLim" RAT_FUNC "%10.0" "%" COEFFS 0.000000 1.000000 -0.000000 0.000000 0.000000 1.000000 /end COMPU_METHOD
/* Scalar measurable for DDE 'Iso2CrntDmdEvseMaxPwrLimPres'. */
/begin MEASUREMENT Iso2CrntDmdEvseMaxPwrLimPres "Indicates the presence of the EvseMaxPwrLimit parameter." UBYTE CU_ISO2CRNTDMDEVSEMAXPWRLIMPRES 1 100 0.0 1.0 ECU_ADDRESS 0x70017c7a BYTE_ORDER MSB_LAST /end MEASUREMENT
/begin COMPU_METHOD CU_ISO2CRNTDMDEVSEMAXPWRLIMPRES "Conversion method for Iso2CrntDmdEvseMaxPwrLimPres" RAT_FUNC "%10.0" "b" COEFFS 0.000000 1.000000 -0.000000 0.000000 0.000000 1.000000 /end COMPU_METHOD
/* Scalar measurable for DDE 'Iso2CrntDmdEvseMaxVoltLim'. */
/begin MEASUREMENT Iso2CrntDmdEvseMaxVoltLim "Indicates the maximum voltage the EVSE can deliver" FLOAT32_IEEE CU_ISO2CRNTDMDEVSEMAXVOLTLIM 1 100 -3.40282346639e+38 3.40282346639e+38 ECU_ADDRESS 0x70018398 BYTE_ORDER MSB_LAST /end MEASUREMENT
/begin COMPU_METHOD CU_ISO2CRNTDMDEVSEMAXVOLTLIM "Conversion method for Iso2CrntDmdEvseMaxVoltLim" RAT_FUNC "%10.0" "%" COEFFS 0.000000 1.000000 -0.000000 0.000000 0.000000 1.000000 /end COMPU_METHOD
/* Scalar measurable for DDE 'Iso2CrntDmdEvseMaxVoltLimPres'. */
/begin MEASUREMENT Iso2CrntDmdEvseMaxVoltLimPres "Indicates the presence of the EvseMaxVoltLimit parameter." UBYTE CU_ISO2CRNTDMDEVSEMAXVOLTLIMPR0 1 100 0.0 1.0 ECU_ADDRESS 0x700181f0 BYTE_ORDER MSB_LAST /end MEASUREMENT
/begin COMPU_METHOD CU_ISO2CRNTDMDEVSEMAXVOLTLIMPR0 "Conversion method for Iso2CrntDmdEvseMaxVoltLimPres" RAT_FUNC "%10.0" "b" COEFFS 0.000000 1.000000 -0.000000 0.000000 0.000000 1.000000 /end COMPU_METHOD
/* Scalar measurable for DDE 'Iso2CrntDmdEvsePresCrnt'. */
/begin MEASUREMENT Iso2CrntDmdEvsePresCrnt "Indicates the measured High Voltage DC (HVDC) current at the output of the DC Supply through the charge coupler" FLOAT32_IEEE CU_ISO2CRNTDMDEVSEPRESCRNT 1 100 -3.40282346639e+38 3.40282346639e+38 ECU_ADDRESS 0x70017fa0 BYTE_ORDER MSB_LAST /end MEASUREMENT
/begin COMPU_METHOD CU_ISO2CRNTDMDEVSEPRESCRNT "Conversion method for Iso2CrntDmdEvsePresCrnt" RAT_FUNC "%10.0" "%" COEFFS 0.000000 1.000000 -0.000000 0.000000 0.000000 1.000000 /end COMPU_METHOD
/* Scalar measurable for DDE 'Iso2CrntDmdEvsePresVolt'. */
/begin MEASUREMENT Iso2CrntDmdEvsePresVolt "Indicates the measured High Voltage DC (HVDC) voltage at the output of the DC Supply." FLOAT32_IEEE CU_ISO2CRNTDMDEVSEPRESVOLT 1 100 -3.40282346639e+38 3.40282346639e+38 ECU_ADDRESS 0x70017d3c BYTE_ORDER MSB_LAST /end MEASUREMENT
/begin COMPU_METHOD CU_ISO2CRNTDMDEVSEPRESVOLT "Conversion method for Iso2CrntDmdEvsePresVolt" RAT_FUNC "%10.0" "%" COEFFS 0.000000 1.000000 -0.000000 0.000000 0.000000 1.000000 /end COMPU_METHOD
/* Scalar measurable for DDE 'Iso2CrntDmdEvsePwrLimAchvd'. */
/begin MEASUREMENT Iso2CrntDmdEvsePwrLimAchvd "Indicates that the charger is at its power limit" UBYTE CU_ISO2CRNTDMDEVSEPWRLIMACHVD 1 100 0.0 1.0 ECU_ADDRESS 0x70017fd4 BYTE_ORDER MSB_LAST /end MEASUREMENT
/begin COMPU_METHOD CU_ISO2CRNTDMDEVSEPWRLIMACHVD "Conversion method for Iso2CrntDmdEvsePwrLimAchvd" RAT_FUNC "%10.0" "b" COEFFS 0.000000 1.000000 -0.000000 0.000000 0.000000 1.000000 /end COMPU_METHOD
/* Scalar measurable for DDE 'Iso2CrntDmdEvseStatPres'. */
/begin MEASUREMENT Iso2CrntDmdEvseStatPres "Indicates the presence of the EVSENotificationMaxDelay and EVSENotification parameters in the CurrentDemandRes message" UBYTE CU_ISO2CRNTDMDEVSESTATPRES 1 100 0.0 1.0 ECU_ADDRESS 0x70018349 BYTE_ORDER MSB_LAST /end MEASUREMENT
/begin COMPU_METHOD CU_ISO2CRNTDMDEVSESTATPRES "Conversion method for Iso2CrntDmdEvseStatPres" RAT_FUNC "%10.0" "b" COEFFS 0.000000 1.000000 -0.000000 0.000000 0.000000 1.000000 /end COMPU_METHOD
/* Scalar measurable for DDE 'Iso2CrntDmdEvseVoltLimAchvd'. */
/begin MEASUREMENT Iso2CrntDmdEvseVoltLimAchvd "Indicates that the charger is at its voltage limit" UBYTE CU_ISO2CRNTDMDEVSEVOLTLIMACHVD 1 100 0.0 1.0 ECU_ADDRESS 0x700181a1 BYTE_ORDER MSB_LAST /end MEASUREMENT
/begin COMPU_METHOD CU_ISO2CRNTDMDEVSEVOLTLIMACHVD "Conversion method for Iso2CrntDmdEvseVoltLimAchvd" RAT_FUNC "%10.0" "b" COEFFS 0.000000 1.000000 -0.000000 0.000000 0.000000 1.000000 /end COMPU_METHOD
/* Scalar measurable for DDE 'Iso2CrntDmdNotif'. */
/begin MEASUREMENT Iso2CrntDmdNotif "Indicates action SECC wants the EVSE to perform in the CurrentDemandRes message" UBYTE CU_ISO2CRNTDMDNOTIF 1 100 0.0 255.0 ECU_ADDRESS 0x70017f58 BYTE_ORDER MSB_LAST /end MEASUREMENT
/begin COMPU_METHOD CU_ISO2CRNTDMDNOTIF "Conversion method for Iso2CrntDmdNotif" RAT_FUNC "%10.0" "1" COEFFS 0.000000 1.000000 -0.000000 0.000000 0.000000 1.000000 /end COMPU_METHOD
/* Scalar measurable for DDE 'Iso2CrntDmdNotifMaxDelay'. */
/begin MEASUREMENT Iso2CrntDmdNotifMaxDelay "Indicates the time until the SECC expects the EVCC to react on the EVSENotification action set in the CurrentDemandRes message" UWORD CU_ISO2CRNTDMDNOTIFMAXDELAY 1 100 0.0 65535.0 ECU_ADDRESS 0x70017db6 BYTE_ORDER MSB_LAST /end MEASUREMENT
/begin COMPU_METHOD CU_ISO2CRNTDMDNOTIFMAXDELAY "Conversion method for Iso2CrntDmdNotifMaxDelay" RAT_FUNC "%10.0" "1" COEFFS 0.000000 1.000000 -0.000000 0.000000 0.000000 1.000000 /end COMPU_METHOD
/* Scalar measurable for DDE 'Iso2CrntDmdRescode'. */
/begin MEASUREMENT Iso2CrntDmdRescode "for ISOv2 CurrentDemandRes message: indicates the acknowledgment status of this V2G messages received by the SECC." UBYTE CU_ISO2CRNTDMDRESCODE 1 100 0.0 255.0 ECU_ADDRESS 0x700183be BYTE_ORDER MSB_LAST /end MEASUREMENT
/begin COMPU_METHOD CU_ISO2CRNTDMDRESCODE "Conversion method for Iso2CrntDmdRescode" RAT_FUNC "%10.0" "1" COEFFS 0.000000 1.000000 -0.000000 0.000000 0.000000 1.000000 /end COMPU_METHOD
/* Scalar measurable for DDE 'Iso2CrntDmdRxTrg'. */
/begin MEASUREMENT Iso2CrntDmdRxTrg "Trigger flag that on a rising edge indicates the event for receiving the PLC (V2G) CurrentDemandRes message from the EVSE" UBYTE CU_ISO2CRNTDMDRXTRG 1 100 0.0 1.0 ECU_ADDRESS 0x70017de9 BYTE_ORDER MSB_LAST /end MEASUREMENT
/begin COMPU_METHOD CU_ISO2CRNTDMDRXTRG "Conversion method for Iso2CrntDmdRxTrg" RAT_FUNC "%10.0" "b" COEFFS 0.000000 1.000000 -0.000000 0.000000 0.000000 1.000000 /end COMPU_METHOD
/* Scalar measurable for DDE 'Iso2CrntDmdSASchTupId'. */
/begin MEASUREMENT Iso2CrntDmdSASchTupId "Represents the unique identifier within a charging session for a SAScheduleTuple element" UBYTE CU_ISO2CRNTDMDSASCHTUPID 1 100 0.0 255.0 ECU_ADDRESS 0x70018150 BYTE_ORDER MSB_LAST /end MEASUREMENT
/begin COMPU_METHOD CU_ISO2CRNTDMDSASCHTUPID "Conversion method for Iso2CrntDmdSASchTupId" RAT_FUNC "%10.0" "1" COEFFS 0.000000 1.000000 -0.000000 0.000000 0.000000 1.000000 /end COMPU_METHOD
/* Scalar measurable for DDE 'Iso2CrntDmdSASchTupIdPres'. */
/begin MEASUREMENT Iso2CrntDmdSASchTupIdPres "Indicates the presence of the SA Schedule Tuple ID parameter." UBYTE CU_ISO2CRNTDMDSASCHTUPIDPRES 1 100 0.0 1.0 ECU_ADDRESS 0x70017ee9 BYTE_ORDER MSB_LAST /end MEASUREMENT
/begin COMPU_METHOD CU_ISO2CRNTDMDSASCHTUPIDPRES "Conversion method for Iso2CrntDmdSASchTupIdPres" RAT_FUNC "%10.0" "b" COEFFS 0.000000 1.000000 -0.000000 0.000000 0.000000 1.000000 /end COMPU_METHOD
/* Scalar measurable for DDE 'Iso2DcBiDirParCrntRegTol'. */
/begin MEASUREMENT Iso2DcBiDirParCrntRegTol "Indicates the DC Supplys ability to regulate current with respect to the current request" FLOAT32_IEEE CU_ISO2DCBIDIRPARCRNTREGTOL 1 100 -3.40282346639e+38 3.40282346639e+38 ECU_ADDRESS 0x70017d6c BYTE_ORDER MSB_LAST /end MEASUREMENT
/begin COMPU_METHOD CU_ISO2DCBIDIRPARCRNTREGTOL "Conversion method for Iso2DcBiDirParCrntRegTol" RAT_FUNC "%10.0" "%" COEFFS 0.000000 1.000000 -0.000000 0.000000 0.000000 1.000000 /end COMPU_METHOD
/* Scalar measurable for DDE 'Iso2DcBiDirParCrntRegTolPres'. */
/begin MEASUREMENT Iso2DcBiDirParCrntRegTolPres "Indicates the presence of the Iso2DcChgParCrntRegTol parameter" UBYTE CU_ISO2DCBIDIRPARCRNTREGTOLPRES 1 100 0.0 255.0 ECU_ADDRESS 0x7001846d BYTE_ORDER MSB_LAST /end MEASUREMENT
/begin COMPU_METHOD CU_ISO2DCBIDIRPARCRNTREGTOLPRES "Conversion method for Iso2DcBiDirParCrntRegTolPres" RAT_FUNC "%10.0" "%" COEFFS 0.000000 1.000000 -0.000000 0.000000 0.000000 1.000000 /end COMPU_METHOD
/* Scalar measurable for DDE 'Iso2DcBiDirParDataVal'. */
/begin MEASUREMENT Iso2DcBiDirParDataVal "Indicates whether the DC EVSE Charge Parameter data is available to be read" UBYTE CU_ISO2DCBIDIRPARDATAVAL 1 100 0.0 255.0 ECU_ADDRESS 0x70017d97 BYTE_ORDER MSB_LAST /end MEASUREMENT
/begin COMPU_METHOD CU_ISO2DCBIDIRPARDATAVAL "Conversion method for Iso2DcBiDirParDataVal" RAT_FUNC "%10.0" "%" COEFFS 0.000000 1.000000 -0.000000 0.000000 0.000000 1.000000 /end COMPU_METHOD
/* Scalar measurable for DDE 'Iso2DcBiDirParEgyToBeDel'. */
/begin MEASUREMENT Iso2DcBiDirParEgyToBeDel "Indicates the allowed or requested units of energy to be delivered during charging (a charging target)" FLOAT32_IEEE CU_ISO2DCBIDIRPAREGYTOBEDEL 1 100 -3.40282346639e+38 3.40282346639e+38 ECU_ADDRESS 0x70018058 BYTE_ORDER MSB_LAST /end MEASUREMENT
/begin COMPU_METHOD CU_ISO2DCBIDIRPAREGYTOBEDEL "Conversion method for Iso2DcBiDirParEgyToBeDel" RAT_FUNC "%10.0" "%" COEFFS 0.000000 1.000000 -0.000000 0.000000 0.000000 1.000000 /end COMPU_METHOD
/* Scalar measurable for DDE 'Iso2DcBiDirParEgyToBeDelPres'. */
/begin MEASUREMENT Iso2DcBiDirParEgyToBeDelPres "Indicates the presence of the pv2gf_dc_energy_to_be_delivered parameter" UBYTE CU_ISO2DCBIDIRPAREGYTOBEDELPRES 1 100 0.0 255.0 ECU_ADDRESS 0x70018391 BYTE_ORDER MSB_LAST /end MEASUREMENT
/begin COMPU_METHOD CU_ISO2DCBIDIRPAREGYTOBEDELPRES "Conversion method for Iso2DcBiDirParEgyToBeDelPres" RAT_FUNC "%10.0" "%" COEFFS 0.000000 1.000000 -0.000000 0.000000 0.000000 1.000000 /end COMPU_METHOD
/* Scalar measurable for DDE 'Iso2DcBiDirParMaxChgCrnt'. */
/begin MEASUREMENT Iso2DcBiDirParMaxChgCrnt "Indicates the maximum current the EVSE can deliver" FLOAT32_IEEE CU_ISO2DCBIDIRPARMAXCHGCRNT 1 100 -3.40282346639e+38 3.40282346639e+38 ECU_ADDRESS 0x700181e8 BYTE_ORDER MSB_LAST /end MEASUREMENT
/begin COMPU_METHOD CU_ISO2DCBIDIRPARMAXCHGCRNT "Conversion method for Iso2DcBiDirParMaxChgCrnt" RAT_FUNC "%10.0" "%" COEFFS 0.000000 1.000000 -0.000000 0.000000 0.000000 1.000000 /end COMPU_METHOD
/* Scalar measurable for DDE 'Iso2DcBiDirParMaxChgPwr'. */
/begin MEASUREMENT Iso2DcBiDirParMaxChgPwr "Indicates the maximum power the EVSE can deliver" FLOAT32_IEEE CU_ISO2DCBIDIRPARMAXCHGPWR 1 100 -3.40282346639e+38 3.40282346639e+38 ECU_ADDRESS 0x70017f98 BYTE_ORDER MSB_LAST /end MEASUREMENT
/begin COMPU_METHOD CU_ISO2DCBIDIRPARMAXCHGPWR "Conversion method for Iso2DcBiDirParMaxChgPwr" RAT_FUNC "%10.0" "%" COEFFS 0.000000 1.000000 -0.000000 0.000000 0.000000 1.000000 /end COMPU_METHOD
/* Scalar measurable for DDE 'Iso2DcBiDirParMaxDischgCrnt'. */
/begin MEASUREMENT Iso2DcBiDirParMaxDischgCrnt "Indicates the maximum discharge current the EVSE can deliver" FLOAT32_IEEE CU_ISO2DCBIDIRPARMAXDISCHGCRNT 1 100 -3.40282346639e+38 3.40282346639e+38 ECU_ADDRESS 0x70017e14 BYTE_ORDER MSB_LAST /end MEASUREMENT
/begin COMPU_METHOD CU_ISO2DCBIDIRPARMAXDISCHGCRNT "Conversion method for Iso2DcBiDirParMaxDischgCrnt" RAT_FUNC "%10.0" "%" COEFFS 0.000000 1.000000 -0.000000 0.000000 0.000000 1.000000 /end COMPU_METHOD
/* Scalar measurable for DDE 'Iso2DcBiDirParMaxDischgPwr'. */
/begin MEASUREMENT Iso2DcBiDirParMaxDischgPwr "Indicates the the maximum discharge power the EVSE can deliver" FLOAT32_IEEE CU_ISO2DCBIDIRPARMAXDISCHGPWR 1 100 -3.40282346639e+38 3.40282346639e+38 ECU_ADDRESS 0x70017fcc BYTE_ORDER MSB_LAST /end MEASUREMENT
/begin COMPU_METHOD CU_ISO2DCBIDIRPARMAXDISCHGPWR "Conversion method for Iso2DcBiDirParMaxDischgPwr" RAT_FUNC "%10.0" "%" COEFFS 0.000000 1.000000 -0.000000 0.000000 0.000000 1.000000 /end COMPU_METHOD
/* Scalar measurable for DDE 'Iso2DcBiDirParMaxVolt'. */
/begin MEASUREMENT Iso2DcBiDirParMaxVolt "Indicates the maximum voltage the EVSE can deliver" FLOAT32_IEEE CU_ISO2DCBIDIRPARMAXVOLT 1 100 -3.40282346639e+38 3.40282346639e+38 ECU_ADDRESS 0x70018344 BYTE_ORDER MSB_LAST /end MEASUREMENT
/begin COMPU_METHOD CU_ISO2DCBIDIRPARMAXVOLT "Conversion method for Iso2DcBiDirParMaxVolt" RAT_FUNC "%10.0" "%" COEFFS 0.000000 1.000000 -0.000000 0.000000 0.000000 1.000000 /end COMPU_METHOD
/* Scalar measurable for DDE 'Iso2DcBiDirParMinChgCrnt'. */
/begin MEASUREMENT Iso2DcBiDirParMinChgCrnt "Indicates the minimum current the EVSE can deliver with the expected accuracy" FLOAT32_IEEE CU_ISO2DCBIDIRPARMINCHGCRNT 1 100 -3.40282346639e+38 3.40282346639e+38 ECU_ADDRESS 0x70017d4c BYTE_ORDER MSB_LAST /end MEASUREMENT
/begin COMPU_METHOD CU_ISO2DCBIDIRPARMINCHGCRNT "Conversion method for Iso2DcBiDirParMinChgCrnt" RAT_FUNC "%10.0" "%" COEFFS 0.000000 1.000000 -0.000000 0.000000 0.000000 1.000000 /end COMPU_METHOD
/* Scalar measurable for DDE 'Iso2DcBiDirParMinDischgCrnt'. */
/begin MEASUREMENT Iso2DcBiDirParMinDischgCrnt "Indicates the minimum discharge current the EVSE can deliver with the expected accuracy" FLOAT32_IEEE CU_ISO2DCBIDIRPARMINDISCHGCRNT 1 100 -3.40282346639e+38 3.40282346639e+38 ECU_ADDRESS 0x70018460 BYTE_ORDER MSB_LAST /end MEASUREMENT
/begin COMPU_METHOD CU_ISO2DCBIDIRPARMINDISCHGCRNT "Conversion method for Iso2DcBiDirParMinDischgCrnt" RAT_FUNC "%10.0" "%" COEFFS 0.000000 1.000000 -0.000000 0.000000 0.000000 1.000000 /end COMPU_METHOD
/* Scalar measurable for DDE 'Iso2DcBiDirParMinVolt'. */
/begin MEASUREMENT Iso2DcBiDirParMinVolt "Indicates the minimum voltage the EVSE can deliver with the expected accuracy" FLOAT32_IEEE CU_ISO2DCBIDIRPARMINVOLT 1 100 -3.40282346639e+38 3.40282346639e+38 ECU_ADDRESS 0x700182a8 BYTE_ORDER MSB_LAST /end MEASUREMENT
/begin COMPU_METHOD CU_ISO2DCBIDIRPARMINVOLT "Conversion method for Iso2DcBiDirParMinVolt" RAT_FUNC "%10.0" "%" COEFFS 0.000000 1.000000 -0.000000 0.000000 0.000000 1.000000 /end COMPU_METHOD
/* Scalar measurable for DDE 'Iso2DcBiDirParPeakCrntRip'. */
/begin MEASUREMENT Iso2DcBiDirParPeakCrntRip "Indicates the DC Supplys peak to peak ripple current amplitude of the regulated output at any current request" FLOAT32_IEEE CU_ISO2DCBIDIRPARPEAKCRNTRIP 1 100 -3.40282346639e+38 3.40282346639e+38 ECU_ADDRESS 0x7001809c BYTE_ORDER MSB_LAST /end MEASUREMENT
/begin COMPU_METHOD CU_ISO2DCBIDIRPARPEAKCRNTRIP "Conversion method for Iso2DcBiDirParPeakCrntRip" RAT_FUNC "%10.0" "%" COEFFS 0.000000 1.000000 -0.000000 0.000000 0.000000 1.000000 /end COMPU_METHOD
/* Scalar measurable for DDE 'Iso2DcChgParCrntRegTol'. */
/begin MEASUREMENT Iso2DcChgParCrntRegTol "Indicates the DC Supplys ability to regulate current with respect to the current request" FLOAT32_IEEE CU_ISO2DCCHGPARCRNTREGTOL 1 100 -3.40282346639e+38 3.40282346639e+38 ECU_ADDRESS 0x700182d4 BYTE_ORDER MSB_LAST /end MEASUREMENT
/begin COMPU_METHOD CU_ISO2DCCHGPARCRNTREGTOL "Conversion method for Iso2DcChgParCrntRegTol" RAT_FUNC "%10.0" "%" COEFFS 0.000000 1.000000 -0.000000 0.000000 0.000000 1.000000 /end COMPU_METHOD
/* Scalar measurable for DDE 'Iso2DcChgParCrntRegTolPres'. */
/begin MEASUREMENT Iso2DcChgParCrntRegTolPres "Indicates the presence of the Iso2DcChgParCrntRegTol parameter" UBYTE CU_ISO2DCCHGPARCRNTREGTOLPRES 1 100 0.0 255.0 ECU_ADDRESS 0x70017cb1 BYTE_ORDER MSB_LAST /end MEASUREMENT
/begin COMPU_METHOD CU_ISO2DCCHGPARCRNTREGTOLPRES "Conversion method for Iso2DcChgParCrntRegTolPres" RAT_FUNC "%10.0" "%" COEFFS 0.000000 1.000000 -0.000000 0.000000 0.000000 1.000000 /end COMPU_METHOD
/* Scalar measurable for DDE 'Iso2DcChgParDataVal'. */
/begin MEASUREMENT Iso2DcChgParDataVal "Indicates whether the DC EVSE Charge Parameter data is available to be read" UBYTE CU_ISO2DCCHGPARDATAVAL 1 100 0.0 255.0 ECU_ADDRESS 0x70017f8f BYTE_ORDER MSB_LAST /end MEASUREMENT
/begin COMPU_METHOD CU_ISO2DCCHGPARDATAVAL "Conversion method for Iso2DcChgParDataVal" RAT_FUNC "%10.0" "%" COEFFS 0.000000 1.000000 -0.000000 0.000000 0.000000 1.000000 /end COMPU_METHOD
/* Scalar measurable for DDE 'Iso2DcChgParEgyToBeDel'. */
/begin MEASUREMENT Iso2DcChgParEgyToBeDel "Indicates the allowed or requested units of energy to be delivered during charging (a charging target)" FLOAT32_IEEE CU_ISO2DCCHGPAREGYTOBEDEL 1 100 -3.40282346639e+38 3.40282346639e+38 ECU_ADDRESS 0x70017e00 BYTE_ORDER MSB_LAST /end MEASUREMENT
/begin COMPU_METHOD CU_ISO2DCCHGPAREGYTOBEDEL "Conversion method for Iso2DcChgParEgyToBeDel" RAT_FUNC "%10.0" "%" COEFFS 0.000000 1.000000 -0.000000 0.000000 0.000000 1.000000 /end COMPU_METHOD
/* Scalar measurable for DDE 'Iso2DcChgParEgyToBeDelPres'. */
/begin MEASUREMENT Iso2DcChgParEgyToBeDelPres "Indicates the presence of the pv2gf_dc_energy_to_be_delivered parameter" UBYTE CU_ISO2DCCHGPAREGYTOBEDELPRES 1 100 0.0 255.0 ECU_ADDRESS 0x70017c39 BYTE_ORDER MSB_LAST /end MEASUREMENT
/begin COMPU_METHOD CU_ISO2DCCHGPAREGYTOBEDELPRES "Conversion method for Iso2DcChgParEgyToBeDelPres" RAT_FUNC "%10.0" "%" COEFFS 0.000000 1.000000 -0.000000 0.000000 0.000000 1.000000 /end COMPU_METHOD
/* Scalar measurable for DDE 'Iso2DcChgParMaxChgCrnt'. */
/begin MEASUREMENT Iso2DcChgParMaxChgCrnt "Indicates the maximum current the EVSE can deliver" FLOAT32_IEEE CU_ISO2DCCHGPARMAXCHGCRNT 1 100 -3.40282346639e+38 3.40282346639e+38 ECU_ADDRESS 0x70018368 BYTE_ORDER MSB_LAST /end MEASUREMENT
/begin COMPU_METHOD CU_ISO2DCCHGPARMAXCHGCRNT "Conversion method for Iso2DcChgParMaxChgCrnt" RAT_FUNC "%10.0" "%" COEFFS 0.000000 1.000000 -0.000000 0.000000 0.000000 1.000000 /end COMPU_METHOD
/* Scalar measurable for DDE 'Iso2DcChgParMaxChgPwr'. */
/begin MEASUREMENT Iso2DcChgParMaxChgPwr "Indicates the maximum power the EVSE can deliver" FLOAT32_IEEE CU_ISO2DCCHGPARMAXCHGPWR 1 100 -3.40282346639e+38 3.40282346639e+38 ECU_ADDRESS 0x70017c64 BYTE_ORDER MSB_LAST /end MEASUREMENT
/begin COMPU_METHOD CU_ISO2DCCHGPARMAXCHGPWR "Conversion method for Iso2DcChgParMaxChgPwr" RAT_FUNC "%10.0" "%" COEFFS 0.000000 1.000000 -0.000000 0.000000 0.000000 1.000000 /end COMPU_METHOD
/* Scalar measurable for DDE 'Iso2DcChgParMaxVolt'. */
/begin MEASUREMENT Iso2DcChgParMaxVolt "Indicates the maximum voltage the EVSE can deliver" FLOAT32_IEEE CU_ISO2DCCHGPARMAXVOLT 1 100 -3.40282346639e+38 3.40282346639e+38 ECU_ADDRESS 0x70017f1c BYTE_ORDER MSB_LAST /end MEASUREMENT
/begin COMPU_METHOD CU_ISO2DCCHGPARMAXVOLT "Conversion method for Iso2DcChgParMaxVolt" RAT_FUNC "%10.0" "%" COEFFS 0.000000 1.000000 -0.000000 0.000000 0.000000 1.000000 /end COMPU_METHOD
/* Scalar measurable for DDE 'Iso2DcChgParMinChgCrnt'. */
/begin MEASUREMENT Iso2DcChgParMinChgCrnt "Indicates the minimum current the EVSE can deliver with the expected accuracy" FLOAT32_IEEE CU_ISO2DCCHGPARMINCHGCRNT 1 100 -3.40282346639e+38 3.40282346639e+38 ECU_ADDRESS 0x7001829c BYTE_ORDER MSB_LAST /end MEASUREMENT
/begin COMPU_METHOD CU_ISO2DCCHGPARMINCHGCRNT "Conversion method for Iso2DcChgParMinChgCrnt" RAT_FUNC "%10.0" "%" COEFFS 0.000000 1.000000 -0.000000 0.000000 0.000000 1.000000 /end COMPU_METHOD
/* Scalar measurable for DDE 'Iso2DcChgParMinVolt'. */
/begin MEASUREMENT Iso2DcChgParMinVolt "Indicates the minimum voltage the EVSE can deliver with the expected accuracy" FLOAT32_IEEE CU_ISO2DCCHGPARMINVOLT 1 100 -3.40282346639e+38 3.40282346639e+38 ECU_ADDRESS 0x70018090 BYTE_ORDER MSB_LAST /end MEASUREMENT
/begin COMPU_METHOD CU_ISO2DCCHGPARMINVOLT "Conversion method for Iso2DcChgParMinVolt" RAT_FUNC "%10.0" "%" COEFFS 0.000000 1.000000 -0.000000 0.000000 0.000000 1.000000 /end COMPU_METHOD
/* Scalar measurable for DDE 'Iso2DcChgParPeakCrntRipple'. */
/begin MEASUREMENT Iso2DcChgParPeakCrntRipple "Indicates the DC Supplys peak to peak ripple current amplitude of the regulated output at any current request" FLOAT32_IEEE CU_ISO2DCCHGPARPEAKCRNTRIPPLE 1 100 -3.40282346639e+38 3.40282346639e+38 ECU_ADDRESS 0x70017eac BYTE_ORDER MSB_LAST /end MEASUREMENT
/begin COMPU_METHOD CU_ISO2DCCHGPARPEAKCRNTRIPPLE "Conversion method for Iso2DcChgParPeakCrntRipple" RAT_FUNC "%10.0" "%" COEFFS 0.000000 1.000000 -0.000000 0.000000 0.000000 1.000000 /end COMPU_METHOD
/* Scalar measurable for DDE 'Iso2EvseIdLen'. */
/begin MEASUREMENT Iso2EvseIdLen "Number of bytes in EVSE ID" UBYTE CU_ISO2EVSEIDLEN 1 100 0.0 255.0 ECU_ADDRESS 0x70017ed8 BYTE_ORDER MSB_LAST /end MEASUREMENT
/begin COMPU_METHOD CU_ISO2EVSEIDLEN "Conversion method for Iso2EvseIdLen" RAT_FUNC "%10.0" "1" COEFFS 0.000000 1.000000 -0.000000 0.000000 0.000000 1.000000 /end COMPU_METHOD
/* Scalar measurable for DDE 'Iso2EvseId[0]'. */
/begin MEASUREMENT Iso2EvseId[0] "The ID that uniquely identifies the EVSE. Format is defined in the ISO 15118 ED2 Spec Annex H" UBYTE CU_ISO2EVSEID[0] 1 100 0.0 255.0 ECU_ADDRESS 0x70017cf4 BYTE_ORDER MSB_LAST /end MEASUREMENT
/begin COMPU_METHOD CU_ISO2EVSEID[0] "Conversion method for Iso2EvseId[0]" RAT_FUNC "%10.0" "1" COEFFS 0.000000 1.000000 -0.000000 0.000000 0.000000 1.000000 /end COMPU_METHOD
/* Scalar measurable for DDE 'Iso2EvseId[10]'. */
/begin MEASUREMENT Iso2EvseId[10] "The ID that uniquely identifies the EVSE. Format is defined in the ISO 15118 ED2 Spec Annex H" UBYTE CU_ISO2EVSEID[10] 1 100 0.0 255.0 ECU_ADDRESS 0x70017cfe BYTE_ORDER MSB_LAST /end MEASUREMENT
/begin COMPU_METHOD CU_ISO2EVSEID[10] "Conversion method for Iso2EvseId[10]" RAT_FUNC "%10.0" "1" COEFFS 0.000000 1.000000 -0.000000 0.000000 0.000000 1.000000 /end COMPU_METHOD
/* Scalar measurable for DDE 'Iso2EvseId[11]'. */
/begin MEASUREMENT Iso2EvseId[11] "The ID that uniquely identifies the EVSE. Format is defined in the ISO 15118 ED2 Spec Annex H" UBYTE CU_ISO2EVSEID[11] 1 100 0.0 255.0 ECU_ADDRESS 0x70017cff BYTE_ORDER MSB_LAST /end MEASUREMENT
/begin COMPU_METHOD CU_ISO2EVSEID[11] "Conversion method for Iso2EvseId[11]" RAT_FUNC "%10.0" "1" COEFFS 0.000000 1.000000 -0.000000 0.000000 0.000000 1.000000 /end COMPU_METHOD
/* Scalar measurable for DDE 'Iso2EvseId[12]'. */
/begin MEASUREMENT Iso2EvseId[12] "The ID that uniquely identifies the EVSE. Format is defined in the ISO 15118 ED2 Spec Annex H" UBYTE CU_ISO2EVSEID[12] 1 100 0.0 255.0 ECU_ADDRESS 0x70017d00 BYTE_ORDER MSB_LAST /end MEASUREMENT
/begin COMPU_METHOD CU_ISO2EVSEID[12] "Conversion method for Iso2EvseId[12]" RAT_FUNC "%10.0" "1" COEFFS 0.000000 1.000000 -0.000000 0.000000 0.000000 1.000000 /end COMPU_METHOD
/* Scalar measurable for DDE 'Iso2EvseId[13]'. */
/begin MEASUREMENT Iso2EvseId[13] "The ID that uniquely identifies the EVSE. Format is defined in the ISO 15118 ED2 Spec Annex H" UBYTE CU_ISO2EVSEID[13] 1 100 0.0 255.0 ECU_ADDRESS 0x70017d01 BYTE_ORDER MSB_LAST /end MEASUREMENT
/begin COMPU_METHOD CU_ISO2EVSEID[13] "Conversion method for Iso2EvseId[13]" RAT_FUNC "%10.0" "1" COEFFS 0.000000 1.000000 -0.000000 0.000000 0.000000 1.000000 /end COMPU_METHOD
/* Scalar measurable for DDE 'Iso2EvseId[14]'. */
/begin MEASUREMENT Iso2EvseId[14] "The ID that uniquely identifies the EVSE. Format is defined in the ISO 15118 ED2 Spec Annex H" UBYTE CU_ISO2EVSEID[14] 1 100 0.0 255.0 ECU_ADDRESS 0x70017d02 BYTE_ORDER MSB_LAST /end MEASUREMENT
/begin COMPU_METHOD CU_ISO2EVSEID[14] "Conversion method for Iso2EvseId[14]" RAT_FUNC "%10.0" "1" COEFFS 0.000000 1.000000 -0.000000 0.000000 0.000000 1.000000 /end COMPU_METHOD
/* Scalar measurable for DDE 'Iso2EvseId[15]'. */
/begin MEASUREMENT Iso2EvseId[15] "The ID that uniquely identifies the EVSE. Format is defined in the ISO 15118 ED2 Spec Annex H" UBYTE CU_ISO2EVSEID[15] 1 100 0.0 255.0 ECU_ADDRESS 0x70017d03 BYTE_ORDER MSB_LAST /end MEASUREMENT
/begin COMPU_METHOD CU_ISO2EVSEID[15] "Conversion method for Iso2EvseId[15]" RAT_FUNC "%10.0" "1" COEFFS 0.000000 1.000000 -0.000000 0.000000 0.000000 1.000000 /end COMPU_METHOD
/* Scalar measurable for DDE 'Iso2EvseId[16]'. */
/begin MEASUREMENT Iso2EvseId[16] "The ID that uniquely identifies the EVSE. Format is defined in the ISO 15118 ED2 Spec Annex H" UBYTE CU_ISO2EVSEID[16] 1 100 0.0 255.0 ECU_ADDRESS 0x70017d04 BYTE_ORDER MSB_LAST /end MEASUREMENT
/begin COMPU_METHOD CU_ISO2EVSEID[16] "Conversion method for Iso2EvseId[16]" RAT_FUNC "%10.0" "1" COEFFS 0.000000 1.000000 -0.000000 0.000000 0.000000 1.000000 /end COMPU_METHOD
/* Scalar measurable for DDE 'Iso2EvseId[17]'. */
/begin MEASUREMENT Iso2EvseId[17] "The ID that uniquely identifies the EVSE. Format is defined in the ISO 15118 ED2 Spec Annex H" UBYTE CU_ISO2EVSEID[17] 1 100 0.0 255.0 ECU_ADDRESS 0x70017d05 BYTE_ORDER MSB_LAST /end MEASUREMENT
/begin COMPU_METHOD CU_ISO2EVSEID[17] "Conversion method for Iso2EvseId[17]" RAT_FUNC "%10.0" "1" COEFFS 0.000000 1.000000 -0.000000 0.000000 0.000000 1.000000 /end COMPU_METHOD
/* Scalar measurable for DDE 'Iso2EvseId[18]'. */
/begin MEASUREMENT Iso2EvseId[18] "The ID that uniquely identifies the EVSE. Format is defined in the ISO 15118 ED2 Spec Annex H" UBYTE CU_ISO2EVSEID[18] 1 100 0.0 255.0 ECU_ADDRESS 0x70017d06 BYTE_ORDER MSB_LAST /end MEASUREMENT
/begin COMPU_METHOD CU_ISO2EVSEID[18] "Conversion method for Iso2EvseId[18]" RAT_FUNC "%10.0" "1" COEFFS 0.000000 1.000000 -0.000000 0.000000 0.000000 1.000000 /end COMPU_METHOD
/* Scalar measurable for DDE 'Iso2EvseId[19]'. */
/begin MEASUREMENT Iso2EvseId[19] "The ID that uniquely identifies the EVSE. Format is defined in the ISO 15118 ED2 Spec Annex H" UBYTE CU_ISO2EVSEID[19] 1 100 0.0 255.0 ECU_ADDRESS 0x70017d07 BYTE_ORDER MSB_LAST /end MEASUREMENT
/begin COMPU_METHOD CU_ISO2EVSEID[19] "Conversion method for Iso2EvseId[19]" RAT_FUNC "%10.0" "1" COEFFS 0.000000 1.000000 -0.000000 0.000000 0.000000 1.000000 /end COMPU_METHOD
/* Scalar measurable for DDE 'Iso2EvseId[1]'. */
/begin MEASUREMENT Iso2EvseId[1] "The ID that uniquely identifies the EVSE. Format is defined in the ISO 15118 ED2 Spec Annex H" UBYTE CU_ISO2EVSEID[1] 1 100 0.0 255.0 ECU_ADDRESS 0x70017cf5 BYTE_ORDER MSB_LAST /end MEASUREMENT
/begin COMPU_METHOD CU_ISO2EVSEID[1] "Conversion method for Iso2EvseId[1]" RAT_FUNC "%10.0" "1" COEFFS 0.000000 1.000000 -0.000000 0.000000 0.000000 1.000000 /end COMPU_METHOD
/* Scalar measurable for DDE 'Iso2EvseId[20]'. */
/begin MEASUREMENT Iso2EvseId[20] "The ID that uniquely identifies the EVSE. Format is defined in the ISO 15118 ED2 Spec Annex H" UBYTE CU_ISO2EVSEID[20] 1 100 0.0 255.0 ECU_ADDRESS 0x70017d08 BYTE_ORDER MSB_LAST /end MEASUREMENT
/begin COMPU_METHOD CU_ISO2EVSEID[20] "Conversion method for Iso2EvseId[20]" RAT_FUNC "%10.0" "1" COEFFS 0.000000 1.000000 -0.000000 0.000000 0.000000 1.000000 /end COMPU_METHOD
/* Scalar measurable for DDE 'Iso2EvseId[21]'. */
/begin MEASUREMENT Iso2EvseId[21] "The ID that uniquely identifies the EVSE. Format is defined in the ISO 15118 ED2 Spec Annex H" UBYTE CU_ISO2EVSEID[21] 1 100 0.0 255.0 ECU_ADDRESS 0x70017d09 BYTE_ORDER MSB_LAST /end MEASUREMENT
/begin COMPU_METHOD CU_ISO2EVSEID[21] "Conversion method for Iso2EvseId[21]" RAT_FUNC "%10.0" "1" COEFFS 0.000000 1.000000 -0.000000 0.000000 0.000000 1.000000 /end COMPU_METHOD
/* Scalar measurable for DDE 'Iso2EvseId[22]'. */
/begin MEASUREMENT Iso2EvseId[22] "The ID that uniquely identifies the EVSE. Format is defined in the ISO 15118 ED2 Spec Annex H" UBYTE CU_ISO2EVSEID[22] 1 100 0.0 255.0 ECU_ADDRESS 0x70017d0a BYTE_ORDER MSB_LAST /end MEASUREMENT
/begin COMPU_METHOD CU_ISO2EVSEID[22] "Conversion method for Iso2EvseId[22]" RAT_FUNC "%10.0" "1" COEFFS 0.000000 1.000000 -0.000000 0.000000 0.000000 1.000000 /end COMPU_METHOD
/* Scalar measurable for DDE 'Iso2EvseId[23]'. */
/begin MEASUREMENT Iso2EvseId[23] "The ID that uniquely identifies the EVSE. Format is defined in the ISO 15118 ED2 Spec Annex H" UBYTE CU_ISO2EVSEID[23] 1 100 0.0 255.0 ECU_ADDRESS 0x70017d0b BYTE_ORDER MSB_LAST /end MEASUREMENT
/begin COMPU_METHOD CU_ISO2EVSEID[23] "Conversion method for Iso2EvseId[23]" RAT_FUNC "%10.0" "1" COEFFS 0.000000 1.000000 -0.000000 0.000000 0.000000 1.000000 /end COMPU_METHOD
/* Scalar measurable for DDE 'Iso2EvseId[24]'. */
/begin MEASUREMENT Iso2EvseId[24] "The ID that uniquely identifies the EVSE. Format is defined in the ISO 15118 ED2 Spec Annex H" UBYTE CU_ISO2EVSEID[24] 1 100 0.0 255.0 ECU_ADDRESS 0x70017d0c BYTE_ORDER MSB_LAST /end MEASUREMENT
/begin COMPU_METHOD CU_ISO2EVSEID[24] "Conversion method for Iso2EvseId[24]" RAT_FUNC "%10.0" "1" COEFFS 0.000000 1.000000 -0.000000 0.000000 0.000000 1.000000 /end COMPU_METHOD
/* Scalar measurable for DDE 'Iso2EvseId[25]'. */
/begin MEASUREMENT Iso2EvseId[25] "The ID that uniquely identifies the EVSE. Format is defined in the ISO 15118 ED2 Spec Annex H" UBYTE CU_ISO2EVSEID[25] 1 100 0.0 255.0 ECU_ADDRESS 0x70017d0d BYTE_ORDER MSB_LAST /end MEASUREMENT
/begin COMPU_METHOD CU_ISO2EVSEID[25] "Conversion method for Iso2EvseId[25]" RAT_FUNC "%10.0" "1" COEFFS 0.000000 1.000000 -0.000000 0.000000 0.000000 1.000000 /end COMPU_METHOD
/* Scalar measurable for DDE 'Iso2EvseId[26]'. */
/begin MEASUREMENT Iso2EvseId[26] "The ID that uniquely identifies the EVSE. Format is defined in the ISO 15118 ED2 Spec Annex H" UBYTE CU_ISO2EVSEID[26] 1 100 0.0 255.0 ECU_ADDRESS 0x70017d0e BYTE_ORDER MSB_LAST /end MEASUREMENT
/begin COMPU_METHOD CU_ISO2EVSEID[26] "Conversion method for Iso2EvseId[26]" RAT_FUNC "%10.0" "1" COEFFS 0.000000 1.000000 -0.000000 0.000000 0.000000 1.000000 /end COMPU_METHOD
/* Scalar measurable for DDE 'Iso2EvseId[27]'. */
/begin MEASUREMENT Iso2EvseId[27] "The ID that uniquely identifies the EVSE. Format is defined in the ISO 15118 ED2 Spec Annex H" UBYTE CU_ISO2EVSEID[27] 1 100 0.0 255.0 ECU_ADDRESS 0x70017d0f BYTE_ORDER MSB_LAST /end MEASUREMENT
/begin COMPU_METHOD CU_ISO2EVSEID[27] "Conversion method for Iso2EvseId[27]" RAT_FUNC "%10.0" "1" COEFFS 0.000000 1.000000 -0.000000 0.000000 0.000000 1.000000 /end COMPU_METHOD
/* Scalar measurable for DDE 'Iso2EvseId[28]'. */
/begin MEASUREMENT Iso2EvseId[28] "The ID that uniquely identifies the EVSE. Format is defined in the ISO 15118 ED2 Spec Annex H" UBYTE CU_ISO2EVSEID[28] 1 100 0.0 255.0 ECU_ADDRESS 0x70017d10 BYTE_ORDER MSB_LAST /end MEASUREMENT
/begin COMPU_METHOD CU_ISO2EVSEID[28] "Conversion method for Iso2EvseId[28]" RAT_FUNC "%10.0" "1" COEFFS 0.000000 1.000000 -0.000000 0.000000 0.000000 1.000000 /end COMPU_METHOD
/* Scalar measurable for DDE 'Iso2EvseId[29]'. */
/begin MEASUREMENT Iso2EvseId[29] "The ID that uniquely identifies the EVSE. Format is defined in the ISO 15118 ED2 Spec Annex H" UBYTE CU_ISO2EVSEID[29] 1 100 0.0 255.0 ECU_ADDRESS 0x70017d11 BYTE_ORDER MSB_LAST /end MEASUREMENT
/begin COMPU_METHOD CU_ISO2EVSEID[29] "Conversion method for Iso2EvseId[29]" RAT_FUNC "%10.0" "1" COEFFS 0.000000 1.000000 -0.000000 0.000000 0.000000 1.000000 /end COMPU_METHOD
/* Scalar measurable for DDE 'Iso2EvseId[2]'. */
/begin MEASUREMENT Iso2EvseId[2] "The ID that uniquely identifies the EVSE. Format is defined in the ISO 15118 ED2 Spec Annex H" UBYTE CU_ISO2EVSEID[2] 1 100 0.0 255.0 ECU_ADDRESS 0x70017cf6 BYTE_ORDER MSB_LAST /end MEASUREMENT
/begin COMPU_METHOD CU_ISO2EVSEID[2] "Conversion method for Iso2EvseId[2]" RAT_FUNC "%10.0" "1" COEFFS 0.000000 1.000000 -0.000000 0.000000 0.000000 1.000000 /end COMPU_METHOD
/* Scalar measurable for DDE 'Iso2EvseId[30]'. */
/begin MEASUREMENT Iso2EvseId[30] "The ID that uniquely identifies the EVSE. Format is defined in the ISO 15118 ED2 Spec Annex H" UBYTE CU_ISO2EVSEID[30] 1 100 0.0 255.0 ECU_ADDRESS 0x70017d12 BYTE_ORDER MSB_LAST /end MEASUREMENT
/begin COMPU_METHOD CU_ISO2EVSEID[30] "Conversion method for Iso2EvseId[30]" RAT_FUNC "%10.0" "1" COEFFS 0.000000 1.000000 -0.000000 0.000000 0.000000 1.000000 /end COMPU_METHOD
/* Scalar measurable for DDE 'Iso2EvseId[31]'. */
/begin MEASUREMENT Iso2EvseId[31] "The ID that uniquely identifies the EVSE. Format is defined in the ISO 15118 ED2 Spec Annex H" UBYTE CU_ISO2EVSEID[31] 1 100 0.0 255.0 ECU_ADDRESS 0x70017d13 BYTE_ORDER MSB_LAST /end MEASUREMENT
/begin COMPU_METHOD CU_ISO2EVSEID[31] "Conversion method for Iso2EvseId[31]" RAT_FUNC "%10.0" "1" COEFFS 0.000000 1.000000 -0.000000 0.000000 0.000000 1.000000 /end COMPU_METHOD
/* Scalar measurable for DDE 'Iso2EvseId[32]'. */
/begin MEASUREMENT Iso2EvseId[32] "The ID that uniquely identifies the EVSE. Format is defined in the ISO 15118 ED2 Spec Annex H" UBYTE CU_ISO2EVSEID[32] 1 100 0.0 255.0 ECU_ADDRESS 0x70017d14 BYTE_ORDER MSB_LAST /end MEASUREMENT
/begin COMPU_METHOD CU_ISO2EVSEID[32] "Conversion method for Iso2EvseId[32]" RAT_FUNC "%10.0" "1" COEFFS 0.000000 1.000000 -0.000000 0.000000 0.000000 1.000000 /end COMPU_METHOD
/* Scalar measurable for DDE 'Iso2EvseId[33]'. */
/begin MEASUREMENT Iso2EvseId[33] "The ID that uniquely identifies the EVSE. Format is defined in the ISO 15118 ED2 Spec Annex H" UBYTE CU_ISO2EVSEID[33] 1 100 0.0 255.0 ECU_ADDRESS 0x70017d15 BYTE_ORDER MSB_LAST /end MEASUREMENT
/begin COMPU_METHOD CU_ISO2EVSEID[33] "Conversion method for Iso2EvseId[33]" RAT_FUNC "%10.0" "1" COEFFS 0.000000 1.000000 -0.000000 0.000000 0.000000 1.000000 /end COMPU_METHOD
/* Scalar measurable for DDE 'Iso2EvseId[34]'. */
/begin MEASUREMENT Iso2EvseId[34] "The ID that uniquely identifies the EVSE. Format is defined in the ISO 15118 ED2 Spec Annex H" UBYTE CU_ISO2EVSEID[34] 1 100 0.0 255.0 ECU_ADDRESS 0x70017d16 BYTE_ORDER MSB_LAST /end MEASUREMENT
/begin COMPU_METHOD CU_ISO2EVSEID[34] "Conversion method for Iso2EvseId[34]" RAT_FUNC "%10.0" "1" COEFFS 0.000000 1.000000 -0.000000 0.000000 0.000000 1.000000 /end COMPU_METHOD
/* Scalar measurable for DDE 'Iso2EvseId[35]'. */
/begin MEASUREMENT Iso2EvseId[35] "The ID that uniquely identifies the EVSE. Format is defined in the ISO 15118 ED2 Spec Annex H" UBYTE CU_ISO2EVSEID[35] 1 100 0.0 255.0 ECU_ADDRESS 0x70017d17 BYTE_ORDER MSB_LAST /end MEASUREMENT
/begin COMPU_METHOD CU_ISO2EVSEID[35] "Conversion method for Iso2EvseId[35]" RAT_FUNC "%10.0" "1" COEFFS 0.000000 1.000000 -0.000000 0.000000 0.000000 1.000000 /end COMPU_METHOD
/* Scalar measurable for DDE 'Iso2EvseId[36]'. */
/begin MEASUREMENT Iso2EvseId[36] "The ID that uniquely identifies the EVSE. Format is defined in the ISO 15118 ED2 Spec Annex H" UBYTE CU_ISO2EVSEID[36] 1 100 0.0 255.0 ECU_ADDRESS 0x70017d18 BYTE_ORDER MSB_LAST /end MEASUREMENT
/begin COMPU_METHOD CU_ISO2EVSEID[36] "Conversion method for Iso2EvseId[36]" RAT_FUNC "%10.0" "1" COEFFS 0.000000 1.000000 -0.000000 0.000000 0.000000 1.000000 /end COMPU_METHOD
/* Scalar measurable for DDE 'Iso2EvseId[37]'. */
/begin MEASUREMENT Iso2EvseId[37] "The ID that uniquely identifies the EVSE. Format is defined in the ISO 15118 ED2 Spec Annex H" UBYTE CU_ISO2EVSEID[37] 1 100 0.0 255.0 ECU_ADDRESS 0x70017d19 BYTE_ORDER MSB_LAST /end MEASUREMENT
/begin COMPU_METHOD CU_ISO2EVSEID[37] "Conversion method for Iso2EvseId[37]" RAT_FUNC "%10.0" "1" COEFFS 0.000000 1.000000 -0.000000 0.000000 0.000000 1.000000 /end COMPU_METHOD
/* Scalar measurable for DDE 'Iso2EvseId[3]'. */
/begin MEASUREMENT Iso2EvseId[3] "The ID that uniquely identifies the EVSE. Format is defined in the ISO 15118 ED2 Spec Annex H" UBYTE CU_ISO2EVSEID[3] 1 100 0.0 255.0 ECU_ADDRESS 0x70017cf7 BYTE_ORDER MSB_LAST /end MEASUREMENT
/begin COMPU_METHOD CU_ISO2EVSEID[3] "Conversion method for Iso2EvseId[3]" RAT_FUNC "%10.0" "1" COEFFS 0.000000 1.000000 -0.000000 0.000000 0.000000 1.000000 /end COMPU_METHOD
/* Scalar measurable for DDE 'Iso2EvseId[4]'. */
/begin MEASUREMENT Iso2EvseId[4] "The ID that uniquely identifies the EVSE. Format is defined in the ISO 15118 ED2 Spec Annex H" UBYTE CU_ISO2EVSEID[4] 1 100 0.0 255.0 ECU_ADDRESS 0x70017cf8 BYTE_ORDER MSB_LAST /end MEASUREMENT
/begin COMPU_METHOD CU_ISO2EVSEID[4] "Conversion method for Iso2EvseId[4]" RAT_FUNC "%10.0" "1" COEFFS 0.000000 1.000000 -0.000000 0.000000 0.000000 1.000000 /end COMPU_METHOD
/begin FUNCTION Signals "Group /ByType/Signals"
 /begin LOC_MEASUREMENT DinSesStopRxTrg DinSvcDiscFreeSvc DinSvcDiscResponseCode DinSvcDiscRxTrg DinSvcDiscSvcCategory DinSvcDiscSvcId DinWeldDetResponseCode DynamicModeEn EcuRunning F2_LedA_MaxFlt F2_LedA_MaxFltActv F2_LedA_MinFlt F2_LedA_MinFltActv F3_LedB_MaxFlt F3_LedB_MaxFltActv F3_LedB_MinFlt F3_LedB_MinFltActv F4_LedC_MaxFlt F4_LedC_MaxFltActv F4_LedC_MinFlt F4_LedC_MinFltActv HostAcCrntPresAtPortEn HostAcCrntPresentAtPort HostAcVltPresAtPortEn HostAcVoltPresentAtPort HostAinEvsePilotVoltPeakRaw HostAinEvsePilotVoltRaw HostAinEvseProximityVoltRaw HostAinProximitySupplyFdbk HostAllChargeRelaysClosed HostAllChgRelaysClosed HostBptModePriority HostChargeEmergencyStop HostChargeInletLockStatus HostChargeNormalStop HostChgInletLockStatus HostChgPortCrntDc HostChgPortCrntDcValid HostChgPortVoltDc HostChgPortVoltDcValid HostChgRlyWeldCheckDone HostDepartureTime HostDesiredEgyTrnsfrMde HostDynamicModePriority HostEvCurrMaxLim HostEvCurrMinLim HostEvDisChgCurrMaxLim HostEvDisChgCurrMinLim HostEvDisChgPwrMaxLim HostEvDisChgPwrMinLim HostEvEgyCapacity HostEvEgyReqAmount HostEvIsolCheckDisabled HostEvMaxEgy HostEvMinEgy HostEvPwrMaxLim HostEvPwrMinLim HostEvTargetCrnt HostEvTargetVolt HostEvVoltMaxLim HostEvVoltMinLim HostIgnoreIsolWarning HostPriorityDin HostPriorityIsoV1 HostPriorityIsoV2 HostProtocolDinEnbl HostProtocolIsoV1Enbl HostProtocolIsoV2Enbl HostPwminEvsePilotDutcyc HostPwminEvsePilotFreq HostPwminEvsePilotTimeout HostRelayWeldCheckEnable HostRemainTimeToFullSoc HostRemainTimetoBulkSoc HostRessBulkSoc HostRessSoc HostRessTargetSoc HostRessVolt Iso1CblChkEvseIsolStatus Iso1CblChkEvseProcessing Iso1CblChkRescode Iso1CrntDmdEvseCrntLimitAchiev0 Iso1CrntDmdEvseIdLen Iso1CrntDmdEvseId[0] Iso1CrntDmdEvseId[10] Iso1CrntDmdEvseId[11] Iso1CrntDmdEvseId[12] Iso1CrntDmdEvseId[13] Iso1CrntDmdEvseId[14] Iso1CrntDmdEvseId[15] Iso1CrntDmdEvseId[16] Iso1CrntDmdEvseId[17] Iso1CrntDmdEvseId[18] Iso1CrntDmdEvseId[19] Iso1CrntDmdEvseId[1] Iso1CrntDmdEvseId[20] Iso1CrntDmdEvseId[21] Iso1CrntDmdEvseId[22] Iso1CrntDmdEvseId[23] Iso1CrntDmdEvseId[24] Iso1CrntDmdEvseId[25] Iso1CrntDmdEvseId[26] Iso1CrntDmdEvseId[27] Iso1CrntDmdEvseId[28] Iso1CrntDmdEvseId[29] Iso1CrntDmdEvseId[2] Iso1CrntDmdEvseId[30] Iso1CrntDmdEvseId[31] Iso1CrntDmdEvseId[32] Iso1CrntDmdEvseId[33] Iso1CrntDmdEvseId[34] Iso1CrntDmdEvseId[35] Iso1CrntDmdEvseId[36] Iso1CrntDmdEvseId[37] Iso1CrntDmdEvseId[3] Iso1CrntDmdEvseId[4] Iso1CrntDmdEvseId[5] Iso1CrntDmdEvseId[6] Iso1CrntDmdEvseId[7] Iso1CrntDmdEvseId[8] Iso1CrntDmdEvseId[9] Iso1CrntDmdEvseMaxVoltLimitPre0 Iso1CrntDmdEvseVoltLimitAchiev0 Iso1CrntDmdNotifMaxDelay Iso1CrntDmdRescode Iso1DcChgParCrntRegTol Iso1DcChgParIsolStatus Iso1DcChgParMaxVoltLim Iso1DcChgParMinCrntLim Iso1DcChgParPeakCrntRipple Iso1PmtSelRescode Iso1PreChgEvseIsolStatusPres Iso1PreChgEvseNotifMaxDelay Iso1PreChgEvsePresVolt Iso1PreChgRxTrg Iso1PwrDelivEvseIsolStatusPres Iso1PwrDelivEvseStatusCode Iso1PwrDelivEvseStatusPresent Iso1PwrDelivNotifMaxDelay Iso1SesSetupEvseId[0] Iso1SesSetupEvseId[10] Iso1SesSetupEvseId[11] Iso1SesSetupEvseId[12] Iso1SesSetupEvseId[13] Iso1SesSetupEvseId[14] Iso1SesSetupEvseId[15] Iso1SesSetupEvseId[16] Iso1SesSetupEvseId[17] Iso1SesSetupEvseId[18] Iso1SesSetupEvseId[19] Iso1SesSetupEvseId[1] Iso1SesSetupEvseId[20] Iso1SesSetupEvseId[21] Iso1SesSetupEvseId[22] Iso1SesSetupEvseId[23] Iso1SesSetupEvseId[24] Iso1SesSetupEvseId[25] Iso1SesSetupEvseId[26] Iso1SesSetupEvseId[27] Iso1SesSetupEvseId[28] Iso1SesSetupEvseId[29] Iso1SesSetupEvseId[2] Iso1SesSetupEvseId[30] Iso1SesSetupEvseId[31] Iso1SesSetupEvseId[32] Iso1SesSetupEvseId[33] Iso1SesSetupEvseId[34] Iso1SesSetupEvseId[35] Iso1SesSetupEvseId[36] Iso1SesSetupEvseId[37] Iso1SesSetupEvseId[3] Iso1SesSetupEvseId[4] Iso1SesSetupEvseId[5] Iso1SesSetupEvseId[6] Iso1SesSetupEvseId[7] Iso1SesSetupEvseId[8] Iso1SesSetupEvseId[9] Iso1SesSetupTimestamp Iso1SvcDetailRxTrg Iso1SvcDiscFreeSvc Iso1SvcDiscRescode Iso1SvcDiscSvcListSize Iso1WeldDetNotifMaxDelay Iso1WeldDetRxTrg Iso2AuthEvseProcessing Iso2AuthEvseStatPres Iso2AuthNotif Iso2AuthNotifMaxDelay Iso2AuthRescode Iso2AuthRxTrg Iso2BPTCtrlEvseCrntLimAchvd Iso2BPTCtrlEvseIdLen Iso2BPTCtrlEvseId[0] Iso2BPTCtrlEvseId[10] Iso2BPTCtrlEvseId[11] Iso2BPTCtrlEvseId[12] Iso2BPTCtrlEvseId[13] Iso2BPTCtrlEvseId[14] Iso2BPTCtrlEvseId[15] Iso2BPTCtrlEvseId[16] Iso2BPTCtrlEvseId[17] Iso2BPTCtrlEvseId[18] Iso2BPTCtrlEvseId[19] Iso2BPTCtrlEvseId[1] Iso2BPTCtrlEvseId[20] Iso2BPTCtrlEvseId[21] Iso2BPTCtrlEvseId[22] Iso2BPTCtrlEvseId[23] Iso2BPTCtrlEvseId[24] Iso2BPTCtrlEvseId[25] Iso2BPTCtrlEvseId[26] Iso2BPTCtrlEvseId[27] Iso2BPTCtrlEvseId[28] Iso2BPTCtrlEvseId[29] Iso2BPTCtrlEvseId[2] Iso2BPTCtrlEvseId[30] Iso2BPTCtrlEvseId[31] Iso2BPTCtrlEvseId[32] Iso2BPTCtrlEvseId[33] Iso2BPTCtrlEvseId[34] Iso2BPTCtrlEvseId[35] Iso2BPTCtrlEvseId[36] Iso2BPTCtrlEvseId[37] Iso2BPTCtrlEvseId[3] Iso2BPTCtrlEvseId[4] Iso2BPTCtrlEvseId[5] Iso2BPTCtrlEvseId[6] Iso2BPTCtrlEvseId[7] Iso2BPTCtrlEvseId[8] Iso2BPTCtrlEvseId[9] Iso2BPTCtrlEvseMaxChgCrnt Iso2BPTCtrlEvseMaxChgCrntPres Iso2BPTCtrlEvseMaxChgPwr Iso2BPTCtrlEvseMaxChgPwrPres Iso2BPTCtrlEvseMaxDisChgCrnt Iso2BPTCtrlEvseMaxDisChgPwr Iso2BPTCtrlEvseMaxVolt Iso2BPTCtrlEvseMaxVoltPres Iso2BPTCtrlEvseMinVolt Iso2BPTCtrlEvseMinVoltPres Iso2BPTCtrlEvsePresCrnt Iso2BPTCtrlEvsePresVolt Iso2BPTCtrlEvseStatPres Iso2BPTCtrlEvseVoltLimAchvd Iso2BPTCtrlMaxDisChgCrntPres Iso2BPTCtrlMaxDisChgPwrPres Iso2BPTCtrlNotif Iso2BPTCtrlNotifMaxDelay Iso2BPTCtrlRescode Iso2BPTCtrlRxTrg Iso2BPTCtrlSaSchTupId Iso2BPTCtrlSaSchTupIdPres Iso2CblChkEvseProcessing Iso2CblChkEvseStatPres Iso2CblChkNotif Iso2CblChkNotifMaxDelay Iso2CblChkRescode Iso2CblChkRxTrg Iso2ChgParDiscDcBptParPres Iso2ChgParDiscDcChgParPres Iso2ChgParDiscEvseProcessing Iso2ChgParDiscEvseStatPres Iso2ChgParDiscNotif Iso2ChgParDiscNotifMaxDelay Iso2ChgParDiscRescode Iso2ChgParDiscRxTrg Iso2ChgParDiscSaSchListSize Iso2CrntDmdEvseCrntLimAchvd Iso2CrntDmdEvseIdLen Iso2CrntDmdEvseId[0] Iso2CrntDmdEvseId[10] Iso2CrntDmdEvseId[11] Iso2CrntDmdEvseId[12] Iso2CrntDmdEvseId[13] Iso2CrntDmdEvseId[14] Iso2CrntDmdEvseId[15] Iso2CrntDmdEvseId[16] Iso2CrntDmdEvseId[17] Iso2CrntDmdEvseId[18] Iso2CrntDmdEvseId[19] Iso2CrntDmdEvseId[1] Iso2CrntDmdEvseId[20] Iso2CrntDmdEvseId[21] Iso2CrntDmdEvseId[22] Iso2CrntDmdEvseId[23] Iso2CrntDmdEvseId[24] Iso2CrntDmdEvseId[25] Iso2CrntDmdEvseId[26] Iso2CrntDmdEvseId[27] Iso2CrntDmdEvseId[28] Iso2CrntDmdEvseId[29] Iso2CrntDmdEvseId[2] Iso2CrntDmdEvseId[30] Iso2CrntDmdEvseId[31] Iso2CrntDmdEvseId[32] Iso2CrntDmdEvseId[33] Iso2CrntDmdEvseId[34] Iso2CrntDmdEvseId[35] Iso2CrntDmdEvseId[36] Iso2CrntDmdEvseId[37] Iso2CrntDmdEvseId[3] Iso2CrntDmdEvseId[4] Iso2CrntDmdEvseId[5] Iso2CrntDmdEvseId[6] Iso2CrntDmdEvseId[7] Iso2CrntDmdEvseId[8] Iso2CrntDmdEvseId[9] Iso2CrntDmdEvseMaxCrntLim Iso2CrntDmdEvseMaxCrntLimPres Iso2CrntDmdEvseMaxPwrLim Iso2CrntDmdEvseMaxPwrLimPres Iso2CrntDmdEvseMaxVoltLim Iso2CrntDmdEvseMaxVoltLimPres Iso2CrntDmdEvsePresCrnt Iso2CrntDmdEvsePresVolt Iso2CrntDmdEvsePwrLimAchvd Iso2CrntDmdEvseStatPres Iso2CrntDmdEvseVoltLimAchvd Iso2CrntDmdNotif Iso2CrntDmdNotifMaxDelay Iso2CrntDmdRescode Iso2CrntDmdRxTrg Iso2CrntDmdSASchTupId Iso2CrntDmdSASchTupIdPres Iso2DcBiDirParCrntRegTol Iso2DcBiDirParCrntRegTolPres Iso2DcBiDirParDataVal Iso2DcBiDirParEgyToBeDel Iso2DcBiDirParEgyToBeDelPres Iso2DcBiDirParMaxChgCrnt Iso2DcBiDirParMaxChgPwr Iso2DcBiDirParMaxDischgCrnt Iso2DcBiDirParMaxDischgPwr Iso2DcBiDirParMaxVolt Iso2DcBiDirParMinChgCrnt Iso2DcBiDirParMinDischgCrnt Iso2DcBiDirParMinVolt Iso2DcBiDirParPeakCrntRip Iso2DcChgParCrntRegTol Iso2DcChgParCrntRegTolPres Iso2DcChgParDataVal Iso2DcChgParEgyToBeDel Iso2DcChgParEgyToBeDelPres Iso2DcChgParMaxChgCrnt Iso2DcChgParMaxChgPwr Iso2DcChgParMaxVolt Iso2DcChgParMinChgCrnt Iso2DcChgParMinVolt Iso2DcChgParPeakCrntRipple Iso2EvseIdLen Iso2EvseId[0] Iso2EvseId[10] Iso2EvseId[11] Iso2EvseId[12] Iso2EvseId[13] Iso2EvseId[14] Iso2EvseId[15] Iso2EvseId[16] Iso2EvseId[17] Iso2EvseId[18] Iso2EvseId[19] Iso2EvseId[1] Iso2EvseId[20] Iso2EvseId[21] Iso2EvseId[22] Iso2EvseId[23] Iso2EvseId[24] Iso2EvseId[25] Iso2EvseId[26] Iso2EvseId[27] Iso2EvseId[28] Iso2EvseId[29] Iso2EvseId[2] Iso2EvseId[30] Iso2EvseId[31] Iso2EvseId[32] Iso2EvseId[33] Iso2EvseId[34] Iso2EvseId[35] Iso2EvseId[36] Iso2EvseId[37] Iso2EvseId[3] Iso2EvseId[4] /end LOC_MEASUREMENT
/end FUNCTION
/end MODULE
/end PROJECT
