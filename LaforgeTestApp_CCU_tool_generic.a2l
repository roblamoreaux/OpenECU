ASAP2_VERSION 1 31
/begin PROJECT LaForge_CCU_TestApp "Test Application for LaForge TC367"
/begin HEADER "Dana" VERSION "0_3_1" /end HEADER
/begin MODULE OpenECU_TC367_001 ""
/* Scalar measurable for DDE 'DynamicModeEn'. */
/begin MEASUREMENT DynamicModeEn "Flag that indicated whether dynamic mode is enabled from the Service Discovery and Detail Parser" UBYTE CU_DYNAMICMODEEN 1 100 0.0 1.0 ECU_ADDRESS 0x70017c97 BYTE_ORDER MSB_LAST /end MEASUREMENT
/begin COMPU_METHOD CU_DYNAMICMODEEN "Conversion method for DynamicModeEn" RAT_FUNC "%10.0" "b" COEFFS 0.000000 1.000000 -0.000000 0.000000 0.000000 1.000000 /end COMPU_METHOD
/* Scalar measurable for DDE 'Iso1CblChkEvseIsolStatus'. */
/begin MEASUREMENT Iso1CblChkEvseIsolStatus "Indicates the isolation condition" UBYTE CU_ISO1CBLCHKEVSEISOLSTATUS 1 100 0.0 255.0 ECU_ADDRESS 0x70018210 BYTE_ORDER MSB_LAST /end MEASUREMENT
/begin COMPU_METHOD CU_ISO1CBLCHKEVSEISOLSTATUS "Conversion method for Iso1CblChkEvseIsolStatus" RAT_FUNC "%10.0" "enum" COEFFS 0.000000 1.000000 -0.000000 0.000000 0.000000 1.000000 /end COMPU_METHOD
/* Scalar measurable for DDE 'Iso1CblChkEvseProcessing'. */
/begin MEASUREMENT Iso1CblChkEvseProcessing "Message 4b: Parameter indicating that the EVSE has finished the processing that was initiated after the ContractAuthenticationReq or that the EVSE is still processing at the time the response message was sent." UBYTE CU_ISO1CBLCHKEVSEPROCESSING 1 100 0.0 255.0 ECU_ADDRESS 0x70017d2c BYTE_ORDER MSB_LAST /end MEASUREMENT
/begin COMPU_METHOD CU_ISO1CBLCHKEVSEPROCESSING "Conversion method for Iso1CblChkEvseProcessing" RAT_FUNC "%10.0" "enum" COEFFS 0.000000 1.000000 -0.000000 0.000000 0.000000 1.000000 /end COMPU_METHOD
/* Scalar measurable for DDE 'Iso1CblChkRescode'. */
/begin MEASUREMENT Iso1CblChkRescode "for message 4b: indicates the acknowledgment status of  this V2G messages received by the SECC." UBYTE CU_ISO1CBLCHKRESCODE 1 100 0.0 255.0 ECU_ADDRESS 0x70018184 BYTE_ORDER MSB_LAST /end MEASUREMENT
/begin COMPU_METHOD CU_ISO1CBLCHKRESCODE "Conversion method for Iso1CblChkRescode" RAT_FUNC "%10.0" "1" COEFFS 0.000000 1.000000 -0.000000 0.000000 0.000000 1.000000 /end COMPU_METHOD
/* Scalar measurable for DDE 'Iso1CrntDmdEvseCrntLimitAchieved'. */
/begin MEASUREMENT Iso1CrntDmdEvseCrntLimitAchiev0 "If set to TRUE, the EVSE has reached its current limit." UBYTE CU_ISO1CRNTDMDEVSECRNTLIMITACH0 1 100 0.0 1.0 ECU_ADDRESS 0x70017c58 BYTE_ORDER MSB_LAST /end MEASUREMENT
/begin COMPU_METHOD CU_ISO1CRNTDMDEVSECRNTLIMITACH0 "Conversion method for Iso1CrntDmdEvseCrntLimitAchieved" RAT_FUNC "%10.0" "b" COEFFS 0.000000 1.000000 -0.000000 0.000000 0.000000 1.000000 /end COMPU_METHOD
/* Scalar measurable for DDE 'Iso1CrntDmdEvseIdLen'. */
/begin MEASUREMENT Iso1CrntDmdEvseIdLen "Number of bytes in EVSE ID" UBYTE CU_ISO1CRNTDMDEVSEIDLEN 1 100 0.0 37.0 ECU_ADDRESS 0x70018480 BYTE_ORDER MSB_LAST /end MEASUREMENT
/begin COMPU_METHOD CU_ISO1CRNTDMDEVSEIDLEN "Conversion method for Iso1CrntDmdEvseIdLen" RAT_FUNC "%10.0" "1" COEFFS 0.000000 1.000000 -0.000000 0.000000 0.000000 1.000000 /end COMPU_METHOD
/* Scalar measurable for DDE 'Iso1CrntDmdEvseId[0]'. */
/begin MEASUREMENT Iso1CrntDmdEvseId[0] "The ID that uniquely identifies the EVSE. Format is defined in DIN SPEC 91286" UBYTE CU_ISO1CRNTDMDEVSEID[0] 1 100 0.0 255.0 ECU_ADDRESS 0x70018020 BYTE_ORDER MSB_LAST /end MEASUREMENT
/begin COMPU_METHOD CU_ISO1CRNTDMDEVSEID[0] "Conversion method for Iso1CrntDmdEvseId[0]" RAT_FUNC "%10.0" "1" COEFFS 0.000000 1.000000 -0.000000 0.000000 0.000000 1.000000 /end COMPU_METHOD
/* Scalar measurable for DDE 'Iso1CrntDmdEvseId[10]'. */
/begin MEASUREMENT Iso1CrntDmdEvseId[10] "The ID that uniquely identifies the EVSE. Format is defined in DIN SPEC 91286" UBYTE CU_ISO1CRNTDMDEVSEID[10] 1 100 0.0 255.0 ECU_ADDRESS 0x7001802a BYTE_ORDER MSB_LAST /end MEASUREMENT
/begin COMPU_METHOD CU_ISO1CRNTDMDEVSEID[10] "Conversion method for Iso1CrntDmdEvseId[10]" RAT_FUNC "%10.0" "1" COEFFS 0.000000 1.000000 -0.000000 0.000000 0.000000 1.000000 /end COMPU_METHOD
/* Scalar measurable for DDE 'Iso1CrntDmdEvseId[11]'. */
/begin MEASUREMENT Iso1CrntDmdEvseId[11] "The ID that uniquely identifies the EVSE. Format is defined in DIN SPEC 91286" UBYTE CU_ISO1CRNTDMDEVSEID[11] 1 100 0.0 255.0 ECU_ADDRESS 0x7001802b BYTE_ORDER MSB_LAST /end MEASUREMENT
/begin COMPU_METHOD CU_ISO1CRNTDMDEVSEID[11] "Conversion method for Iso1CrntDmdEvseId[11]" RAT_FUNC "%10.0" "1" COEFFS 0.000000 1.000000 -0.000000 0.000000 0.000000 1.000000 /end COMPU_METHOD
/* Scalar measurable for DDE 'Iso1CrntDmdEvseId[12]'. */
/begin MEASUREMENT Iso1CrntDmdEvseId[12] "The ID that uniquely identifies the EVSE. Format is defined in DIN SPEC 91286" UBYTE CU_ISO1CRNTDMDEVSEID[12] 1 100 0.0 255.0 ECU_ADDRESS 0x7001802c BYTE_ORDER MSB_LAST /end MEASUREMENT
/begin COMPU_METHOD CU_ISO1CRNTDMDEVSEID[12] "Conversion method for Iso1CrntDmdEvseId[12]" RAT_FUNC "%10.0" "1" COEFFS 0.000000 1.000000 -0.000000 0.000000 0.000000 1.000000 /end COMPU_METHOD
/* Scalar measurable for DDE 'Iso1CrntDmdEvseId[13]'. */
/begin MEASUREMENT Iso1CrntDmdEvseId[13] "The ID that uniquely identifies the EVSE. Format is defined in DIN SPEC 91286" UBYTE CU_ISO1CRNTDMDEVSEID[13] 1 100 0.0 255.0 ECU_ADDRESS 0x7001802d BYTE_ORDER MSB_LAST /end MEASUREMENT
/begin COMPU_METHOD CU_ISO1CRNTDMDEVSEID[13] "Conversion method for Iso1CrntDmdEvseId[13]" RAT_FUNC "%10.0" "1" COEFFS 0.000000 1.000000 -0.000000 0.000000 0.000000 1.000000 /end COMPU_METHOD
/* Scalar measurable for DDE 'Iso1CrntDmdEvseId[14]'. */
/begin MEASUREMENT Iso1CrntDmdEvseId[14] "The ID that uniquely identifies the EVSE. Format is defined in DIN SPEC 91286" UBYTE CU_ISO1CRNTDMDEVSEID[14] 1 100 0.0 255.0 ECU_ADDRESS 0x7001802e BYTE_ORDER MSB_LAST /end MEASUREMENT
/begin COMPU_METHOD CU_ISO1CRNTDMDEVSEID[14] "Conversion method for Iso1CrntDmdEvseId[14]" RAT_FUNC "%10.0" "1" COEFFS 0.000000 1.000000 -0.000000 0.000000 0.000000 1.000000 /end COMPU_METHOD
/* Scalar measurable for DDE 'Iso1CrntDmdEvseId[15]'. */
/begin MEASUREMENT Iso1CrntDmdEvseId[15] "The ID that uniquely identifies the EVSE. Format is defined in DIN SPEC 91286" UBYTE CU_ISO1CRNTDMDEVSEID[15] 1 100 0.0 255.0 ECU_ADDRESS 0x7001802f BYTE_ORDER MSB_LAST /end MEASUREMENT
/begin COMPU_METHOD CU_ISO1CRNTDMDEVSEID[15] "Conversion method for Iso1CrntDmdEvseId[15]" RAT_FUNC "%10.0" "1" COEFFS 0.000000 1.000000 -0.000000 0.000000 0.000000 1.000000 /end COMPU_METHOD
/* Scalar measurable for DDE 'Iso1CrntDmdEvseId[16]'. */
/begin MEASUREMENT Iso1CrntDmdEvseId[16] "The ID that uniquely identifies the EVSE. Format is defined in DIN SPEC 91286" UBYTE CU_ISO1CRNTDMDEVSEID[16] 1 100 0.0 255.0 ECU_ADDRESS 0x70018030 BYTE_ORDER MSB_LAST /end MEASUREMENT
/begin COMPU_METHOD CU_ISO1CRNTDMDEVSEID[16] "Conversion method for Iso1CrntDmdEvseId[16]" RAT_FUNC "%10.0" "1" COEFFS 0.000000 1.000000 -0.000000 0.000000 0.000000 1.000000 /end COMPU_METHOD
/* Scalar measurable for DDE 'Iso1CrntDmdEvseId[17]'. */
/begin MEASUREMENT Iso1CrntDmdEvseId[17] "The ID that uniquely identifies the EVSE. Format is defined in DIN SPEC 91286" UBYTE CU_ISO1CRNTDMDEVSEID[17] 1 100 0.0 255.0 ECU_ADDRESS 0x70018031 BYTE_ORDER MSB_LAST /end MEASUREMENT
/begin COMPU_METHOD CU_ISO1CRNTDMDEVSEID[17] "Conversion method for Iso1CrntDmdEvseId[17]" RAT_FUNC "%10.0" "1" COEFFS 0.000000 1.000000 -0.000000 0.000000 0.000000 1.000000 /end COMPU_METHOD
/* Scalar measurable for DDE 'Iso1CrntDmdEvseId[18]'. */
/begin MEASUREMENT Iso1CrntDmdEvseId[18] "The ID that uniquely identifies the EVSE. Format is defined in DIN SPEC 91286" UBYTE CU_ISO1CRNTDMDEVSEID[18] 1 100 0.0 255.0 ECU_ADDRESS 0x70018032 BYTE_ORDER MSB_LAST /end MEASUREMENT
/begin COMPU_METHOD CU_ISO1CRNTDMDEVSEID[18] "Conversion method for Iso1CrntDmdEvseId[18]" RAT_FUNC "%10.0" "1" COEFFS 0.000000 1.000000 -0.000000 0.000000 0.000000 1.000000 /end COMPU_METHOD
/* Scalar measurable for DDE 'Iso1CrntDmdEvseId[19]'. */
/begin MEASUREMENT Iso1CrntDmdEvseId[19] "The ID that uniquely identifies the EVSE. Format is defined in DIN SPEC 91286" UBYTE CU_ISO1CRNTDMDEVSEID[19] 1 100 0.0 255.0 ECU_ADDRESS 0x70018033 BYTE_ORDER MSB_LAST /end MEASUREMENT
/begin COMPU_METHOD CU_ISO1CRNTDMDEVSEID[19] "Conversion method for Iso1CrntDmdEvseId[19]" RAT_FUNC "%10.0" "1" COEFFS 0.000000 1.000000 -0.000000 0.000000 0.000000 1.000000 /end COMPU_METHOD
/* Scalar measurable for DDE 'Iso1CrntDmdEvseId[1]'. */
/begin MEASUREMENT Iso1CrntDmdEvseId[1] "The ID that uniquely identifies the EVSE. Format is defined in DIN SPEC 91286" UBYTE CU_ISO1CRNTDMDEVSEID[1] 1 100 0.0 255.0 ECU_ADDRESS 0x70018021 BYTE_ORDER MSB_LAST /end MEASUREMENT
/begin COMPU_METHOD CU_ISO1CRNTDMDEVSEID[1] "Conversion method for Iso1CrntDmdEvseId[1]" RAT_FUNC "%10.0" "1" COEFFS 0.000000 1.000000 -0.000000 0.000000 0.000000 1.000000 /end COMPU_METHOD
/* Scalar measurable for DDE 'Iso1CrntDmdEvseId[20]'. */
/begin MEASUREMENT Iso1CrntDmdEvseId[20] "The ID that uniquely identifies the EVSE. Format is defined in DIN SPEC 91286" UBYTE CU_ISO1CRNTDMDEVSEID[20] 1 100 0.0 255.0 ECU_ADDRESS 0x70018034 BYTE_ORDER MSB_LAST /end MEASUREMENT
/begin COMPU_METHOD CU_ISO1CRNTDMDEVSEID[20] "Conversion method for Iso1CrntDmdEvseId[20]" RAT_FUNC "%10.0" "1" COEFFS 0.000000 1.000000 -0.000000 0.000000 0.000000 1.000000 /end COMPU_METHOD
/* Scalar measurable for DDE 'Iso1CrntDmdEvseId[21]'. */
/begin MEASUREMENT Iso1CrntDmdEvseId[21] "The ID that uniquely identifies the EVSE. Format is defined in DIN SPEC 91286" UBYTE CU_ISO1CRNTDMDEVSEID[21] 1 100 0.0 255.0 ECU_ADDRESS 0x70018035 BYTE_ORDER MSB_LAST /end MEASUREMENT
/begin COMPU_METHOD CU_ISO1CRNTDMDEVSEID[21] "Conversion method for Iso1CrntDmdEvseId[21]" RAT_FUNC "%10.0" "1" COEFFS 0.000000 1.000000 -0.000000 0.000000 0.000000 1.000000 /end COMPU_METHOD
/* Scalar measurable for DDE 'Iso1CrntDmdEvseId[22]'. */
/begin MEASUREMENT Iso1CrntDmdEvseId[22] "The ID that uniquely identifies the EVSE. Format is defined in DIN SPEC 91286" UBYTE CU_ISO1CRNTDMDEVSEID[22] 1 100 0.0 255.0 ECU_ADDRESS 0x70018036 BYTE_ORDER MSB_LAST /end MEASUREMENT
/begin COMPU_METHOD CU_ISO1CRNTDMDEVSEID[22] "Conversion method for Iso1CrntDmdEvseId[22]" RAT_FUNC "%10.0" "1" COEFFS 0.000000 1.000000 -0.000000 0.000000 0.000000 1.000000 /end COMPU_METHOD
/* Scalar measurable for DDE 'Iso1CrntDmdEvseId[23]'. */
/begin MEASUREMENT Iso1CrntDmdEvseId[23] "The ID that uniquely identifies the EVSE. Format is defined in DIN SPEC 91286" UBYTE CU_ISO1CRNTDMDEVSEID[23] 1 100 0.0 255.0 ECU_ADDRESS 0x70018037 BYTE_ORDER MSB_LAST /end MEASUREMENT
/begin COMPU_METHOD CU_ISO1CRNTDMDEVSEID[23] "Conversion method for Iso1CrntDmdEvseId[23]" RAT_FUNC "%10.0" "1" COEFFS 0.000000 1.000000 -0.000000 0.000000 0.000000 1.000000 /end COMPU_METHOD
/* Scalar measurable for DDE 'Iso1CrntDmdEvseId[24]'. */
/begin MEASUREMENT Iso1CrntDmdEvseId[24] "The ID that uniquely identifies the EVSE. Format is defined in DIN SPEC 91286" UBYTE CU_ISO1CRNTDMDEVSEID[24] 1 100 0.0 255.0 ECU_ADDRESS 0x70018038 BYTE_ORDER MSB_LAST /end MEASUREMENT
/begin COMPU_METHOD CU_ISO1CRNTDMDEVSEID[24] "Conversion method for Iso1CrntDmdEvseId[24]" RAT_FUNC "%10.0" "1" COEFFS 0.000000 1.000000 -0.000000 0.000000 0.000000 1.000000 /end COMPU_METHOD
/* Scalar measurable for DDE 'Iso1CrntDmdEvseId[25]'. */
/begin MEASUREMENT Iso1CrntDmdEvseId[25] "The ID that uniquely identifies the EVSE. Format is defined in DIN SPEC 91286" UBYTE CU_ISO1CRNTDMDEVSEID[25] 1 100 0.0 255.0 ECU_ADDRESS 0x70018039 BYTE_ORDER MSB_LAST /end MEASUREMENT
/begin COMPU_METHOD CU_ISO1CRNTDMDEVSEID[25] "Conversion method for Iso1CrntDmdEvseId[25]" RAT_FUNC "%10.0" "1" COEFFS 0.000000 1.000000 -0.000000 0.000000 0.000000 1.000000 /end COMPU_METHOD
/* Scalar measurable for DDE 'Iso1CrntDmdEvseId[26]'. */
/begin MEASUREMENT Iso1CrntDmdEvseId[26] "The ID that uniquely identifies the EVSE. Format is defined in DIN SPEC 91286" UBYTE CU_ISO1CRNTDMDEVSEID[26] 1 100 0.0 255.0 ECU_ADDRESS 0x7001803a BYTE_ORDER MSB_LAST /end MEASUREMENT
/begin COMPU_METHOD CU_ISO1CRNTDMDEVSEID[26] "Conversion method for Iso1CrntDmdEvseId[26]" RAT_FUNC "%10.0" "1" COEFFS 0.000000 1.000000 -0.000000 0.000000 0.000000 1.000000 /end COMPU_METHOD
/* Scalar measurable for DDE 'Iso1CrntDmdEvseId[27]'. */
/begin MEASUREMENT Iso1CrntDmdEvseId[27] "The ID that uniquely identifies the EVSE. Format is defined in DIN SPEC 91286" UBYTE CU_ISO1CRNTDMDEVSEID[27] 1 100 0.0 255.0 ECU_ADDRESS 0x7001803b BYTE_ORDER MSB_LAST /end MEASUREMENT
/begin COMPU_METHOD CU_ISO1CRNTDMDEVSEID[27] "Conversion method for Iso1CrntDmdEvseId[27]" RAT_FUNC "%10.0" "1" COEFFS 0.000000 1.000000 -0.000000 0.000000 0.000000 1.000000 /end COMPU_METHOD
/* Scalar measurable for DDE 'Iso1CrntDmdEvseId[28]'. */
/begin MEASUREMENT Iso1CrntDmdEvseId[28] "The ID that uniquely identifies the EVSE. Format is defined in DIN SPEC 91286" UBYTE CU_ISO1CRNTDMDEVSEID[28] 1 100 0.0 255.0 ECU_ADDRESS 0x7001803c BYTE_ORDER MSB_LAST /end MEASUREMENT
/begin COMPU_METHOD CU_ISO1CRNTDMDEVSEID[28] "Conversion method for Iso1CrntDmdEvseId[28]" RAT_FUNC "%10.0" "1" COEFFS 0.000000 1.000000 -0.000000 0.000000 0.000000 1.000000 /end COMPU_METHOD
/* Scalar measurable for DDE 'Iso1CrntDmdEvseId[29]'. */
/begin MEASUREMENT Iso1CrntDmdEvseId[29] "The ID that uniquely identifies the EVSE. Format is defined in DIN SPEC 91286" UBYTE CU_ISO1CRNTDMDEVSEID[29] 1 100 0.0 255.0 ECU_ADDRESS 0x7001803d BYTE_ORDER MSB_LAST /end MEASUREMENT
/begin COMPU_METHOD CU_ISO1CRNTDMDEVSEID[29] "Conversion method for Iso1CrntDmdEvseId[29]" RAT_FUNC "%10.0" "1" COEFFS 0.000000 1.000000 -0.000000 0.000000 0.000000 1.000000 /end COMPU_METHOD
/* Scalar measurable for DDE 'Iso1CrntDmdEvseId[2]'. */
/begin MEASUREMENT Iso1CrntDmdEvseId[2] "The ID that uniquely identifies the EVSE. Format is defined in DIN SPEC 91286" UBYTE CU_ISO1CRNTDMDEVSEID[2] 1 100 0.0 255.0 ECU_ADDRESS 0x70018022 BYTE_ORDER MSB_LAST /end MEASUREMENT
/begin COMPU_METHOD CU_ISO1CRNTDMDEVSEID[2] "Conversion method for Iso1CrntDmdEvseId[2]" RAT_FUNC "%10.0" "1" COEFFS 0.000000 1.000000 -0.000000 0.000000 0.000000 1.000000 /end COMPU_METHOD
/* Scalar measurable for DDE 'Iso1CrntDmdEvseId[30]'. */
/begin MEASUREMENT Iso1CrntDmdEvseId[30] "The ID that uniquely identifies the EVSE. Format is defined in DIN SPEC 91286" UBYTE CU_ISO1CRNTDMDEVSEID[30] 1 100 0.0 255.0 ECU_ADDRESS 0x7001803e BYTE_ORDER MSB_LAST /end MEASUREMENT
/begin COMPU_METHOD CU_ISO1CRNTDMDEVSEID[30] "Conversion method for Iso1CrntDmdEvseId[30]" RAT_FUNC "%10.0" "1" COEFFS 0.000000 1.000000 -0.000000 0.000000 0.000000 1.000000 /end COMPU_METHOD
/* Scalar measurable for DDE 'Iso1CrntDmdEvseId[31]'. */
/begin MEASUREMENT Iso1CrntDmdEvseId[31] "The ID that uniquely identifies the EVSE. Format is defined in DIN SPEC 91286" UBYTE CU_ISO1CRNTDMDEVSEID[31] 1 100 0.0 255.0 ECU_ADDRESS 0x7001803f BYTE_ORDER MSB_LAST /end MEASUREMENT
/begin COMPU_METHOD CU_ISO1CRNTDMDEVSEID[31] "Conversion method for Iso1CrntDmdEvseId[31]" RAT_FUNC "%10.0" "1" COEFFS 0.000000 1.000000 -0.000000 0.000000 0.000000 1.000000 /end COMPU_METHOD
/* Scalar measurable for DDE 'Iso1CrntDmdEvseId[32]'. */
/begin MEASUREMENT Iso1CrntDmdEvseId[32] "The ID that uniquely identifies the EVSE. Format is defined in DIN SPEC 91286" UBYTE CU_ISO1CRNTDMDEVSEID[32] 1 100 0.0 255.0 ECU_ADDRESS 0x70018040 BYTE_ORDER MSB_LAST /end MEASUREMENT
/begin COMPU_METHOD CU_ISO1CRNTDMDEVSEID[32] "Conversion method for Iso1CrntDmdEvseId[32]" RAT_FUNC "%10.0" "1" COEFFS 0.000000 1.000000 -0.000000 0.000000 0.000000 1.000000 /end COMPU_METHOD
/* Scalar measurable for DDE 'Iso1CrntDmdEvseId[33]'. */
/begin MEASUREMENT Iso1CrntDmdEvseId[33] "The ID that uniquely identifies the EVSE. Format is defined in DIN SPEC 91286" UBYTE CU_ISO1CRNTDMDEVSEID[33] 1 100 0.0 255.0 ECU_ADDRESS 0x70018041 BYTE_ORDER MSB_LAST /end MEASUREMENT
/begin COMPU_METHOD CU_ISO1CRNTDMDEVSEID[33] "Conversion method for Iso1CrntDmdEvseId[33]" RAT_FUNC "%10.0" "1" COEFFS 0.000000 1.000000 -0.000000 0.000000 0.000000 1.000000 /end COMPU_METHOD
/* Scalar measurable for DDE 'Iso1CrntDmdEvseId[34]'. */
/begin MEASUREMENT Iso1CrntDmdEvseId[34] "The ID that uniquely identifies the EVSE. Format is defined in DIN SPEC 91286" UBYTE CU_ISO1CRNTDMDEVSEID[34] 1 100 0.0 255.0 ECU_ADDRESS 0x70018042 BYTE_ORDER MSB_LAST /end MEASUREMENT
/begin COMPU_METHOD CU_ISO1CRNTDMDEVSEID[34] "Conversion method for Iso1CrntDmdEvseId[34]" RAT_FUNC "%10.0" "1" COEFFS 0.000000 1.000000 -0.000000 0.000000 0.000000 1.000000 /end COMPU_METHOD
/* Scalar measurable for DDE 'Iso1CrntDmdEvseId[35]'. */
/begin MEASUREMENT Iso1CrntDmdEvseId[35] "The ID that uniquely identifies the EVSE. Format is defined in DIN SPEC 91286" UBYTE CU_ISO1CRNTDMDEVSEID[35] 1 100 0.0 255.0 ECU_ADDRESS 0x70018043 BYTE_ORDER MSB_LAST /end MEASUREMENT
/begin COMPU_METHOD CU_ISO1CRNTDMDEVSEID[35] "Conversion method for Iso1CrntDmdEvseId[35]" RAT_FUNC "%10.0" "1" COEFFS 0.000000 1.000000 -0.000000 0.000000 0.000000 1.000000 /end COMPU_METHOD
/* Scalar measurable for DDE 'Iso1CrntDmdEvseId[36]'. */
/begin MEASUREMENT Iso1CrntDmdEvseId[36] "The ID that uniquely identifies the EVSE. Format is defined in DIN SPEC 91286" UBYTE CU_ISO1CRNTDMDEVSEID[36] 1 100 0.0 255.0 ECU_ADDRESS 0x70018044 BYTE_ORDER MSB_LAST /end MEASUREMENT
/begin COMPU_METHOD CU_ISO1CRNTDMDEVSEID[36] "Conversion method for Iso1CrntDmdEvseId[36]" RAT_FUNC "%10.0" "1" COEFFS 0.000000 1.000000 -0.000000 0.000000 0.000000 1.000000 /end COMPU_METHOD
/* Scalar measurable for DDE 'Iso1CrntDmdEvseId[37]'. */
/begin MEASUREMENT Iso1CrntDmdEvseId[37] "The ID that uniquely identifies the EVSE. Format is defined in DIN SPEC 91286" UBYTE CU_ISO1CRNTDMDEVSEID[37] 1 100 0.0 255.0 ECU_ADDRESS 0x70018045 BYTE_ORDER MSB_LAST /end MEASUREMENT
/begin COMPU_METHOD CU_ISO1CRNTDMDEVSEID[37] "Conversion method for Iso1CrntDmdEvseId[37]" RAT_FUNC "%10.0" "1" COEFFS 0.000000 1.000000 -0.000000 0.000000 0.000000 1.000000 /end COMPU_METHOD
/* Scalar measurable for DDE 'Iso1CrntDmdEvseId[3]'. */
/begin MEASUREMENT Iso1CrntDmdEvseId[3] "The ID that uniquely identifies the EVSE. Format is defined in DIN SPEC 91286" UBYTE CU_ISO1CRNTDMDEVSEID[3] 1 100 0.0 255.0 ECU_ADDRESS 0x70018023 BYTE_ORDER MSB_LAST /end MEASUREMENT
/begin COMPU_METHOD CU_ISO1CRNTDMDEVSEID[3] "Conversion method for Iso1CrntDmdEvseId[3]" RAT_FUNC "%10.0" "1" COEFFS 0.000000 1.000000 -0.000000 0.000000 0.000000 1.000000 /end COMPU_METHOD
/* Scalar measurable for DDE 'Iso1CrntDmdEvseId[4]'. */
/begin MEASUREMENT Iso1CrntDmdEvseId[4] "The ID that uniquely identifies the EVSE. Format is defined in DIN SPEC 91286" UBYTE CU_ISO1CRNTDMDEVSEID[4] 1 100 0.0 255.0 ECU_ADDRESS 0x70018024 BYTE_ORDER MSB_LAST /end MEASUREMENT
/begin COMPU_METHOD CU_ISO1CRNTDMDEVSEID[4] "Conversion method for Iso1CrntDmdEvseId[4]" RAT_FUNC "%10.0" "1" COEFFS 0.000000 1.000000 -0.000000 0.000000 0.000000 1.000000 /end COMPU_METHOD
/* Scalar measurable for DDE 'Iso1CrntDmdEvseId[5]'. */
/begin MEASUREMENT Iso1CrntDmdEvseId[5] "The ID that uniquely identifies the EVSE. Format is defined in DIN SPEC 91286" UBYTE CU_ISO1CRNTDMDEVSEID[5] 1 100 0.0 255.0 ECU_ADDRESS 0x70018025 BYTE_ORDER MSB_LAST /end MEASUREMENT
/begin COMPU_METHOD CU_ISO1CRNTDMDEVSEID[5] "Conversion method for Iso1CrntDmdEvseId[5]" RAT_FUNC "%10.0" "1" COEFFS 0.000000 1.000000 -0.000000 0.000000 0.000000 1.000000 /end COMPU_METHOD
/* Scalar measurable for DDE 'Iso1CrntDmdEvseId[6]'. */
/begin MEASUREMENT Iso1CrntDmdEvseId[6] "The ID that uniquely identifies the EVSE. Format is defined in DIN SPEC 91286" UBYTE CU_ISO1CRNTDMDEVSEID[6] 1 100 0.0 255.0 ECU_ADDRESS 0x70018026 BYTE_ORDER MSB_LAST /end MEASUREMENT
/begin COMPU_METHOD CU_ISO1CRNTDMDEVSEID[6] "Conversion method for Iso1CrntDmdEvseId[6]" RAT_FUNC "%10.0" "1" COEFFS 0.000000 1.000000 -0.000000 0.000000 0.000000 1.000000 /end COMPU_METHOD
/* Scalar measurable for DDE 'Iso1CrntDmdEvseId[7]'. */
/begin MEASUREMENT Iso1CrntDmdEvseId[7] "The ID that uniquely identifies the EVSE. Format is defined in DIN SPEC 91286" UBYTE CU_ISO1CRNTDMDEVSEID[7] 1 100 0.0 255.0 ECU_ADDRESS 0x70018027 BYTE_ORDER MSB_LAST /end MEASUREMENT
/begin COMPU_METHOD CU_ISO1CRNTDMDEVSEID[7] "Conversion method for Iso1CrntDmdEvseId[7]" RAT_FUNC "%10.0" "1" COEFFS 0.000000 1.000000 -0.000000 0.000000 0.000000 1.000000 /end COMPU_METHOD
/* Scalar measurable for DDE 'Iso1CrntDmdEvseId[8]'. */
/begin MEASUREMENT Iso1CrntDmdEvseId[8] "The ID that uniquely identifies the EVSE. Format is defined in DIN SPEC 91286" UBYTE CU_ISO1CRNTDMDEVSEID[8] 1 100 0.0 255.0 ECU_ADDRESS 0x70018028 BYTE_ORDER MSB_LAST /end MEASUREMENT
/begin COMPU_METHOD CU_ISO1CRNTDMDEVSEID[8] "Conversion method for Iso1CrntDmdEvseId[8]" RAT_FUNC "%10.0" "1" COEFFS 0.000000 1.000000 -0.000000 0.000000 0.000000 1.000000 /end COMPU_METHOD
/* Scalar measurable for DDE 'Iso1CrntDmdEvseId[9]'. */
/begin MEASUREMENT Iso1CrntDmdEvseId[9] "The ID that uniquely identifies the EVSE. Format is defined in DIN SPEC 91286" UBYTE CU_ISO1CRNTDMDEVSEID[9] 1 100 0.0 255.0 ECU_ADDRESS 0x70018029 BYTE_ORDER MSB_LAST /end MEASUREMENT
/begin COMPU_METHOD CU_ISO1CRNTDMDEVSEID[9] "Conversion method for Iso1CrntDmdEvseId[9]" RAT_FUNC "%10.0" "1" COEFFS 0.000000 1.000000 -0.000000 0.000000 0.000000 1.000000 /end COMPU_METHOD
/* Scalar measurable for DDE 'Iso1CrntDmdEvseMaxVoltLimitPresent'. */
/begin MEASUREMENT Iso1CrntDmdEvseMaxVoltLimitPre0 "Indicates that the EVSEMaximumVoltageLimit parameter is available." UBYTE CU_ISO1CRNTDMDEVSEMAXVOLTLIMIT0 1 100 0.0 1.0 ECU_ADDRESS 0x70017f7c BYTE_ORDER MSB_LAST /end MEASUREMENT
/begin COMPU_METHOD CU_ISO1CRNTDMDEVSEMAXVOLTLIMIT0 "Conversion method for Iso1CrntDmdEvseMaxVoltLimitPresent" RAT_FUNC "%10.0" "b" COEFFS 0.000000 1.000000 -0.000000 0.000000 0.000000 1.000000 /end COMPU_METHOD
/* Scalar measurable for DDE 'Iso1CrntDmdEvseVoltLimitAchieved'. */
/begin MEASUREMENT Iso1CrntDmdEvseVoltLimitAchiev0 "f set to TRUE, the EVSE has reached its voltage limit." UBYTE CU_ISO1CRNTDMDEVSEVOLTLIMITACH0 1 100 0.0 1.0 ECU_ADDRESS 0x700183ba BYTE_ORDER MSB_LAST /end MEASUREMENT
/begin COMPU_METHOD CU_ISO1CRNTDMDEVSEVOLTLIMITACH0 "Conversion method for Iso1CrntDmdEvseVoltLimitAchieved" RAT_FUNC "%10.0" "b" COEFFS 0.000000 1.000000 -0.000000 0.000000 0.000000 1.000000 /end COMPU_METHOD
/* Scalar measurable for DDE 'Iso1CrntDmdNotifMaxDelay'. */
/begin MEASUREMENT Iso1CrntDmdNotifMaxDelay "The Notification Max Delay parameter in the received message from EVSE" UWORD CU_ISO1CRNTDMDNOTIFMAXDELAY 1 100 0.0 65535.0 ECU_ADDRESS 0x70017eca BYTE_ORDER MSB_LAST /end MEASUREMENT
/begin COMPU_METHOD CU_ISO1CRNTDMDNOTIFMAXDELAY "Conversion method for Iso1CrntDmdNotifMaxDelay" RAT_FUNC "%10.0" "s" COEFFS 0.000000 1.000000 -0.000000 0.000000 0.000000 1.000000 /end COMPU_METHOD
/* Scalar measurable for DDE 'Iso1CrntDmdRescode'. */
/begin MEASUREMENT Iso1CrntDmdRescode "for message 7b: indicates the acknowledgment status of  this V2G messages received by the SECC." UBYTE CU_ISO1CRNTDMDRESCODE 1 100 0.0 255.0 ECU_ADDRESS 0x70018326 BYTE_ORDER MSB_LAST /end MEASUREMENT
/begin COMPU_METHOD CU_ISO1CRNTDMDRESCODE "Conversion method for Iso1CrntDmdRescode" RAT_FUNC "%10.0" "1" COEFFS 0.000000 1.000000 -0.000000 0.000000 0.000000 1.000000 /end COMPU_METHOD
/* Scalar measurable for DDE 'Iso1DcChgParCrntRegTol'. */
/begin MEASUREMENT Iso1DcChgParCrntRegTol "Absolute magnitude of the regulation tolerance of the EVSE." FLOAT32_IEEE CU_ISO1DCCHGPARCRNTREGTOL 1 100 0.0 196605.0 ECU_ADDRESS 0x70017e2c BYTE_ORDER MSB_LAST /end MEASUREMENT
/begin COMPU_METHOD CU_ISO1DCCHGPARCRNTREGTOL "Conversion method for Iso1DcChgParCrntRegTol" RAT_FUNC "%10.0" "A" COEFFS 0.000000 1.000000 -0.000000 0.000000 0.000000 1.000000 /end COMPU_METHOD
/* Scalar measurable for DDE 'Iso1DcChgParIsolStatus'. */
/begin MEASUREMENT Iso1DcChgParIsolStatus "Indicates the isolation condition" UBYTE CU_ISO1DCCHGPARISOLSTATUS 1 100 0.0 255.0 ECU_ADDRESS 0x70018281 BYTE_ORDER MSB_LAST /end MEASUREMENT
/begin COMPU_METHOD CU_ISO1DCCHGPARISOLSTATUS "Conversion method for Iso1DcChgParIsolStatus" RAT_FUNC "%10.0" "enum" COEFFS 0.000000 1.000000 -0.000000 0.000000 0.000000 1.000000 /end COMPU_METHOD
/* Scalar measurable for DDE 'Iso1DcChgParMaxVoltLim'. */
/begin MEASUREMENT Iso1DcChgParMaxVoltLim "Maximum voltage the EVSE can deliver" FLOAT32_IEEE CU_ISO1DCCHGPARMAXVOLTLIM 1 100 0.0 196605.0 ECU_ADDRESS 0x70017d90 BYTE_ORDER MSB_LAST /end MEASUREMENT
/begin COMPU_METHOD CU_ISO1DCCHGPARMAXVOLTLIM "Conversion method for Iso1DcChgParMaxVoltLim" RAT_FUNC "%10.0" "V" COEFFS 0.000000 1.000000 -0.000000 0.000000 0.000000 1.000000 /end COMPU_METHOD
/* Scalar measurable for DDE 'Iso1DcChgParMinCrntLim'. */
/begin MEASUREMENT Iso1DcChgParMinCrntLim "Minimum current the EVSE can deliver with the expected accuracy" FLOAT32_IEEE CU_ISO1DCCHGPARMINCRNTLIM 1 100 0.0 196605.0 ECU_ADDRESS 0x700181bc BYTE_ORDER MSB_LAST /end MEASUREMENT
/begin COMPU_METHOD CU_ISO1DCCHGPARMINCRNTLIM "Conversion method for Iso1DcChgParMinCrntLim" RAT_FUNC "%10.0" "A" COEFFS 0.000000 1.000000 -0.000000 0.000000 0.000000 1.000000 /end COMPU_METHOD
/* Scalar measurable for DDE 'Iso1DcChgParPeakCrntRipple'. */
/begin MEASUREMENT Iso1DcChgParPeakCrntRipple "Peak-to-peak magnitude of the current ripple of the EVSE." FLOAT32_IEEE CU_ISO1DCCHGPARPEAKCRNTRIPPLE 1 100 0.0 196605.0 ECU_ADDRESS 0x70017ca0 BYTE_ORDER MSB_LAST /end MEASUREMENT
/begin COMPU_METHOD CU_ISO1DCCHGPARPEAKCRNTRIPPLE "Conversion method for Iso1DcChgParPeakCrntRipple" RAT_FUNC "%10.0" "A" COEFFS 0.000000 1.000000 -0.000000 0.000000 0.000000 1.000000 /end COMPU_METHOD
/* Scalar measurable for DDE 'Iso1PmtSelRescode'. */
/begin MEASUREMENT Iso1PmtSelRescode "for ISOv1 PaymentServiceSelection  message: indicates the acknowledgment status of this V2G messages received by the SECC." UBYTE CU_ISO1PMTSELRESCODE 1 100 0.0 255.0 ECU_ADDRESS 0x700180f4 BYTE_ORDER MSB_LAST /end MEASUREMENT
/begin COMPU_METHOD CU_ISO1PMTSELRESCODE "Conversion method for Iso1PmtSelRescode" RAT_FUNC "%10.0" "1" COEFFS 0.000000 1.000000 -0.000000 0.000000 0.000000 1.000000 /end COMPU_METHOD
/* Scalar measurable for DDE 'Iso1PreChgEvseIsolStatusPres'. */
/begin MEASUREMENT Iso1PreChgEvseIsolStatusPres "Identifies the presence of the EVSEIsolationStatus parameter." UBYTE CU_ISO1PRECHGEVSEISOLSTATUSPRES 1 100 0.0 1.0 ECU_ADDRESS 0x70017c1d BYTE_ORDER MSB_LAST /end MEASUREMENT
/begin COMPU_METHOD CU_ISO1PRECHGEVSEISOLSTATUSPRES "Conversion method for Iso1PreChgEvseIsolStatusPres" RAT_FUNC "%10.0" "b" COEFFS 0.000000 1.000000 -0.000000 0.000000 0.000000 1.000000 /end COMPU_METHOD
/* Scalar measurable for DDE 'Iso1PreChgEvseNotifMaxDelay'. */
/begin MEASUREMENT Iso1PreChgEvseNotifMaxDelay "The Notification Max Delay parameter in the received message from EVSE" UWORD CU_ISO1PRECHGEVSENOTIFMAXDELAY 1 100 0.0 65535.0 ECU_ADDRESS 0x70017fc2 BYTE_ORDER MSB_LAST /end MEASUREMENT
/begin COMPU_METHOD CU_ISO1PRECHGEVSENOTIFMAXDELAY "Conversion method for Iso1PreChgEvseNotifMaxDelay" RAT_FUNC "%10.0" "s" COEFFS 0.000000 1.000000 -0.000000 0.000000 0.000000 1.000000 /end COMPU_METHOD
/* Scalar measurable for DDE 'Iso1PreChgEvsePresVolt'. */
/begin MEASUREMENT Iso1PreChgEvsePresVolt "Present voltage of EVSE" FLOAT32_IEEE CU_ISO1PRECHGEVSEPRESVOLT 1 100 0.0 196605.0 ECU_ADDRESS 0x70018440 BYTE_ORDER MSB_LAST /end MEASUREMENT
/begin COMPU_METHOD CU_ISO1PRECHGEVSEPRESVOLT "Conversion method for Iso1PreChgEvsePresVolt" RAT_FUNC "%10.0" "V" COEFFS 0.000000 1.000000 -0.000000 0.000000 0.000000 1.000000 /end COMPU_METHOD
/* Scalar measurable for DDE 'Iso1PreChgRxTrg'. */
/begin MEASUREMENT Iso1PreChgRxTrg "Trigger falg that on a rising edge indicates the event for receiving the PLC (V2G) message response 5b from EVSE" UBYTE CU_ISO1PRECHGRXTRG 1 100 0.0 1.0 ECU_ADDRESS 0x70017f0c BYTE_ORDER MSB_LAST /end MEASUREMENT
/begin COMPU_METHOD CU_ISO1PRECHGRXTRG "Conversion method for Iso1PreChgRxTrg" RAT_FUNC "%10.0" "b" COEFFS 0.000000 1.000000 -0.000000 0.000000 0.000000 1.000000 /end COMPU_METHOD
/* Scalar measurable for DDE 'Iso1PwrDelivEvseIsolStatusPres'. */
/begin MEASUREMENT Iso1PwrDelivEvseIsolStatusPres "Identifies the presence of the EVSEIsolationStatus_present, EVSEIsolationStatus" UBYTE CU_ISO1PWRDELIVEVSEISOLSTATUSP0 1 100 0.0 1.0 ECU_ADDRESS 0x70018380 BYTE_ORDER MSB_LAST /end MEASUREMENT
/begin COMPU_METHOD CU_ISO1PWRDELIVEVSEISOLSTATUSP0 "Conversion method for Iso1PwrDelivEvseIsolStatusPres" RAT_FUNC "%10.0" "b" COEFFS 0.000000 1.000000 -0.000000 0.000000 0.000000 1.000000 /end COMPU_METHOD
/* Scalar measurable for DDE 'Iso1PwrDelivEvseStatusCode'. */
/begin MEASUREMENT Iso1PwrDelivEvseStatusCode "Indicates the internal state of the EVSE." UBYTE CU_ISO1PWRDELIVEVSESTATUSCODE 1 100 0.0 255.0 ECU_ADDRESS 0x70017e80 BYTE_ORDER MSB_LAST /end MEASUREMENT
/begin COMPU_METHOD CU_ISO1PWRDELIVEVSESTATUSCODE "Conversion method for Iso1PwrDelivEvseStatusCode" RAT_FUNC "%10.0" "enum" COEFFS 0.000000 1.000000 -0.000000 0.000000 0.000000 1.000000 /end COMPU_METHOD
/* Scalar measurable for DDE 'Iso1PwrDelivEvseStatusPresent'. */
/begin MEASUREMENT Iso1PwrDelivEvseStatusPresent "Identifies the presence of the EVSEStatusCode_present, and EVSEStatusCode parameters." UBYTE CU_ISO1PWRDELIVEVSESTATUSPRESE0 1 100 0.0 1.0 ECU_ADDRESS 0x700182c8 BYTE_ORDER MSB_LAST /end MEASUREMENT
/begin COMPU_METHOD CU_ISO1PWRDELIVEVSESTATUSPRESE0 "Conversion method for Iso1PwrDelivEvseStatusPresent" RAT_FUNC "%10.0" "b" COEFFS 0.000000 1.000000 -0.000000 0.000000 0.000000 1.000000 /end COMPU_METHOD
/* Scalar measurable for DDE 'Iso1PwrDelivNotifMaxDelay'. */
/begin MEASUREMENT Iso1PwrDelivNotifMaxDelay "The Notification Max Delay parameter in the received message from EVSE" UWORD CU_ISO1PWRDELIVNOTIFMAXDELAY 1 100 0.0 65535.0 ECU_ADDRESS 0x70017dd8 BYTE_ORDER MSB_LAST /end MEASUREMENT
/begin COMPU_METHOD CU_ISO1PWRDELIVNOTIFMAXDELAY "Conversion method for Iso1PwrDelivNotifMaxDelay" RAT_FUNC "%10.0" "s" COEFFS 0.000000 1.000000 -0.000000 0.000000 0.000000 1.000000 /end COMPU_METHOD
/* Scalar measurable for DDE 'Iso1SesSetupEvseId[0]'. */
/begin MEASUREMENT Iso1SesSetupEvseId[0] "The ID that uniquely identifies the EVSE. Format is defined in the ISO 15118 ED2 Spec Annex H" UBYTE CU_ISO1SESSETUPEVSEID[0] 1 100 0.0 255.0 ECU_ADDRESS 0x70018211 BYTE_ORDER MSB_LAST /end MEASUREMENT
/begin COMPU_METHOD CU_ISO1SESSETUPEVSEID[0] "Conversion method for Iso1SesSetupEvseId[0]" RAT_FUNC "%10.0" "1" COEFFS 0.000000 1.000000 -0.000000 0.000000 0.000000 1.000000 /end COMPU_METHOD
/* Scalar measurable for DDE 'Iso1SesSetupEvseId[10]'. */
/begin MEASUREMENT Iso1SesSetupEvseId[10] "The ID that uniquely identifies the EVSE. Format is defined in the ISO 15118 ED2 Spec Annex H" UBYTE CU_ISO1SESSETUPEVSEID[10] 1 100 0.0 255.0 ECU_ADDRESS 0x7001821b BYTE_ORDER MSB_LAST /end MEASUREMENT
/begin COMPU_METHOD CU_ISO1SESSETUPEVSEID[10] "Conversion method for Iso1SesSetupEvseId[10]" RAT_FUNC "%10.0" "1" COEFFS 0.000000 1.000000 -0.000000 0.000000 0.000000 1.000000 /end COMPU_METHOD
/* Scalar measurable for DDE 'Iso1SesSetupEvseId[11]'. */
/begin MEASUREMENT Iso1SesSetupEvseId[11] "The ID that uniquely identifies the EVSE. Format is defined in the ISO 15118 ED2 Spec Annex H" UBYTE CU_ISO1SESSETUPEVSEID[11] 1 100 0.0 255.0 ECU_ADDRESS 0x7001821c BYTE_ORDER MSB_LAST /end MEASUREMENT
/begin COMPU_METHOD CU_ISO1SESSETUPEVSEID[11] "Conversion method for Iso1SesSetupEvseId[11]" RAT_FUNC "%10.0" "1" COEFFS 0.000000 1.000000 -0.000000 0.000000 0.000000 1.000000 /end COMPU_METHOD
/* Scalar measurable for DDE 'Iso1SesSetupEvseId[12]'. */
/begin MEASUREMENT Iso1SesSetupEvseId[12] "The ID that uniquely identifies the EVSE. Format is defined in the ISO 15118 ED2 Spec Annex H" UBYTE CU_ISO1SESSETUPEVSEID[12] 1 100 0.0 255.0 ECU_ADDRESS 0x7001821d BYTE_ORDER MSB_LAST /end MEASUREMENT
/begin COMPU_METHOD CU_ISO1SESSETUPEVSEID[12] "Conversion method for Iso1SesSetupEvseId[12]" RAT_FUNC "%10.0" "1" COEFFS 0.000000 1.000000 -0.000000 0.000000 0.000000 1.000000 /end COMPU_METHOD
/* Scalar measurable for DDE 'Iso1SesSetupEvseId[13]'. */
/begin MEASUREMENT Iso1SesSetupEvseId[13] "The ID that uniquely identifies the EVSE. Format is defined in the ISO 15118 ED2 Spec Annex H" UBYTE CU_ISO1SESSETUPEVSEID[13] 1 100 0.0 255.0 ECU_ADDRESS 0x7001821e BYTE_ORDER MSB_LAST /end MEASUREMENT
/begin COMPU_METHOD CU_ISO1SESSETUPEVSEID[13] "Conversion method for Iso1SesSetupEvseId[13]" RAT_FUNC "%10.0" "1" COEFFS 0.000000 1.000000 -0.000000 0.000000 0.000000 1.000000 /end COMPU_METHOD
/* Scalar measurable for DDE 'Iso1SesSetupEvseId[14]'. */
/begin MEASUREMENT Iso1SesSetupEvseId[14] "The ID that uniquely identifies the EVSE. Format is defined in the ISO 15118 ED2 Spec Annex H" UBYTE CU_ISO1SESSETUPEVSEID[14] 1 100 0.0 255.0 ECU_ADDRESS 0x7001821f BYTE_ORDER MSB_LAST /end MEASUREMENT
/begin COMPU_METHOD CU_ISO1SESSETUPEVSEID[14] "Conversion method for Iso1SesSetupEvseId[14]" RAT_FUNC "%10.0" "1" COEFFS 0.000000 1.000000 -0.000000 0.000000 0.000000 1.000000 /end COMPU_METHOD
/* Scalar measurable for DDE 'Iso1SesSetupEvseId[15]'. */
/begin MEASUREMENT Iso1SesSetupEvseId[15] "The ID that uniquely identifies the EVSE. Format is defined in the ISO 15118 ED2 Spec Annex H" UBYTE CU_ISO1SESSETUPEVSEID[15] 1 100 0.0 255.0 ECU_ADDRESS 0x70018220 BYTE_ORDER MSB_LAST /end MEASUREMENT
/begin COMPU_METHOD CU_ISO1SESSETUPEVSEID[15] "Conversion method for Iso1SesSetupEvseId[15]" RAT_FUNC "%10.0" "1" COEFFS 0.000000 1.000000 -0.000000 0.000000 0.000000 1.000000 /end COMPU_METHOD
/* Scalar measurable for DDE 'Iso1SesSetupEvseId[16]'. */
/begin MEASUREMENT Iso1SesSetupEvseId[16] "The ID that uniquely identifies the EVSE. Format is defined in the ISO 15118 ED2 Spec Annex H" UBYTE CU_ISO1SESSETUPEVSEID[16] 1 100 0.0 255.0 ECU_ADDRESS 0x70018221 BYTE_ORDER MSB_LAST /end MEASUREMENT
/begin COMPU_METHOD CU_ISO1SESSETUPEVSEID[16] "Conversion method for Iso1SesSetupEvseId[16]" RAT_FUNC "%10.0" "1" COEFFS 0.000000 1.000000 -0.000000 0.000000 0.000000 1.000000 /end COMPU_METHOD
/* Scalar measurable for DDE 'Iso1SesSetupEvseId[17]'. */
/begin MEASUREMENT Iso1SesSetupEvseId[17] "The ID that uniquely identifies the EVSE. Format is defined in the ISO 15118 ED2 Spec Annex H" UBYTE CU_ISO1SESSETUPEVSEID[17] 1 100 0.0 255.0 ECU_ADDRESS 0x70018222 BYTE_ORDER MSB_LAST /end MEASUREMENT
/begin COMPU_METHOD CU_ISO1SESSETUPEVSEID[17] "Conversion method for Iso1SesSetupEvseId[17]" RAT_FUNC "%10.0" "1" COEFFS 0.000000 1.000000 -0.000000 0.000000 0.000000 1.000000 /end COMPU_METHOD
/* Scalar measurable for DDE 'Iso1SesSetupEvseId[18]'. */
/begin MEASUREMENT Iso1SesSetupEvseId[18] "The ID that uniquely identifies the EVSE. Format is defined in the ISO 15118 ED2 Spec Annex H" UBYTE CU_ISO1SESSETUPEVSEID[18] 1 100 0.0 255.0 ECU_ADDRESS 0x70018223 BYTE_ORDER MSB_LAST /end MEASUREMENT
/begin COMPU_METHOD CU_ISO1SESSETUPEVSEID[18] "Conversion method for Iso1SesSetupEvseId[18]" RAT_FUNC "%10.0" "1" COEFFS 0.000000 1.000000 -0.000000 0.000000 0.000000 1.000000 /end COMPU_METHOD
/* Scalar measurable for DDE 'Iso1SesSetupEvseId[19]'. */
/begin MEASUREMENT Iso1SesSetupEvseId[19] "The ID that uniquely identifies the EVSE. Format is defined in the ISO 15118 ED2 Spec Annex H" UBYTE CU_ISO1SESSETUPEVSEID[19] 1 100 0.0 255.0 ECU_ADDRESS 0x70018224 BYTE_ORDER MSB_LAST /end MEASUREMENT
/begin COMPU_METHOD CU_ISO1SESSETUPEVSEID[19] "Conversion method for Iso1SesSetupEvseId[19]" RAT_FUNC "%10.0" "1" COEFFS 0.000000 1.000000 -0.000000 0.000000 0.000000 1.000000 /end COMPU_METHOD
/* Scalar measurable for DDE 'Iso1SesSetupEvseId[1]'. */
/begin MEASUREMENT Iso1SesSetupEvseId[1] "The ID that uniquely identifies the EVSE. Format is defined in the ISO 15118 ED2 Spec Annex H" UBYTE CU_ISO1SESSETUPEVSEID[1] 1 100 0.0 255.0 ECU_ADDRESS 0x70018212 BYTE_ORDER MSB_LAST /end MEASUREMENT
/begin COMPU_METHOD CU_ISO1SESSETUPEVSEID[1] "Conversion method for Iso1SesSetupEvseId[1]" RAT_FUNC "%10.0" "1" COEFFS 0.000000 1.000000 -0.000000 0.000000 0.000000 1.000000 /end COMPU_METHOD
/* Scalar measurable for DDE 'Iso1SesSetupEvseId[20]'. */
/begin MEASUREMENT Iso1SesSetupEvseId[20] "The ID that uniquely identifies the EVSE. Format is defined in the ISO 15118 ED2 Spec Annex H" UBYTE CU_ISO1SESSETUPEVSEID[20] 1 100 0.0 255.0 ECU_ADDRESS 0x70018225 BYTE_ORDER MSB_LAST /end MEASUREMENT
/begin COMPU_METHOD CU_ISO1SESSETUPEVSEID[20] "Conversion method for Iso1SesSetupEvseId[20]" RAT_FUNC "%10.0" "1" COEFFS 0.000000 1.000000 -0.000000 0.000000 0.000000 1.000000 /end COMPU_METHOD
/* Scalar measurable for DDE 'Iso1SesSetupEvseId[21]'. */
/begin MEASUREMENT Iso1SesSetupEvseId[21] "The ID that uniquely identifies the EVSE. Format is defined in the ISO 15118 ED2 Spec Annex H" UBYTE CU_ISO1SESSETUPEVSEID[21] 1 100 0.0 255.0 ECU_ADDRESS 0x70018226 BYTE_ORDER MSB_LAST /end MEASUREMENT
/begin COMPU_METHOD CU_ISO1SESSETUPEVSEID[21] "Conversion method for Iso1SesSetupEvseId[21]" RAT_FUNC "%10.0" "1" COEFFS 0.000000 1.000000 -0.000000 0.000000 0.000000 1.000000 /end COMPU_METHOD
/* Scalar measurable for DDE 'Iso1SesSetupEvseId[22]'. */
/begin MEASUREMENT Iso1SesSetupEvseId[22] "The ID that uniquely identifies the EVSE. Format is defined in the ISO 15118 ED2 Spec Annex H" UBYTE CU_ISO1SESSETUPEVSEID[22] 1 100 0.0 255.0 ECU_ADDRESS 0x70018227 BYTE_ORDER MSB_LAST /end MEASUREMENT
/begin COMPU_METHOD CU_ISO1SESSETUPEVSEID[22] "Conversion method for Iso1SesSetupEvseId[22]" RAT_FUNC "%10.0" "1" COEFFS 0.000000 1.000000 -0.000000 0.000000 0.000000 1.000000 /end COMPU_METHOD
/* Scalar measurable for DDE 'Iso1SesSetupEvseId[23]'. */
/begin MEASUREMENT Iso1SesSetupEvseId[23] "The ID that uniquely identifies the EVSE. Format is defined in the ISO 15118 ED2 Spec Annex H" UBYTE CU_ISO1SESSETUPEVSEID[23] 1 100 0.0 255.0 ECU_ADDRESS 0x70018228 BYTE_ORDER MSB_LAST /end MEASUREMENT
/begin COMPU_METHOD CU_ISO1SESSETUPEVSEID[23] "Conversion method for Iso1SesSetupEvseId[23]" RAT_FUNC "%10.0" "1" COEFFS 0.000000 1.000000 -0.000000 0.000000 0.000000 1.000000 /end COMPU_METHOD
/* Scalar measurable for DDE 'Iso1SesSetupEvseId[24]'. */
/begin MEASUREMENT Iso1SesSetupEvseId[24] "The ID that uniquely identifies the EVSE. Format is defined in the ISO 15118 ED2 Spec Annex H" UBYTE CU_ISO1SESSETUPEVSEID[24] 1 100 0.0 255.0 ECU_ADDRESS 0x70018229 BYTE_ORDER MSB_LAST /end MEASUREMENT
/begin COMPU_METHOD CU_ISO1SESSETUPEVSEID[24] "Conversion method for Iso1SesSetupEvseId[24]" RAT_FUNC "%10.0" "1" COEFFS 0.000000 1.000000 -0.000000 0.000000 0.000000 1.000000 /end COMPU_METHOD
/* Scalar measurable for DDE 'Iso1SesSetupEvseId[25]'. */
/begin MEASUREMENT Iso1SesSetupEvseId[25] "The ID that uniquely identifies the EVSE. Format is defined in the ISO 15118 ED2 Spec Annex H" UBYTE CU_ISO1SESSETUPEVSEID[25] 1 100 0.0 255.0 ECU_ADDRESS 0x7001822a BYTE_ORDER MSB_LAST /end MEASUREMENT
/begin COMPU_METHOD CU_ISO1SESSETUPEVSEID[25] "Conversion method for Iso1SesSetupEvseId[25]" RAT_FUNC "%10.0" "1" COEFFS 0.000000 1.000000 -0.000000 0.000000 0.000000 1.000000 /end COMPU_METHOD
/* Scalar measurable for DDE 'Iso1SesSetupEvseId[26]'. */
/begin MEASUREMENT Iso1SesSetupEvseId[26] "The ID that uniquely identifies the EVSE. Format is defined in the ISO 15118 ED2 Spec Annex H" UBYTE CU_ISO1SESSETUPEVSEID[26] 1 100 0.0 255.0 ECU_ADDRESS 0x7001822b BYTE_ORDER MSB_LAST /end MEASUREMENT
/begin COMPU_METHOD CU_ISO1SESSETUPEVSEID[26] "Conversion method for Iso1SesSetupEvseId[26]" RAT_FUNC "%10.0" "1" COEFFS 0.000000 1.000000 -0.000000 0.000000 0.000000 1.000000 /end COMPU_METHOD
/* Scalar measurable for DDE 'Iso1SesSetupEvseId[27]'. */
/begin MEASUREMENT Iso1SesSetupEvseId[27] "The ID that uniquely identifies the EVSE. Format is defined in the ISO 15118 ED2 Spec Annex H" UBYTE CU_ISO1SESSETUPEVSEID[27] 1 100 0.0 255.0 ECU_ADDRESS 0x7001822c BYTE_ORDER MSB_LAST /end MEASUREMENT
/begin COMPU_METHOD CU_ISO1SESSETUPEVSEID[27] "Conversion method for Iso1SesSetupEvseId[27]" RAT_FUNC "%10.0" "1" COEFFS 0.000000 1.000000 -0.000000 0.000000 0.000000 1.000000 /end COMPU_METHOD
/* Scalar measurable for DDE 'Iso1SesSetupEvseId[28]'. */
/begin MEASUREMENT Iso1SesSetupEvseId[28] "The ID that uniquely identifies the EVSE. Format is defined in the ISO 15118 ED2 Spec Annex H" UBYTE CU_ISO1SESSETUPEVSEID[28] 1 100 0.0 255.0 ECU_ADDRESS 0x7001822d BYTE_ORDER MSB_LAST /end MEASUREMENT
/begin COMPU_METHOD CU_ISO1SESSETUPEVSEID[28] "Conversion method for Iso1SesSetupEvseId[28]" RAT_FUNC "%10.0" "1" COEFFS 0.000000 1.000000 -0.000000 0.000000 0.000000 1.000000 /end COMPU_METHOD
/* Scalar measurable for DDE 'Iso1SesSetupEvseId[29]'. */
/begin MEASUREMENT Iso1SesSetupEvseId[29] "The ID that uniquely identifies the EVSE. Format is defined in the ISO 15118 ED2 Spec Annex H" UBYTE CU_ISO1SESSETUPEVSEID[29] 1 100 0.0 255.0 ECU_ADDRESS 0x7001822e BYTE_ORDER MSB_LAST /end MEASUREMENT
/begin COMPU_METHOD CU_ISO1SESSETUPEVSEID[29] "Conversion method for Iso1SesSetupEvseId[29]" RAT_FUNC "%10.0" "1" COEFFS 0.000000 1.000000 -0.000000 0.000000 0.000000 1.000000 /end COMPU_METHOD
/* Scalar measurable for DDE 'Iso1SesSetupEvseId[2]'. */
/begin MEASUREMENT Iso1SesSetupEvseId[2] "The ID that uniquely identifies the EVSE. Format is defined in the ISO 15118 ED2 Spec Annex H" UBYTE CU_ISO1SESSETUPEVSEID[2] 1 100 0.0 255.0 ECU_ADDRESS 0x70018213 BYTE_ORDER MSB_LAST /end MEASUREMENT
/begin COMPU_METHOD CU_ISO1SESSETUPEVSEID[2] "Conversion method for Iso1SesSetupEvseId[2]" RAT_FUNC "%10.0" "1" COEFFS 0.000000 1.000000 -0.000000 0.000000 0.000000 1.000000 /end COMPU_METHOD
/* Scalar measurable for DDE 'Iso1SesSetupEvseId[30]'. */
/begin MEASUREMENT Iso1SesSetupEvseId[30] "The ID that uniquely identifies the EVSE. Format is defined in the ISO 15118 ED2 Spec Annex H" UBYTE CU_ISO1SESSETUPEVSEID[30] 1 100 0.0 255.0 ECU_ADDRESS 0x7001822f BYTE_ORDER MSB_LAST /end MEASUREMENT
/begin COMPU_METHOD CU_ISO1SESSETUPEVSEID[30] "Conversion method for Iso1SesSetupEvseId[30]" RAT_FUNC "%10.0" "1" COEFFS 0.000000 1.000000 -0.000000 0.000000 0.000000 1.000000 /end COMPU_METHOD
/* Scalar measurable for DDE 'Iso1SesSetupEvseId[31]'. */
/begin MEASUREMENT Iso1SesSetupEvseId[31] "The ID that uniquely identifies the EVSE. Format is defined in the ISO 15118 ED2 Spec Annex H" UBYTE CU_ISO1SESSETUPEVSEID[31] 1 100 0.0 255.0 ECU_ADDRESS 0x70018230 BYTE_ORDER MSB_LAST /end MEASUREMENT
/begin COMPU_METHOD CU_ISO1SESSETUPEVSEID[31] "Conversion method for Iso1SesSetupEvseId[31]" RAT_FUNC "%10.0" "1" COEFFS 0.000000 1.000000 -0.000000 0.000000 0.000000 1.000000 /end COMPU_METHOD
/* Scalar measurable for DDE 'Iso1SesSetupEvseId[32]'. */
/begin MEASUREMENT Iso1SesSetupEvseId[32] "The ID that uniquely identifies the EVSE. Format is defined in the ISO 15118 ED2 Spec Annex H" UBYTE CU_ISO1SESSETUPEVSEID[32] 1 100 0.0 255.0 ECU_ADDRESS 0x70018231 BYTE_ORDER MSB_LAST /end MEASUREMENT
/begin COMPU_METHOD CU_ISO1SESSETUPEVSEID[32] "Conversion method for Iso1SesSetupEvseId[32]" RAT_FUNC "%10.0" "1" COEFFS 0.000000 1.000000 -0.000000 0.000000 0.000000 1.000000 /end COMPU_METHOD
/* Scalar measurable for DDE 'Iso1SesSetupEvseId[33]'. */
/begin MEASUREMENT Iso1SesSetupEvseId[33] "The ID that uniquely identifies the EVSE. Format is defined in the ISO 15118 ED2 Spec Annex H" UBYTE CU_ISO1SESSETUPEVSEID[33] 1 100 0.0 255.0 ECU_ADDRESS 0x70018232 BYTE_ORDER MSB_LAST /end MEASUREMENT
/begin COMPU_METHOD CU_ISO1SESSETUPEVSEID[33] "Conversion method for Iso1SesSetupEvseId[33]" RAT_FUNC "%10.0" "1" COEFFS 0.000000 1.000000 -0.000000 0.000000 0.000000 1.000000 /end COMPU_METHOD
/* Scalar measurable for DDE 'Iso1SesSetupEvseId[34]'. */
/begin MEASUREMENT Iso1SesSetupEvseId[34] "The ID that uniquely identifies the EVSE. Format is defined in the ISO 15118 ED2 Spec Annex H" UBYTE CU_ISO1SESSETUPEVSEID[34] 1 100 0.0 255.0 ECU_ADDRESS 0x70018233 BYTE_ORDER MSB_LAST /end MEASUREMENT
/begin COMPU_METHOD CU_ISO1SESSETUPEVSEID[34] "Conversion method for Iso1SesSetupEvseId[34]" RAT_FUNC "%10.0" "1" COEFFS 0.000000 1.000000 -0.000000 0.000000 0.000000 1.000000 /end COMPU_METHOD
/* Scalar measurable for DDE 'Iso1SesSetupEvseId[35]'. */
/begin MEASUREMENT Iso1SesSetupEvseId[35] "The ID that uniquely identifies the EVSE. Format is defined in the ISO 15118 ED2 Spec Annex H" UBYTE CU_ISO1SESSETUPEVSEID[35] 1 100 0.0 255.0 ECU_ADDRESS 0x70018234 BYTE_ORDER MSB_LAST /end MEASUREMENT
/begin COMPU_METHOD CU_ISO1SESSETUPEVSEID[35] "Conversion method for Iso1SesSetupEvseId[35]" RAT_FUNC "%10.0" "1" COEFFS 0.000000 1.000000 -0.000000 0.000000 0.000000 1.000000 /end COMPU_METHOD
/* Scalar measurable for DDE 'Iso1SesSetupEvseId[36]'. */
/begin MEASUREMENT Iso1SesSetupEvseId[36] "The ID that uniquely identifies the EVSE. Format is defined in the ISO 15118 ED2 Spec Annex H" UBYTE CU_ISO1SESSETUPEVSEID[36] 1 100 0.0 255.0 ECU_ADDRESS 0x70018235 BYTE_ORDER MSB_LAST /end MEASUREMENT
/begin COMPU_METHOD CU_ISO1SESSETUPEVSEID[36] "Conversion method for Iso1SesSetupEvseId[36]" RAT_FUNC "%10.0" "1" COEFFS 0.000000 1.000000 -0.000000 0.000000 0.000000 1.000000 /end COMPU_METHOD
/* Scalar measurable for DDE 'Iso1SesSetupEvseId[37]'. */
/begin MEASUREMENT Iso1SesSetupEvseId[37] "The ID that uniquely identifies the EVSE. Format is defined in the ISO 15118 ED2 Spec Annex H" UBYTE CU_ISO1SESSETUPEVSEID[37] 1 100 0.0 255.0 ECU_ADDRESS 0x70018236 BYTE_ORDER MSB_LAST /end MEASUREMENT
/begin COMPU_METHOD CU_ISO1SESSETUPEVSEID[37] "Conversion method for Iso1SesSetupEvseId[37]" RAT_FUNC "%10.0" "1" COEFFS 0.000000 1.000000 -0.000000 0.000000 0.000000 1.000000 /end COMPU_METHOD
/* Scalar measurable for DDE 'Iso1SesSetupEvseId[3]'. */
/begin MEASUREMENT Iso1SesSetupEvseId[3] "The ID that uniquely identifies the EVSE. Format is defined in the ISO 15118 ED2 Spec Annex H" UBYTE CU_ISO1SESSETUPEVSEID[3] 1 100 0.0 255.0 ECU_ADDRESS 0x70018214 BYTE_ORDER MSB_LAST /end MEASUREMENT
/begin COMPU_METHOD CU_ISO1SESSETUPEVSEID[3] "Conversion method for Iso1SesSetupEvseId[3]" RAT_FUNC "%10.0" "1" COEFFS 0.000000 1.000000 -0.000000 0.000000 0.000000 1.000000 /end COMPU_METHOD
/* Scalar measurable for DDE 'Iso1SesSetupEvseId[4]'. */
/begin MEASUREMENT Iso1SesSetupEvseId[4] "The ID that uniquely identifies the EVSE. Format is defined in the ISO 15118 ED2 Spec Annex H" UBYTE CU_ISO1SESSETUPEVSEID[4] 1 100 0.0 255.0 ECU_ADDRESS 0x70018215 BYTE_ORDER MSB_LAST /end MEASUREMENT
/begin COMPU_METHOD CU_ISO1SESSETUPEVSEID[4] "Conversion method for Iso1SesSetupEvseId[4]" RAT_FUNC "%10.0" "1" COEFFS 0.000000 1.000000 -0.000000 0.000000 0.000000 1.000000 /end COMPU_METHOD
/* Scalar measurable for DDE 'Iso1SesSetupEvseId[5]'. */
/begin MEASUREMENT Iso1SesSetupEvseId[5] "The ID that uniquely identifies the EVSE. Format is defined in the ISO 15118 ED2 Spec Annex H" UBYTE CU_ISO1SESSETUPEVSEID[5] 1 100 0.0 255.0 ECU_ADDRESS 0x70018216 BYTE_ORDER MSB_LAST /end MEASUREMENT
/begin COMPU_METHOD CU_ISO1SESSETUPEVSEID[5] "Conversion method for Iso1SesSetupEvseId[5]" RAT_FUNC "%10.0" "1" COEFFS 0.000000 1.000000 -0.000000 0.000000 0.000000 1.000000 /end COMPU_METHOD
/* Scalar measurable for DDE 'Iso1SesSetupEvseId[6]'. */
/begin MEASUREMENT Iso1SesSetupEvseId[6] "The ID that uniquely identifies the EVSE. Format is defined in the ISO 15118 ED2 Spec Annex H" UBYTE CU_ISO1SESSETUPEVSEID[6] 1 100 0.0 255.0 ECU_ADDRESS 0x70018217 BYTE_ORDER MSB_LAST /end MEASUREMENT
/begin COMPU_METHOD CU_ISO1SESSETUPEVSEID[6] "Conversion method for Iso1SesSetupEvseId[6]" RAT_FUNC "%10.0" "1" COEFFS 0.000000 1.000000 -0.000000 0.000000 0.000000 1.000000 /end COMPU_METHOD
/* Scalar measurable for DDE 'Iso1SesSetupEvseId[7]'. */
/begin MEASUREMENT Iso1SesSetupEvseId[7] "The ID that uniquely identifies the EVSE. Format is defined in the ISO 15118 ED2 Spec Annex H" UBYTE CU_ISO1SESSETUPEVSEID[7] 1 100 0.0 255.0 ECU_ADDRESS 0x70018218 BYTE_ORDER MSB_LAST /end MEASUREMENT
/begin COMPU_METHOD CU_ISO1SESSETUPEVSEID[7] "Conversion method for Iso1SesSetupEvseId[7]" RAT_FUNC "%10.0" "1" COEFFS 0.000000 1.000000 -0.000000 0.000000 0.000000 1.000000 /end COMPU_METHOD
/* Scalar measurable for DDE 'Iso1SesSetupEvseId[8]'. */
/begin MEASUREMENT Iso1SesSetupEvseId[8] "The ID that uniquely identifies the EVSE. Format is defined in the ISO 15118 ED2 Spec Annex H" UBYTE CU_ISO1SESSETUPEVSEID[8] 1 100 0.0 255.0 ECU_ADDRESS 0x70018219 BYTE_ORDER MSB_LAST /end MEASUREMENT
/begin COMPU_METHOD CU_ISO1SESSETUPEVSEID[8] "Conversion method for Iso1SesSetupEvseId[8]" RAT_FUNC "%10.0" "1" COEFFS 0.000000 1.000000 -0.000000 0.000000 0.000000 1.000000 /end COMPU_METHOD
/* Scalar measurable for DDE 'Iso1SesSetupEvseId[9]'. */
/begin MEASUREMENT Iso1SesSetupEvseId[9] "The ID that uniquely identifies the EVSE. Format is defined in the ISO 15118 ED2 Spec Annex H" UBYTE CU_ISO1SESSETUPEVSEID[9] 1 100 0.0 255.0 ECU_ADDRESS 0x7001821a BYTE_ORDER MSB_LAST /end MEASUREMENT
/begin COMPU_METHOD CU_ISO1SESSETUPEVSEID[9] "Conversion method for Iso1SesSetupEvseId[9]" RAT_FUNC "%10.0" "1" COEFFS 0.000000 1.000000 -0.000000 0.000000 0.000000 1.000000 /end COMPU_METHOD
/* Scalar measurable for DDE 'Iso1SesSetupTimestamp'. */
/begin MEASUREMENT Iso1SesSetupTimestamp "Timestamp of the current SECC time using the Unix Time Stamp format." SLONG CU_ISO1SESSETUPTIMESTAMP 1 100 0.0 2147483647.0 ECU_ADDRESS 0x70017d30 BYTE_ORDER MSB_LAST /end MEASUREMENT
/begin COMPU_METHOD CU_ISO1SESSETUPTIMESTAMP "Conversion method for Iso1SesSetupTimestamp" RAT_FUNC "%10.0" "1" COEFFS 0.000000 1.000000 -0.000000 0.000000 0.000000 1.000000 /end COMPU_METHOD
/* Scalar measurable for DDE 'Iso1SvcDetailRxTrg'. */
/begin MEASUREMENT Iso1SvcDetailRxTrg "Trigger flag that on a rising edge indicates the event for receiving the PLC (V2G) ServiceDetailRes message from the EVSE" UBYTE CU_ISO1SVCDETAILRXTRG 1 100 0.0 1.0 ECU_ADDRESS 0x70018185 BYTE_ORDER MSB_LAST /end MEASUREMENT
/begin COMPU_METHOD CU_ISO1SVCDETAILRXTRG "Conversion method for Iso1SvcDetailRxTrg" RAT_FUNC "%10.0" "b" COEFFS 0.000000 1.000000 -0.000000 0.000000 0.000000 1.000000 /end COMPU_METHOD
/* Scalar measurable for DDE 'Iso1SvcDiscFreeSvc'. */
/begin MEASUREMENT Iso1SvcDiscFreeSvc "If true, indicates that the service can be used free of charge." UBYTE CU_ISO1SVCDISCFREESVC 1 100 0.0 1.0 ECU_ADDRESS 0x70017c59 BYTE_ORDER MSB_LAST /end MEASUREMENT
/begin COMPU_METHOD CU_ISO1SVCDISCFREESVC "Conversion method for Iso1SvcDiscFreeSvc" RAT_FUNC "%10.0" "b" COEFFS 0.000000 1.000000 -0.000000 0.000000 0.000000 1.000000 /end COMPU_METHOD
/* Scalar measurable for DDE 'Iso1SvcDiscRescode'. */
/begin MEASUREMENT Iso1SvcDiscRescode "for ISOv1 ServiceDiscoveryRes  message: indicates the acknowledgment status of this V2G messages received by the SECC." UBYTE CU_ISO1SVCDISCRESCODE 1 100 0.0 255.0 ECU_ADDRESS 0x70018046 BYTE_ORDER MSB_LAST /end MEASUREMENT
/begin COMPU_METHOD CU_ISO1SVCDISCRESCODE "Conversion method for Iso1SvcDiscRescode" RAT_FUNC "%10.0" "1" COEFFS 0.000000 1.000000 -0.000000 0.000000 0.000000 1.000000 /end COMPU_METHOD
/* Scalar measurable for DDE 'Iso1SvcDiscSvcListSize'. */
/begin MEASUREMENT Iso1SvcDiscSvcListSize "The Service List Size parameter in the received message from EVSE" UBYTE CU_ISO1SVCDISCSVCLISTSIZE 1 100 0.0 255.0 ECU_ADDRESS 0x70018481 BYTE_ORDER MSB_LAST /end MEASUREMENT
/begin COMPU_METHOD CU_ISO1SVCDISCSVCLISTSIZE "Conversion method for Iso1SvcDiscSvcListSize" RAT_FUNC "%10.0" "1" COEFFS 0.000000 1.000000 -0.000000 0.000000 0.000000 1.000000 /end COMPU_METHOD
/* Scalar measurable for DDE 'Iso1WeldDetNotifMaxDelay'. */
/begin MEASUREMENT Iso1WeldDetNotifMaxDelay "The Notification Max Delay parameter in the received message from EVSE" UWORD CU_ISO1WELDDETNOTIFMAXDELAY 1 100 0.0 65535.0 ECU_ADDRESS 0x70017f7e BYTE_ORDER MSB_LAST /end MEASUREMENT
/begin COMPU_METHOD CU_ISO1WELDDETNOTIFMAXDELAY "Conversion method for Iso1WeldDetNotifMaxDelay" RAT_FUNC "%10.0" "s" COEFFS 0.000000 1.000000 -0.000000 0.000000 0.000000 1.000000 /end COMPU_METHOD
/* Scalar measurable for DDE 'Iso1WeldDetRxTrg'. */
/begin MEASUREMENT Iso1WeldDetRxTrg "Trigger falg that on a rising edge indicates the event for receiving the PLC (V2G) message response 9b from EVSE" UBYTE CU_ISO1WELDDETRXTRG 1 100 0.0 1.0 ECU_ADDRESS 0x700183bb BYTE_ORDER MSB_LAST /end MEASUREMENT
/begin COMPU_METHOD CU_ISO1WELDDETRXTRG "Conversion method for Iso1WeldDetRxTrg" RAT_FUNC "%10.0" "b" COEFFS 0.000000 1.000000 -0.000000 0.000000 0.000000 1.000000 /end COMPU_METHOD
/* Scalar measurable for DDE 'Iso2DcBiDirParCrntRegTol'. */
/begin MEASUREMENT Iso2DcBiDirParCrntRegTol "Indicates the DC Supplys ability to regulate current with respect to the current request" FLOAT32_IEEE CU_ISO2DCBIDIRPARCRNTREGTOL 1 100 -3.40282346639e+38 3.40282346639e+38 ECU_ADDRESS 0x70017d6c BYTE_ORDER MSB_LAST /end MEASUREMENT
/begin COMPU_METHOD CU_ISO2DCBIDIRPARCRNTREGTOL "Conversion method for Iso2DcBiDirParCrntRegTol" RAT_FUNC "%10.0" "%" COEFFS 0.000000 1.000000 -0.000000 0.000000 0.000000 1.000000 /end COMPU_METHOD
/* Scalar measurable for DDE 'Iso2DcBiDirParCrntRegTolPres'. */
/begin MEASUREMENT Iso2DcBiDirParCrntRegTolPres "Indicates the presence of the Iso2DcChgParCrntRegTol parameter" UBYTE CU_ISO2DCBIDIRPARCRNTREGTOLPRES 1 100 0.0 255.0 ECU_ADDRESS 0x7001846d BYTE_ORDER MSB_LAST /end MEASUREMENT
/begin COMPU_METHOD CU_ISO2DCBIDIRPARCRNTREGTOLPRES "Conversion method for Iso2DcBiDirParCrntRegTolPres" RAT_FUNC "%10.0" "%" COEFFS 0.000000 1.000000 -0.000000 0.000000 0.000000 1.000000 /end COMPU_METHOD
/* Scalar measurable for DDE 'Iso2DcBiDirParDataVal'. */
/begin MEASUREMENT Iso2DcBiDirParDataVal "Indicates whether the DC EVSE Charge Parameter data is available to be read" UBYTE CU_ISO2DCBIDIRPARDATAVAL 1 100 0.0 255.0 ECU_ADDRESS 0x70017d97 BYTE_ORDER MSB_LAST /end MEASUREMENT
/begin COMPU_METHOD CU_ISO2DCBIDIRPARDATAVAL "Conversion method for Iso2DcBiDirParDataVal" RAT_FUNC "%10.0" "%" COEFFS 0.000000 1.000000 -0.000000 0.000000 0.000000 1.000000 /end COMPU_METHOD
/* Scalar measurable for DDE 'Iso2DcBiDirParEgyToBeDel'. */
/begin MEASUREMENT Iso2DcBiDirParEgyToBeDel "Indicates the allowed or requested units of energy to be delivered during charging (a charging target)" FLOAT32_IEEE CU_ISO2DCBIDIRPAREGYTOBEDEL 1 100 -3.40282346639e+38 3.40282346639e+38 ECU_ADDRESS 0x70018058 BYTE_ORDER MSB_LAST /end MEASUREMENT
/begin COMPU_METHOD CU_ISO2DCBIDIRPAREGYTOBEDEL "Conversion method for Iso2DcBiDirParEgyToBeDel" RAT_FUNC "%10.0" "%" COEFFS 0.000000 1.000000 -0.000000 0.000000 0.000000 1.000000 /end COMPU_METHOD
/* Scalar measurable for DDE 'Iso2DcBiDirParEgyToBeDelPres'. */
/begin MEASUREMENT Iso2DcBiDirParEgyToBeDelPres "Indicates the presence of the pv2gf_dc_energy_to_be_delivered parameter" UBYTE CU_ISO2DCBIDIRPAREGYTOBEDELPRES 1 100 0.0 255.0 ECU_ADDRESS 0x70018391 BYTE_ORDER MSB_LAST /end MEASUREMENT
/begin COMPU_METHOD CU_ISO2DCBIDIRPAREGYTOBEDELPRES "Conversion method for Iso2DcBiDirParEgyToBeDelPres" RAT_FUNC "%10.0" "%" COEFFS 0.000000 1.000000 -0.000000 0.000000 0.000000 1.000000 /end COMPU_METHOD
/* Scalar measurable for DDE 'Iso2DcBiDirParMaxChgCrnt'. */
/begin MEASUREMENT Iso2DcBiDirParMaxChgCrnt "Indicates the maximum current the EVSE can deliver" FLOAT32_IEEE CU_ISO2DCBIDIRPARMAXCHGCRNT 1 100 -3.40282346639e+38 3.40282346639e+38 ECU_ADDRESS 0x700181e8 BYTE_ORDER MSB_LAST /end MEASUREMENT
/begin COMPU_METHOD CU_ISO2DCBIDIRPARMAXCHGCRNT "Conversion method for Iso2DcBiDirParMaxChgCrnt" RAT_FUNC "%10.0" "%" COEFFS 0.000000 1.000000 -0.000000 0.000000 0.000000 1.000000 /end COMPU_METHOD
/* Scalar measurable for DDE 'Iso2DcBiDirParMaxChgPwr'. */
/begin MEASUREMENT Iso2DcBiDirParMaxChgPwr "Indicates the maximum power the EVSE can deliver" FLOAT32_IEEE CU_ISO2DCBIDIRPARMAXCHGPWR 1 100 -3.40282346639e+38 3.40282346639e+38 ECU_ADDRESS 0x70017f98 BYTE_ORDER MSB_LAST /end MEASUREMENT
/begin COMPU_METHOD CU_ISO2DCBIDIRPARMAXCHGPWR "Conversion method for Iso2DcBiDirParMaxChgPwr" RAT_FUNC "%10.0" "%" COEFFS 0.000000 1.000000 -0.000000 0.000000 0.000000 1.000000 /end COMPU_METHOD
/* Scalar measurable for DDE 'Iso2DcBiDirParMaxDischgCrnt'. */
/begin MEASUREMENT Iso2DcBiDirParMaxDischgCrnt "Indicates the maximum discharge current the EVSE can deliver" FLOAT32_IEEE CU_ISO2DCBIDIRPARMAXDISCHGCRNT 1 100 -3.40282346639e+38 3.40282346639e+38 ECU_ADDRESS 0x70017e14 BYTE_ORDER MSB_LAST /end MEASUREMENT
/begin COMPU_METHOD CU_ISO2DCBIDIRPARMAXDISCHGCRNT "Conversion method for Iso2DcBiDirParMaxDischgCrnt" RAT_FUNC "%10.0" "%" COEFFS 0.000000 1.000000 -0.000000 0.000000 0.000000 1.000000 /end COMPU_METHOD
/* Scalar measurable for DDE 'Iso2DcBiDirParMaxDischgPwr'. */
/begin MEASUREMENT Iso2DcBiDirParMaxDischgPwr "Indicates the the maximum discharge power the EVSE can deliver" FLOAT32_IEEE CU_ISO2DCBIDIRPARMAXDISCHGPWR 1 100 -3.40282346639e+38 3.40282346639e+38 ECU_ADDRESS 0x70017fcc BYTE_ORDER MSB_LAST /end MEASUREMENT
/begin COMPU_METHOD CU_ISO2DCBIDIRPARMAXDISCHGPWR "Conversion method for Iso2DcBiDirParMaxDischgPwr" RAT_FUNC "%10.0" "%" COEFFS 0.000000 1.000000 -0.000000 0.000000 0.000000 1.000000 /end COMPU_METHOD
/* Scalar measurable for DDE 'Iso2DcBiDirParMaxVolt'. */
/begin MEASUREMENT Iso2DcBiDirParMaxVolt "Indicates the maximum voltage the EVSE can deliver" FLOAT32_IEEE CU_ISO2DCBIDIRPARMAXVOLT 1 100 -3.40282346639e+38 3.40282346639e+38 ECU_ADDRESS 0x70018344 BYTE_ORDER MSB_LAST /end MEASUREMENT
/begin COMPU_METHOD CU_ISO2DCBIDIRPARMAXVOLT "Conversion method for Iso2DcBiDirParMaxVolt" RAT_FUNC "%10.0" "%" COEFFS 0.000000 1.000000 -0.000000 0.000000 0.000000 1.000000 /end COMPU_METHOD
/* Scalar measurable for DDE 'Iso2DcBiDirParMinChgCrnt'. */
/begin MEASUREMENT Iso2DcBiDirParMinChgCrnt "Indicates the minimum current the EVSE can deliver with the expected accuracy" FLOAT32_IEEE CU_ISO2DCBIDIRPARMINCHGCRNT 1 100 -3.40282346639e+38 3.40282346639e+38 ECU_ADDRESS 0x70017d4c BYTE_ORDER MSB_LAST /end MEASUREMENT
/begin COMPU_METHOD CU_ISO2DCBIDIRPARMINCHGCRNT "Conversion method for Iso2DcBiDirParMinChgCrnt" RAT_FUNC "%10.0" "%" COEFFS 0.000000 1.000000 -0.000000 0.000000 0.000000 1.000000 /end COMPU_METHOD
/* Scalar measurable for DDE 'Iso2DcBiDirParMinDischgCrnt'. */
/begin MEASUREMENT Iso2DcBiDirParMinDischgCrnt "Indicates the minimum discharge current the EVSE can deliver with the expected accuracy" FLOAT32_IEEE CU_ISO2DCBIDIRPARMINDISCHGCRNT 1 100 -3.40282346639e+38 3.40282346639e+38 ECU_ADDRESS 0x70018460 BYTE_ORDER MSB_LAST /end MEASUREMENT
/begin COMPU_METHOD CU_ISO2DCBIDIRPARMINDISCHGCRNT "Conversion method for Iso2DcBiDirParMinDischgCrnt" RAT_FUNC "%10.0" "%" COEFFS 0.000000 1.000000 -0.000000 0.000000 0.000000 1.000000 /end COMPU_METHOD
/* Scalar measurable for DDE 'Iso2DcBiDirParMinVolt'. */
/begin MEASUREMENT Iso2DcBiDirParMinVolt "Indicates the minimum voltage the EVSE can deliver with the expected accuracy" FLOAT32_IEEE CU_ISO2DCBIDIRPARMINVOLT 1 100 -3.40282346639e+38 3.40282346639e+38 ECU_ADDRESS 0x700182a8 BYTE_ORDER MSB_LAST /end MEASUREMENT
/begin COMPU_METHOD CU_ISO2DCBIDIRPARMINVOLT "Conversion method for Iso2DcBiDirParMinVolt" RAT_FUNC "%10.0" "%" COEFFS 0.000000 1.000000 -0.000000 0.000000 0.000000 1.000000 /end COMPU_METHOD
/* Scalar measurable for DDE 'Iso2DcBiDirParPeakCrntRip'. */
/begin MEASUREMENT Iso2DcBiDirParPeakCrntRip "Indicates the DC Supplys peak to peak ripple current amplitude of the regulated output at any current request" FLOAT32_IEEE CU_ISO2DCBIDIRPARPEAKCRNTRIP 1 100 -3.40282346639e+38 3.40282346639e+38 ECU_ADDRESS 0x7001809c BYTE_ORDER MSB_LAST /end MEASUREMENT
/begin COMPU_METHOD CU_ISO2DCBIDIRPARPEAKCRNTRIP "Conversion method for Iso2DcBiDirParPeakCrntRip" RAT_FUNC "%10.0" "%" COEFFS 0.000000 1.000000 -0.000000 0.000000 0.000000 1.000000 /end COMPU_METHOD
/* Scalar measurable for DDE 'Iso2DcChgParCrntRegTol'. */
/begin MEASUREMENT Iso2DcChgParCrntRegTol "Indicates the DC Supplys ability to regulate current with respect to the current request" FLOAT32_IEEE CU_ISO2DCCHGPARCRNTREGTOL 1 100 -3.40282346639e+38 3.40282346639e+38 ECU_ADDRESS 0x700182d4 BYTE_ORDER MSB_LAST /end MEASUREMENT
/begin COMPU_METHOD CU_ISO2DCCHGPARCRNTREGTOL "Conversion method for Iso2DcChgParCrntRegTol" RAT_FUNC "%10.0" "%" COEFFS 0.000000 1.000000 -0.000000 0.000000 0.000000 1.000000 /end COMPU_METHOD
/* Scalar measurable for DDE 'Iso2DcChgParCrntRegTolPres'. */
/begin MEASUREMENT Iso2DcChgParCrntRegTolPres "Indicates the presence of the Iso2DcChgParCrntRegTol parameter" UBYTE CU_ISO2DCCHGPARCRNTREGTOLPRES 1 100 0.0 255.0 ECU_ADDRESS 0x70017cb1 BYTE_ORDER MSB_LAST /end MEASUREMENT
/begin COMPU_METHOD CU_ISO2DCCHGPARCRNTREGTOLPRES "Conversion method for Iso2DcChgParCrntRegTolPres" RAT_FUNC "%10.0" "%" COEFFS 0.000000 1.000000 -0.000000 0.000000 0.000000 1.000000 /end COMPU_METHOD
/* Scalar measurable for DDE 'Iso2DcChgParDataVal'. */
/begin MEASUREMENT Iso2DcChgParDataVal "Indicates whether the DC EVSE Charge Parameter data is available to be read" UBYTE CU_ISO2DCCHGPARDATAVAL 1 100 0.0 255.0 ECU_ADDRESS 0x70017f8f BYTE_ORDER MSB_LAST /end MEASUREMENT
/begin COMPU_METHOD CU_ISO2DCCHGPARDATAVAL "Conversion method for Iso2DcChgParDataVal" RAT_FUNC "%10.0" "%" COEFFS 0.000000 1.000000 -0.000000 0.000000 0.000000 1.000000 /end COMPU_METHOD
/* Scalar measurable for DDE 'Iso2DcChgParEgyToBeDel'. */
/begin MEASUREMENT Iso2DcChgParEgyToBeDel "Indicates the allowed or requested units of energy to be delivered during charging (a charging target)" FLOAT32_IEEE CU_ISO2DCCHGPAREGYTOBEDEL 1 100 -3.40282346639e+38 3.40282346639e+38 ECU_ADDRESS 0x70017e00 BYTE_ORDER MSB_LAST /end MEASUREMENT
/begin COMPU_METHOD CU_ISO2DCCHGPAREGYTOBEDEL "Conversion method for Iso2DcChgParEgyToBeDel" RAT_FUNC "%10.0" "%" COEFFS 0.000000 1.000000 -0.000000 0.000000 0.000000 1.000000 /end COMPU_METHOD
/* Scalar measurable for DDE 'Iso2DcChgParEgyToBeDelPres'. */
/begin MEASUREMENT Iso2DcChgParEgyToBeDelPres "Indicates the presence of the pv2gf_dc_energy_to_be_delivered parameter" UBYTE CU_ISO2DCCHGPAREGYTOBEDELPRES 1 100 0.0 255.0 ECU_ADDRESS 0x70017c39 BYTE_ORDER MSB_LAST /end MEASUREMENT
/begin COMPU_METHOD CU_ISO2DCCHGPAREGYTOBEDELPRES "Conversion method for Iso2DcChgParEgyToBeDelPres" RAT_FUNC "%10.0" "%" COEFFS 0.000000 1.000000 -0.000000 0.000000 0.000000 1.000000 /end COMPU_METHOD
/* Scalar measurable for DDE 'Iso2DcChgParMaxChgCrnt'. */
/begin MEASUREMENT Iso2DcChgParMaxChgCrnt "Indicates the maximum current the EVSE can deliver" FLOAT32_IEEE CU_ISO2DCCHGPARMAXCHGCRNT 1 100 -3.40282346639e+38 3.40282346639e+38 ECU_ADDRESS 0x70018368 BYTE_ORDER MSB_LAST /end MEASUREMENT
/begin COMPU_METHOD CU_ISO2DCCHGPARMAXCHGCRNT "Conversion method for Iso2DcChgParMaxChgCrnt" RAT_FUNC "%10.0" "%" COEFFS 0.000000 1.000000 -0.000000 0.000000 0.000000 1.000000 /end COMPU_METHOD
/* Scalar measurable for DDE 'Iso2DcChgParMaxChgPwr'. */
/begin MEASUREMENT Iso2DcChgParMaxChgPwr "Indicates the maximum power the EVSE can deliver" FLOAT32_IEEE CU_ISO2DCCHGPARMAXCHGPWR 1 100 -3.40282346639e+38 3.40282346639e+38 ECU_ADDRESS 0x70017c64 BYTE_ORDER MSB_LAST /end MEASUREMENT
/begin COMPU_METHOD CU_ISO2DCCHGPARMAXCHGPWR "Conversion method for Iso2DcChgParMaxChgPwr" RAT_FUNC "%10.0" "%" COEFFS 0.000000 1.000000 -0.000000 0.000000 0.000000 1.000000 /end COMPU_METHOD
/* Scalar measurable for DDE 'Iso2DcChgParMaxVolt'. */
/begin MEASUREMENT Iso2DcChgParMaxVolt "Indicates the maximum voltage the EVSE can deliver" FLOAT32_IEEE CU_ISO2DCCHGPARMAXVOLT 1 100 -3.40282346639e+38 3.40282346639e+38 ECU_ADDRESS 0x70017f1c BYTE_ORDER MSB_LAST /end MEASUREMENT
/begin COMPU_METHOD CU_ISO2DCCHGPARMAXVOLT "Conversion method for Iso2DcChgParMaxVolt" RAT_FUNC "%10.0" "%" COEFFS 0.000000 1.000000 -0.000000 0.000000 0.000000 1.000000 /end COMPU_METHOD
/* Scalar measurable for DDE 'Iso2DcChgParMinChgCrnt'. */
/begin MEASUREMENT Iso2DcChgParMinChgCrnt "Indicates the minimum current the EVSE can deliver with the expected accuracy" FLOAT32_IEEE CU_ISO2DCCHGPARMINCHGCRNT 1 100 -3.40282346639e+38 3.40282346639e+38 ECU_ADDRESS 0x7001829c BYTE_ORDER MSB_LAST /end MEASUREMENT
/begin COMPU_METHOD CU_ISO2DCCHGPARMINCHGCRNT "Conversion method for Iso2DcChgParMinChgCrnt" RAT_FUNC "%10.0" "%" COEFFS 0.000000 1.000000 -0.000000 0.000000 0.000000 1.000000 /end COMPU_METHOD
/* Scalar measurable for DDE 'Iso2DcChgParMinVolt'. */
/begin MEASUREMENT Iso2DcChgParMinVolt "Indicates the minimum voltage the EVSE can deliver with the expected accuracy" FLOAT32_IEEE CU_ISO2DCCHGPARMINVOLT 1 100 -3.40282346639e+38 3.40282346639e+38 ECU_ADDRESS 0x70018090 BYTE_ORDER MSB_LAST /end MEASUREMENT
/begin COMPU_METHOD CU_ISO2DCCHGPARMINVOLT "Conversion method for Iso2DcChgParMinVolt" RAT_FUNC "%10.0" "%" COEFFS 0.000000 1.000000 -0.000000 0.000000 0.000000 1.000000 /end COMPU_METHOD
/* Scalar measurable for DDE 'Iso2DcChgParPeakCrntRipple'. */
/begin MEASUREMENT Iso2DcChgParPeakCrntRipple "Indicates the DC Supplys peak to peak ripple current amplitude of the regulated output at any current request" FLOAT32_IEEE CU_ISO2DCCHGPARPEAKCRNTRIPPLE 1 100 -3.40282346639e+38 3.40282346639e+38 ECU_ADDRESS 0x70017eac BYTE_ORDER MSB_LAST /end MEASUREMENT
/begin COMPU_METHOD CU_ISO2DCCHGPARPEAKCRNTRIPPLE "Conversion method for Iso2DcChgParPeakCrntRipple" RAT_FUNC "%10.0" "%" COEFFS 0.000000 1.000000 -0.000000 0.000000 0.000000 1.000000 /end COMPU_METHOD
/* Scalar measurable for DDE 'ParamSetIdSelected'. */
/begin MEASUREMENT ParamSetIdSelected "Selected Parameter Set Id from the Service Discovery and Detail Parser" UWORD CU_PARAMSETIDSELECTED 1 100 0.0 65535.0 ECU_ADDRESS 0x70017eb2 BYTE_ORDER MSB_LAST /end MEASUREMENT
/begin COMPU_METHOD CU_PARAMSETIDSELECTED "Conversion method for ParamSetIdSelected" RAT_FUNC "%10.0" "NU" COEFFS 0.000000 1.000000 -0.000000 0.000000 0.000000 1.000000 /end COMPU_METHOD
/* Scalar measurable for DDE 'ServiceIdSelected'. */
/begin MEASUREMENT ServiceIdSelected "Selected Service Id from the Service Discovery and Detail Parser" UWORD CU_SERVICEIDSELECTED 1 100 0.0 65535.0 ECU_ADDRESS 0x70018142 BYTE_ORDER MSB_LAST /end MEASUREMENT
/begin COMPU_METHOD CU_SERVICEIDSELECTED "Conversion method for ServiceIdSelected" RAT_FUNC "%10.0" "NU" COEFFS 0.000000 1.000000 -0.000000 0.000000 0.000000 1.000000 /end COMPU_METHOD
/* Scalar measurable for DDE 'SvcSearchSt'. */
/begin MEASUREMENT SvcSearchSt "Service Discovery and Detail Parser Search Status" SLONG CU_SVCSEARCHST 1 100 -2147483648.0 2147483647.0 ECU_ADDRESS 0x70017c30 BYTE_ORDER MSB_LAST /end MEASUREMENT
/begin COMPU_METHOD CU_SVCSEARCHST "Conversion method for SvcSearchSt" TAB_VERB "%12.0" "enum" COMPU_TAB_REF CT_SVCSEARCHST /end COMPU_METHOD
/begin COMPU_VTAB CT_SVCSEARCHST "Conversion method for SvcSearchSt" TAB_VERB 5 0 "SEARCH_ONGOING" 1 "WAIT_FOR_SVCDETAIL" 2 "FINISHED_NO_RESULT" 3 "SEARCH_FINISHED" 4 "SEARCH_STARTUP" /end COMPU_VTAB
/begin FUNCTION V2G_RX_ISO15118ED1 "Group /ByModelHeirarchy/LaforgeTestApp_CCU/Core0-TestApp/V2G/OE_CCS/V2gRx/V2G_RX_ISO15118ED1"
 /begin LOC_MEASUREMENT Iso1CblChkEvseIsolStatus Iso1CblChkEvseProcessing Iso1CblChkRescode Iso1CrntDmdEvseCrntLimitAchiev0 Iso1CrntDmdEvseIdLen Iso1CrntDmdEvseId[0] Iso1CrntDmdEvseId[10] Iso1CrntDmdEvseId[11] Iso1CrntDmdEvseId[12] Iso1CrntDmdEvseId[13] Iso1CrntDmdEvseId[14] Iso1CrntDmdEvseId[15] Iso1CrntDmdEvseId[16] Iso1CrntDmdEvseId[17] Iso1CrntDmdEvseId[18] Iso1CrntDmdEvseId[19] Iso1CrntDmdEvseId[1] Iso1CrntDmdEvseId[20] Iso1CrntDmdEvseId[21] Iso1CrntDmdEvseId[22] Iso1CrntDmdEvseId[23] Iso1CrntDmdEvseId[24] Iso1CrntDmdEvseId[25] Iso1CrntDmdEvseId[26] Iso1CrntDmdEvseId[27] Iso1CrntDmdEvseId[28] Iso1CrntDmdEvseId[29] Iso1CrntDmdEvseId[2] Iso1CrntDmdEvseId[30] Iso1CrntDmdEvseId[31] Iso1CrntDmdEvseId[32] Iso1CrntDmdEvseId[33] Iso1CrntDmdEvseId[34] Iso1CrntDmdEvseId[35] Iso1CrntDmdEvseId[36] Iso1CrntDmdEvseId[37] Iso1CrntDmdEvseId[3] Iso1CrntDmdEvseId[4] Iso1CrntDmdEvseId[5] Iso1CrntDmdEvseId[6] Iso1CrntDmdEvseId[7] Iso1CrntDmdEvseId[8] Iso1CrntDmdEvseId[9] Iso1CrntDmdEvseMaxVoltLimitPre0 Iso1CrntDmdEvseVoltLimitAchiev0 Iso1CrntDmdNotifMaxDelay Iso1CrntDmdRescode Iso1DcChgParCrntRegTol Iso1DcChgParIsolStatus Iso1DcChgParMaxVoltLim Iso1DcChgParMinCrntLim Iso1DcChgParPeakCrntRipple Iso1PmtSelRescode Iso1PreChgEvseIsolStatusPres Iso1PreChgEvseNotifMaxDelay Iso1PreChgEvsePresVolt Iso1PreChgRxTrg Iso1PwrDelivEvseIsolStatusPres Iso1PwrDelivEvseStatusCode Iso1PwrDelivEvseStatusPresent Iso1PwrDelivNotifMaxDelay Iso1SesSetupEvseId[0] Iso1SesSetupEvseId[10] Iso1SesSetupEvseId[11] Iso1SesSetupEvseId[12] Iso1SesSetupEvseId[13] Iso1SesSetupEvseId[14] Iso1SesSetupEvseId[15] Iso1SesSetupEvseId[16] Iso1SesSetupEvseId[17] Iso1SesSetupEvseId[18] Iso1SesSetupEvseId[19] Iso1SesSetupEvseId[1] Iso1SesSetupEvseId[20] Iso1SesSetupEvseId[21] Iso1SesSetupEvseId[22] Iso1SesSetupEvseId[23] Iso1SesSetupEvseId[24] Iso1SesSetupEvseId[25] Iso1SesSetupEvseId[26] Iso1SesSetupEvseId[27] Iso1SesSetupEvseId[28] Iso1SesSetupEvseId[29] Iso1SesSetupEvseId[2] Iso1SesSetupEvseId[30] Iso1SesSetupEvseId[31] Iso1SesSetupEvseId[32] Iso1SesSetupEvseId[33] Iso1SesSetupEvseId[34] Iso1SesSetupEvseId[35] Iso1SesSetupEvseId[36] Iso1SesSetupEvseId[37] Iso1SesSetupEvseId[3] Iso1SesSetupEvseId[4] Iso1SesSetupEvseId[5] Iso1SesSetupEvseId[6] Iso1SesSetupEvseId[7] Iso1SesSetupEvseId[8] Iso1SesSetupEvseId[9] Iso1SesSetupTimestamp Iso1SvcDetailRxTrg Iso1SvcDiscFreeSvc Iso1SvcDiscRescode Iso1SvcDiscSvcListSize Iso1WeldDetNotifMaxDelay Iso1WeldDetRxTrg /end LOC_MEASUREMENT
/end FUNCTION
/begin FUNCTION Iso2Rx_DcEvseBiDirPar "Group /ByModelHeirarchy/LaforgeTestApp_CCU/Core0-TestApp/V2G/OE_CCS/V2gRx/V2G_RX_ISO15118ED2/Iso2Rx_DcEvseBiDirPar"
 /begin LOC_MEASUREMENT Iso2DcBiDirParCrntRegTol Iso2DcBiDirParCrntRegTolPres Iso2DcBiDirParDataVal Iso2DcBiDirParEgyToBeDel Iso2DcBiDirParEgyToBeDelPres Iso2DcBiDirParMaxChgCrnt Iso2DcBiDirParMaxChgPwr Iso2DcBiDirParMaxDischgCrnt Iso2DcBiDirParMaxDischgPwr Iso2DcBiDirParMaxVolt Iso2DcBiDirParMinChgCrnt Iso2DcBiDirParMinDischgCrnt Iso2DcBiDirParMinVolt Iso2DcBiDirParPeakCrntRip /end LOC_MEASUREMENT
/end FUNCTION
/begin FUNCTION Iso2Rx_DcEvseChgPar "Group /ByModelHeirarchy/LaforgeTestApp_CCU/Core0-TestApp/V2G/OE_CCS/V2gRx/V2G_RX_ISO15118ED2/Iso2Rx_DcEvseChgPar"
 /begin LOC_MEASUREMENT Iso2DcChgParCrntRegTol Iso2DcChgParCrntRegTolPres Iso2DcChgParDataVal Iso2DcChgParEgyToBeDel Iso2DcChgParEgyToBeDelPres Iso2DcChgParMaxChgCrnt Iso2DcChgParMaxChgPwr Iso2DcChgParMaxVolt Iso2DcChgParMinChgCrnt Iso2DcChgParMinVolt Iso2DcChgParPeakCrntRipple /end LOC_MEASUREMENT
/end FUNCTION
/begin FUNCTION Chart "Group /ByModelHeirarchy/LaforgeTestApp_CCU/Core0-TestApp/V2G/OE_CCS/V2gRx/V2G_RX_ISO15118ED2/Subsystem/Chart" /begin LOC_MEASUREMENT DynamicModeEn /end LOC_MEASUREMENT /end FUNCTION
/begin FUNCTION Subsystem9 "Group /ByModelHeirarchy/LaforgeTestApp_CCU/Core0-TestApp/V2G/OE_CCS/V2gRx/V2G_RX_ISO15118ED2/Subsystem" /begin SUB_FUNCTION Chart /end SUB_FUNCTION
 /begin LOC_MEASUREMENT DynamicModeEn ParamSetIdSelected ServiceIdSelected SvcSearchSt /end LOC_MEASUREMENT
/end FUNCTION
/end MODULE
/end PROJECT
