ASAP2_VERSION 1 31
/begin PROJECT LaForge_CCU_TestApp "Test Application for LaForge TC367"
/begin HEADER "Dana" VERSION "0_3_1" /end HEADER
/begin MODULE OpenECU_TC367_001 ""
/* Vector/array calibration for DDE 'SimRessProfileSoc_Ax'. */
/begin CHARACTERISTIC SimRessProfileSoc_Ax "Calibration for setting the maximum charge curretn of HV battery pack. The battery might report its own max current. The smaller value of these two will be considered as battery max chagrge current" VAL_BLK 0x7001744c RL_SIMRESSPROFILESOC_AX 20000.000000 CU_SIMRESSPROFILESOC_AX -10000.000000 10000.000000 NUMBER 14 BYTE_ORDER MSB_LAST /end CHARACTERISTIC
/begin RECORD_LAYOUT RL_SIMRESSPROFILESOC_AX FNC_VALUES 1 FLOAT32_IEEE COLUMN_DIR DIRECT /end RECORD_LAYOUT
/begin COMPU_METHOD CU_SIMRESSPROFILESOC_AX "Conversion method for SimRessProfileSoc_Ax" RAT_FUNC "%10.0" "%" COEFFS 0.000000 1.000000 -0.000000 0.000000 0.000000 1.000000 /end COMPU_METHOD
/* Vector/array calibration for DDE 'SimRessProfileVolt_Ay'. */
/begin CHARACTERISTIC SimRessProfileVolt_Ay "Calibration for setting the maximum charge curretn of HV battery pack. The battery might report its own max current. The smaller value of these two will be considered as battery max chagrge current" VAL_BLK 0x700174b0 RL_SIMRESSPROFILEVOLT_AY 20000.000000 CU_SIMRESSPROFILEVOLT_AY -10000.000000 10000.000000 NUMBER 14 BYTE_ORDER MSB_LAST /end CHARACTERISTIC
/begin RECORD_LAYOUT RL_SIMRESSPROFILEVOLT_AY FNC_VALUES 1 FLOAT32_IEEE COLUMN_DIR DIRECT /end RECORD_LAYOUT
/begin COMPU_METHOD CU_SIMRESSPROFILEVOLT_AY "Conversion method for SimRessProfileVolt_Ay" RAT_FUNC "%10.0" "V" COEFFS 0.000000 1.000000 -0.000000 0.000000 0.000000 1.000000 /end COMPU_METHOD
/* Scalar calibration for DDE 'SimRessSocOf_C'. */
/begin CHARACTERISTIC SimRessSocOf_C "Enables overriding Processed HV battery SOC value received from HV battery controller" VALUE 0x7001762d RL_SIMRESSSOCOF_C 1.000000 CU_SIMRESSSOCOF_C 0.000000 1.000000 BYTE_ORDER MSB_LAST /end CHARACTERISTIC
/begin RECORD_LAYOUT RL_SIMRESSSOCOF_C FNC_VALUES 1 UBYTE COLUMN_DIR DIRECT /end RECORD_LAYOUT
/begin COMPU_METHOD CU_SIMRESSSOCOF_C "Conversion method for SimRessSocOf_C" RAT_FUNC "%10.0" "b" COEFFS 0.000000 1.000000 -0.000000 0.000000 0.000000 1.000000 /end COMPU_METHOD
/* Scalar calibration for DDE 'SimRessSocOv_C'. */
/begin CHARACTERISTIC SimRessSocOv_C "Override value for Processed HV battery SOC value received from HV battery controller" VALUE 0x700174ec RL_SIMRESSSOCOV_C 100.000000 CU_SIMRESSSOCOV_C 0.000000 100.000000 BYTE_ORDER MSB_LAST /end CHARACTERISTIC
/begin RECORD_LAYOUT RL_SIMRESSSOCOV_C FNC_VALUES 1 FLOAT32_IEEE COLUMN_DIR DIRECT /end RECORD_LAYOUT
/begin COMPU_METHOD CU_SIMRESSSOCOV_C "Conversion method for SimRessSocOv_C" RAT_FUNC "%10.0" "%" COEFFS 0.000000 1.000000 -0.000000 0.000000 0.000000 1.000000 /end COMPU_METHOD
/* Scalar calibration for DDE 'SimRessVoltOf_C'. */
/begin CHARACTERISTIC SimRessVoltOf_C "Override enable flag for the Processed value of HV battery voltage" VALUE 0x70019dad RL_SIMRESSVOLTOF_C 1.000000 CU_SIMRESSVOLTOF_C 0.000000 1.000000 BYTE_ORDER MSB_LAST /end CHARACTERISTIC
/begin RECORD_LAYOUT RL_SIMRESSVOLTOF_C FNC_VALUES 1 UBYTE COLUMN_DIR DIRECT /end RECORD_LAYOUT
/begin COMPU_METHOD CU_SIMRESSVOLTOF_C "Conversion method for SimRessVoltOf_C" RAT_FUNC "%10.0" "b" COEFFS 0.000000 1.000000 -0.000000 0.000000 0.000000 1.000000 /end COMPU_METHOD
/* Scalar calibration for DDE 'SimRessVoltOv_C'. */
/begin CHARACTERISTIC SimRessVoltOv_C "Override value of Processed value of HV battery voltage" VALUE 0x700184e0 RL_SIMRESSVOLTOV_C 1510.000000 CU_SIMRESSVOLTOV_C -10.000000 1500.000000 BYTE_ORDER MSB_LAST /end CHARACTERISTIC
/begin RECORD_LAYOUT RL_SIMRESSVOLTOV_C FNC_VALUES 1 FLOAT32_IEEE COLUMN_DIR DIRECT /end RECORD_LAYOUT
/begin COMPU_METHOD CU_SIMRESSVOLTOV_C "Conversion method for SimRessVoltOv_C" RAT_FUNC "%10.0" "V" COEFFS 0.000000 1.000000 -0.000000 0.000000 0.000000 1.000000 /end COMPU_METHOD
/* Scalar calibration for DDE 'SvcSearchStOf_C'. */
/begin CHARACTERISTIC SvcSearchStOf_C "Enables overriding the Service Discovery and Detail Parser Search Status" VALUE 0x7001975c RL_SVCSEARCHSTOF_C 1.000000 CU_SVCSEARCHSTOF_C 0.000000 1.000000 BYTE_ORDER MSB_LAST /end CHARACTERISTIC
/begin RECORD_LAYOUT RL_SVCSEARCHSTOF_C FNC_VALUES 1 UBYTE COLUMN_DIR DIRECT /end RECORD_LAYOUT
/begin COMPU_METHOD CU_SVCSEARCHSTOF_C "Conversion method for SvcSearchStOf_C" RAT_FUNC "%10.0" "b" COEFFS 0.000000 1.000000 -0.000000 0.000000 0.000000 1.000000 /end COMPU_METHOD
/* Scalar calibration for DDE 'SvcSearchStOv_C'. */
/begin CHARACTERISTIC SvcSearchStOv_C "Override value for the Service Discovery and Detail Parser Search Status" VALUE 0x700175dc RL_SVCSEARCHSTOV_C 4294967295.000000 CU_SVCSEARCHSTOV_C -2147483648.000000 2147483647.000000 BYTE_ORDER MSB_LAST /end CHARACTERISTIC
/begin RECORD_LAYOUT RL_SVCSEARCHSTOV_C FNC_VALUES 1 SLONG COLUMN_DIR DIRECT /end RECORD_LAYOUT
/begin COMPU_METHOD CU_SVCSEARCHSTOV_C "Conversion method for SvcSearchStOv_C" TAB_VERB "%12.0" "enum" COMPU_TAB_REF CT_SVCSEARCHSTOV_C /end COMPU_METHOD
/begin COMPU_VTAB CT_SVCSEARCHSTOV_C "Conversion method for SvcSearchStOv_C" TAB_VERB 5 0 "SEARCH_ONGOING" 1 "WAIT_FOR_SVCDETAIL" 2 "FINISHED_NO_RESULT" 3 "SEARCH_FINISHED" 4 "SEARCH_STARTUP" /end COMPU_VTAB
/* Scalar calibration for DDE 'SysModuleReset_C'. */
/begin CHARACTERISTIC SysModuleReset_C "Cal for module Reset" VALUE 0x700195ee RL_SYSMODULERESET_C 1.000000 CU_SYSMODULERESET_C 0.000000 1.000000 BYTE_ORDER MSB_LAST /end CHARACTERISTIC
/begin RECORD_LAYOUT RL_SYSMODULERESET_C FNC_VALUES 1 UBYTE COLUMN_DIR DIRECT /end RECORD_LAYOUT
/begin COMPU_METHOD CU_SYSMODULERESET_C "Conversion method for SysModuleReset_C" RAT_FUNC "%10.0" "b" COEFFS 0.000000 1.000000 -0.000000 0.000000 0.000000 1.000000 /end COMPU_METHOD
/* Scalar calibration for DDE 'TLF35584CmdOvrdFlg_C'. */
/begin CHARACTERISTIC TLF35584CmdOvrdFlg_C "Enable to allow manual TLF35584 messages." VALUE 0xa01085ac RL_TLF35584CMDOVRDFLG_C 680564693277057719623408366969033850880.000000 CU_TLF35584CMDOVRDFLG_C -340282346638528859811704183484516925440.000000 340282346638528859811704183484516925440.000000 BYTE_ORDER MSB_LAST /end CHARACTERISTIC
/begin RECORD_LAYOUT RL_TLF35584CMDOVRDFLG_C FNC_VALUES 1 FLOAT32_IEEE COLUMN_DIR DIRECT /end RECORD_LAYOUT
/begin COMPU_METHOD CU_TLF35584CMDOVRDFLG_C "Conversion method for TLF35584CmdOvrdFlg_C" RAT_FUNC "%10.0" "(not defined)" COEFFS 0.000000 1.000000 -0.000000 0.000000 0.000000 1.000000 /end COMPU_METHOD
/* Scalar calibration for DDE 'TLF35584DEVCTRLCmdB0_C'. */
/begin CHARACTERISTIC TLF35584DEVCTRLCmdB0_C "(not defined)" VALUE 0xa01085a8 RL_TLF35584DEVCTRLCMDB0_C 680564693277057719623408366969033850880.000000 CU_TLF35584DEVCTRLCMDB0_C -340282346638528859811704183484516925440.000000 340282346638528859811704183484516925440.000000 BYTE_ORDER MSB_LAST /end CHARACTERISTIC
/begin RECORD_LAYOUT RL_TLF35584DEVCTRLCMDB0_C FNC_VALUES 1 FLOAT32_IEEE COLUMN_DIR DIRECT /end RECORD_LAYOUT
/begin COMPU_METHOD CU_TLF35584DEVCTRLCMDB0_C "Conversion method for TLF35584DEVCTRLCmdB0_C" RAT_FUNC "%10.0" "(not defined)" COEFFS 0.000000 1.000000 -0.000000 0.000000 0.000000 1.000000 /end COMPU_METHOD
/* Scalar calibration for DDE 'TLF35584DEVCTRLCmdB1_C'. */
/begin CHARACTERISTIC TLF35584DEVCTRLCmdB1_C "(not defined)" VALUE 0xa01085a4 RL_TLF35584DEVCTRLCMDB1_C 680564693277057719623408366969033850880.000000 CU_TLF35584DEVCTRLCMDB1_C -340282346638528859811704183484516925440.000000 340282346638528859811704183484516925440.000000 BYTE_ORDER MSB_LAST /end CHARACTERISTIC
/begin RECORD_LAYOUT RL_TLF35584DEVCTRLCMDB1_C FNC_VALUES 1 FLOAT32_IEEE COLUMN_DIR DIRECT /end RECORD_LAYOUT
/begin COMPU_METHOD CU_TLF35584DEVCTRLCMDB1_C "Conversion method for TLF35584DEVCTRLCmdB1_C" RAT_FUNC "%10.0" "(not defined)" COEFFS 0.000000 1.000000 -0.000000 0.000000 0.000000 1.000000 /end COMPU_METHOD
/* Scalar calibration for DDE 'TLF35584DEVCTRLCmdB2_C'. */
/begin CHARACTERISTIC TLF35584DEVCTRLCmdB2_C "(not defined)" VALUE 0xa01085a0 RL_TLF35584DEVCTRLCMDB2_C 680564693277057719623408366969033850880.000000 CU_TLF35584DEVCTRLCMDB2_C -340282346638528859811704183484516925440.000000 340282346638528859811704183484516925440.000000 BYTE_ORDER MSB_LAST /end CHARACTERISTIC
/begin RECORD_LAYOUT RL_TLF35584DEVCTRLCMDB2_C FNC_VALUES 1 FLOAT32_IEEE COLUMN_DIR DIRECT /end RECORD_LAYOUT
/begin COMPU_METHOD CU_TLF35584DEVCTRLCMDB2_C "Conversion method for TLF35584DEVCTRLCmdB2_C" RAT_FUNC "%10.0" "(not defined)" COEFFS 0.000000 1.000000 -0.000000 0.000000 0.000000 1.000000 /end COMPU_METHOD
/* Scalar calibration for DDE 'TLF35584DEVCTRLCmdB3_C'. */
/begin CHARACTERISTIC TLF35584DEVCTRLCmdB3_C "(not defined)" VALUE 0xa010859c RL_TLF35584DEVCTRLCMDB3_C 680564693277057719623408366969033850880.000000 CU_TLF35584DEVCTRLCMDB3_C -340282346638528859811704183484516925440.000000 340282346638528859811704183484516925440.000000 BYTE_ORDER MSB_LAST /end CHARACTERISTIC
/begin RECORD_LAYOUT RL_TLF35584DEVCTRLCMDB3_C FNC_VALUES 1 FLOAT32_IEEE COLUMN_DIR DIRECT /end RECORD_LAYOUT
/begin COMPU_METHOD CU_TLF35584DEVCTRLCMDB3_C "Conversion method for TLF35584DEVCTRLCmdB3_C" RAT_FUNC "%10.0" "(not defined)" COEFFS 0.000000 1.000000 -0.000000 0.000000 0.000000 1.000000 /end COMPU_METHOD
/* Scalar calibration for DDE 'TLF35584DEVCTRLCmdB4_C'. */
/begin CHARACTERISTIC TLF35584DEVCTRLCmdB4_C "(not defined)" VALUE 0xa0108598 RL_TLF35584DEVCTRLCMDB4_C 680564693277057719623408366969033850880.000000 CU_TLF35584DEVCTRLCMDB4_C -340282346638528859811704183484516925440.000000 340282346638528859811704183484516925440.000000 BYTE_ORDER MSB_LAST /end CHARACTERISTIC
/begin RECORD_LAYOUT RL_TLF35584DEVCTRLCMDB4_C FNC_VALUES 1 FLOAT32_IEEE COLUMN_DIR DIRECT /end RECORD_LAYOUT
/begin COMPU_METHOD CU_TLF35584DEVCTRLCMDB4_C "Conversion method for TLF35584DEVCTRLCmdB4_C" RAT_FUNC "%10.0" "(not defined)" COEFFS 0.000000 1.000000 -0.000000 0.000000 0.000000 1.000000 /end COMPU_METHOD
/* Scalar calibration for DDE 'TLF35584DataStartupOvrdFlg_C'. */
/begin CHARACTERISTIC TLF35584DataStartupOvrdFlg_C "(not defined)" VALUE 0xa0108594 RL_TLF35584DATASTARTUPOVRDFLG_C 680564693277057719623408366969033850880.000000 CU_TLF35584DATASTARTUPOVRDFLG_C -340282346638528859811704183484516925440.000000 340282346638528859811704183484516925440.000000 BYTE_ORDER MSB_LAST /end CHARACTERISTIC
/begin RECORD_LAYOUT RL_TLF35584DATASTARTUPOVRDFLG_C FNC_VALUES 1 FLOAT32_IEEE COLUMN_DIR DIRECT /end RECORD_LAYOUT
/begin COMPU_METHOD CU_TLF35584DATASTARTUPOVRDFLG_C "Conversion method for TLF35584DataStartupOvrdFlg_C" RAT_FUNC "%10.0" "(not defined)" COEFFS 0.000000 1.000000 -0.000000 0.000000 0.000000 1.000000 /end COMPU_METHOD
/* Scalar calibration for DDE 'TLF35584DataVrefOffOvrdFlg_C'. */
/begin CHARACTERISTIC TLF35584DataVrefOffOvrdFlg_C "Enable to set message to turn off Vrefs." VALUE 0xa0108590 RL_TLF35584DATAVREFOFFOVRDFLG_C 680564693277057719623408366969033850880.000000 CU_TLF35584DATAVREFOFFOVRDFLG_C -340282346638528859811704183484516925440.000000 340282346638528859811704183484516925440.000000 BYTE_ORDER MSB_LAST /end CHARACTERISTIC
/begin RECORD_LAYOUT RL_TLF35584DATAVREFOFFOVRDFLG_C FNC_VALUES 1 FLOAT32_IEEE COLUMN_DIR DIRECT /end RECORD_LAYOUT
/begin COMPU_METHOD CU_TLF35584DATAVREFOFFOVRDFLG_C "Conversion method for TLF35584DataVrefOffOvrdFlg_C" RAT_FUNC "%10.0" "(not defined)" COEFFS 0.000000 1.000000 -0.000000 0.000000 0.000000 1.000000 /end COMPU_METHOD
/* Scalar calibration for DDE 'TLF35584DefaultSize_C'. */
/begin CHARACTERISTIC TLF35584DefaultSize_C "(not defined)" VALUE 0xa010858c RL_TLF35584DEFAULTSIZE_C 65535.000000 CU_TLF35584DEFAULTSIZE_C 0.000000 65535.000000 BYTE_ORDER MSB_LAST /end CHARACTERISTIC
/begin RECORD_LAYOUT RL_TLF35584DEFAULTSIZE_C FNC_VALUES 1 UWORD COLUMN_DIR DIRECT /end RECORD_LAYOUT
/begin COMPU_METHOD CU_TLF35584DEFAULTSIZE_C "Conversion method for TLF35584DefaultSize_C" RAT_FUNC "%10.0" "(not defined)" COEFFS 0.000000 1.000000 -0.000000 0.000000 0.000000 1.000000 /end COMPU_METHOD
/* Scalar calibration for DDE 'TLF35584GetJobResultOvrdFlg_C'. */
/begin CHARACTERISTIC TLF35584GetJobResultOvrdFlg_C "(not defined)" VALUE 0xa0108588 RL_TLF35584GETJOBRESULTOVRDFLG0 680564693277057719623408366969033850880.000000 CU_TLF35584GETJOBRESULTOVRDFLG0 -340282346638528859811704183484516925440.000000 340282346638528859811704183484516925440.000000 BYTE_ORDER MSB_LAST /end CHARACTERISTIC
/begin RECORD_LAYOUT RL_TLF35584GETJOBRESULTOVRDFLG0 FNC_VALUES 1 FLOAT32_IEEE COLUMN_DIR DIRECT /end RECORD_LAYOUT
/begin COMPU_METHOD CU_TLF35584GETJOBRESULTOVRDFLG0 "Conversion method for TLF35584GetJobResultOvrdFlg_C" RAT_FUNC "%10.0" "(not defined)" COEFFS 0.000000 1.000000 -0.000000 0.000000 0.000000 1.000000 /end COMPU_METHOD
/* Scalar calibration for DDE 'TLF35584GetJobResult_C'. */
/begin CHARACTERISTIC TLF35584GetJobResult_C "(not defined)" VALUE 0xa0108584 RL_TLF35584GETJOBRESULT_C 255.000000 CU_TLF35584GETJOBRESULT_C 0.000000 255.000000 BYTE_ORDER MSB_LAST /end CHARACTERISTIC
/begin RECORD_LAYOUT RL_TLF35584GETJOBRESULT_C FNC_VALUES 1 UBYTE COLUMN_DIR DIRECT /end RECORD_LAYOUT
/begin COMPU_METHOD CU_TLF35584GETJOBRESULT_C "Conversion method for TLF35584GetJobResult_C" RAT_FUNC "%10.0" "(not defined)" COEFFS 0.000000 1.000000 -0.000000 0.000000 0.000000 1.000000 /end COMPU_METHOD
/* Scalar calibration for DDE 'TLF35584RqstCmdDEVCTRLOvrdFlg_C'. */
/begin CHARACTERISTIC TLF35584RqstCmdDEVCTRLOvrdFlg_C "(not defined)" VALUE 0xa0108580 RL_TLF35584RQSTCMDDEVCTRLOVRDF0 680564693277057719623408366969033850880.000000 CU_TLF35584RQSTCMDDEVCTRLOVRDF0 -340282346638528859811704183484516925440.000000 340282346638528859811704183484516925440.000000 BYTE_ORDER MSB_LAST /end CHARACTERISTIC
/begin RECORD_LAYOUT RL_TLF35584RQSTCMDDEVCTRLOVRDF0 FNC_VALUES 1 FLOAT32_IEEE COLUMN_DIR DIRECT /end RECORD_LAYOUT
/begin COMPU_METHOD CU_TLF35584RQSTCMDDEVCTRLOVRDF0 "Conversion method for TLF35584RqstCmdDEVCTRLOvrdFlg_C" RAT_FUNC "%10.0" "(not defined)" COEFFS 0.000000 1.000000 -0.000000 0.000000 0.000000 1.000000 /end COMPU_METHOD
/* Vector/array calibration for DDE 'TLF35584RqstCmd_C'. */
/begin CHARACTERISTIC TLF35584RqstCmd_C "(not defined)" VAL_BLK 0xa0108564 RL_TLF35584RQSTCMD_C 255.000000 CU_TLF35584RQSTCMD_C 0.000000 255.000000 NUMBER 25 BYTE_ORDER MSB_LAST /end CHARACTERISTIC
/begin RECORD_LAYOUT RL_TLF35584RQSTCMD_C FNC_VALUES 1 UBYTE COLUMN_DIR DIRECT /end RECORD_LAYOUT
/begin COMPU_METHOD CU_TLF35584RQSTCMD_C "Conversion method for TLF35584RqstCmd_C" RAT_FUNC "%10.0" "(not defined)" COEFFS 0.000000 1.000000 -0.000000 0.000000 0.000000 1.000000 /end COMPU_METHOD
/* Scalar calibration for DDE 'TLF35584SendOvrdFlg_C'. */
/begin CHARACTERISTIC TLF35584SendOvrdFlg_C "(not defined)" VALUE 0xa0108560 RL_TLF35584SENDOVRDFLG_C 680564693277057719623408366969033850880.000000 CU_TLF35584SENDOVRDFLG_C -340282346638528859811704183484516925440.000000 340282346638528859811704183484516925440.000000 BYTE_ORDER MSB_LAST /end CHARACTERISTIC
/begin RECORD_LAYOUT RL_TLF35584SENDOVRDFLG_C FNC_VALUES 1 FLOAT32_IEEE COLUMN_DIR DIRECT /end RECORD_LAYOUT
/begin COMPU_METHOD CU_TLF35584SENDOVRDFLG_C "Conversion method for TLF35584SendOvrdFlg_C" RAT_FUNC "%10.0" "(not defined)" COEFFS 0.000000 1.000000 -0.000000 0.000000 0.000000 1.000000 /end COMPU_METHOD
/* Scalar calibration for DDE 'TLF35584Send_C'. */
/begin CHARACTERISTIC TLF35584Send_C "(not defined)" VALUE 0xa010855e RL_TLF35584SEND_C 255.000000 CU_TLF35584SEND_C 0.000000 255.000000 BYTE_ORDER MSB_LAST /end CHARACTERISTIC
/begin RECORD_LAYOUT RL_TLF35584SEND_C FNC_VALUES 1 UBYTE COLUMN_DIR DIRECT /end RECORD_LAYOUT
/begin COMPU_METHOD CU_TLF35584SEND_C "Conversion method for TLF35584Send_C" RAT_FUNC "%10.0" "(not defined)" COEFFS 0.000000 1.000000 -0.000000 0.000000 0.000000 1.000000 /end COMPU_METHOD
/* Scalar calibration for DDE 'TLF35584Size_C'. */
/begin CHARACTERISTIC TLF35584Size_C "(not defined)" VALUE 0xa010855c RL_TLF35584SIZE_C 65535.000000 CU_TLF35584SIZE_C 0.000000 65535.000000 BYTE_ORDER MSB_LAST /end CHARACTERISTIC
/begin RECORD_LAYOUT RL_TLF35584SIZE_C FNC_VALUES 1 UWORD COLUMN_DIR DIRECT /end RECORD_LAYOUT
/begin COMPU_METHOD CU_TLF35584SIZE_C "Conversion method for TLF35584Size_C" RAT_FUNC "%10.0" "(not defined)" COEFFS 0.000000 1.000000 -0.000000 0.000000 0.000000 1.000000 /end COMPU_METHOD
/* Scalar calibration for DDE 'TLF35584StartupCmdB0_C'. */
/begin CHARACTERISTIC TLF35584StartupCmdB0_C "(not defined)" VALUE 0xa010855a RL_TLF35584STARTUPCMDB0_C 255.000000 CU_TLF35584STARTUPCMDB0_C 0.000000 255.000000 BYTE_ORDER MSB_LAST /end CHARACTERISTIC
/begin RECORD_LAYOUT RL_TLF35584STARTUPCMDB0_C FNC_VALUES 1 UBYTE COLUMN_DIR DIRECT /end RECORD_LAYOUT
/begin COMPU_METHOD CU_TLF35584STARTUPCMDB0_C "Conversion method for TLF35584StartupCmdB0_C" RAT_FUNC "%10.0" "(not defined)" COEFFS 0.000000 1.000000 -0.000000 0.000000 0.000000 1.000000 /end COMPU_METHOD
/* Scalar calibration for DDE 'TLF35584StartupCmdB1_C'. */
/begin CHARACTERISTIC TLF35584StartupCmdB1_C "(not defined)" VALUE 0xa0108559 RL_TLF35584STARTUPCMDB1_C 255.000000 CU_TLF35584STARTUPCMDB1_C 0.000000 255.000000 BYTE_ORDER MSB_LAST /end CHARACTERISTIC
/begin RECORD_LAYOUT RL_TLF35584STARTUPCMDB1_C FNC_VALUES 1 UBYTE COLUMN_DIR DIRECT /end RECORD_LAYOUT
/begin COMPU_METHOD CU_TLF35584STARTUPCMDB1_C "Conversion method for TLF35584StartupCmdB1_C" RAT_FUNC "%10.0" "(not defined)" COEFFS 0.000000 1.000000 -0.000000 0.000000 0.000000 1.000000 /end COMPU_METHOD
/* Scalar calibration for DDE 'TLF35584StartupCmdB2_C'. */
/begin CHARACTERISTIC TLF35584StartupCmdB2_C "(not defined)" VALUE 0xa0108558 RL_TLF35584STARTUPCMDB2_C 255.000000 CU_TLF35584STARTUPCMDB2_C 0.000000 255.000000 BYTE_ORDER MSB_LAST /end CHARACTERISTIC
/begin RECORD_LAYOUT RL_TLF35584STARTUPCMDB2_C FNC_VALUES 1 UBYTE COLUMN_DIR DIRECT /end RECORD_LAYOUT
/begin COMPU_METHOD CU_TLF35584STARTUPCMDB2_C "Conversion method for TLF35584StartupCmdB2_C" RAT_FUNC "%10.0" "(not defined)" COEFFS 0.000000 1.000000 -0.000000 0.000000 0.000000 1.000000 /end COMPU_METHOD
/* Scalar calibration for DDE 'TLF35584StartupCmdB3_C'. */
/begin CHARACTERISTIC TLF35584StartupCmdB3_C "(not defined)" VALUE 0xa0108557 RL_TLF35584STARTUPCMDB3_C 255.000000 CU_TLF35584STARTUPCMDB3_C 0.000000 255.000000 BYTE_ORDER MSB_LAST /end CHARACTERISTIC
/begin RECORD_LAYOUT RL_TLF35584STARTUPCMDB3_C FNC_VALUES 1 UBYTE COLUMN_DIR DIRECT /end RECORD_LAYOUT
/begin COMPU_METHOD CU_TLF35584STARTUPCMDB3_C "Conversion method for TLF35584StartupCmdB3_C" RAT_FUNC "%10.0" "(not defined)" COEFFS 0.000000 1.000000 -0.000000 0.000000 0.000000 1.000000 /end COMPU_METHOD
/* Scalar calibration for DDE 'TLF35584StartupCmdB4_C'. */
/begin CHARACTERISTIC TLF35584StartupCmdB4_C "(not defined)" VALUE 0xa0108556 RL_TLF35584STARTUPCMDB4_C 255.000000 CU_TLF35584STARTUPCMDB4_C 0.000000 255.000000 BYTE_ORDER MSB_LAST /end CHARACTERISTIC
/begin RECORD_LAYOUT RL_TLF35584STARTUPCMDB4_C FNC_VALUES 1 UBYTE COLUMN_DIR DIRECT /end RECORD_LAYOUT
/begin COMPU_METHOD CU_TLF35584STARTUPCMDB4_C "Conversion method for TLF35584StartupCmdB4_C" RAT_FUNC "%10.0" "(not defined)" COEFFS 0.000000 1.000000 -0.000000 0.000000 0.000000 1.000000 /end COMPU_METHOD
/* Scalar calibration for DDE 'TLF35584StartupDataB0_C'. */
/begin CHARACTERISTIC TLF35584StartupDataB0_C "(not defined)" VALUE 0xa0108555 RL_TLF35584STARTUPDATAB0_C 255.000000 CU_TLF35584STARTUPDATAB0_C 0.000000 255.000000 BYTE_ORDER MSB_LAST /end CHARACTERISTIC
/begin RECORD_LAYOUT RL_TLF35584STARTUPDATAB0_C FNC_VALUES 1 UBYTE COLUMN_DIR DIRECT /end RECORD_LAYOUT
/begin COMPU_METHOD CU_TLF35584STARTUPDATAB0_C "Conversion method for TLF35584StartupDataB0_C" RAT_FUNC "%10.0" "(not defined)" COEFFS 0.000000 1.000000 -0.000000 0.000000 0.000000 1.000000 /end COMPU_METHOD
/* Scalar calibration for DDE 'TLF35584StartupDataB1_C'. */
/begin CHARACTERISTIC TLF35584StartupDataB1_C "For Spread Spectrum on startup 114 = (0h32+0h40)\n0 = No Spread; 0h2b = 1%, 0h55 = 2%, 0h80 = 3%, 0hAA = 4%, 0hD5 = 5%, 0hFF = 6%\nAll other values invalid." VALUE 0xa0108554 RL_TLF35584STARTUPDATAB1_C 255.000000 CU_TLF35584STARTUPDATAB1_C 0.000000 255.000000 BYTE_ORDER MSB_LAST /end CHARACTERISTIC
/begin RECORD_LAYOUT RL_TLF35584STARTUPDATAB1_C FNC_VALUES 1 UBYTE COLUMN_DIR DIRECT /end RECORD_LAYOUT
/begin COMPU_METHOD CU_TLF35584STARTUPDATAB1_C "Conversion method for TLF35584StartupDataB1_C" RAT_FUNC "%10.0" "(not defined)" COEFFS 0.000000 1.000000 -0.000000 0.000000 0.000000 1.000000 /end COMPU_METHOD
/* Scalar calibration for DDE 'TLF35584StartupDataB2_C'. */
/begin CHARACTERISTIC TLF35584StartupDataB2_C "(not defined)" VALUE 0xa0108553 RL_TLF35584STARTUPDATAB2_C 255.000000 CU_TLF35584STARTUPDATAB2_C 0.000000 255.000000 BYTE_ORDER MSB_LAST /end CHARACTERISTIC
/begin RECORD_LAYOUT RL_TLF35584STARTUPDATAB2_C FNC_VALUES 1 UBYTE COLUMN_DIR DIRECT /end RECORD_LAYOUT
/begin COMPU_METHOD CU_TLF35584STARTUPDATAB2_C "Conversion method for TLF35584StartupDataB2_C" RAT_FUNC "%10.0" "(not defined)" COEFFS 0.000000 1.000000 -0.000000 0.000000 0.000000 1.000000 /end COMPU_METHOD
/* Scalar calibration for DDE 'TLF35584StartupDataB3_C'. */
/begin CHARACTERISTIC TLF35584StartupDataB3_C "(not defined)" VALUE 0xa0108552 RL_TLF35584STARTUPDATAB3_C 255.000000 CU_TLF35584STARTUPDATAB3_C 0.000000 255.000000 BYTE_ORDER MSB_LAST /end CHARACTERISTIC
/begin RECORD_LAYOUT RL_TLF35584STARTUPDATAB3_C FNC_VALUES 1 UBYTE COLUMN_DIR DIRECT /end RECORD_LAYOUT
/begin COMPU_METHOD CU_TLF35584STARTUPDATAB3_C "Conversion method for TLF35584StartupDataB3_C" RAT_FUNC "%10.0" "(not defined)" COEFFS 0.000000 1.000000 -0.000000 0.000000 0.000000 1.000000 /end COMPU_METHOD
/* Scalar calibration for DDE 'TLF35584StartupDataB4_C'. */
/begin CHARACTERISTIC TLF35584StartupDataB4_C "(not defined)" VALUE 0xa0108551 RL_TLF35584STARTUPDATAB4_C 255.000000 CU_TLF35584STARTUPDATAB4_C 0.000000 255.000000 BYTE_ORDER MSB_LAST /end CHARACTERISTIC
/begin RECORD_LAYOUT RL_TLF35584STARTUPDATAB4_C FNC_VALUES 1 UBYTE COLUMN_DIR DIRECT /end RECORD_LAYOUT
/begin COMPU_METHOD CU_TLF35584STARTUPDATAB4_C "Conversion method for TLF35584StartupDataB4_C" RAT_FUNC "%10.0" "(not defined)" COEFFS 0.000000 1.000000 -0.000000 0.000000 0.000000 1.000000 /end COMPU_METHOD
/* Vector/array calibration for DDE 'TLF35584UserData_C'. */
/begin CHARACTERISTIC TLF35584UserData_C "(not defined)" VAL_BLK 0xa0108538 RL_TLF35584USERDATA_C 255.000000 CU_TLF35584USERDATA_C 0.000000 255.000000 NUMBER 25 BYTE_ORDER MSB_LAST /end CHARACTERISTIC
/begin RECORD_LAYOUT RL_TLF35584USERDATA_C FNC_VALUES 1 UBYTE COLUMN_DIR DIRECT /end RECORD_LAYOUT
/begin COMPU_METHOD CU_TLF35584USERDATA_C "Conversion method for TLF35584UserData_C" RAT_FUNC "%10.0" "(not defined)" COEFFS 0.000000 1.000000 -0.000000 0.000000 0.000000 1.000000 /end COMPU_METHOD
/* Scalar calibration for DDE 'TempIntDegC_FltMax_C'. */
/begin CHARACTERISTIC TempIntDegC_FltMax_C "Internal temperature in DegC Max Fault Limit Cal" VALUE 0xa0108534 RL_TEMPINTDEGC_FLTMAX_C 210.000000 CU_TEMPINTDEGC_FLTMAX_C -60.000000 150.000000 BYTE_ORDER MSB_LAST /end CHARACTERISTIC
/begin RECORD_LAYOUT RL_TEMPINTDEGC_FLTMAX_C FNC_VALUES 1 FLOAT32_IEEE COLUMN_DIR DIRECT /end RECORD_LAYOUT
/begin COMPU_METHOD CU_TEMPINTDEGC_FLTMAX_C "Conversion method for TempIntDegC_FltMax_C" RAT_FUNC "%10.3" "C" COEFFS 0.000000 1.000000 -0.000000 0.000000 0.000000 1.000000 /end COMPU_METHOD
/* Scalar calibration for DDE 'TempIntDegC_FltMin_C'. */
/begin CHARACTERISTIC TempIntDegC_FltMin_C "Internal temperature in DegC Min Fault Limit Cal" VALUE 0xa0108530 RL_TEMPINTDEGC_FLTMIN_C 210.000000 CU_TEMPINTDEGC_FLTMIN_C -60.000000 150.000000 BYTE_ORDER MSB_LAST /end CHARACTERISTIC
/begin RECORD_LAYOUT RL_TEMPINTDEGC_FLTMIN_C FNC_VALUES 1 FLOAT32_IEEE COLUMN_DIR DIRECT /end RECORD_LAYOUT
/begin COMPU_METHOD CU_TEMPINTDEGC_FLTMIN_C "Conversion method for TempIntDegC_FltMin_C" RAT_FUNC "%10.3" "C" COEFFS 0.000000 1.000000 -0.000000 0.000000 0.000000 1.000000 /end COMPU_METHOD
/* Scalar calibration for DDE 'TempInt_FltMax_C'. */
/begin CHARACTERISTIC TempInt_FltMax_C "Internal Temp Max Fault Limit Cal" VALUE 0xa010852c RL_TEMPINT_FLTMAX_C 40.000000 CU_TEMPINT_FLTMAX_C 0.000000 40.000000 BYTE_ORDER MSB_LAST /end CHARACTERISTIC
/begin RECORD_LAYOUT RL_TEMPINT_FLTMAX_C FNC_VALUES 1 FLOAT32_IEEE COLUMN_DIR DIRECT /end RECORD_LAYOUT
/begin COMPU_METHOD CU_TEMPINT_FLTMAX_C "Conversion method for TempInt_FltMax_C" RAT_FUNC "%10.3" "V" COEFFS 0.000000 1.000000 -0.000000 0.000000 0.000000 1.000000 /end COMPU_METHOD
/* Scalar calibration for DDE 'TempInt_FltMin_C'. */
/begin CHARACTERISTIC TempInt_FltMin_C "Internal Temp Min Fault Limit Cal" VALUE 0xa0108528 RL_TEMPINT_FLTMIN_C 40.000000 CU_TEMPINT_FLTMIN_C 0.000000 40.000000 BYTE_ORDER MSB_LAST /end CHARACTERISTIC
/begin RECORD_LAYOUT RL_TEMPINT_FLTMIN_C FNC_VALUES 1 FLOAT32_IEEE COLUMN_DIR DIRECT /end RECORD_LAYOUT
/begin COMPU_METHOD CU_TEMPINT_FLTMIN_C "Conversion method for TempInt_FltMin_C" RAT_FUNC "%10.3" "V" COEFFS 0.000000 1.000000 -0.000000 0.000000 0.000000 1.000000 /end COMPU_METHOD
/* Scalar calibration for DDE 'TempInt_ScaleFactor_C'. */
/begin CHARACTERISTIC TempInt_ScaleFactor_C "Internal Temp Scale value (raw divided by this value to get pin voltage)" VALUE 0xa0108524 RL_TEMPINT_SCALEFACTOR_C 39.999000 CU_TEMPINT_SCALEFACTOR_C 0.001000 40.000000 BYTE_ORDER MSB_LAST /end CHARACTERISTIC
/begin RECORD_LAYOUT RL_TEMPINT_SCALEFACTOR_C FNC_VALUES 1 FLOAT32_IEEE COLUMN_DIR DIRECT /end RECORD_LAYOUT
/begin COMPU_METHOD CU_TEMPINT_SCALEFACTOR_C "Conversion method for TempInt_ScaleFactor_C" RAT_FUNC "%10.3" "(not defined)" COEFFS 0.000000 1.000000 -0.000000 0.000000 0.000000 1.000000 /end COMPU_METHOD
/* Scalar calibration for DDE 'V2gRxMsgSupPrtclRescodeOf_C'. */
/begin CHARACTERISTIC V2gRxMsgSupPrtclRescodeOf_C "Enables overriding for message SupportedAppProtocolRes: indicates the acknowledgment status of  this V2G messages received by the SECC." VALUE 0x70018500 RL_V2GRXMSGSUPPRTCLRESCODEOF_C 1.000000 CU_V2GRXMSGSUPPRTCLRESCODEOF_C 0.000000 1.000000 BYTE_ORDER MSB_LAST /end CHARACTERISTIC
/begin RECORD_LAYOUT RL_V2GRXMSGSUPPRTCLRESCODEOF_C FNC_VALUES 1 UBYTE COLUMN_DIR DIRECT /end RECORD_LAYOUT
/begin COMPU_METHOD CU_V2GRXMSGSUPPRTCLRESCODEOF_C "Conversion method for V2gRxMsgSupPrtclRescodeOf_C" RAT_FUNC "%10.0" "b" COEFFS 0.000000 1.000000 -0.000000 0.000000 0.000000 1.000000 /end COMPU_METHOD
/* Scalar calibration for DDE 'V2gRxMsgSupPrtclRescodeOv_C'. */
/begin CHARACTERISTIC V2gRxMsgSupPrtclRescodeOv_C "Override value for for message SupportedAppProtocolRes: indicates the acknowledgment status of  this V2G messages received by the SECC." VALUE 0x70019e38 RL_V2GRXMSGSUPPRTCLRESCODEOV_C 255.000000 CU_V2GRXMSGSUPPRTCLRESCODEOV_C 0.000000 255.000000 BYTE_ORDER MSB_LAST /end CHARACTERISTIC
/begin RECORD_LAYOUT RL_V2GRXMSGSUPPRTCLRESCODEOV_C FNC_VALUES 1 UBYTE COLUMN_DIR DIRECT /end RECORD_LAYOUT
/begin COMPU_METHOD CU_V2GRXMSGSUPPRTCLRESCODEOV_C "Conversion method for V2gRxMsgSupPrtclRescodeOv_C" RAT_FUNC "%10.0" "1" COEFFS 0.000000 1.000000 -0.000000 0.000000 0.000000 1.000000 /end COMPU_METHOD
/* Scalar calibration for DDE 'V2gRxMsgSupPrtclRxTrgOf_C'. */
/begin CHARACTERISTIC V2gRxMsgSupPrtclRxTrgOf_C "Enables overriding Trigger falg that on a rising edge indicates the event for receiving the PLC (V2G) message response SupportedAppProtocolRes from EVSE" VALUE 0x700185bf RL_V2GRXMSGSUPPRTCLRXTRGOF_C 1.000000 CU_V2GRXMSGSUPPRTCLRXTRGOF_C 0.000000 1.000000 BYTE_ORDER MSB_LAST /end CHARACTERISTIC
/begin RECORD_LAYOUT RL_V2GRXMSGSUPPRTCLRXTRGOF_C FNC_VALUES 1 UBYTE COLUMN_DIR DIRECT /end RECORD_LAYOUT
/begin COMPU_METHOD CU_V2GRXMSGSUPPRTCLRXTRGOF_C "Conversion method for V2gRxMsgSupPrtclRxTrgOf_C" RAT_FUNC "%10.0" "b" COEFFS 0.000000 1.000000 -0.000000 0.000000 0.000000 1.000000 /end COMPU_METHOD
/* Scalar calibration for DDE 'V2gRxMsgSupPrtclRxTrgOv_C'. */
/begin CHARACTERISTIC V2gRxMsgSupPrtclRxTrgOv_C "Override value for Trigger falg that on a rising edge indicates the event for receiving the PLC (V2G) message response SupportedAppProtocolRes from EVSE" VALUE 0x70019d6f RL_V2GRXMSGSUPPRTCLRXTRGOV_C 1.000000 CU_V2GRXMSGSUPPRTCLRXTRGOV_C 0.000000 1.000000 BYTE_ORDER MSB_LAST /end CHARACTERISTIC
/begin RECORD_LAYOUT RL_V2GRXMSGSUPPRTCLRXTRGOV_C FNC_VALUES 1 UBYTE COLUMN_DIR DIRECT /end RECORD_LAYOUT
/begin COMPU_METHOD CU_V2GRXMSGSUPPRTCLRXTRGOV_C "Conversion method for V2gRxMsgSupPrtclRxTrgOv_C" RAT_FUNC "%10.0" "b" COEFFS 0.000000 1.000000 -0.000000 0.000000 0.000000 1.000000 /end COMPU_METHOD
/* Scalar calibration for DDE 'V2gRxSigCrntLimReachedOf_C'. */
/begin CHARACTERISTIC V2gRxSigCrntLimReachedOf_C "Enables overriding V2gRxSigCrntLimReached" VALUE 0x70018701 RL_V2GRXSIGCRNTLIMREACHEDOF_C 1.000000 CU_V2GRXSIGCRNTLIMREACHEDOF_C 0.000000 1.000000 BYTE_ORDER MSB_LAST /end CHARACTERISTIC
/begin RECORD_LAYOUT RL_V2GRXSIGCRNTLIMREACHEDOF_C FNC_VALUES 1 UBYTE COLUMN_DIR DIRECT /end RECORD_LAYOUT
/begin COMPU_METHOD CU_V2GRXSIGCRNTLIMREACHEDOF_C "Conversion method for V2gRxSigCrntLimReachedOf_C" RAT_FUNC "%10.0" "b" COEFFS 0.000000 1.000000 -0.000000 0.000000 0.000000 1.000000 /end COMPU_METHOD
/* Scalar calibration for DDE 'V2gRxSigCrntLimReachedOv_C'. */
/begin CHARACTERISTIC V2gRxSigCrntLimReachedOv_C "Override value for V2gRxSigCrntLimReached" VALUE 0x70019e54 RL_V2GRXSIGCRNTLIMREACHEDOV_C 255.000000 CU_V2GRXSIGCRNTLIMREACHEDOV_C 0.000000 255.000000 BYTE_ORDER MSB_LAST /end CHARACTERISTIC
/begin RECORD_LAYOUT RL_V2GRXSIGCRNTLIMREACHEDOV_C FNC_VALUES 1 UBYTE COLUMN_DIR DIRECT /end RECORD_LAYOUT
/begin COMPU_METHOD CU_V2GRXSIGCRNTLIMREACHEDOV_C "Conversion method for V2gRxSigCrntLimReachedOv_C" RAT_FUNC "%10.0" "b" COEFFS 0.000000 1.000000 -0.000000 0.000000 0.000000 1.000000 /end COMPU_METHOD
/* Scalar calibration for DDE 'V2gRxSigEvseCurrentOf_C'. */
/begin CHARACTERISTIC V2gRxSigEvseCurrentOf_C "Enables overriding V2gRxSigEvseCurrent" VALUE 0x70019784 RL_V2GRXSIGEVSECURRENTOF_C 1.000000 CU_V2GRXSIGEVSECURRENTOF_C 0.000000 1.000000 BYTE_ORDER MSB_LAST /end CHARACTERISTIC
/begin RECORD_LAYOUT RL_V2GRXSIGEVSECURRENTOF_C FNC_VALUES 1 UBYTE COLUMN_DIR DIRECT /end RECORD_LAYOUT
/begin COMPU_METHOD CU_V2GRXSIGEVSECURRENTOF_C "Conversion method for V2gRxSigEvseCurrentOf_C" RAT_FUNC "%10.0" "b" COEFFS 0.000000 1.000000 -0.000000 0.000000 0.000000 1.000000 /end COMPU_METHOD
/* Scalar calibration for DDE 'V2gRxSigEvseCurrentOv_C'. */
/begin CHARACTERISTIC V2gRxSigEvseCurrentOv_C "Override value for V2gRxSigEvseCurrent" VALUE 0x700195c0 RL_V2GRXSIGEVSECURRENTOV_C 680564693277057719623408366969033850880.000000 CU_V2GRXSIGEVSECURRENTOV_C -340282346638528859811704183484516925440.000000 340282346638528859811704183484516925440.000000 BYTE_ORDER MSB_LAST /end CHARACTERISTIC
/begin RECORD_LAYOUT RL_V2GRXSIGEVSECURRENTOV_C FNC_VALUES 1 FLOAT32_IEEE COLUMN_DIR DIRECT /end RECORD_LAYOUT
/begin COMPU_METHOD CU_V2GRXSIGEVSECURRENTOV_C "Conversion method for V2gRxSigEvseCurrentOv_C" RAT_FUNC "%10.0" "A" COEFFS 0.000000 1.000000 -0.000000 0.000000 0.000000 1.000000 /end COMPU_METHOD
/* Scalar calibration for DDE 'V2gRxSigEvseIdLenOf_C'. */
/begin CHARACTERISTIC V2gRxSigEvseIdLenOf_C "Enables overriding V2gRxSigEvseIdLen" VALUE 0x70019e89 RL_V2GRXSIGEVSEIDLENOF_C 1.000000 CU_V2GRXSIGEVSEIDLENOF_C 0.000000 1.000000 BYTE_ORDER MSB_LAST /end CHARACTERISTIC
/begin RECORD_LAYOUT RL_V2GRXSIGEVSEIDLENOF_C FNC_VALUES 1 UBYTE COLUMN_DIR DIRECT /end RECORD_LAYOUT
/begin COMPU_METHOD CU_V2GRXSIGEVSEIDLENOF_C "Conversion method for V2gRxSigEvseIdLenOf_C" RAT_FUNC "%10.0" "b" COEFFS 0.000000 1.000000 -0.000000 0.000000 0.000000 1.000000 /end COMPU_METHOD
/* Scalar calibration for DDE 'V2gRxSigEvseIdLenOv_C'. */
/begin CHARACTERISTIC V2gRxSigEvseIdLenOv_C "Override value for V2gRxSigEvseIdLen" VALUE 0x70019634 RL_V2GRXSIGEVSEIDLENOV_C 255.000000 CU_V2GRXSIGEVSEIDLENOV_C 0.000000 255.000000 BYTE_ORDER MSB_LAST /end CHARACTERISTIC
/begin RECORD_LAYOUT RL_V2GRXSIGEVSEIDLENOV_C FNC_VALUES 1 UBYTE COLUMN_DIR DIRECT /end RECORD_LAYOUT
/begin COMPU_METHOD CU_V2GRXSIGEVSEIDLENOV_C "Conversion method for V2gRxSigEvseIdLenOv_C" RAT_FUNC "%10.0" "1" COEFFS 0.000000 1.000000 -0.000000 0.000000 0.000000 1.000000 /end COMPU_METHOD
/* Scalar calibration for DDE 'V2gRxSigEvseIdOf_C'. */
/begin CHARACTERISTIC V2gRxSigEvseIdOf_C "Enables overriding V2gRxSigEvseId" VALUE 0x700184f5 RL_V2GRXSIGEVSEIDOF_C 1.000000 CU_V2GRXSIGEVSEIDOF_C 0.000000 1.000000 BYTE_ORDER MSB_LAST /end CHARACTERISTIC
/begin RECORD_LAYOUT RL_V2GRXSIGEVSEIDOF_C FNC_VALUES 1 UBYTE COLUMN_DIR DIRECT /end RECORD_LAYOUT
/begin COMPU_METHOD CU_V2GRXSIGEVSEIDOF_C "Conversion method for V2gRxSigEvseIdOf_C" RAT_FUNC "%10.0" "b" COEFFS 0.000000 1.000000 -0.000000 0.000000 0.000000 1.000000 /end COMPU_METHOD
/* Vector/array calibration for DDE 'V2gRxSigEvseIdOv_C'. */
/begin CHARACTERISTIC V2gRxSigEvseIdOv_C "Override value for V2gRxSigEvseId" VAL_BLK 0x70019680 RL_V2GRXSIGEVSEIDOV_C 255.000000 CU_V2GRXSIGEVSEIDOV_C 0.000000 255.000000 NUMBER 38 BYTE_ORDER MSB_LAST /end CHARACTERISTIC
/begin RECORD_LAYOUT RL_V2GRXSIGEVSEIDOV_C FNC_VALUES 1 UBYTE COLUMN_DIR DIRECT /end RECORD_LAYOUT
/begin COMPU_METHOD CU_V2GRXSIGEVSEIDOV_C "Conversion method for V2gRxSigEvseIdOv_C" RAT_FUNC "%10.0" "1" COEFFS 0.000000 1.000000 -0.000000 0.000000 0.000000 1.000000 /end COMPU_METHOD
/* Scalar calibration for DDE 'V2gRxSigEvseMaxDchgCrntOf_C'. */
/begin CHARACTERISTIC V2gRxSigEvseMaxDchgCrntOf_C "Enables overriding V2gRxSigEvseMaxDchgCrnt" VALUE 0x70018703 RL_V2GRXSIGEVSEMAXDCHGCRNTOF_C 1.000000 CU_V2GRXSIGEVSEMAXDCHGCRNTOF_C 0.000000 1.000000 BYTE_ORDER MSB_LAST /end CHARACTERISTIC
/begin RECORD_LAYOUT RL_V2GRXSIGEVSEMAXDCHGCRNTOF_C FNC_VALUES 1 UBYTE COLUMN_DIR DIRECT /end RECORD_LAYOUT
/begin COMPU_METHOD CU_V2GRXSIGEVSEMAXDCHGCRNTOF_C "Conversion method for V2gRxSigEvseMaxDchgCrntOf_C" RAT_FUNC "%10.0" "b" COEFFS 0.000000 1.000000 -0.000000 0.000000 0.000000 1.000000 /end COMPU_METHOD
/* Scalar calibration for DDE 'V2gRxSigEvseMaxDchgCrntOv_C'. */
/begin CHARACTERISTIC V2gRxSigEvseMaxDchgCrntOv_C "Override value for V2gRxSigEvseMaxDchgCrnt" VALUE 0x700176c4 RL_V2GRXSIGEVSEMAXDCHGCRNTOV_C 680564693277057719623408366969033850880.000000 CU_V2GRXSIGEVSEMAXDCHGCRNTOV_C -340282346638528859811704183484516925440.000000 340282346638528859811704183484516925440.000000 BYTE_ORDER MSB_LAST /end CHARACTERISTIC
/begin RECORD_LAYOUT RL_V2GRXSIGEVSEMAXDCHGCRNTOV_C FNC_VALUES 1 FLOAT32_IEEE COLUMN_DIR DIRECT /end RECORD_LAYOUT
/begin COMPU_METHOD CU_V2GRXSIGEVSEMAXDCHGCRNTOV_C "Conversion method for V2gRxSigEvseMaxDchgCrntOv_C" RAT_FUNC "%10.0" "A" COEFFS 0.000000 1.000000 -0.000000 0.000000 0.000000 1.000000 /end COMPU_METHOD
/* Scalar calibration for DDE 'V2gRxSigEvseMaxDchgCrnt_flgOf_C'. */
/begin CHARACTERISTIC V2gRxSigEvseMaxDchgCrnt_flgOf_C "Enables overriding V2gRxSigEvseMaxDchgCrnt_flg" VALUE 0x700197a3 RL_V2GRXSIGEVSEMAXDCHGCRNT_FLG0 1.000000 CU_V2GRXSIGEVSEMAXDCHGCRNT_FLG0 0.000000 1.000000 BYTE_ORDER MSB_LAST /end CHARACTERISTIC
/begin RECORD_LAYOUT RL_V2GRXSIGEVSEMAXDCHGCRNT_FLG0 FNC_VALUES 1 UBYTE COLUMN_DIR DIRECT /end RECORD_LAYOUT
/begin COMPU_METHOD CU_V2GRXSIGEVSEMAXDCHGCRNT_FLG0 "Conversion method for V2gRxSigEvseMaxDchgCrnt_flgOf_C" RAT_FUNC "%10.0" "b" COEFFS 0.000000 1.000000 -0.000000 0.000000 0.000000 1.000000 /end COMPU_METHOD
/* Scalar calibration for DDE 'V2gRxSigEvseMaxDchgCrnt_flgOv_C'. */
/begin CHARACTERISTIC V2gRxSigEvseMaxDchgCrnt_flgOv_C "Override value for V2gRxSigEvseMaxDchgCrnt_flg" VALUE 0x700197a1 RL_V2GRXSIGEVSEMAXDCHGCRNT_FLG2 255.000000 CU_V2GRXSIGEVSEMAXDCHGCRNT_FLG2 0.000000 255.000000 BYTE_ORDER MSB_LAST /end CHARACTERISTIC
/begin RECORD_LAYOUT RL_V2GRXSIGEVSEMAXDCHGCRNT_FLG2 FNC_VALUES 1 UBYTE COLUMN_DIR DIRECT /end RECORD_LAYOUT
/begin COMPU_METHOD CU_V2GRXSIGEVSEMAXDCHGCRNT_FLG2 "Conversion method for V2gRxSigEvseMaxDchgCrnt_flgOv_C" RAT_FUNC "%10.0" "b" COEFFS 0.000000 1.000000 -0.000000 0.000000 0.000000 1.000000 /end COMPU_METHOD
/* Scalar calibration for DDE 'V2gRxSigEvseMaxDchgPwrOf_C'. */
/begin CHARACTERISTIC V2gRxSigEvseMaxDchgPwrOf_C "Enables overriding V2gRxSigEvseMaxDchgPwr" VALUE 0x700196bc RL_V2GRXSIGEVSEMAXDCHGPWROF_C 1.000000 CU_V2GRXSIGEVSEMAXDCHGPWROF_C 0.000000 1.000000 BYTE_ORDER MSB_LAST /end CHARACTERISTIC
/begin RECORD_LAYOUT RL_V2GRXSIGEVSEMAXDCHGPWROF_C FNC_VALUES 1 UBYTE COLUMN_DIR DIRECT /end RECORD_LAYOUT
/begin COMPU_METHOD CU_V2GRXSIGEVSEMAXDCHGPWROF_C "Conversion method for V2gRxSigEvseMaxDchgPwrOf_C" RAT_FUNC "%10.0" "b" COEFFS 0.000000 1.000000 -0.000000 0.000000 0.000000 1.000000 /end COMPU_METHOD
/* Scalar calibration for DDE 'V2gRxSigEvseMaxDchgPwrOv_C'. */
/begin CHARACTERISTIC V2gRxSigEvseMaxDchgPwrOv_C "Override value for V2gRxSigEvseMaxDchgPwr" VALUE 0x700186c0 RL_V2GRXSIGEVSEMAXDCHGPWROV_C 680564693277057719623408366969033850880.000000 CU_V2GRXSIGEVSEMAXDCHGPWROV_C -340282346638528859811704183484516925440.000000 340282346638528859811704183484516925440.000000 BYTE_ORDER MSB_LAST /end CHARACTERISTIC
/begin RECORD_LAYOUT RL_V2GRXSIGEVSEMAXDCHGPWROV_C FNC_VALUES 1 FLOAT32_IEEE COLUMN_DIR DIRECT /end RECORD_LAYOUT
/begin COMPU_METHOD CU_V2GRXSIGEVSEMAXDCHGPWROV_C "Conversion method for V2gRxSigEvseMaxDchgPwrOv_C" RAT_FUNC "%10.0" "W" COEFFS 0.000000 1.000000 -0.000000 0.000000 0.000000 1.000000 /end COMPU_METHOD
/* Scalar calibration for DDE 'V2gRxSigEvseMaxDchgPwr_flgOf_C'. */
/begin CHARACTERISTIC V2gRxSigEvseMaxDchgPwr_flgOf_C "Enables overriding V2gRxSigEvseMaxDchgPwr_flg" VALUE 0x700185bb RL_V2GRXSIGEVSEMAXDCHGPWR_FLGO0 1.000000 CU_V2GRXSIGEVSEMAXDCHGPWR_FLGO0 0.000000 1.000000 BYTE_ORDER MSB_LAST /end CHARACTERISTIC
/begin RECORD_LAYOUT RL_V2GRXSIGEVSEMAXDCHGPWR_FLGO0 FNC_VALUES 1 UBYTE COLUMN_DIR DIRECT /end RECORD_LAYOUT
/begin COMPU_METHOD CU_V2GRXSIGEVSEMAXDCHGPWR_FLGO0 "Conversion method for V2gRxSigEvseMaxDchgPwr_flgOf_C" RAT_FUNC "%10.0" "b" COEFFS 0.000000 1.000000 -0.000000 0.000000 0.000000 1.000000 /end COMPU_METHOD
/* Scalar calibration for DDE 'V2gRxSigEvseMaxDchgPwr_flgOv_C'. */
/begin CHARACTERISTIC V2gRxSigEvseMaxDchgPwr_flgOv_C "Override value for V2gRxSigEvseMaxDchgPwr_flg" VALUE 0x700186e2 RL_V2GRXSIGEVSEMAXDCHGPWR_FLGO1 255.000000 CU_V2GRXSIGEVSEMAXDCHGPWR_FLGO1 0.000000 255.000000 BYTE_ORDER MSB_LAST /end CHARACTERISTIC
/begin RECORD_LAYOUT RL_V2GRXSIGEVSEMAXDCHGPWR_FLGO1 FNC_VALUES 1 UBYTE COLUMN_DIR DIRECT /end RECORD_LAYOUT
/begin COMPU_METHOD CU_V2GRXSIGEVSEMAXDCHGPWR_FLGO1 "Conversion method for V2gRxSigEvseMaxDchgPwr_flgOv_C" RAT_FUNC "%10.0" "b" COEFFS 0.000000 1.000000 -0.000000 0.000000 0.000000 1.000000 /end COMPU_METHOD
/* Scalar calibration for DDE 'V2gRxSigEvseMinCrntOf_C'. */
/begin CHARACTERISTIC V2gRxSigEvseMinCrntOf_C "Enables overriding V2gRxSigEvseMinCrnt" VALUE 0x70019624 RL_V2GRXSIGEVSEMINCRNTOF_C 1.000000 CU_V2GRXSIGEVSEMINCRNTOF_C 0.000000 1.000000 BYTE_ORDER MSB_LAST /end CHARACTERISTIC
/begin RECORD_LAYOUT RL_V2GRXSIGEVSEMINCRNTOF_C FNC_VALUES 1 UBYTE COLUMN_DIR DIRECT /end RECORD_LAYOUT
/begin COMPU_METHOD CU_V2GRXSIGEVSEMINCRNTOF_C "Conversion method for V2gRxSigEvseMinCrntOf_C" RAT_FUNC "%10.0" "b" COEFFS 0.000000 1.000000 -0.000000 0.000000 0.000000 1.000000 /end COMPU_METHOD
/* Scalar calibration for DDE 'V2gRxSigEvseMinCrntOv_C'. */
/begin CHARACTERISTIC V2gRxSigEvseMinCrntOv_C "Override value for V2gRxSigEvseMinCrnt" VALUE 0x700186bc RL_V2GRXSIGEVSEMINCRNTOV_C 680564693277057719623408366969033850880.000000 CU_V2GRXSIGEVSEMINCRNTOV_C -340282346638528859811704183484516925440.000000 340282346638528859811704183484516925440.000000 BYTE_ORDER MSB_LAST /end CHARACTERISTIC
/begin RECORD_LAYOUT RL_V2GRXSIGEVSEMINCRNTOV_C FNC_VALUES 1 FLOAT32_IEEE COLUMN_DIR DIRECT /end RECORD_LAYOUT
/begin COMPU_METHOD CU_V2GRXSIGEVSEMINCRNTOV_C "Conversion method for V2gRxSigEvseMinCrntOv_C" RAT_FUNC "%10.0" "A" COEFFS 0.000000 1.000000 -0.000000 0.000000 0.000000 1.000000 /end COMPU_METHOD
/* Scalar calibration for DDE 'V2gRxSigEvseMinCrnt_flgOf_C'. */
/begin CHARACTERISTIC V2gRxSigEvseMinCrnt_flgOf_C "Enables overriding V2gRxSigEvseMinCrnt_flg" VALUE 0x70019d6a RL_V2GRXSIGEVSEMINCRNT_FLGOF_C 1.000000 CU_V2GRXSIGEVSEMINCRNT_FLGOF_C 0.000000 1.000000 BYTE_ORDER MSB_LAST /end CHARACTERISTIC
/begin RECORD_LAYOUT RL_V2GRXSIGEVSEMINCRNT_FLGOF_C FNC_VALUES 1 UBYTE COLUMN_DIR DIRECT /end RECORD_LAYOUT
/begin COMPU_METHOD CU_V2GRXSIGEVSEMINCRNT_FLGOF_C "Conversion method for V2gRxSigEvseMinCrnt_flgOf_C" RAT_FUNC "%10.0" "b" COEFFS 0.000000 1.000000 -0.000000 0.000000 0.000000 1.000000 /end COMPU_METHOD
/* Scalar calibration for DDE 'V2gRxSigEvseMinCrnt_flgOv_C'. */
/begin CHARACTERISTIC V2gRxSigEvseMinCrnt_flgOv_C "Override value for V2gRxSigEvseMinCrnt_flg" VALUE 0x700195d5 RL_V2GRXSIGEVSEMINCRNT_FLGOV_C 255.000000 CU_V2GRXSIGEVSEMINCRNT_FLGOV_C 0.000000 255.000000 BYTE_ORDER MSB_LAST /end CHARACTERISTIC
/begin RECORD_LAYOUT RL_V2GRXSIGEVSEMINCRNT_FLGOV_C FNC_VALUES 1 UBYTE COLUMN_DIR DIRECT /end RECORD_LAYOUT
/begin COMPU_METHOD CU_V2GRXSIGEVSEMINCRNT_FLGOV_C "Conversion method for V2gRxSigEvseMinCrnt_flgOv_C" RAT_FUNC "%10.0" "b" COEFFS 0.000000 1.000000 -0.000000 0.000000 0.000000 1.000000 /end COMPU_METHOD
/* Scalar calibration for DDE 'V2gRxSigEvseMinDchgCrntOf_C'. */
/begin CHARACTERISTIC V2gRxSigEvseMinDchgCrntOf_C "Enables overriding V2gRxSigEvseMinDchgCrnt" VALUE 0x70019e5f RL_V2GRXSIGEVSEMINDCHGCRNTOF_C 1.000000 CU_V2GRXSIGEVSEMINDCHGCRNTOF_C 0.000000 1.000000 BYTE_ORDER MSB_LAST /end CHARACTERISTIC
/begin RECORD_LAYOUT RL_V2GRXSIGEVSEMINDCHGCRNTOF_C FNC_VALUES 1 UBYTE COLUMN_DIR DIRECT /end RECORD_LAYOUT
/begin COMPU_METHOD CU_V2GRXSIGEVSEMINDCHGCRNTOF_C "Conversion method for V2gRxSigEvseMinDchgCrntOf_C" RAT_FUNC "%10.0" "b" COEFFS 0.000000 1.000000 -0.000000 0.000000 0.000000 1.000000 /end COMPU_METHOD
/* Scalar calibration for DDE 'V2gRxSigEvseMinDchgCrntOv_C'. */
/begin CHARACTERISTIC V2gRxSigEvseMinDchgCrntOv_C "Override value for V2gRxSigEvseMinDchgCrnt" VALUE 0x70019650 RL_V2GRXSIGEVSEMINDCHGCRNTOV_C 680564693277057719623408366969033850880.000000 CU_V2GRXSIGEVSEMINDCHGCRNTOV_C -340282346638528859811704183484516925440.000000 340282346638528859811704183484516925440.000000 BYTE_ORDER MSB_LAST /end CHARACTERISTIC
/begin RECORD_LAYOUT RL_V2GRXSIGEVSEMINDCHGCRNTOV_C FNC_VALUES 1 FLOAT32_IEEE COLUMN_DIR DIRECT /end RECORD_LAYOUT
/begin COMPU_METHOD CU_V2GRXSIGEVSEMINDCHGCRNTOV_C "Conversion method for V2gRxSigEvseMinDchgCrntOv_C" RAT_FUNC "%10.0" "A" COEFFS 0.000000 1.000000 -0.000000 0.000000 0.000000 1.000000 /end COMPU_METHOD
/* Scalar calibration for DDE 'V2gRxSigEvseMinDchgCrnt_flgOf_C'. */
/begin CHARACTERISTIC V2gRxSigEvseMinDchgCrnt_flgOf_C "Enables overriding V2gRxSigEvseMinDchgCrnt_flg" VALUE 0x700196cd RL_V2GRXSIGEVSEMINDCHGCRNT_FLG1 1.000000 CU_V2GRXSIGEVSEMINDCHGCRNT_FLG1 0.000000 1.000000 BYTE_ORDER MSB_LAST /end CHARACTERISTIC
/begin RECORD_LAYOUT RL_V2GRXSIGEVSEMINDCHGCRNT_FLG1 FNC_VALUES 1 UBYTE COLUMN_DIR DIRECT /end RECORD_LAYOUT
/begin COMPU_METHOD CU_V2GRXSIGEVSEMINDCHGCRNT_FLG1 "Conversion method for V2gRxSigEvseMinDchgCrnt_flgOf_C" RAT_FUNC "%10.0" "b" COEFFS 0.000000 1.000000 -0.000000 0.000000 0.000000 1.000000 /end COMPU_METHOD
/* Scalar calibration for DDE 'V2gRxSigEvseMinDchgCrnt_flgOv_C'. */
/begin CHARACTERISTIC V2gRxSigEvseMinDchgCrnt_flgOv_C "Override value for V2gRxSigEvseMinDchgCrnt_flg" VALUE 0x700185cb RL_V2GRXSIGEVSEMINDCHGCRNT_FLG2 255.000000 CU_V2GRXSIGEVSEMINDCHGCRNT_FLG2 0.000000 255.000000 BYTE_ORDER MSB_LAST /end CHARACTERISTIC
/begin RECORD_LAYOUT RL_V2GRXSIGEVSEMINDCHGCRNT_FLG2 FNC_VALUES 1 UBYTE COLUMN_DIR DIRECT /end RECORD_LAYOUT
/begin COMPU_METHOD CU_V2GRXSIGEVSEMINDCHGCRNT_FLG2 "Conversion method for V2gRxSigEvseMinDchgCrnt_flgOv_C" RAT_FUNC "%10.0" "b" COEFFS 0.000000 1.000000 -0.000000 0.000000 0.000000 1.000000 /end COMPU_METHOD
/* Scalar calibration for DDE 'V2gRxSigEvseProcessingOf_C'. */
/begin CHARACTERISTIC V2gRxSigEvseProcessingOf_C "Enables overriding V2gRxSigEvseProcessing" VALUE 0x700195ea RL_V2GRXSIGEVSEPROCESSINGOF_C 1.000000 CU_V2GRXSIGEVSEPROCESSINGOF_C 0.000000 1.000000 BYTE_ORDER MSB_LAST /end CHARACTERISTIC
/begin RECORD_LAYOUT RL_V2GRXSIGEVSEPROCESSINGOF_C FNC_VALUES 1 UBYTE COLUMN_DIR DIRECT /end RECORD_LAYOUT
/begin COMPU_METHOD CU_V2GRXSIGEVSEPROCESSINGOF_C "Conversion method for V2gRxSigEvseProcessingOf_C" RAT_FUNC "%10.0" "b" COEFFS 0.000000 1.000000 -0.000000 0.000000 0.000000 1.000000 /end COMPU_METHOD
/* Scalar calibration for DDE 'V2gRxSigEvseProcessingOv_C'. */
/begin CHARACTERISTIC V2gRxSigEvseProcessingOv_C "Override value for V2gRxSigEvseProcessing" VALUE 0x70018688 RL_V2GRXSIGEVSEPROCESSINGOV_C 4294967295.000000 CU_V2GRXSIGEVSEPROCESSINGOV_C -2147483648.000000 2147483647.000000 BYTE_ORDER MSB_LAST /end CHARACTERISTIC
/begin RECORD_LAYOUT RL_V2GRXSIGEVSEPROCESSINGOV_C FNC_VALUES 1 SLONG COLUMN_DIR DIRECT /end RECORD_LAYOUT
/begin COMPU_METHOD CU_V2GRXSIGEVSEPROCESSINGOV_C "Conversion method for V2gRxSigEvseProcessingOv_C" TAB_VERB "%12.0" "enum" COMPU_TAB_REF CT_V2GRXSIGEVSEPROCESSINGOV_C /end COMPU_METHOD
/begin COMPU_VTAB CT_V2GRXSIGEVSEPROCESSINGOV_C "Conversion method for V2gRxSigEvseProcessingOv_C" TAB_VERB 3 0 "FINISHED" 1 "ONGOING" 2 "ONGOING_WAITINGFORCUSTOMERINTERACTION" /end COMPU_VTAB
/* Scalar calibration for DDE 'V2gRxSigEvseStatusOf_C'. */
/begin CHARACTERISTIC V2gRxSigEvseStatusOf_C "Enables overriding V2gRxSigEvseStatus" VALUE 0x70019e30 RL_V2GRXSIGEVSESTATUSOF_C 1.000000 CU_V2GRXSIGEVSESTATUSOF_C 0.000000 1.000000 BYTE_ORDER MSB_LAST /end CHARACTERISTIC
/begin RECORD_LAYOUT RL_V2GRXSIGEVSESTATUSOF_C FNC_VALUES 1 UBYTE COLUMN_DIR DIRECT /end RECORD_LAYOUT
/begin COMPU_METHOD CU_V2GRXSIGEVSESTATUSOF_C "Conversion method for V2gRxSigEvseStatusOf_C" RAT_FUNC "%10.0" "b" COEFFS 0.000000 1.000000 -0.000000 0.000000 0.000000 1.000000 /end COMPU_METHOD
/* Scalar calibration for DDE 'V2gRxSigEvseStatusOv_C'. */
/begin CHARACTERISTIC V2gRxSigEvseStatusOv_C "Override value for V2gRxSigEvseStatus" VALUE 0x70018668 RL_V2GRXSIGEVSESTATUSOV_C 4294967295.000000 CU_V2GRXSIGEVSESTATUSOV_C -2147483648.000000 2147483647.000000 BYTE_ORDER MSB_LAST /end CHARACTERISTIC
/begin RECORD_LAYOUT RL_V2GRXSIGEVSESTATUSOV_C FNC_VALUES 1 SLONG COLUMN_DIR DIRECT /end RECORD_LAYOUT
/begin COMPU_METHOD CU_V2GRXSIGEVSESTATUSOV_C "Conversion method for V2gRxSigEvseStatusOv_C" TAB_VERB "%12.0" "enum" COMPU_TAB_REF CT_V2GRXSIGEVSESTATUSOV_C /end COMPU_METHOD
/begin COMPU_VTAB CT_V2GRXSIGEVSESTATUSOV_C "Conversion method for V2gRxSigEvseStatusOv_C" TAB_VERB 12 0 "EVSE_NOT_READY" 1 "EVSE_READY" 2 "EVSE_SHUTDOWN" 3 "EVSE_UTILITY_INTERRUPT" 4 "EVSE_ISOLATION_MONITOR_ACTV" 5 "EVSE_EMERGENCY_SHUTDOWN" 6 "EVSE_MALFUNCTION" 7 "EVSE_STATUS_RESERVED1" 8 "EVSE_STATUS_RESERVED2" 9 "EVSE_STATUS_RESERVED3" 10 "EVSE_STATUS_RESERVED4" 11 "EVSE_STATUS_RESERVED5" /end COMPU_VTAB
/* Scalar calibration for DDE 'V2gRxSigEvseStatus_flgOf_C'. */
/begin CHARACTERISTIC V2gRxSigEvseStatus_flgOf_C "Enables overriding V2gRxSigEvseStatus_flg" VALUE 0x700186f4 RL_V2GRXSIGEVSESTATUS_FLGOF_C 1.000000 CU_V2GRXSIGEVSESTATUS_FLGOF_C 0.000000 1.000000 BYTE_ORDER MSB_LAST /end CHARACTERISTIC
/begin RECORD_LAYOUT RL_V2GRXSIGEVSESTATUS_FLGOF_C FNC_VALUES 1 UBYTE COLUMN_DIR DIRECT /end RECORD_LAYOUT
/begin COMPU_METHOD CU_V2GRXSIGEVSESTATUS_FLGOF_C "Conversion method for V2gRxSigEvseStatus_flgOf_C" RAT_FUNC "%10.0" "b" COEFFS 0.000000 1.000000 -0.000000 0.000000 0.000000 1.000000 /end COMPU_METHOD
/* Scalar calibration for DDE 'V2gRxSigEvseStatus_flgOv_C'. */
/begin CHARACTERISTIC V2gRxSigEvseStatus_flgOv_C "Override value for V2gRxSigEvseStatus_flg" VALUE 0x700197a4 RL_V2GRXSIGEVSESTATUS_FLGOV_C 255.000000 CU_V2GRXSIGEVSESTATUS_FLGOV_C 0.000000 255.000000 BYTE_ORDER MSB_LAST /end CHARACTERISTIC
/begin RECORD_LAYOUT RL_V2GRXSIGEVSESTATUS_FLGOV_C FNC_VALUES 1 UBYTE COLUMN_DIR DIRECT /end RECORD_LAYOUT
/begin COMPU_METHOD CU_V2GRXSIGEVSESTATUS_FLGOV_C "Conversion method for V2gRxSigEvseStatus_flgOv_C" RAT_FUNC "%10.0" "b" COEFFS 0.000000 1.000000 -0.000000 0.000000 0.000000 1.000000 /end COMPU_METHOD
/* Scalar calibration for DDE 'V2gRxSigEvseVoltageOf_C'. */
/begin CHARACTERISTIC V2gRxSigEvseVoltageOf_C "Enables overriding V2gRxSigEvseVoltage" VALUE 0x7001867d RL_V2GRXSIGEVSEVOLTAGEOF_C 1.000000 CU_V2GRXSIGEVSEVOLTAGEOF_C 0.000000 1.000000 BYTE_ORDER MSB_LAST /end CHARACTERISTIC
/begin RECORD_LAYOUT RL_V2GRXSIGEVSEVOLTAGEOF_C FNC_VALUES 1 UBYTE COLUMN_DIR DIRECT /end RECORD_LAYOUT
/begin COMPU_METHOD CU_V2GRXSIGEVSEVOLTAGEOF_C "Conversion method for V2gRxSigEvseVoltageOf_C" RAT_FUNC "%10.0" "b" COEFFS 0.000000 1.000000 -0.000000 0.000000 0.000000 1.000000 /end COMPU_METHOD
/* Scalar calibration for DDE 'V2gRxSigEvseVoltageOv_C'. */
/begin CHARACTERISTIC V2gRxSigEvseVoltageOv_C "Override value for V2gRxSigEvseVoltage" VALUE 0x700184d8 RL_V2GRXSIGEVSEVOLTAGEOV_C 680564693277057719623408366969033850880.000000 CU_V2GRXSIGEVSEVOLTAGEOV_C -340282346638528859811704183484516925440.000000 340282346638528859811704183484516925440.000000 BYTE_ORDER MSB_LAST /end CHARACTERISTIC
/begin RECORD_LAYOUT RL_V2GRXSIGEVSEVOLTAGEOV_C FNC_VALUES 1 FLOAT32_IEEE COLUMN_DIR DIRECT /end RECORD_LAYOUT
/begin COMPU_METHOD CU_V2GRXSIGEVSEVOLTAGEOV_C "Conversion method for V2gRxSigEvseVoltageOv_C" RAT_FUNC "%10.0" "V" COEFFS 0.000000 1.000000 -0.000000 0.000000 0.000000 1.000000 /end COMPU_METHOD
/* Scalar calibration for DDE 'V2gRxSigIsolStatusOf_C'. */
/begin CHARACTERISTIC V2gRxSigIsolStatusOf_C "Enables overriding V2gRxSigIsolStatus" VALUE 0x700185a0 RL_V2GRXSIGISOLSTATUSOF_C 1.000000 CU_V2GRXSIGISOLSTATUSOF_C 0.000000 1.000000 BYTE_ORDER MSB_LAST /end CHARACTERISTIC
/begin RECORD_LAYOUT RL_V2GRXSIGISOLSTATUSOF_C FNC_VALUES 1 UBYTE COLUMN_DIR DIRECT /end RECORD_LAYOUT
/begin COMPU_METHOD CU_V2GRXSIGISOLSTATUSOF_C "Conversion method for V2gRxSigIsolStatusOf_C" RAT_FUNC "%10.0" "b" COEFFS 0.000000 1.000000 -0.000000 0.000000 0.000000 1.000000 /end COMPU_METHOD
/* Scalar calibration for DDE 'V2gRxSigIsolStatusOv_C'. */
/begin CHARACTERISTIC V2gRxSigIsolStatusOv_C "Override value for V2gRxSigIsolStatus" VALUE 0x70018660 RL_V2GRXSIGISOLSTATUSOV_C 4294967295.000000 CU_V2GRXSIGISOLSTATUSOV_C -2147483648.000000 2147483647.000000 BYTE_ORDER MSB_LAST /end CHARACTERISTIC
/begin RECORD_LAYOUT RL_V2GRXSIGISOLSTATUSOV_C FNC_VALUES 1 SLONG COLUMN_DIR DIRECT /end RECORD_LAYOUT
/begin COMPU_METHOD CU_V2GRXSIGISOLSTATUSOV_C "Conversion method for V2gRxSigIsolStatusOv_C" TAB_VERB "%12.0" "enum" COMPU_TAB_REF CT_V2GRXSIGISOLSTATUSOV_C /end COMPU_METHOD
/begin COMPU_VTAB CT_V2GRXSIGISOLSTATUSOV_C "Conversion method for V2gRxSigIsolStatusOv_C" TAB_VERB 4 0 "ISOLATION_INVALID" 1 "ISOLATION_VALID" 2 "ISOLATION_WARNING" 3 "ISOLATION_FAULT" /end COMPU_VTAB
/* Scalar calibration for DDE 'V2gRxSigIsolStatus_flgOf_C'. */
/begin CHARACTERISTIC V2gRxSigIsolStatus_flgOf_C "Enables overriding V2gRxSigIsolStatus_flg" VALUE 0x700185d6 RL_V2GRXSIGISOLSTATUS_FLGOF_C 1.000000 CU_V2GRXSIGISOLSTATUS_FLGOF_C 0.000000 1.000000 BYTE_ORDER MSB_LAST /end CHARACTERISTIC
/begin RECORD_LAYOUT RL_V2GRXSIGISOLSTATUS_FLGOF_C FNC_VALUES 1 UBYTE COLUMN_DIR DIRECT /end RECORD_LAYOUT
/begin COMPU_METHOD CU_V2GRXSIGISOLSTATUS_FLGOF_C "Conversion method for V2gRxSigIsolStatus_flgOf_C" RAT_FUNC "%10.0" "b" COEFFS 0.000000 1.000000 -0.000000 0.000000 0.000000 1.000000 /end COMPU_METHOD
/* Scalar calibration for DDE 'V2gRxSigIsolStatus_flgOv_C'. */
/begin CHARACTERISTIC V2gRxSigIsolStatus_flgOv_C "Override value for V2gRxSigIsolStatus_flg" VALUE 0x70019db0 RL_V2GRXSIGISOLSTATUS_FLGOV_C 255.000000 CU_V2GRXSIGISOLSTATUS_FLGOV_C 0.000000 255.000000 BYTE_ORDER MSB_LAST /end CHARACTERISTIC
/begin RECORD_LAYOUT RL_V2GRXSIGISOLSTATUS_FLGOV_C FNC_VALUES 1 UBYTE COLUMN_DIR DIRECT /end RECORD_LAYOUT
/begin COMPU_METHOD CU_V2GRXSIGISOLSTATUS_FLGOV_C "Conversion method for V2gRxSigIsolStatus_flgOv_C" RAT_FUNC "%10.0" "b" COEFFS 0.000000 1.000000 -0.000000 0.000000 0.000000 1.000000 /end COMPU_METHOD
/* Scalar calibration for DDE 'V2gRxSigMaxCrntOf_C'. */
/begin CHARACTERISTIC V2gRxSigMaxCrntOf_C "Enables overriding V2gRxSigMaxCrnt" VALUE 0x70019e9d RL_V2GRXSIGMAXCRNTOF_C 1.000000 CU_V2GRXSIGMAXCRNTOF_C 0.000000 1.000000 BYTE_ORDER MSB_LAST /end CHARACTERISTIC
/begin RECORD_LAYOUT RL_V2GRXSIGMAXCRNTOF_C FNC_VALUES 1 UBYTE COLUMN_DIR DIRECT /end RECORD_LAYOUT
/begin COMPU_METHOD CU_V2GRXSIGMAXCRNTOF_C "Conversion method for V2gRxSigMaxCrntOf_C" RAT_FUNC "%10.0" "b" COEFFS 0.000000 1.000000 -0.000000 0.000000 0.000000 1.000000 /end COMPU_METHOD
/* Scalar calibration for DDE 'V2gRxSigMaxCrntOv_C'. */
/begin CHARACTERISTIC V2gRxSigMaxCrntOv_C "Override value for V2gRxSigMaxCrnt" VALUE 0x70019724 RL_V2GRXSIGMAXCRNTOV_C 680564693277057719623408366969033850880.000000 CU_V2GRXSIGMAXCRNTOV_C -340282346638528859811704183484516925440.000000 340282346638528859811704183484516925440.000000 BYTE_ORDER MSB_LAST /end CHARACTERISTIC
/begin RECORD_LAYOUT RL_V2GRXSIGMAXCRNTOV_C FNC_VALUES 1 FLOAT32_IEEE COLUMN_DIR DIRECT /end RECORD_LAYOUT
/begin COMPU_METHOD CU_V2GRXSIGMAXCRNTOV_C "Conversion method for V2gRxSigMaxCrntOv_C" RAT_FUNC "%10.0" "A" COEFFS 0.000000 1.000000 -0.000000 0.000000 0.000000 1.000000 /end COMPU_METHOD
/* Scalar calibration for DDE 'V2gRxSigMaxCrnt_flgOf_C'. */
/begin CHARACTERISTIC V2gRxSigMaxCrnt_flgOf_C "Enables overriding V2gRxSigMaxCrnt_flg" VALUE 0x700196b3 RL_V2GRXSIGMAXCRNT_FLGOF_C 1.000000 CU_V2GRXSIGMAXCRNT_FLGOF_C 0.000000 1.000000 BYTE_ORDER MSB_LAST /end CHARACTERISTIC
/begin RECORD_LAYOUT RL_V2GRXSIGMAXCRNT_FLGOF_C FNC_VALUES 1 UBYTE COLUMN_DIR DIRECT /end RECORD_LAYOUT
/begin COMPU_METHOD CU_V2GRXSIGMAXCRNT_FLGOF_C "Conversion method for V2gRxSigMaxCrnt_flgOf_C" RAT_FUNC "%10.0" "b" COEFFS 0.000000 1.000000 -0.000000 0.000000 0.000000 1.000000 /end COMPU_METHOD
/* Scalar calibration for DDE 'V2gRxSigMaxCrnt_flgOv_C'. */
/begin CHARACTERISTIC V2gRxSigMaxCrnt_flgOv_C "Override value for V2gRxSigMaxCrnt_flg" VALUE 0x700185b8 RL_V2GRXSIGMAXCRNT_FLGOV_C 255.000000 CU_V2GRXSIGMAXCRNT_FLGOV_C 0.000000 255.000000 BYTE_ORDER MSB_LAST /end CHARACTERISTIC
/begin RECORD_LAYOUT RL_V2GRXSIGMAXCRNT_FLGOV_C FNC_VALUES 1 UBYTE COLUMN_DIR DIRECT /end RECORD_LAYOUT
/begin COMPU_METHOD CU_V2GRXSIGMAXCRNT_FLGOV_C "Conversion method for V2gRxSigMaxCrnt_flgOv_C" RAT_FUNC "%10.0" "b" COEFFS 0.000000 1.000000 -0.000000 0.000000 0.000000 1.000000 /end COMPU_METHOD
/* Scalar calibration for DDE 'V2gRxSigMaxPwrOf_C'. */
/begin CHARACTERISTIC V2gRxSigMaxPwrOf_C "Enables overriding V2gRxSigMaxPwr" VALUE 0x700195eb RL_V2GRXSIGMAXPWROF_C 1.000000 CU_V2GRXSIGMAXPWROF_C 0.000000 1.000000 BYTE_ORDER MSB_LAST /end CHARACTERISTIC
/begin RECORD_LAYOUT RL_V2GRXSIGMAXPWROF_C FNC_VALUES 1 UBYTE COLUMN_DIR DIRECT /end RECORD_LAYOUT
/begin COMPU_METHOD CU_V2GRXSIGMAXPWROF_C "Conversion method for V2gRxSigMaxPwrOf_C" RAT_FUNC "%10.0" "b" COEFFS 0.000000 1.000000 -0.000000 0.000000 0.000000 1.000000 /end COMPU_METHOD
/* Scalar calibration for DDE 'V2gRxSigMaxPwrOv_C'. */
/begin CHARACTERISTIC V2gRxSigMaxPwrOv_C "Override value for V2gRxSigMaxPwr" VALUE 0x7001853c RL_V2GRXSIGMAXPWROV_C 680564693277057719623408366969033850880.000000 CU_V2GRXSIGMAXPWROV_C -340282346638528859811704183484516925440.000000 340282346638528859811704183484516925440.000000 BYTE_ORDER MSB_LAST /end CHARACTERISTIC
/begin RECORD_LAYOUT RL_V2GRXSIGMAXPWROV_C FNC_VALUES 1 FLOAT32_IEEE COLUMN_DIR DIRECT /end RECORD_LAYOUT
/begin COMPU_METHOD CU_V2GRXSIGMAXPWROV_C "Conversion method for V2gRxSigMaxPwrOv_C" RAT_FUNC "%10.0" "W" COEFFS 0.000000 1.000000 -0.000000 0.000000 0.000000 1.000000 /end COMPU_METHOD
/* Scalar calibration for DDE 'V2gRxSigMaxPwr_flgOf_C'. */
/begin CHARACTERISTIC V2gRxSigMaxPwr_flgOf_C "Enables overriding V2gRxSigMaxPwr_flg" VALUE 0x700197a2 RL_V2GRXSIGMAXPWR_FLGOF_C 1.000000 CU_V2GRXSIGMAXPWR_FLGOF_C 0.000000 1.000000 BYTE_ORDER MSB_LAST /end CHARACTERISTIC
/begin RECORD_LAYOUT RL_V2GRXSIGMAXPWR_FLGOF_C FNC_VALUES 1 UBYTE COLUMN_DIR DIRECT /end RECORD_LAYOUT
/begin COMPU_METHOD CU_V2GRXSIGMAXPWR_FLGOF_C "Conversion method for V2gRxSigMaxPwr_flgOf_C" RAT_FUNC "%10.0" "b" COEFFS 0.000000 1.000000 -0.000000 0.000000 0.000000 1.000000 /end COMPU_METHOD
/* Scalar calibration for DDE 'V2gRxSigMaxPwr_flgOv_C'. */
/begin CHARACTERISTIC V2gRxSigMaxPwr_flgOv_C "Override value for V2gRxSigMaxPwr_flg" VALUE 0x70018704 RL_V2GRXSIGMAXPWR_FLGOV_C 255.000000 CU_V2GRXSIGMAXPWR_FLGOV_C 0.000000 255.000000 BYTE_ORDER MSB_LAST /end CHARACTERISTIC
/begin RECORD_LAYOUT RL_V2GRXSIGMAXPWR_FLGOV_C FNC_VALUES 1 UBYTE COLUMN_DIR DIRECT /end RECORD_LAYOUT
/begin COMPU_METHOD CU_V2GRXSIGMAXPWR_FLGOV_C "Conversion method for V2gRxSigMaxPwr_flgOv_C" RAT_FUNC "%10.0" "b" COEFFS 0.000000 1.000000 -0.000000 0.000000 0.000000 1.000000 /end COMPU_METHOD
/* Scalar calibration for DDE 'V2gRxSigMaxVoltOf_C'. */
/begin CHARACTERISTIC V2gRxSigMaxVoltOf_C "Enables overriding V2gRxSigMaxVolt" VALUE 0x70019654 RL_V2GRXSIGMAXVOLTOF_C 1.000000 CU_V2GRXSIGMAXVOLTOF_C 0.000000 1.000000 BYTE_ORDER MSB_LAST /end CHARACTERISTIC
/begin RECORD_LAYOUT RL_V2GRXSIGMAXVOLTOF_C FNC_VALUES 1 UBYTE COLUMN_DIR DIRECT /end RECORD_LAYOUT
/begin COMPU_METHOD CU_V2GRXSIGMAXVOLTOF_C "Conversion method for V2gRxSigMaxVoltOf_C" RAT_FUNC "%10.0" "b" COEFFS 0.000000 1.000000 -0.000000 0.000000 0.000000 1.000000 /end COMPU_METHOD
/* Scalar calibration for DDE 'V2gRxSigMaxVoltOv_C'. */
/begin CHARACTERISTIC V2gRxSigMaxVoltOv_C "Override value for V2gRxSigMaxVolt\n" VALUE 0x70019e6c RL_V2GRXSIGMAXVOLTOV_C 680564693277057719623408366969033850880.000000 CU_V2GRXSIGMAXVOLTOV_C -340282346638528859811704183484516925440.000000 340282346638528859811704183484516925440.000000 BYTE_ORDER MSB_LAST /end CHARACTERISTIC
/begin RECORD_LAYOUT RL_V2GRXSIGMAXVOLTOV_C FNC_VALUES 1 FLOAT32_IEEE COLUMN_DIR DIRECT /end RECORD_LAYOUT
/begin COMPU_METHOD CU_V2GRXSIGMAXVOLTOV_C "Conversion method for V2gRxSigMaxVoltOv_C" RAT_FUNC "%10.0" "V" COEFFS 0.000000 1.000000 -0.000000 0.000000 0.000000 1.000000 /end COMPU_METHOD
/* Scalar calibration for DDE 'V2gRxSigMaxVolt_flgOf_C'. */
/begin CHARACTERISTIC V2gRxSigMaxVolt_flgOf_C "Enables overriding V2gRxSigMaxVolt_flg" VALUE 0x700189c8 RL_V2GRXSIGMAXVOLT_FLGOF_C 1.000000 CU_V2GRXSIGMAXVOLT_FLGOF_C 0.000000 1.000000 BYTE_ORDER MSB_LAST /end CHARACTERISTIC
/begin RECORD_LAYOUT RL_V2GRXSIGMAXVOLT_FLGOF_C FNC_VALUES 1 UBYTE COLUMN_DIR DIRECT /end RECORD_LAYOUT
/begin COMPU_METHOD CU_V2GRXSIGMAXVOLT_FLGOF_C "Conversion method for V2gRxSigMaxVolt_flgOf_C" RAT_FUNC "%10.0" "b" COEFFS 0.000000 1.000000 -0.000000 0.000000 0.000000 1.000000 /end COMPU_METHOD
/* Scalar calibration for DDE 'V2gRxSigMaxVolt_flgOv_C'. */
/begin CHARACTERISTIC V2gRxSigMaxVolt_flgOv_C "Override value for V2gRxSigMaxVolt_flg" VALUE 0x70019e5e RL_V2GRXSIGMAXVOLT_FLGOV_C 255.000000 CU_V2GRXSIGMAXVOLT_FLGOV_C 0.000000 255.000000 BYTE_ORDER MSB_LAST /end CHARACTERISTIC
/begin RECORD_LAYOUT RL_V2GRXSIGMAXVOLT_FLGOV_C FNC_VALUES 1 UBYTE COLUMN_DIR DIRECT /end RECORD_LAYOUT
/begin COMPU_METHOD CU_V2GRXSIGMAXVOLT_FLGOV_C "Conversion method for V2gRxSigMaxVolt_flgOv_C" RAT_FUNC "%10.0" "b" COEFFS 0.000000 1.000000 -0.000000 0.000000 0.000000 1.000000 /end COMPU_METHOD
/* Scalar calibration for DDE 'V2gRxSigMinVoltOf_C'. */
/begin CHARACTERISTIC V2gRxSigMinVoltOf_C "Enables overriding V2gRxSigMinVolt" VALUE 0x70019d67 RL_V2GRXSIGMINVOLTOF_C 1.000000 CU_V2GRXSIGMINVOLTOF_C 0.000000 1.000000 BYTE_ORDER MSB_LAST /end CHARACTERISTIC
/begin RECORD_LAYOUT RL_V2GRXSIGMINVOLTOF_C FNC_VALUES 1 UBYTE COLUMN_DIR DIRECT /end RECORD_LAYOUT
/begin COMPU_METHOD CU_V2GRXSIGMINVOLTOF_C "Conversion method for V2gRxSigMinVoltOf_C" RAT_FUNC "%10.0" "b" COEFFS 0.000000 1.000000 -0.000000 0.000000 0.000000 1.000000 /end COMPU_METHOD
/* Scalar calibration for DDE 'V2gRxSigMinVoltOv_C'. */
/begin CHARACTERISTIC V2gRxSigMinVoltOv_C "Override value for V2gRxSigMinVolt" VALUE 0x70019db4 RL_V2GRXSIGMINVOLTOV_C 680564693277057719623408366969033850880.000000 CU_V2GRXSIGMINVOLTOV_C -340282346638528859811704183484516925440.000000 340282346638528859811704183484516925440.000000 BYTE_ORDER MSB_LAST /end CHARACTERISTIC
/begin RECORD_LAYOUT RL_V2GRXSIGMINVOLTOV_C FNC_VALUES 1 FLOAT32_IEEE COLUMN_DIR DIRECT /end RECORD_LAYOUT
/begin COMPU_METHOD CU_V2GRXSIGMINVOLTOV_C "Conversion method for V2gRxSigMinVoltOv_C" RAT_FUNC "%10.0" "V" COEFFS 0.000000 1.000000 -0.000000 0.000000 0.000000 1.000000 /end COMPU_METHOD
/* Scalar calibration for DDE 'V2gRxSigMinVolt_flgOf_C'. */
/begin CHARACTERISTIC V2gRxSigMinVolt_flgOf_C "Enables overriding V2gRxSigMinVolt_flg" VALUE 0x700186f0 RL_V2GRXSIGMINVOLT_FLGOF_C 1.000000 CU_V2GRXSIGMINVOLT_FLGOF_C 0.000000 1.000000 BYTE_ORDER MSB_LAST /end CHARACTERISTIC
/begin RECORD_LAYOUT RL_V2GRXSIGMINVOLT_FLGOF_C FNC_VALUES 1 UBYTE COLUMN_DIR DIRECT /end RECORD_LAYOUT
/begin COMPU_METHOD CU_V2GRXSIGMINVOLT_FLGOF_C "Conversion method for V2gRxSigMinVolt_flgOf_C" RAT_FUNC "%10.0" "b" COEFFS 0.000000 1.000000 -0.000000 0.000000 0.000000 1.000000 /end COMPU_METHOD
/* Scalar calibration for DDE 'V2gRxSigMinVolt_flgOv_C'. */
/begin CHARACTERISTIC V2gRxSigMinVolt_flgOv_C "Override value for V2gRxSigMinVolt_flg\n" VALUE 0x700185d0 RL_V2GRXSIGMINVOLT_FLGOV_C 255.000000 CU_V2GRXSIGMINVOLT_FLGOV_C 0.000000 255.000000 BYTE_ORDER MSB_LAST /end CHARACTERISTIC
/begin RECORD_LAYOUT RL_V2GRXSIGMINVOLT_FLGOV_C FNC_VALUES 1 UBYTE COLUMN_DIR DIRECT /end RECORD_LAYOUT
/begin COMPU_METHOD CU_V2GRXSIGMINVOLT_FLGOV_C "Conversion method for V2gRxSigMinVolt_flgOv_C" RAT_FUNC "%10.0" "b" COEFFS 0.000000 1.000000 -0.000000 0.000000 0.000000 1.000000 /end COMPU_METHOD
/* Scalar calibration for DDE 'V2gRxSigNotifFlgOf_C'. */
/begin CHARACTERISTIC V2gRxSigNotifFlgOf_C "Enables overriding V2gRxSigNotifFlg" VALUE 0x700186a4 RL_V2GRXSIGNOTIFFLGOF_C 1.000000 CU_V2GRXSIGNOTIFFLGOF_C 0.000000 1.000000 BYTE_ORDER MSB_LAST /end CHARACTERISTIC
/begin RECORD_LAYOUT RL_V2GRXSIGNOTIFFLGOF_C FNC_VALUES 1 UBYTE COLUMN_DIR DIRECT /end RECORD_LAYOUT
/begin COMPU_METHOD CU_V2GRXSIGNOTIFFLGOF_C "Conversion method for V2gRxSigNotifFlgOf_C" RAT_FUNC "%10.0" "b" COEFFS 0.000000 1.000000 -0.000000 0.000000 0.000000 1.000000 /end COMPU_METHOD
/* Scalar calibration for DDE 'V2gRxSigNotifFlgOv_C'. */
/begin CHARACTERISTIC V2gRxSigNotifFlgOv_C "Override value for V2gRxSigNotifFlg" VALUE 0x70019d95 RL_V2GRXSIGNOTIFFLGOV_C 255.000000 CU_V2GRXSIGNOTIFFLGOV_C 0.000000 255.000000 BYTE_ORDER MSB_LAST /end CHARACTERISTIC
/begin RECORD_LAYOUT RL_V2GRXSIGNOTIFFLGOV_C FNC_VALUES 1 UBYTE COLUMN_DIR DIRECT /end RECORD_LAYOUT
/begin COMPU_METHOD CU_V2GRXSIGNOTIFFLGOV_C "Conversion method for V2gRxSigNotifFlgOv_C" RAT_FUNC "%10.0" "b" COEFFS 0.000000 1.000000 -0.000000 0.000000 0.000000 1.000000 /end COMPU_METHOD
/* Scalar calibration for DDE 'V2gRxSigNotifMaxDelayOf_C'. */
/begin CHARACTERISTIC V2gRxSigNotifMaxDelayOf_C "Enables overriding V2gRxSigNotifMaxDelay" VALUE 0x700185b5 RL_V2GRXSIGNOTIFMAXDELAYOF_C 1.000000 CU_V2GRXSIGNOTIFMAXDELAYOF_C 0.000000 1.000000 BYTE_ORDER MSB_LAST /end CHARACTERISTIC
/begin RECORD_LAYOUT RL_V2GRXSIGNOTIFMAXDELAYOF_C FNC_VALUES 1 UBYTE COLUMN_DIR DIRECT /end RECORD_LAYOUT
/begin COMPU_METHOD CU_V2GRXSIGNOTIFMAXDELAYOF_C "Conversion method for V2gRxSigNotifMaxDelayOf_C" RAT_FUNC "%10.0" "b" COEFFS 0.000000 1.000000 -0.000000 0.000000 0.000000 1.000000 /end COMPU_METHOD
/* Scalar calibration for DDE 'V2gRxSigNotifMaxDelayOv_C'. */
/begin CHARACTERISTIC V2gRxSigNotifMaxDelayOv_C "Override value for V2gRxSigNotifMaxDelay" VALUE 0x70019740 RL_V2GRXSIGNOTIFMAXDELAYOV_C 65535.000000 CU_V2GRXSIGNOTIFMAXDELAYOV_C 0.000000 65535.000000 BYTE_ORDER MSB_LAST /end CHARACTERISTIC
/begin RECORD_LAYOUT RL_V2GRXSIGNOTIFMAXDELAYOV_C FNC_VALUES 1 UWORD COLUMN_DIR DIRECT /end RECORD_LAYOUT
/begin COMPU_METHOD CU_V2GRXSIGNOTIFMAXDELAYOV_C "Conversion method for V2gRxSigNotifMaxDelayOv_C" RAT_FUNC "%10.0" "s" COEFFS 0.000000 1.000000 -0.000000 0.000000 0.000000 1.000000 /end COMPU_METHOD
/* Scalar calibration for DDE 'V2gRxSigNotifOf_C'. */
/begin CHARACTERISTIC V2gRxSigNotifOf_C "Enables overriding V2gRxSigNotif" VALUE 0x700185e6 RL_V2GRXSIGNOTIFOF_C 1.000000 CU_V2GRXSIGNOTIFOF_C 0.000000 1.000000 BYTE_ORDER MSB_LAST /end CHARACTERISTIC
/begin RECORD_LAYOUT RL_V2GRXSIGNOTIFOF_C FNC_VALUES 1 UBYTE COLUMN_DIR DIRECT /end RECORD_LAYOUT
/begin COMPU_METHOD CU_V2GRXSIGNOTIFOF_C "Conversion method for V2gRxSigNotifOf_C" RAT_FUNC "%10.0" "b" COEFFS 0.000000 1.000000 -0.000000 0.000000 0.000000 1.000000 /end COMPU_METHOD
/* Scalar calibration for DDE 'V2gRxSigNotifOv_C'. */
/begin CHARACTERISTIC V2gRxSigNotifOv_C "Override value for V2gRxSigNotif" VALUE 0x7001979c RL_V2GRXSIGNOTIFOV_C 4294967295.000000 CU_V2GRXSIGNOTIFOV_C -2147483648.000000 2147483647.000000 BYTE_ORDER MSB_LAST /end CHARACTERISTIC
/begin RECORD_LAYOUT RL_V2GRXSIGNOTIFOV_C FNC_VALUES 1 SLONG COLUMN_DIR DIRECT /end RECORD_LAYOUT
/begin COMPU_METHOD CU_V2GRXSIGNOTIFOV_C "Conversion method for V2gRxSigNotifOv_C" TAB_VERB "%12.0" "enum" COMPU_TAB_REF CT_V2GRXSIGNOTIFOV_C /end COMPU_METHOD
/begin COMPU_VTAB CT_V2GRXSIGNOTIFOV_C "Conversion method for V2gRxSigNotifOv_C" TAB_VERB 3 0 "NONE" 1 "STOPCHARGING" 2 "RENEGOTIATION" /end COMPU_VTAB
/* Scalar calibration for DDE 'V2gRxSigPwrLimReachedOf_C'. */
/begin CHARACTERISTIC V2gRxSigPwrLimReachedOf_C "Enables overriding V2gRxSigPwrLimReached" VALUE 0x7001964d RL_V2GRXSIGPWRLIMREACHEDOF_C 1.000000 CU_V2GRXSIGPWRLIMREACHEDOF_C 0.000000 1.000000 BYTE_ORDER MSB_LAST /end CHARACTERISTIC
/begin RECORD_LAYOUT RL_V2GRXSIGPWRLIMREACHEDOF_C FNC_VALUES 1 UBYTE COLUMN_DIR DIRECT /end RECORD_LAYOUT
/begin COMPU_METHOD CU_V2GRXSIGPWRLIMREACHEDOF_C "Conversion method for V2gRxSigPwrLimReachedOf_C" RAT_FUNC "%10.0" "b" COEFFS 0.000000 1.000000 -0.000000 0.000000 0.000000 1.000000 /end COMPU_METHOD
/* Scalar calibration for DDE 'V2gRxSigPwrLimReachedOv_C'. */
/begin CHARACTERISTIC V2gRxSigPwrLimReachedOv_C "Override value for V2gRxSigPwrLimReached" VALUE 0x70018524 RL_V2GRXSIGPWRLIMREACHEDOV_C 255.000000 CU_V2GRXSIGPWRLIMREACHEDOV_C 0.000000 255.000000 BYTE_ORDER MSB_LAST /end CHARACTERISTIC
/begin RECORD_LAYOUT RL_V2GRXSIGPWRLIMREACHEDOV_C FNC_VALUES 1 UBYTE COLUMN_DIR DIRECT /end RECORD_LAYOUT
/begin COMPU_METHOD CU_V2GRXSIGPWRLIMREACHEDOV_C "Conversion method for V2gRxSigPwrLimReachedOv_C" RAT_FUNC "%10.0" "b" COEFFS 0.000000 1.000000 -0.000000 0.000000 0.000000 1.000000 /end COMPU_METHOD
/* Scalar calibration for DDE 'V2gRxSigRescodeOf_C'. */
/begin CHARACTERISTIC V2gRxSigRescodeOf_C "Enables overriding V2gRxSigRescode" VALUE 0x70019e34 RL_V2GRXSIGRESCODEOF_C 1.000000 CU_V2GRXSIGRESCODEOF_C 0.000000 1.000000 BYTE_ORDER MSB_LAST /end CHARACTERISTIC
/begin RECORD_LAYOUT RL_V2GRXSIGRESCODEOF_C FNC_VALUES 1 UBYTE COLUMN_DIR DIRECT /end RECORD_LAYOUT
/begin COMPU_METHOD CU_V2GRXSIGRESCODEOF_C "Conversion method for V2gRxSigRescodeOf_C" RAT_FUNC "%10.0" "b" COEFFS 0.000000 1.000000 -0.000000 0.000000 0.000000 1.000000 /end COMPU_METHOD
/* Scalar calibration for DDE 'V2gRxSigRescodeOv_C'. */
/begin CHARACTERISTIC V2gRxSigRescodeOv_C "Override value for V2gRxSigRescode" VALUE 0x70019655 RL_V2GRXSIGRESCODEOV_C 255.000000 CU_V2GRXSIGRESCODEOV_C 0.000000 255.000000 BYTE_ORDER MSB_LAST /end CHARACTERISTIC
/begin RECORD_LAYOUT RL_V2GRXSIGRESCODEOV_C FNC_VALUES 1 UBYTE COLUMN_DIR DIRECT /end RECORD_LAYOUT
/begin COMPU_METHOD CU_V2GRXSIGRESCODEOV_C "Conversion method for V2gRxSigRescodeOv_C" RAT_FUNC "%10.0" "1" COEFFS 0.000000 1.000000 -0.000000 0.000000 0.000000 1.000000 /end COMPU_METHOD
/* Scalar calibration for DDE 'V2gRxSigSASchTupIdFlgOf_C'. */
/begin CHARACTERISTIC V2gRxSigSASchTupIdFlgOf_C "Enables overriding V2gRxSigSASchTupIdFlg" VALUE 0x700185e5 RL_V2GRXSIGSASCHTUPIDFLGOF_C 1.000000 CU_V2GRXSIGSASCHTUPIDFLGOF_C 0.000000 1.000000 BYTE_ORDER MSB_LAST /end CHARACTERISTIC
/begin RECORD_LAYOUT RL_V2GRXSIGSASCHTUPIDFLGOF_C FNC_VALUES 1 UBYTE COLUMN_DIR DIRECT /end RECORD_LAYOUT
/begin COMPU_METHOD CU_V2GRXSIGSASCHTUPIDFLGOF_C "Conversion method for V2gRxSigSASchTupIdFlgOf_C" RAT_FUNC "%10.0" "b" COEFFS 0.000000 1.000000 -0.000000 0.000000 0.000000 1.000000 /end COMPU_METHOD
/* Scalar calibration for DDE 'V2gRxSigSASchTupIdFlgOv_C'. */
/begin CHARACTERISTIC V2gRxSigSASchTupIdFlgOv_C "Override value for V2gRxSigSASchTupIdFlg" VALUE 0x70019798 RL_V2GRXSIGSASCHTUPIDFLGOV_C 255.000000 CU_V2GRXSIGSASCHTUPIDFLGOV_C 0.000000 255.000000 BYTE_ORDER MSB_LAST /end CHARACTERISTIC
/begin RECORD_LAYOUT RL_V2GRXSIGSASCHTUPIDFLGOV_C FNC_VALUES 1 UBYTE COLUMN_DIR DIRECT /end RECORD_LAYOUT
/begin COMPU_METHOD CU_V2GRXSIGSASCHTUPIDFLGOV_C "Conversion method for V2gRxSigSASchTupIdFlgOv_C" RAT_FUNC "%10.0" "b" COEFFS 0.000000 1.000000 -0.000000 0.000000 0.000000 1.000000 /end COMPU_METHOD
/* Scalar calibration for DDE 'V2gRxSigSASchTupIdOf_C'. */
/begin CHARACTERISTIC V2gRxSigSASchTupIdOf_C "Enables overriding V2gRxSigSASchTupId" VALUE 0x700186a3 RL_V2GRXSIGSASCHTUPIDOF_C 1.000000 CU_V2GRXSIGSASCHTUPIDOF_C 0.000000 1.000000 BYTE_ORDER MSB_LAST /end CHARACTERISTIC
/begin RECORD_LAYOUT RL_V2GRXSIGSASCHTUPIDOF_C FNC_VALUES 1 UBYTE COLUMN_DIR DIRECT /end RECORD_LAYOUT
/begin COMPU_METHOD CU_V2GRXSIGSASCHTUPIDOF_C "Conversion method for V2gRxSigSASchTupIdOf_C" RAT_FUNC "%10.0" "b" COEFFS 0.000000 1.000000 -0.000000 0.000000 0.000000 1.000000 /end COMPU_METHOD
/* Scalar calibration for DDE 'V2gRxSigSASchTupIdOv_C'. */
/begin CHARACTERISTIC V2gRxSigSASchTupIdOv_C "Override value for V2gRxSigSASchTupId" VALUE 0x70019d94 RL_V2GRXSIGSASCHTUPIDOV_C 255.000000 CU_V2GRXSIGSASCHTUPIDOV_C 0.000000 255.000000 BYTE_ORDER MSB_LAST /end CHARACTERISTIC
/begin RECORD_LAYOUT RL_V2GRXSIGSASCHTUPIDOV_C FNC_VALUES 1 UBYTE COLUMN_DIR DIRECT /end RECORD_LAYOUT
/begin COMPU_METHOD CU_V2GRXSIGSASCHTUPIDOV_C "Conversion method for V2gRxSigSASchTupIdOv_C" RAT_FUNC "%10.0" "1" COEFFS 0.000000 1.000000 -0.000000 0.000000 0.000000 1.000000 /end COMPU_METHOD
/* Scalar calibration for DDE 'V2gRxSigTrgOf_C'. */
/begin CHARACTERISTIC V2gRxSigTrgOf_C "Enables overriding the V2gRxSigTrg" VALUE 0x70019e5d RL_V2GRXSIGTRGOF_C 1.000000 CU_V2GRXSIGTRGOF_C 0.000000 1.000000 BYTE_ORDER MSB_LAST /end CHARACTERISTIC
/begin RECORD_LAYOUT RL_V2GRXSIGTRGOF_C FNC_VALUES 1 UBYTE COLUMN_DIR DIRECT /end RECORD_LAYOUT
/begin COMPU_METHOD CU_V2GRXSIGTRGOF_C "Conversion method for V2gRxSigTrgOf_C" RAT_FUNC "%10.0" "b" COEFFS 0.000000 1.000000 -0.000000 0.000000 0.000000 1.000000 /end COMPU_METHOD
/* Scalar calibration for DDE 'V2gRxSigTrgOv_C'. */
/begin CHARACTERISTIC V2gRxSigTrgOv_C "Override value for V2gRxSigTrg" VALUE 0x70018525 RL_V2GRXSIGTRGOV_C 255.000000 CU_V2GRXSIGTRGOV_C 0.000000 255.000000 BYTE_ORDER MSB_LAST /end CHARACTERISTIC
/begin RECORD_LAYOUT RL_V2GRXSIGTRGOV_C FNC_VALUES 1 UBYTE COLUMN_DIR DIRECT /end RECORD_LAYOUT
/begin COMPU_METHOD CU_V2GRXSIGTRGOV_C "Conversion method for V2gRxSigTrgOv_C" RAT_FUNC "%10.0" "b" COEFFS 0.000000 1.000000 -0.000000 0.000000 0.000000 1.000000 /end COMPU_METHOD
/* Scalar calibration for DDE 'V2gRxSigVoltLimReachedOf_C'. */
/begin CHARACTERISTIC V2gRxSigVoltLimReachedOf_C "Enables overriding V2gRxSigVoltLimReachedOf_C" VALUE 0x700195f4 RL_V2GRXSIGVOLTLIMREACHEDOF_C 1.000000 CU_V2GRXSIGVOLTLIMREACHEDOF_C 0.000000 1.000000 BYTE_ORDER MSB_LAST /end CHARACTERISTIC
/begin RECORD_LAYOUT RL_V2GRXSIGVOLTLIMREACHEDOF_C FNC_VALUES 1 UBYTE COLUMN_DIR DIRECT /end RECORD_LAYOUT
/begin COMPU_METHOD CU_V2GRXSIGVOLTLIMREACHEDOF_C "Conversion method for V2gRxSigVoltLimReachedOf_C" RAT_FUNC "%10.0" "b" COEFFS 0.000000 1.000000 -0.000000 0.000000 0.000000 1.000000 /end COMPU_METHOD
/* Scalar calibration for DDE 'V2gRxSigVoltLimReachedOv_C'. */
/begin CHARACTERISTIC V2gRxSigVoltLimReachedOv_C "Override value for V2gRxSigVoltLimReached" VALUE 0x700184cc RL_V2GRXSIGVOLTLIMREACHEDOV_C 255.000000 CU_V2GRXSIGVOLTLIMREACHEDOV_C 0.000000 255.000000 BYTE_ORDER MSB_LAST /end CHARACTERISTIC
/begin RECORD_LAYOUT RL_V2GRXSIGVOLTLIMREACHEDOV_C FNC_VALUES 1 UBYTE COLUMN_DIR DIRECT /end RECORD_LAYOUT
/begin COMPU_METHOD CU_V2GRXSIGVOLTLIMREACHEDOV_C "Conversion method for V2gRxSigVoltLimReachedOv_C" RAT_FUNC "%10.0" "b" COEFFS 0.000000 1.000000 -0.000000 0.000000 0.000000 1.000000 /end COMPU_METHOD
/* Scalar calibration for DDE 'V2gSlacLinkStOf_C'. */
/begin CHARACTERISTIC V2gSlacLinkStOf_C "Enables overriding Communication link status. Do not attempt to initiate communication unless the link status indicates connection." VALUE 0x70018538 RL_V2GSLACLINKSTOF_C 1.000000 CU_V2GSLACLINKSTOF_C 0.000000 1.000000 BYTE_ORDER MSB_LAST /end CHARACTERISTIC
/begin RECORD_LAYOUT RL_V2GSLACLINKSTOF_C FNC_VALUES 1 UBYTE COLUMN_DIR DIRECT /end RECORD_LAYOUT
/begin COMPU_METHOD CU_V2GSLACLINKSTOF_C "Conversion method for V2gSlacLinkStOf_C" RAT_FUNC "%10.0" "b" COEFFS 0.000000 1.000000 -0.000000 0.000000 0.000000 1.000000 /end COMPU_METHOD
/* Scalar calibration for DDE 'V2gSlacLinkStOv_C'. */
/begin CHARACTERISTIC V2gSlacLinkStOv_C "Override value for Communication link status. Do not attempt to initiate communication unless the link status indicates connection." VALUE 0x700186ac RL_V2GSLACLINKSTOV_C 4294967295.000000 CU_V2GSLACLINKSTOV_C -2147483648.000000 2147483647.000000 BYTE_ORDER MSB_LAST /end CHARACTERISTIC
/begin RECORD_LAYOUT RL_V2GSLACLINKSTOV_C FNC_VALUES 1 SLONG COLUMN_DIR DIRECT /end RECORD_LAYOUT
/begin COMPU_METHOD CU_V2GSLACLINKSTOV_C "Conversion method for V2gSlacLinkStOv_C" TAB_VERB "%12.0" "enum" COMPU_TAB_REF CT_V2GSLACLINKSTOV_C /end COMPU_METHOD
/begin COMPU_VTAB CT_V2GSLACLINKSTOV_C "Conversion method for V2gSlacLinkStOv_C" TAB_VERB 2 0 "PLC_LINK_DISCONNECTED" 1 "PLC_LINK_CONNECTED" /end COMPU_VTAB
/* Scalar calibration for DDE 'V2gSlacTcpStOf_C'. */
/begin CHARACTERISTIC V2gSlacTcpStOf_C "Enables overriding PLC Communication TCP connection status." VALUE 0x700186a8 RL_V2GSLACTCPSTOF_C 1.000000 CU_V2GSLACTCPSTOF_C 0.000000 1.000000 BYTE_ORDER MSB_LAST /end CHARACTERISTIC
/begin RECORD_LAYOUT RL_V2GSLACTCPSTOF_C FNC_VALUES 1 UBYTE COLUMN_DIR DIRECT /end RECORD_LAYOUT
/begin COMPU_METHOD CU_V2GSLACTCPSTOF_C "Conversion method for V2gSlacTcpStOf_C" RAT_FUNC "%10.0" "b" COEFFS 0.000000 1.000000 -0.000000 0.000000 0.000000 1.000000 /end COMPU_METHOD
/* Scalar calibration for DDE 'V2gSlacTcpStOv_C'. */
/begin CHARACTERISTIC V2gSlacTcpStOv_C "Override value for PLC Communication TCP connection status." VALUE 0x70019e58 RL_V2GSLACTCPSTOV_C 4294967295.000000 CU_V2GSLACTCPSTOV_C -2147483648.000000 2147483647.000000 BYTE_ORDER MSB_LAST /end CHARACTERISTIC
/begin RECORD_LAYOUT RL_V2GSLACTCPSTOV_C FNC_VALUES 1 SLONG COLUMN_DIR DIRECT /end RECORD_LAYOUT
/begin COMPU_METHOD CU_V2GSLACTCPSTOV_C "Conversion method for V2gSlacTcpStOv_C" TAB_VERB "%12.0" "enum" COMPU_TAB_REF CT_V2GSLACTCPSTOV_C /end COMPU_METHOD
/begin COMPU_VTAB CT_V2GSLACTCPSTOV_C "Conversion method for V2gSlacTcpStOv_C" TAB_VERB 6 0 "PLC_TCP_DISCONNECTED" 1 "PLC_TCP_WAITING_SDP_RESPONSE" 2 "PLC_TCP_WAITING_SDP_READY" 3 "PLC_TCP_READY_TO_CONNECT" 4 "PLC_TCP_CONNECTING" 5 "PLC_TCP_CONNECTED" /end COMPU_VTAB
/* Scalar calibration for DDE 'V2gSupPrtclSelectedOf_C'. */
/begin CHARACTERISTIC V2gSupPrtclSelectedOf_C "Enables overriding for the V2G protcol that the SECC has determined to use for this charging session" VALUE 0x700185ba RL_V2GSUPPRTCLSELECTEDOF_C 1.000000 CU_V2GSUPPRTCLSELECTEDOF_C 0.000000 1.000000 BYTE_ORDER MSB_LAST /end CHARACTERISTIC
/begin RECORD_LAYOUT RL_V2GSUPPRTCLSELECTEDOF_C FNC_VALUES 1 UBYTE COLUMN_DIR DIRECT /end RECORD_LAYOUT
/begin COMPU_METHOD CU_V2GSUPPRTCLSELECTEDOF_C "Conversion method for V2gSupPrtclSelectedOf_C" RAT_FUNC "%10.0" "b" COEFFS 0.000000 1.000000 -0.000000 0.000000 0.000000 1.000000 /end COMPU_METHOD
/* Scalar calibration for DDE 'V2gSupPrtclSelectedOv_C'. */
/begin CHARACTERISTIC V2gSupPrtclSelectedOv_C "Override value for the V2G protcol that the SECC has determined to use for this charging session" VALUE 0x700197a0 RL_V2GSUPPRTCLSELECTEDOV_C 255.000000 CU_V2GSUPPRTCLSELECTEDOV_C 0.000000 255.000000 BYTE_ORDER MSB_LAST /end CHARACTERISTIC
/begin RECORD_LAYOUT RL_V2GSUPPRTCLSELECTEDOV_C FNC_VALUES 1 UBYTE COLUMN_DIR DIRECT /end RECORD_LAYOUT
/begin COMPU_METHOD CU_V2GSUPPRTCLSELECTEDOV_C "Conversion method for V2gSupPrtclSelectedOv_C" RAT_FUNC "%10.0" "1" COEFFS 0.000000 1.000000 -0.000000 0.000000 0.000000 1.000000 /end COMPU_METHOD
/* Scalar calibration for DDE 'V2gTxBptParamEnableOf_C'. */
/begin CHARACTERISTIC V2gTxBptParamEnableOf_C "Enables overriding If EV bidirectional parameter is enabled by the EV" VALUE 0x700184c4 RL_V2GTXBPTPARAMENABLEOF_C 1.000000 CU_V2GTXBPTPARAMENABLEOF_C 0.000000 1.000000 BYTE_ORDER MSB_LAST /end CHARACTERISTIC
/begin RECORD_LAYOUT RL_V2GTXBPTPARAMENABLEOF_C FNC_VALUES 1 UBYTE COLUMN_DIR DIRECT /end RECORD_LAYOUT
/begin COMPU_METHOD CU_V2GTXBPTPARAMENABLEOF_C "Conversion method for V2gTxBptParamEnableOf_C" RAT_FUNC "%10.0" "b" COEFFS 0.000000 1.000000 -0.000000 0.000000 0.000000 1.000000 /end COMPU_METHOD
/* Scalar calibration for DDE 'V2gTxBptParamEnableOv_C'. */
/begin CHARACTERISTIC V2gTxBptParamEnableOv_C "Override value for If EV bidirectional parameter is enabled by the EV" VALUE 0x70019647 RL_V2GTXBPTPARAMENABLEOV_C 1.000000 CU_V2GTXBPTPARAMENABLEOV_C 0.000000 1.000000 BYTE_ORDER MSB_LAST /end CHARACTERISTIC
/begin RECORD_LAYOUT RL_V2GTXBPTPARAMENABLEOV_C FNC_VALUES 1 UBYTE COLUMN_DIR DIRECT /end RECORD_LAYOUT
/begin COMPU_METHOD CU_V2GTXBPTPARAMENABLEOV_C "Conversion method for V2gTxBptParamEnableOv_C" RAT_FUNC "%10.0" "b" COEFFS 0.000000 1.000000 -0.000000 0.000000 0.000000 1.000000 /end COMPU_METHOD
/* Scalar calibration for DDE 'V2gTxBulkChargingCompleteOf_C'. */
/begin CHARACTERISTIC V2gTxBulkChargingCompleteOf_C "Enables overriding If set to TRUE, the vehicle indicates that bulk charge is complete." VALUE 0x70019d8c RL_V2GTXBULKCHARGINGCOMPLETEOF0 1.000000 CU_V2GTXBULKCHARGINGCOMPLETEOF0 0.000000 1.000000 BYTE_ORDER MSB_LAST /end CHARACTERISTIC
/begin RECORD_LAYOUT RL_V2GTXBULKCHARGINGCOMPLETEOF0 FNC_VALUES 1 UBYTE COLUMN_DIR DIRECT /end RECORD_LAYOUT
/begin COMPU_METHOD CU_V2GTXBULKCHARGINGCOMPLETEOF0 "Conversion method for V2gTxBulkChargingCompleteOf_C" RAT_FUNC "%10.0" "b" COEFFS 0.000000 1.000000 -0.000000 0.000000 0.000000 1.000000 /end COMPU_METHOD
/* Scalar calibration for DDE 'V2gTxBulkChargingCompleteOv_C'. */
/begin CHARACTERISTIC V2gTxBulkChargingCompleteOv_C "Override value for If set to TRUE, the vehicle indicates that bulk charge is complete." VALUE 0x700186fe RL_V2GTXBULKCHARGINGCOMPLETEOV0 1.000000 CU_V2GTXBULKCHARGINGCOMPLETEOV0 0.000000 1.000000 BYTE_ORDER MSB_LAST /end CHARACTERISTIC
/begin RECORD_LAYOUT RL_V2GTXBULKCHARGINGCOMPLETEOV0 FNC_VALUES 1 UBYTE COLUMN_DIR DIRECT /end RECORD_LAYOUT
/begin COMPU_METHOD CU_V2GTXBULKCHARGINGCOMPLETEOV0 "Conversion method for V2gTxBulkChargingCompleteOv_C" RAT_FUNC "%10.0" "b" COEFFS 0.000000 1.000000 -0.000000 0.000000 0.000000 1.000000 /end COMPU_METHOD
/* Scalar calibration for DDE 'V2gTxBulkSocOf_C'. */
/begin CHARACTERISTIC V2gTxBulkSocOf_C "Enables overriding State of charge at which the vehicle considers a fast charge process to be complete" VALUE 0x700185aa RL_V2GTXBULKSOCOF_C 1.000000 CU_V2GTXBULKSOCOF_C 0.000000 1.000000 BYTE_ORDER MSB_LAST /end CHARACTERISTIC
/begin RECORD_LAYOUT RL_V2GTXBULKSOCOF_C FNC_VALUES 1 UBYTE COLUMN_DIR DIRECT /end RECORD_LAYOUT
/begin COMPU_METHOD CU_V2GTXBULKSOCOF_C "Conversion method for V2gTxBulkSocOf_C" RAT_FUNC "%10.0" "b" COEFFS 0.000000 1.000000 -0.000000 0.000000 0.000000 1.000000 /end COMPU_METHOD
/* Scalar calibration for DDE 'V2gTxBulkSocOv_C'. */
/begin CHARACTERISTIC V2gTxBulkSocOv_C "Override value for State of charge at which the vehicle considers a fast charge process to be complete" VALUE 0x70019734 RL_V2GTXBULKSOCOV_C 100.000000 CU_V2GTXBULKSOCOV_C 0.000000 100.000000 BYTE_ORDER MSB_LAST /end CHARACTERISTIC
/begin RECORD_LAYOUT RL_V2GTXBULKSOCOV_C FNC_VALUES 1 FLOAT32_IEEE COLUMN_DIR DIRECT /end RECORD_LAYOUT
/begin COMPU_METHOD CU_V2GTXBULKSOCOV_C "Conversion method for V2gTxBulkSocOv_C" RAT_FUNC "%10.0" "%" COEFFS 0.000000 1.000000 -0.000000 0.000000 0.000000 1.000000 /end COMPU_METHOD
/* Scalar calibration for DDE 'V2gTxChargeProgressOf_C'. */
/begin CHARACTERISTIC V2gTxChargeProgressOf_C "Enables overriding of variable Charge Progress signal determined for ISO15118 Power Delivery Req message." VALUE 0x700196cc RL_V2GTXCHARGEPROGRESSOF_C 1.000000 CU_V2GTXCHARGEPROGRESSOF_C 0.000000 1.000000 BYTE_ORDER MSB_LAST /end CHARACTERISTIC
/begin RECORD_LAYOUT RL_V2GTXCHARGEPROGRESSOF_C FNC_VALUES 1 UBYTE COLUMN_DIR DIRECT /end RECORD_LAYOUT
/begin COMPU_METHOD CU_V2GTXCHARGEPROGRESSOF_C "Conversion method for V2gTxChargeProgressOf_C" RAT_FUNC "%10.0" "b" COEFFS 0.000000 1.000000 -0.000000 0.000000 0.000000 1.000000 /end COMPU_METHOD
/* Scalar calibration for DDE 'V2gTxChargeProgressOv_C'. */
/begin CHARACTERISTIC V2gTxChargeProgressOv_C "Override value for Charge Progress signal determined for ISO15118 Power Delivery Req message." VALUE 0x70017704 RL_V2GTXCHARGEPROGRESSOV_C 4294967295.000000 CU_V2GTXCHARGEPROGRESSOV_C -2147483648.000000 2147483647.000000 BYTE_ORDER MSB_LAST /end CHARACTERISTIC
/begin RECORD_LAYOUT RL_V2GTXCHARGEPROGRESSOV_C FNC_VALUES 1 SLONG COLUMN_DIR DIRECT /end RECORD_LAYOUT
/begin COMPU_METHOD CU_V2GTXCHARGEPROGRESSOV_C "Conversion method for V2gTxChargeProgressOv_C" TAB_VERB "%12.0" "1" COMPU_TAB_REF CT_V2GTXCHARGEPROGRESSOV_C /end COMPU_METHOD
/begin COMPU_VTAB CT_V2GTXCHARGEPROGRESSOV_C "Conversion method for V2gTxChargeProgressOv_C" TAB_VERB 3 0 "START" 1 "STOP" 2 "RENEGOTIATE" /end COMPU_VTAB
/* Scalar calibration for DDE 'V2gTxChargingCompleteOf_C'. */
/begin CHARACTERISTIC V2gTxChargingCompleteOf_C "Enables overriding If set to TRUE, the vehicle indicates that full charge is complete." VALUE 0x70019e4c RL_V2GTXCHARGINGCOMPLETEOF_C 1.000000 CU_V2GTXCHARGINGCOMPLETEOF_C 0.000000 1.000000 BYTE_ORDER MSB_LAST /end CHARACTERISTIC
/begin RECORD_LAYOUT RL_V2GTXCHARGINGCOMPLETEOF_C FNC_VALUES 1 UBYTE COLUMN_DIR DIRECT /end RECORD_LAYOUT
/begin COMPU_METHOD CU_V2GTXCHARGINGCOMPLETEOF_C "Conversion method for V2gTxChargingCompleteOf_C" RAT_FUNC "%10.0" "b" COEFFS 0.000000 1.000000 -0.000000 0.000000 0.000000 1.000000 /end COMPU_METHOD
/* Scalar calibration for DDE 'V2gTxChargingCompleteOv_C'. */
/begin CHARACTERISTIC V2gTxChargingCompleteOv_C "Override value for If set to TRUE, the vehicle indicates that full charge is complete." VALUE 0x700195f1 RL_V2GTXCHARGINGCOMPLETEOV_C 1.000000 CU_V2GTXCHARGINGCOMPLETEOV_C 0.000000 1.000000 BYTE_ORDER MSB_LAST /end CHARACTERISTIC
/begin RECORD_LAYOUT RL_V2GTXCHARGINGCOMPLETEOV_C FNC_VALUES 1 UBYTE COLUMN_DIR DIRECT /end RECORD_LAYOUT
/begin COMPU_METHOD CU_V2GTXCHARGINGCOMPLETEOV_C "Conversion method for V2gTxChargingCompleteOv_C" RAT_FUNC "%10.0" "b" COEFFS 0.000000 1.000000 -0.000000 0.000000 0.000000 1.000000 /end COMPU_METHOD
/* Scalar calibration for DDE 'V2gTxDcChgParamEnableOf_C'. */
/begin CHARACTERISTIC V2gTxDcChgParamEnableOf_C "Enables overriding If the Charge parmeter is enabled by the EV" VALUE 0x70019e4d RL_V2GTXDCCHGPARAMENABLEOF_C 1.000000 CU_V2GTXDCCHGPARAMENABLEOF_C 0.000000 1.000000 BYTE_ORDER MSB_LAST /end CHARACTERISTIC
/begin RECORD_LAYOUT RL_V2GTXDCCHGPARAMENABLEOF_C FNC_VALUES 1 UBYTE COLUMN_DIR DIRECT /end RECORD_LAYOUT
/begin COMPU_METHOD CU_V2GTXDCCHGPARAMENABLEOF_C "Conversion method for V2gTxDcChgParamEnableOf_C" RAT_FUNC "%10.0" "b" COEFFS 0.000000 1.000000 -0.000000 0.000000 0.000000 1.000000 /end COMPU_METHOD
/* Scalar calibration for DDE 'V2gTxDcChgParamEnableOv_C'. */
/begin CHARACTERISTIC V2gTxDcChgParamEnableOv_C "Override value for If the Charge parmeter is enabled by the EV" VALUE 0x700195f2 RL_V2GTXDCCHGPARAMENABLEOV_C 1.000000 CU_V2GTXDCCHGPARAMENABLEOV_C 0.000000 1.000000 BYTE_ORDER MSB_LAST /end CHARACTERISTIC
/begin RECORD_LAYOUT RL_V2GTXDCCHGPARAMENABLEOV_C FNC_VALUES 1 UBYTE COLUMN_DIR DIRECT /end RECORD_LAYOUT
/begin COMPU_METHOD CU_V2GTXDCCHGPARAMENABLEOV_C "Conversion method for V2gTxDcChgParamEnableOv_C" RAT_FUNC "%10.0" "b" COEFFS 0.000000 1.000000 -0.000000 0.000000 0.000000 1.000000 /end COMPU_METHOD
/* Scalar calibration for DDE 'V2gTxEvCrntMaxLimOf_C'. */
/begin CHARACTERISTIC V2gTxEvCrntMaxLimOf_C "Enables overriding Maximum current supported by the vehicle." VALUE 0x700195cf RL_V2GTXEVCRNTMAXLIMOF_C 1.000000 CU_V2GTXEVCRNTMAXLIMOF_C 0.000000 1.000000 BYTE_ORDER MSB_LAST /end CHARACTERISTIC
/begin RECORD_LAYOUT RL_V2GTXEVCRNTMAXLIMOF_C FNC_VALUES 1 UBYTE COLUMN_DIR DIRECT /end RECORD_LAYOUT
/begin COMPU_METHOD CU_V2GTXEVCRNTMAXLIMOF_C "Conversion method for V2gTxEvCrntMaxLimOf_C" RAT_FUNC "%10.0" "b" COEFFS 0.000000 1.000000 -0.000000 0.000000 0.000000 1.000000 /end COMPU_METHOD
/* Scalar calibration for DDE 'V2gTxEvCrntMaxLimOv_C'. */
/begin CHARACTERISTIC V2gTxEvCrntMaxLimOv_C "Override value for Maximum current supported by the vehicle." VALUE 0x70019e84 RL_V2GTXEVCRNTMAXLIMOV_C 196605.000000 CU_V2GTXEVCRNTMAXLIMOV_C 0.000000 196605.000000 BYTE_ORDER MSB_LAST /end CHARACTERISTIC
/begin RECORD_LAYOUT RL_V2GTXEVCRNTMAXLIMOV_C FNC_VALUES 1 FLOAT32_IEEE COLUMN_DIR DIRECT /end RECORD_LAYOUT
/begin COMPU_METHOD CU_V2GTXEVCRNTMAXLIMOV_C "Conversion method for V2gTxEvCrntMaxLimOv_C" RAT_FUNC "%10.0" "A" COEFFS 0.000000 1.000000 -0.000000 0.000000 0.000000 1.000000 /end COMPU_METHOD
/* Scalar calibration for DDE 'V2gTxEvCrntMinLimOf_C'. */
/begin CHARACTERISTIC V2gTxEvCrntMinLimOf_C "Enables overriding Minimum current supported by the vehicle." VALUE 0x70019679 RL_V2GTXEVCRNTMINLIMOF_C 1.000000 CU_V2GTXEVCRNTMINLIMOF_C 0.000000 1.000000 BYTE_ORDER MSB_LAST /end CHARACTERISTIC
/begin RECORD_LAYOUT RL_V2GTXEVCRNTMINLIMOF_C FNC_VALUES 1 UBYTE COLUMN_DIR DIRECT /end RECORD_LAYOUT
/begin COMPU_METHOD CU_V2GTXEVCRNTMINLIMOF_C "Conversion method for V2gTxEvCrntMinLimOf_C" RAT_FUNC "%10.0" "b" COEFFS 0.000000 1.000000 -0.000000 0.000000 0.000000 1.000000 /end COMPU_METHOD
/* Scalar calibration for DDE 'V2gTxEvCrntMinLimOv_C'. */
/begin CHARACTERISTIC V2gTxEvCrntMinLimOv_C "Override value for Minimum current supported by the vehicle." VALUE 0x700185b0 RL_V2GTXEVCRNTMINLIMOV_C 196605.000000 CU_V2GTXEVCRNTMINLIMOV_C 0.000000 196605.000000 BYTE_ORDER MSB_LAST /end CHARACTERISTIC
/begin RECORD_LAYOUT RL_V2GTXEVCRNTMINLIMOV_C FNC_VALUES 1 FLOAT32_IEEE COLUMN_DIR DIRECT /end RECORD_LAYOUT
/begin COMPU_METHOD CU_V2GTXEVCRNTMINLIMOV_C "Conversion method for V2gTxEvCrntMinLimOv_C" RAT_FUNC "%10.0" "A" COEFFS 0.000000 1.000000 -0.000000 0.000000 0.000000 1.000000 /end COMPU_METHOD
/* Scalar calibration for DDE 'V2gTxEvDisChgCrntMaxLimOf_C'. */
/begin CHARACTERISTIC V2gTxEvDisChgCrntMaxLimOf_C "Enables overriding Maximum discharge current supported by the EV" VALUE 0x700195ce RL_V2GTXEVDISCHGCRNTMAXLIMOF_C 1.000000 CU_V2GTXEVDISCHGCRNTMAXLIMOF_C 0.000000 1.000000 BYTE_ORDER MSB_LAST /end CHARACTERISTIC
/begin RECORD_LAYOUT RL_V2GTXEVDISCHGCRNTMAXLIMOF_C FNC_VALUES 1 UBYTE COLUMN_DIR DIRECT /end RECORD_LAYOUT
/begin COMPU_METHOD CU_V2GTXEVDISCHGCRNTMAXLIMOF_C "Conversion method for V2gTxEvDisChgCrntMaxLimOf_C" RAT_FUNC "%10.0" "b" COEFFS 0.000000 1.000000 -0.000000 0.000000 0.000000 1.000000 /end COMPU_METHOD
/* Scalar calibration for DDE 'V2gTxEvDisChgCrntMaxLimOv_C'. */
/begin CHARACTERISTIC V2gTxEvDisChgCrntMaxLimOv_C "Override value for Maximum discharge current supported by the EV" VALUE 0x70019e80 RL_V2GTXEVDISCHGCRNTMAXLIMOV_C 196605.000000 CU_V2GTXEVDISCHGCRNTMAXLIMOV_C 0.000000 196605.000000 BYTE_ORDER MSB_LAST /end CHARACTERISTIC
/begin RECORD_LAYOUT RL_V2GTXEVDISCHGCRNTMAXLIMOV_C FNC_VALUES 1 FLOAT32_IEEE COLUMN_DIR DIRECT /end RECORD_LAYOUT
/begin COMPU_METHOD CU_V2GTXEVDISCHGCRNTMAXLIMOV_C "Conversion method for V2gTxEvDisChgCrntMaxLimOv_C" RAT_FUNC "%10.0" "A" COEFFS 0.000000 1.000000 -0.000000 0.000000 0.000000 1.000000 /end COMPU_METHOD
/* Scalar calibration for DDE 'V2gTxEvDisChgCrntMinLimOf_C'. */
/begin CHARACTERISTIC V2gTxEvDisChgCrntMinLimOf_C "Enables overriding Minimum discharge current supported by the EV" VALUE 0x70018674 RL_V2GTXEVDISCHGCRNTMINLIMOF_C 1.000000 CU_V2GTXEVDISCHGCRNTMINLIMOF_C 0.000000 1.000000 BYTE_ORDER MSB_LAST /end CHARACTERISTIC
/begin RECORD_LAYOUT RL_V2GTXEVDISCHGCRNTMINLIMOF_C FNC_VALUES 1 UBYTE COLUMN_DIR DIRECT /end RECORD_LAYOUT
/begin COMPU_METHOD CU_V2GTXEVDISCHGCRNTMINLIMOF_C "Conversion method for V2gTxEvDisChgCrntMinLimOf_C" RAT_FUNC "%10.0" "b" COEFFS 0.000000 1.000000 -0.000000 0.000000 0.000000 1.000000 /end COMPU_METHOD
/* Scalar calibration for DDE 'V2gTxEvDisChgCrntMinLimOv_C'. */
/begin CHARACTERISTIC V2gTxEvDisChgCrntMinLimOv_C "Override value for Minimum discharge current supported by the EV" VALUE 0x70019d5c RL_V2GTXEVDISCHGCRNTMINLIMOV_C 196605.000000 CU_V2GTXEVDISCHGCRNTMINLIMOV_C 0.000000 196605.000000 BYTE_ORDER MSB_LAST /end CHARACTERISTIC
/begin RECORD_LAYOUT RL_V2GTXEVDISCHGCRNTMINLIMOV_C FNC_VALUES 1 FLOAT32_IEEE COLUMN_DIR DIRECT /end RECORD_LAYOUT
/begin COMPU_METHOD CU_V2GTXEVDISCHGCRNTMINLIMOV_C "Conversion method for V2gTxEvDisChgCrntMinLimOv_C" RAT_FUNC "%10.0" "A" COEFFS 0.000000 1.000000 -0.000000 0.000000 0.000000 1.000000 /end COMPU_METHOD
/* Scalar calibration for DDE 'V2gTxEvDisChgPwrMaxLimOf_C'. */
/begin CHARACTERISTIC V2gTxEvDisChgPwrMaxLimOf_C "Enables overriding Maximum discharge power supported by the EV" VALUE 0x7001962d RL_V2GTXEVDISCHGPWRMAXLIMOF_C 1.000000 CU_V2GTXEVDISCHGPWRMAXLIMOF_C 0.000000 1.000000 BYTE_ORDER MSB_LAST /end CHARACTERISTIC
/begin RECORD_LAYOUT RL_V2GTXEVDISCHGPWRMAXLIMOF_C FNC_VALUES 1 UBYTE COLUMN_DIR DIRECT /end RECORD_LAYOUT
/begin COMPU_METHOD CU_V2GTXEVDISCHGPWRMAXLIMOF_C "Conversion method for V2gTxEvDisChgPwrMaxLimOf_C" RAT_FUNC "%10.0" "b" COEFFS 0.000000 1.000000 -0.000000 0.000000 0.000000 1.000000 /end COMPU_METHOD
/* Scalar calibration for DDE 'V2gTxEvDisChgPwrMaxLimOv_C'. */
/begin CHARACTERISTIC V2gTxEvDisChgPwrMaxLimOv_C "Override value for Maximum discharge power supported by the EV" VALUE 0x700184f0 RL_V2GTXEVDISCHGPWRMAXLIMOV_C 196605.000000 CU_V2GTXEVDISCHGPWRMAXLIMOV_C 0.000000 196605.000000 BYTE_ORDER MSB_LAST /end CHARACTERISTIC
/begin RECORD_LAYOUT RL_V2GTXEVDISCHGPWRMAXLIMOV_C FNC_VALUES 1 FLOAT32_IEEE COLUMN_DIR DIRECT /end RECORD_LAYOUT
/begin COMPU_METHOD CU_V2GTXEVDISCHGPWRMAXLIMOV_C "Conversion method for V2gTxEvDisChgPwrMaxLimOv_C" RAT_FUNC "%10.0" "A" COEFFS 0.000000 1.000000 -0.000000 0.000000 0.000000 1.000000 /end COMPU_METHOD
/* Scalar calibration for DDE 'V2gTxEvDisChgPwrMinLimOf_C'. */
/begin CHARACTERISTIC V2gTxEvDisChgPwrMinLimOf_C "Enables overriding Minimum discharge power supported by the EV" VALUE 0x700186d8 RL_V2GTXEVDISCHGPWRMINLIMOF_C 1.000000 CU_V2GTXEVDISCHGPWRMINLIMOF_C 0.000000 1.000000 BYTE_ORDER MSB_LAST /end CHARACTERISTIC
/begin RECORD_LAYOUT RL_V2GTXEVDISCHGPWRMINLIMOF_C FNC_VALUES 1 UBYTE COLUMN_DIR DIRECT /end RECORD_LAYOUT
/begin COMPU_METHOD CU_V2GTXEVDISCHGPWRMINLIMOF_C "Conversion method for V2gTxEvDisChgPwrMinLimOf_C" RAT_FUNC "%10.0" "b" COEFFS 0.000000 1.000000 -0.000000 0.000000 0.000000 1.000000 /end COMPU_METHOD
/* Scalar calibration for DDE 'V2gTxEvDisChgPwrMinLimOv_C'. */
/begin CHARACTERISTIC V2gTxEvDisChgPwrMinLimOv_C "Override value for Minimum discharge power supported by the EV" VALUE 0x70019e1c RL_V2GTXEVDISCHGPWRMINLIMOV_C 196605.000000 CU_V2GTXEVDISCHGPWRMINLIMOV_C 0.000000 196605.000000 BYTE_ORDER MSB_LAST /end CHARACTERISTIC
/begin RECORD_LAYOUT RL_V2GTXEVDISCHGPWRMINLIMOV_C FNC_VALUES 1 FLOAT32_IEEE COLUMN_DIR DIRECT /end RECORD_LAYOUT
/begin COMPU_METHOD CU_V2GTXEVDISCHGPWRMINLIMOV_C "Conversion method for V2gTxEvDisChgPwrMinLimOv_C" RAT_FUNC "%10.0" "A" COEFFS 0.000000 1.000000 -0.000000 0.000000 0.000000 1.000000 /end COMPU_METHOD
/* Scalar calibration for DDE 'V2gTxEvEgyCapacityOf_C'. */
/begin CHARACTERISTIC V2gTxEvEgyCapacityOf_C "Enables overriding Maximum energy capacity supported by the vehicle" VALUE 0x700195f0 RL_V2GTXEVEGYCAPACITYOF_C 1.000000 CU_V2GTXEVEGYCAPACITYOF_C 0.000000 1.000000 BYTE_ORDER MSB_LAST /end CHARACTERISTIC
/begin RECORD_LAYOUT RL_V2GTXEVEGYCAPACITYOF_C FNC_VALUES 1 UBYTE COLUMN_DIR DIRECT /end RECORD_LAYOUT
/begin COMPU_METHOD CU_V2GTXEVEGYCAPACITYOF_C "Conversion method for V2gTxEvEgyCapacityOf_C" RAT_FUNC "%10.0" "b" COEFFS 0.000000 1.000000 -0.000000 0.000000 0.000000 1.000000 /end COMPU_METHOD
/* Scalar calibration for DDE 'V2gTxEvEgyCapacityOv_C'. */
/begin CHARACTERISTIC V2gTxEvEgyCapacityOv_C "Override value for Maximum energy capacity supported by the vehicle" VALUE 0x700184c0 RL_V2GTXEVEGYCAPACITYOV_C 196605.000000 CU_V2GTXEVEGYCAPACITYOV_C 0.000000 196605.000000 BYTE_ORDER MSB_LAST /end CHARACTERISTIC
/begin RECORD_LAYOUT RL_V2GTXEVEGYCAPACITYOV_C FNC_VALUES 1 FLOAT32_IEEE COLUMN_DIR DIRECT /end RECORD_LAYOUT
/begin COMPU_METHOD CU_V2GTXEVEGYCAPACITYOV_C "Conversion method for V2gTxEvEgyCapacityOv_C" RAT_FUNC "%10.0" "Wh" COEFFS 0.000000 1.000000 -0.000000 0.000000 0.000000 1.000000 /end COMPU_METHOD
/* Scalar calibration for DDE 'V2gTxEvEgyReqAmountOf_C'. */
/begin CHARACTERISTIC V2gTxEvEgyReqAmountOf_C "Enables overriding Amount of energy requested by the vehicle" VALUE 0x700196c5 RL_V2GTXEVEGYREQAMOUNTOF_C 1.000000 CU_V2GTXEVEGYREQAMOUNTOF_C 0.000000 1.000000 BYTE_ORDER MSB_LAST /end CHARACTERISTIC
/begin RECORD_LAYOUT RL_V2GTXEVEGYREQAMOUNTOF_C FNC_VALUES 1 UBYTE COLUMN_DIR DIRECT /end RECORD_LAYOUT
/begin COMPU_METHOD CU_V2GTXEVEGYREQAMOUNTOF_C "Conversion method for V2gTxEvEgyReqAmountOf_C" RAT_FUNC "%10.0" "b" COEFFS 0.000000 1.000000 -0.000000 0.000000 0.000000 1.000000 /end COMPU_METHOD
/* Scalar calibration for DDE 'V2gTxEvEgyReqAmountOv_C'. */
/begin CHARACTERISTIC V2gTxEvEgyReqAmountOv_C "Override value for Amount of energy requested by the vehicle" VALUE 0x700185c4 RL_V2GTXEVEGYREQAMOUNTOV_C 196605.000000 CU_V2GTXEVEGYREQAMOUNTOV_C 0.000000 196605.000000 BYTE_ORDER MSB_LAST /end CHARACTERISTIC
/begin RECORD_LAYOUT RL_V2GTXEVEGYREQAMOUNTOV_C FNC_VALUES 1 FLOAT32_IEEE COLUMN_DIR DIRECT /end RECORD_LAYOUT
/begin COMPU_METHOD CU_V2GTXEVEGYREQAMOUNTOV_C "Conversion method for V2gTxEvEgyReqAmountOv_C" RAT_FUNC "%10.0" "Wh" COEFFS 0.000000 1.000000 -0.000000 0.000000 0.000000 1.000000 /end COMPU_METHOD
/* Scalar calibration for DDE 'V2gTxEvErrorCodeOf_C'. */
/begin CHARACTERISTIC V2gTxEvErrorCodeOf_C "Enables overriding Indicates the EV internal status" VALUE 0x7001976d RL_V2GTXEVERRORCODEOF_C 1.000000 CU_V2GTXEVERRORCODEOF_C 0.000000 1.000000 BYTE_ORDER MSB_LAST /end CHARACTERISTIC
/begin RECORD_LAYOUT RL_V2GTXEVERRORCODEOF_C FNC_VALUES 1 UBYTE COLUMN_DIR DIRECT /end RECORD_LAYOUT
/begin COMPU_METHOD CU_V2GTXEVERRORCODEOF_C "Conversion method for V2gTxEvErrorCodeOf_C" RAT_FUNC "%10.0" "b" COEFFS 0.000000 1.000000 -0.000000 0.000000 0.000000 1.000000 /end COMPU_METHOD
/* Scalar calibration for DDE 'V2gTxEvErrorCodeOv_C'. */
/begin CHARACTERISTIC V2gTxEvErrorCodeOv_C "Override value for Indicates the EV internal status" VALUE 0x70018670 RL_V2GTXEVERRORCODEOV_C 4294967295.000000 CU_V2GTXEVERRORCODEOV_C -2147483648.000000 2147483647.000000 BYTE_ORDER MSB_LAST /end CHARACTERISTIC
/begin RECORD_LAYOUT RL_V2GTXEVERRORCODEOV_C FNC_VALUES 1 SLONG COLUMN_DIR DIRECT /end RECORD_LAYOUT
/begin COMPU_METHOD CU_V2GTXEVERRORCODEOV_C "Conversion method for V2gTxEvErrorCodeOv_C" TAB_VERB "%12.0" "enum" COMPU_TAB_REF CT_V2GTXEVERRORCODEOV_C /end COMPU_METHOD
/begin COMPU_VTAB CT_V2GTXEVERRORCODEOV_C "Conversion method for V2gTxEvErrorCodeOv_C" TAB_VERB 12 0 "EVERRORCODE_NO_ERROR" 1 "FAILED_RESS_TEMP_INHIBIT" 2 "FAILED_EV_SHIFT_POSITION" 3 "FAILED_CHARGER_CONNECTOR_LOCK_FLT" 4 "FAILED_RESS_MALFUNCTION" 5 "FAILED_CHARGE_CRNT_DIFFERENTIAL" 6 "FAILED_CHARGE_VOLT_OOR" 7 "Reserved_A_C1" 8 "Reserved_A_C2" 9 "Reserved_A_C3" 10 "FAILED_CHARGE_SYSTEM_INCOMPATIBLE" 11 "EVERRORCODE_NO_DATA" /end COMPU_VTAB
/* Scalar calibration for DDE 'V2gTxEvMaxEgyReqOf_C'. */
/begin CHARACTERISTIC V2gTxEvMaxEgyReqOf_C "Enables overriding Maximum energy energy level accepted by the EV at any given time during the energy transfer loop" VALUE 0x700173f0 RL_V2GTXEVMAXEGYREQOF_C 1.000000 CU_V2GTXEVMAXEGYREQOF_C 0.000000 1.000000 BYTE_ORDER MSB_LAST /end CHARACTERISTIC
/begin RECORD_LAYOUT RL_V2GTXEVMAXEGYREQOF_C FNC_VALUES 1 UBYTE COLUMN_DIR DIRECT /end RECORD_LAYOUT
/begin COMPU_METHOD CU_V2GTXEVMAXEGYREQOF_C "Conversion method for V2gTxEvMaxEgyReqOf_C" RAT_FUNC "%10.0" "b" COEFFS 0.000000 1.000000 -0.000000 0.000000 0.000000 1.000000 /end COMPU_METHOD
/* Scalar calibration for DDE 'V2gTxEvMaxEgyReqOv_C'. */
/begin CHARACTERISTIC V2gTxEvMaxEgyReqOv_C "Override value for Maximum energy energy level accepted by the EV at any given time during the energy transfer loop" VALUE 0x700175c0 RL_V2GTXEVMAXEGYREQOV_C 196605.000000 CU_V2GTXEVMAXEGYREQOV_C 0.000000 196605.000000 BYTE_ORDER MSB_LAST /end CHARACTERISTIC
/begin RECORD_LAYOUT RL_V2GTXEVMAXEGYREQOV_C FNC_VALUES 1 FLOAT32_IEEE COLUMN_DIR DIRECT /end RECORD_LAYOUT
/begin COMPU_METHOD CU_V2GTXEVMAXEGYREQOV_C "Conversion method for V2gTxEvMaxEgyReqOv_C" RAT_FUNC "%10.0" "Wh" COEFFS 0.000000 1.000000 -0.000000 0.000000 0.000000 1.000000 /end COMPU_METHOD
/* Scalar calibration for DDE 'V2gTxEvMinEgyReqOf_C'. */
/begin CHARACTERISTIC V2gTxEvMinEgyReqOf_C "Enables overriding energy requested by the EV at any given time during the energy transfer loop" VALUE 0x700175a0 RL_V2GTXEVMINEGYREQOF_C 1.000000 CU_V2GTXEVMINEGYREQOF_C 0.000000 1.000000 BYTE_ORDER MSB_LAST /end CHARACTERISTIC
/begin RECORD_LAYOUT RL_V2GTXEVMINEGYREQOF_C FNC_VALUES 1 UBYTE COLUMN_DIR DIRECT /end RECORD_LAYOUT
/begin COMPU_METHOD CU_V2GTXEVMINEGYREQOF_C "Conversion method for V2gTxEvMinEgyReqOf_C" RAT_FUNC "%10.0" "b" COEFFS 0.000000 1.000000 -0.000000 0.000000 0.000000 1.000000 /end COMPU_METHOD
/* Scalar calibration for DDE 'V2gTxEvMinEgyReqOv_C'. */
/begin CHARACTERISTIC V2gTxEvMinEgyReqOv_C "Override value for energy requested by the EV at any given time during the energy transfer loop" VALUE 0x700173e0 RL_V2GTXEVMINEGYREQOV_C 196605.000000 CU_V2GTXEVMINEGYREQOV_C 0.000000 196605.000000 BYTE_ORDER MSB_LAST /end CHARACTERISTIC
/begin RECORD_LAYOUT RL_V2GTXEVMINEGYREQOV_C FNC_VALUES 1 FLOAT32_IEEE COLUMN_DIR DIRECT /end RECORD_LAYOUT
/begin COMPU_METHOD CU_V2GTXEVMINEGYREQOV_C "Conversion method for V2gTxEvMinEgyReqOv_C" RAT_FUNC "%10.0" "Wh" COEFFS 0.000000 1.000000 -0.000000 0.000000 0.000000 1.000000 /end COMPU_METHOD
/* Scalar calibration for DDE 'V2gTxEvOperationEnOf_C'. */
/begin CHARACTERISTIC V2gTxEvOperationEnOf_C "Enables overriding of EV Operation enable V2g signal" VALUE 0x70018676 RL_V2GTXEVOPERATIONENOF_C 1.000000 CU_V2GTXEVOPERATIONENOF_C 0.000000 1.000000 BYTE_ORDER MSB_LAST /end CHARACTERISTIC
/begin RECORD_LAYOUT RL_V2GTXEVOPERATIONENOF_C FNC_VALUES 1 UBYTE COLUMN_DIR DIRECT /end RECORD_LAYOUT
/begin COMPU_METHOD CU_V2GTXEVOPERATIONENOF_C "Conversion method for V2gTxEvOperationEnOf_C" RAT_FUNC "%10.0" "b" COEFFS 0.000000 1.000000 -0.000000 0.000000 0.000000 1.000000 /end COMPU_METHOD
/* Scalar calibration for DDE 'V2gTxEvOperationEnOv_C'. */
/begin CHARACTERISTIC V2gTxEvOperationEnOv_C "Override value for EV Operation enable V2g signal" VALUE 0x70019d64 RL_V2GTXEVOPERATIONENOV_C 1.000000 CU_V2GTXEVOPERATIONENOV_C 0.000000 1.000000 BYTE_ORDER MSB_LAST /end CHARACTERISTIC
/begin RECORD_LAYOUT RL_V2GTXEVOPERATIONENOV_C FNC_VALUES 1 UBYTE COLUMN_DIR DIRECT /end RECORD_LAYOUT
/begin COMPU_METHOD CU_V2GTXEVOPERATIONENOV_C "Conversion method for V2gTxEvOperationEnOv_C" RAT_FUNC "%10.0" "b" COEFFS 0.000000 1.000000 -0.000000 0.000000 0.000000 1.000000 /end COMPU_METHOD
/* Scalar calibration for DDE 'V2gTxEvOperationOf_C'. */
/begin CHARACTERISTIC V2gTxEvOperationOf_C "Enables overriding of EV Operation V2g signal" VALUE 0x700185ca RL_V2GTXEVOPERATIONOF_C 1.000000 CU_V2GTXEVOPERATIONOF_C 0.000000 1.000000 BYTE_ORDER MSB_LAST /end CHARACTERISTIC
/begin RECORD_LAYOUT RL_V2GTXEVOPERATIONOF_C FNC_VALUES 1 UBYTE COLUMN_DIR DIRECT /end RECORD_LAYOUT
/begin COMPU_METHOD CU_V2GTXEVOPERATIONOF_C "Conversion method for V2gTxEvOperationOf_C" RAT_FUNC "%10.0" "b" COEFFS 0.000000 1.000000 -0.000000 0.000000 0.000000 1.000000 /end COMPU_METHOD
/* Scalar calibration for DDE 'V2gTxEvOperationOv_C'. */
/begin CHARACTERISTIC V2gTxEvOperationOv_C "Override value for EV Operation V2g signal" VALUE 0x70019774 RL_V2GTXEVOPERATIONOV_C 1.000000 CU_V2GTXEVOPERATIONOV_C 0.000000 1.000000 BYTE_ORDER MSB_LAST /end CHARACTERISTIC
/begin RECORD_LAYOUT RL_V2GTXEVOPERATIONOV_C FNC_VALUES 1 UBYTE COLUMN_DIR DIRECT /end RECORD_LAYOUT
/begin COMPU_METHOD CU_V2GTXEVOPERATIONOV_C "Conversion method for V2gTxEvOperationOv_C" RAT_FUNC "%10.0" "1" COEFFS 0.000000 1.000000 -0.000000 0.000000 0.000000 1.000000 /end COMPU_METHOD
/* Scalar calibration for DDE 'V2gTxEvPwrMaxLimOf_C'. */
/begin CHARACTERISTIC V2gTxEvPwrMaxLimOf_C "Enables overriding Maximum power supported by the vehicle." VALUE 0x700184c5 RL_V2GTXEVPWRMAXLIMOF_C 1.000000 CU_V2GTXEVPWRMAXLIMOF_C 0.000000 1.000000 BYTE_ORDER MSB_LAST /end CHARACTERISTIC
/begin RECORD_LAYOUT RL_V2GTXEVPWRMAXLIMOF_C FNC_VALUES 1 UBYTE COLUMN_DIR DIRECT /end RECORD_LAYOUT
/begin COMPU_METHOD CU_V2GTXEVPWRMAXLIMOF_C "Conversion method for V2gTxEvPwrMaxLimOf_C" RAT_FUNC "%10.0" "b" COEFFS 0.000000 1.000000 -0.000000 0.000000 0.000000 1.000000 /end COMPU_METHOD
/* Scalar calibration for DDE 'V2gTxEvPwrMaxLimOv_C'. */
/begin CHARACTERISTIC V2gTxEvPwrMaxLimOv_C "Override value for Maximum power supported by the vehicle." VALUE 0x70019648 RL_V2GTXEVPWRMAXLIMOV_C 196605.000000 CU_V2GTXEVPWRMAXLIMOV_C 0.000000 196605.000000 BYTE_ORDER MSB_LAST /end CHARACTERISTIC
/begin RECORD_LAYOUT RL_V2GTXEVPWRMAXLIMOV_C FNC_VALUES 1 FLOAT32_IEEE COLUMN_DIR DIRECT /end RECORD_LAYOUT
/begin COMPU_METHOD CU_V2GTXEVPWRMAXLIMOV_C "Conversion method for V2gTxEvPwrMaxLimOv_C" RAT_FUNC "%10.0" "W" COEFFS 0.000000 1.000000 -0.000000 0.000000 0.000000 1.000000 /end COMPU_METHOD
/* Scalar calibration for DDE 'V2gTxEvPwrMinLimOf_C'. */
/begin CHARACTERISTIC V2gTxEvPwrMinLimOf_C "Enables overriding Minimum power supported by the vehicle." VALUE 0x70019739 RL_V2GTXEVPWRMINLIMOF_C 1.000000 CU_V2GTXEVPWRMINLIMOF_C 0.000000 1.000000 BYTE_ORDER MSB_LAST /end CHARACTERISTIC
/begin RECORD_LAYOUT RL_V2GTXEVPWRMINLIMOF_C FNC_VALUES 1 UBYTE COLUMN_DIR DIRECT /end RECORD_LAYOUT
/begin COMPU_METHOD CU_V2GTXEVPWRMINLIMOF_C "Conversion method for V2gTxEvPwrMinLimOf_C" RAT_FUNC "%10.0" "b" COEFFS 0.000000 1.000000 -0.000000 0.000000 0.000000 1.000000 /end COMPU_METHOD
/* Scalar calibration for DDE 'V2gTxEvPwrMinLimOv_C'. */
/begin CHARACTERISTIC V2gTxEvPwrMinLimOv_C "Override value for Minimum power supported by the vehicle." VALUE 0x700185e0 RL_V2GTXEVPWRMINLIMOV_C 196605.000000 CU_V2GTXEVPWRMINLIMOV_C 0.000000 196605.000000 BYTE_ORDER MSB_LAST /end CHARACTERISTIC
/begin RECORD_LAYOUT RL_V2GTXEVPWRMINLIMOV_C FNC_VALUES 1 FLOAT32_IEEE COLUMN_DIR DIRECT /end RECORD_LAYOUT
/begin COMPU_METHOD CU_V2GTXEVPWRMINLIMOV_C "Conversion method for V2gTxEvPwrMinLimOv_C" RAT_FUNC "%10.0" "W" COEFFS 0.000000 1.000000 -0.000000 0.000000 0.000000 1.000000 /end COMPU_METHOD
/* Scalar calibration for DDE 'V2gTxEvReadyOf_C'. */
/begin CHARACTERISTIC V2gTxEvReadyOf_C "Enables overriding If set to TRUE, the vehicle is ready to charge." VALUE 0x70019d5a RL_V2GTXEVREADYOF_C 1.000000 CU_V2GTXEVREADYOF_C 0.000000 1.000000 BYTE_ORDER MSB_LAST /end CHARACTERISTIC
/begin RECORD_LAYOUT RL_V2GTXEVREADYOF_C FNC_VALUES 1 UBYTE COLUMN_DIR DIRECT /end RECORD_LAYOUT
/begin COMPU_METHOD CU_V2GTXEVREADYOF_C "Conversion method for V2gTxEvReadyOf_C" RAT_FUNC "%10.0" "b" COEFFS 0.000000 1.000000 -0.000000 0.000000 0.000000 1.000000 /end COMPU_METHOD
/* Scalar calibration for DDE 'V2gTxEvReadyOv_C'. */
/begin CHARACTERISTIC V2gTxEvReadyOv_C "Override value for If set to TRUE, the vehicle is ready to charge." VALUE 0x700186d7 RL_V2GTXEVREADYOV_C 1.000000 CU_V2GTXEVREADYOV_C 0.000000 1.000000 BYTE_ORDER MSB_LAST /end CHARACTERISTIC
/begin RECORD_LAYOUT RL_V2GTXEVREADYOV_C FNC_VALUES 1 UBYTE COLUMN_DIR DIRECT /end RECORD_LAYOUT
/begin COMPU_METHOD CU_V2GTXEVREADYOV_C "Conversion method for V2gTxEvReadyOv_C" RAT_FUNC "%10.0" "b" COEFFS 0.000000 1.000000 -0.000000 0.000000 0.000000 1.000000 /end COMPU_METHOD
/* Scalar calibration for DDE 'V2gTxEvRessConditionOf_C'. */
/begin CHARACTERISTIC V2gTxEvRessConditionOf_C "Enables overriding The vehicle is using energy from the DC charger to condition the RESS to a target temperature" VALUE 0x70019e78 RL_V2GTXEVRESSCONDITIONOF_C 1.000000 CU_V2GTXEVRESSCONDITIONOF_C 0.000000 1.000000 BYTE_ORDER MSB_LAST /end CHARACTERISTIC
/begin RECORD_LAYOUT RL_V2GTXEVRESSCONDITIONOF_C FNC_VALUES 1 UBYTE COLUMN_DIR DIRECT /end RECORD_LAYOUT
/begin COMPU_METHOD CU_V2GTXEVRESSCONDITIONOF_C "Conversion method for V2gTxEvRessConditionOf_C" RAT_FUNC "%10.0" "b" COEFFS 0.000000 1.000000 -0.000000 0.000000 0.000000 1.000000 /end COMPU_METHOD
/* Scalar calibration for DDE 'V2gTxEvRessConditionOv_C'. */
/begin CHARACTERISTIC V2gTxEvRessConditionOv_C "Override value for The vehicle is using energy from the DC charger to condition the RESS to a target temperature" VALUE 0x7001962b RL_V2GTXEVRESSCONDITIONOV_C 1.000000 CU_V2GTXEVRESSCONDITIONOV_C 0.000000 1.000000 BYTE_ORDER MSB_LAST /end CHARACTERISTIC
/begin RECORD_LAYOUT RL_V2GTXEVRESSCONDITIONOV_C FNC_VALUES 1 UBYTE COLUMN_DIR DIRECT /end RECORD_LAYOUT
/begin COMPU_METHOD CU_V2GTXEVRESSCONDITIONOV_C "Conversion method for V2gTxEvRessConditionOv_C" RAT_FUNC "%10.0" "b" COEFFS 0.000000 1.000000 -0.000000 0.000000 0.000000 1.000000 /end COMPU_METHOD
/* Scalar calibration for DDE 'V2gTxEvRessSocOf_C'. */
/begin CHARACTERISTIC V2gTxEvRessSocOf_C "Enables overriding State of charge of the vehicle’s battery" VALUE 0x7001869a RL_V2GTXEVRESSSOCOF_C 1.000000 CU_V2GTXEVRESSSOCOF_C 0.000000 1.000000 BYTE_ORDER MSB_LAST /end CHARACTERISTIC
/begin RECORD_LAYOUT RL_V2GTXEVRESSSOCOF_C FNC_VALUES 1 UBYTE COLUMN_DIR DIRECT /end RECORD_LAYOUT
/begin COMPU_METHOD CU_V2GTXEVRESSSOCOF_C "Conversion method for V2gTxEvRessSocOf_C" RAT_FUNC "%10.0" "b" COEFFS 0.000000 1.000000 -0.000000 0.000000 0.000000 1.000000 /end COMPU_METHOD
/* Scalar calibration for DDE 'V2gTxEvRessSocOv_C'. */
/begin CHARACTERISTIC V2gTxEvRessSocOv_C "Override value for State of charge of the vehicle’s battery" VALUE 0x70019d88 RL_V2GTXEVRESSSOCOV_C 100.000000 CU_V2GTXEVRESSSOCOV_C 0.000000 100.000000 BYTE_ORDER MSB_LAST /end CHARACTERISTIC
/begin RECORD_LAYOUT RL_V2GTXEVRESSSOCOV_C FNC_VALUES 1 FLOAT32_IEEE COLUMN_DIR DIRECT /end RECORD_LAYOUT
/begin COMPU_METHOD CU_V2GTXEVRESSSOCOV_C "Conversion method for V2gTxEvRessSocOv_C" RAT_FUNC "%10.0" "%" COEFFS 0.000000 1.000000 -0.000000 0.000000 0.000000 1.000000 /end COMPU_METHOD
/* Scalar calibration for DDE 'V2gTxEvTargetCrntOf_C'. */
/begin CHARACTERISTIC V2gTxEvTargetCrntOf_C "Enables overriding Instantaneous current requested by the vehicle" VALUE 0x7001851d RL_V2GTXEVTARGETCRNTOF_C 1.000000 CU_V2GTXEVTARGETCRNTOF_C 0.000000 1.000000 BYTE_ORDER MSB_LAST /end CHARACTERISTIC
/begin RECORD_LAYOUT RL_V2GTXEVTARGETCRNTOF_C FNC_VALUES 1 UBYTE COLUMN_DIR DIRECT /end RECORD_LAYOUT
/begin COMPU_METHOD CU_V2GTXEVTARGETCRNTOF_C "Conversion method for V2gTxEvTargetCrntOf_C" RAT_FUNC "%10.0" "b" COEFFS 0.000000 1.000000 -0.000000 0.000000 0.000000 1.000000 /end COMPU_METHOD
/* Scalar calibration for DDE 'V2gTxEvTargetCrntOv_C'. */
/begin CHARACTERISTIC V2gTxEvTargetCrntOv_C "Override value for Instantaneous current requested by the vehicle" VALUE 0x700196c8 RL_V2GTXEVTARGETCRNTOV_C 196605.000000 CU_V2GTXEVTARGETCRNTOV_C 0.000000 196605.000000 BYTE_ORDER MSB_LAST /end CHARACTERISTIC
/begin RECORD_LAYOUT RL_V2GTXEVTARGETCRNTOV_C FNC_VALUES 1 FLOAT32_IEEE COLUMN_DIR DIRECT /end RECORD_LAYOUT
/begin COMPU_METHOD CU_V2GTXEVTARGETCRNTOV_C "Conversion method for V2gTxEvTargetCrntOv_C" RAT_FUNC "%10.0" "A" COEFFS 0.000000 1.000000 -0.000000 0.000000 0.000000 1.000000 /end COMPU_METHOD
/* Scalar calibration for DDE 'V2gTxEvTargetVoltOf_C'. */
/begin CHARACTERISTIC V2gTxEvTargetVoltOf_C "Enables overriding Target Voltage requested by EV" VALUE 0x700185c9 RL_V2GTXEVTARGETVOLTOF_C 1.000000 CU_V2GTXEVTARGETVOLTOF_C 0.000000 1.000000 BYTE_ORDER MSB_LAST /end CHARACTERISTIC
/begin RECORD_LAYOUT RL_V2GTXEVTARGETVOLTOF_C FNC_VALUES 1 UBYTE COLUMN_DIR DIRECT /end RECORD_LAYOUT
/begin COMPU_METHOD CU_V2GTXEVTARGETVOLTOF_C "Conversion method for V2gTxEvTargetVoltOf_C" RAT_FUNC "%10.0" "b" COEFFS 0.000000 1.000000 -0.000000 0.000000 0.000000 1.000000 /end COMPU_METHOD
/* Scalar calibration for DDE 'V2gTxEvTargetVoltOv_C'. */
/begin CHARACTERISTIC V2gTxEvTargetVoltOv_C "Override value for Target Voltage requested by EV" VALUE 0x70019770 RL_V2GTXEVTARGETVOLTOV_C 196605.000000 CU_V2GTXEVTARGETVOLTOV_C 0.000000 196605.000000 BYTE_ORDER MSB_LAST /end CHARACTERISTIC
/begin RECORD_LAYOUT RL_V2GTXEVTARGETVOLTOV_C FNC_VALUES 1 FLOAT32_IEEE COLUMN_DIR DIRECT /end RECORD_LAYOUT
/begin COMPU_METHOD CU_V2GTXEVTARGETVOLTOV_C "Conversion method for V2gTxEvTargetVoltOv_C" RAT_FUNC "%10.0" "V" COEFFS 0.000000 1.000000 -0.000000 0.000000 0.000000 1.000000 /end COMPU_METHOD
/* Scalar calibration for DDE 'V2gTxEvVoltMaxLimOf_C'. */
/begin CHARACTERISTIC V2gTxEvVoltMaxLimOf_C "Enables overriding Maximum voltage supported by the vehicle." VALUE 0x700186da RL_V2GTXEVVOLTMAXLIMOF_C 1.000000 CU_V2GTXEVVOLTMAXLIMOF_C 0.000000 1.000000 BYTE_ORDER MSB_LAST /end CHARACTERISTIC
/begin RECORD_LAYOUT RL_V2GTXEVVOLTMAXLIMOF_C FNC_VALUES 1 UBYTE COLUMN_DIR DIRECT /end RECORD_LAYOUT
/begin COMPU_METHOD CU_V2GTXEVVOLTMAXLIMOF_C "Conversion method for V2gTxEvVoltMaxLimOf_C" RAT_FUNC "%10.0" "b" COEFFS 0.000000 1.000000 -0.000000 0.000000 0.000000 1.000000 /end COMPU_METHOD
/* Scalar calibration for DDE 'V2gTxEvVoltMaxLimOv_C'. */
/begin CHARACTERISTIC V2gTxEvVoltMaxLimOv_C "Override value for Maximum voltage supported by the vehicle." VALUE 0x70019e24 RL_V2GTXEVVOLTMAXLIMOV_C 196605.000000 CU_V2GTXEVVOLTMAXLIMOV_C 0.000000 196605.000000 BYTE_ORDER MSB_LAST /end CHARACTERISTIC
/begin RECORD_LAYOUT RL_V2GTXEVVOLTMAXLIMOV_C FNC_VALUES 1 FLOAT32_IEEE COLUMN_DIR DIRECT /end RECORD_LAYOUT
/begin COMPU_METHOD CU_V2GTXEVVOLTMAXLIMOV_C "Conversion method for V2gTxEvVoltMaxLimOv_C" RAT_FUNC "%10.0" "V" COEFFS 0.000000 1.000000 -0.000000 0.000000 0.000000 1.000000 /end COMPU_METHOD
/* Scalar calibration for DDE 'V2gTxEvVoltMinLimOf_C'. */
/begin CHARACTERISTIC V2gTxEvVoltMinLimOf_C "Enables overriding Minimum voltage supported by the vehicle." VALUE 0x70018675 RL_V2GTXEVVOLTMINLIMOF_C 1.000000 CU_V2GTXEVVOLTMINLIMOF_C 0.000000 1.000000 BYTE_ORDER MSB_LAST /end CHARACTERISTIC
/begin RECORD_LAYOUT RL_V2GTXEVVOLTMINLIMOF_C FNC_VALUES 1 UBYTE COLUMN_DIR DIRECT /end RECORD_LAYOUT
/begin COMPU_METHOD CU_V2GTXEVVOLTMINLIMOF_C "Conversion method for V2gTxEvVoltMinLimOf_C" RAT_FUNC "%10.0" "b" COEFFS 0.000000 1.000000 -0.000000 0.000000 0.000000 1.000000 /end COMPU_METHOD
/* Scalar calibration for DDE 'V2gTxEvVoltMinLimOv_C'. */
/begin CHARACTERISTIC V2gTxEvVoltMinLimOv_C "Override value for Minimum voltage supported by the vehicle." VALUE 0x70019d60 RL_V2GTXEVVOLTMINLIMOV_C 196605.000000 CU_V2GTXEVVOLTMINLIMOV_C 0.000000 196605.000000 BYTE_ORDER MSB_LAST /end CHARACTERISTIC
/begin RECORD_LAYOUT RL_V2GTXEVVOLTMINLIMOV_C FNC_VALUES 1 FLOAT32_IEEE COLUMN_DIR DIRECT /end RECORD_LAYOUT
/begin COMPU_METHOD CU_V2GTXEVVOLTMINLIMOV_C "Conversion method for V2gTxEvVoltMinLimOv_C" RAT_FUNC "%10.0" "V" COEFFS 0.000000 1.000000 -0.000000 0.000000 0.000000 1.000000 /end COMPU_METHOD
/* Scalar calibration for DDE 'V2gTxFullSocOf_C'. */
/begin CHARACTERISTIC V2gTxFullSocOf_C "Enables overriding State of charge at which the vehicle considers the battery fully charged." VALUE 0x700185da RL_V2GTXFULLSOCOF_C 1.000000 CU_V2GTXFULLSOCOF_C 0.000000 1.000000 BYTE_ORDER MSB_LAST /end CHARACTERISTIC
/begin RECORD_LAYOUT RL_V2GTXFULLSOCOF_C FNC_VALUES 1 UBYTE COLUMN_DIR DIRECT /end RECORD_LAYOUT
/begin COMPU_METHOD CU_V2GTXFULLSOCOF_C "Conversion method for V2gTxFullSocOf_C" RAT_FUNC "%10.0" "b" COEFFS 0.000000 1.000000 -0.000000 0.000000 0.000000 1.000000 /end COMPU_METHOD
/* Scalar calibration for DDE 'V2gTxFullSocOv_C'. */
/begin CHARACTERISTIC V2gTxFullSocOv_C "Override value for State of charge at which the vehicle considers the battery fully charged." VALUE 0x7001978c RL_V2GTXFULLSOCOV_C 100.000000 CU_V2GTXFULLSOCOV_C 0.000000 100.000000 BYTE_ORDER MSB_LAST /end CHARACTERISTIC
/begin RECORD_LAYOUT RL_V2GTXFULLSOCOV_C FNC_VALUES 1 FLOAT32_IEEE COLUMN_DIR DIRECT /end RECORD_LAYOUT
/begin COMPU_METHOD CU_V2GTXFULLSOCOV_C "Conversion method for V2gTxFullSocOv_C" RAT_FUNC "%10.0" "%" COEFFS 0.000000 1.000000 -0.000000 0.000000 0.000000 1.000000 /end COMPU_METHOD
/* Scalar calibration for DDE 'V2gTxParameterSetIdOf_C'. */
/begin CHARACTERISTIC V2gTxParameterSetIdOf_C "Enables overriding of variable Used to select a specific parameter set for a specific ServiceID when selecting a service" VALUE 0x7001851c RL_V2GTXPARAMETERSETIDOF_C 1.000000 CU_V2GTXPARAMETERSETIDOF_C 0.000000 1.000000 BYTE_ORDER MSB_LAST /end CHARACTERISTIC
/begin RECORD_LAYOUT RL_V2GTXPARAMETERSETIDOF_C FNC_VALUES 1 UBYTE COLUMN_DIR DIRECT /end RECORD_LAYOUT
/begin COMPU_METHOD CU_V2GTXPARAMETERSETIDOF_C "Conversion method for V2gTxParameterSetIdOf_C" RAT_FUNC "%10.0" "b" COEFFS 0.000000 1.000000 -0.000000 0.000000 0.000000 1.000000 /end COMPU_METHOD
/* Scalar calibration for DDE 'V2gTxParameterSetIdOv_C'. */
/begin CHARACTERISTIC V2gTxParameterSetIdOv_C "Override value for the signal Used to select a specific parameter set for a specific ServiceID when selecting a service" VALUE 0x700196c6 RL_V2GTXPARAMETERSETIDOV_C 65535.000000 CU_V2GTXPARAMETERSETIDOV_C 0.000000 65535.000000 BYTE_ORDER MSB_LAST /end CHARACTERISTIC
/begin RECORD_LAYOUT RL_V2GTXPARAMETERSETIDOV_C FNC_VALUES 1 UWORD COLUMN_DIR DIRECT /end RECORD_LAYOUT
/begin COMPU_METHOD CU_V2GTXPARAMETERSETIDOV_C "Conversion method for V2gTxParameterSetIdOv_C" RAT_FUNC "%10.0" "1" COEFFS 0.000000 1.000000 -0.000000 0.000000 0.000000 1.000000 /end COMPU_METHOD
/* Scalar calibration for DDE 'V2gTxProfileEntryCntOf_C'. */
/begin CHARACTERISTIC V2gTxProfileEntryCntOf_C "Enables overriding Identifies the number of charging profile entries that have been provided in the ChargingProfileEntryStart and ChargingProfileEntryMaxPower parameters." VALUE 0x70019791 RL_V2GTXPROFILEENTRYCNTOF_C 1.000000 CU_V2GTXPROFILEENTRYCNTOF_C 0.000000 1.000000 BYTE_ORDER MSB_LAST /end CHARACTERISTIC
/begin RECORD_LAYOUT RL_V2GTXPROFILEENTRYCNTOF_C FNC_VALUES 1 UBYTE COLUMN_DIR DIRECT /end RECORD_LAYOUT
/begin COMPU_METHOD CU_V2GTXPROFILEENTRYCNTOF_C "Conversion method for V2gTxProfileEntryCntOf_C" RAT_FUNC "%10.0" "b" COEFFS 0.000000 1.000000 -0.000000 0.000000 0.000000 1.000000 /end COMPU_METHOD
/* Scalar calibration for DDE 'V2gTxProfileEntryCntOv_C'. */
/begin CHARACTERISTIC V2gTxProfileEntryCntOv_C "Override value for Identifies the number of charging profile entries that have been provided in the ChargingProfileEntryStart and ChargingProfileEntryMaxPower parameters." VALUE 0x700186a0 RL_V2GTXPROFILEENTRYCNTOV_C 24.000000 CU_V2GTXPROFILEENTRYCNTOV_C 0.000000 24.000000 BYTE_ORDER MSB_LAST /end CHARACTERISTIC
/begin RECORD_LAYOUT RL_V2GTXPROFILEENTRYCNTOV_C FNC_VALUES 1 UWORD COLUMN_DIR DIRECT /end RECORD_LAYOUT
/begin COMPU_METHOD CU_V2GTXPROFILEENTRYCNTOV_C "Conversion method for V2gTxProfileEntryCntOv_C" RAT_FUNC "%10.0" "1" COEFFS 0.000000 1.000000 -0.000000 0.000000 0.000000 1.000000 /end COMPU_METHOD
/* Scalar calibration for DDE 'V2gTxRemainTimeToFullSocOf_C'. */
/begin CHARACTERISTIC V2gTxRemainTimeToFullSocOf_C "Enables overriding Estimated or calculated time until full charge is complete." VALUE 0x70018699 RL_V2GTXREMAINTIMETOFULLSOCOF_C 1.000000 CU_V2GTXREMAINTIMETOFULLSOCOF_C 0.000000 1.000000 BYTE_ORDER MSB_LAST /end CHARACTERISTIC
/begin RECORD_LAYOUT RL_V2GTXREMAINTIMETOFULLSOCOF_C FNC_VALUES 1 UBYTE COLUMN_DIR DIRECT /end RECORD_LAYOUT
/begin COMPU_METHOD CU_V2GTXREMAINTIMETOFULLSOCOF_C "Conversion method for V2gTxRemainTimeToFullSocOf_C" RAT_FUNC "%10.0" "b" COEFFS 0.000000 1.000000 -0.000000 0.000000 0.000000 1.000000 /end COMPU_METHOD
/* Scalar calibration for DDE 'V2gTxRemainTimeToFullSocOv_C'. */
/begin CHARACTERISTIC V2gTxRemainTimeToFullSocOv_C "Override value for Estimated or calculated time until full charge is complete." VALUE 0x70019d84 RL_V2GTXREMAINTIMETOFULLSOCOV_C 196605.000000 CU_V2GTXREMAINTIMETOFULLSOCOV_C 0.000000 196605.000000 BYTE_ORDER MSB_LAST /end CHARACTERISTIC
/begin RECORD_LAYOUT RL_V2GTXREMAINTIMETOFULLSOCOV_C FNC_VALUES 1 FLOAT32_IEEE COLUMN_DIR DIRECT /end RECORD_LAYOUT
/begin COMPU_METHOD CU_V2GTXREMAINTIMETOFULLSOCOV_C "Conversion method for V2gTxRemainTimeToFullSocOv_C" RAT_FUNC "%10.0" "s" COEFFS 0.000000 1.000000 -0.000000 0.000000 0.000000 1.000000 /end COMPU_METHOD
/* Scalar calibration for DDE 'V2gTxRemainTimetoBulkSocOf_C'. */
/begin CHARACTERISTIC V2gTxRemainTimetoBulkSocOf_C "Enables overriding Estimated or calculated time until bulk charge is complete." VALUE 0x700185a9 RL_V2GTXREMAINTIMETOBULKSOCOF_C 1.000000 CU_V2GTXREMAINTIMETOBULKSOCOF_C 0.000000 1.000000 BYTE_ORDER MSB_LAST /end CHARACTERISTIC
/begin RECORD_LAYOUT RL_V2GTXREMAINTIMETOBULKSOCOF_C FNC_VALUES 1 UBYTE COLUMN_DIR DIRECT /end RECORD_LAYOUT
/begin COMPU_METHOD CU_V2GTXREMAINTIMETOBULKSOCOF_C "Conversion method for V2gTxRemainTimetoBulkSocOf_C" RAT_FUNC "%10.0" "b" COEFFS 0.000000 1.000000 -0.000000 0.000000 0.000000 1.000000 /end COMPU_METHOD
/* Scalar calibration for DDE 'V2gTxRemainTimetoBulkSocOv_C'. */
/begin CHARACTERISTIC V2gTxRemainTimetoBulkSocOv_C "Override value for Estimated or calculated time until bulk charge is complete." VALUE 0x70019730 RL_V2GTXREMAINTIMETOBULKSOCOV_C 196605.000000 CU_V2GTXREMAINTIMETOBULKSOCOV_C 0.000000 196605.000000 BYTE_ORDER MSB_LAST /end CHARACTERISTIC
/begin RECORD_LAYOUT RL_V2GTXREMAINTIMETOBULKSOCOV_C FNC_VALUES 1 FLOAT32_IEEE COLUMN_DIR DIRECT /end RECORD_LAYOUT
/begin COMPU_METHOD CU_V2GTXREMAINTIMETOBULKSOCOV_C "Conversion method for V2gTxRemainTimetoBulkSocOv_C" RAT_FUNC "%10.0" "s" COEFFS 0.000000 1.000000 -0.000000 0.000000 0.000000 1.000000 /end COMPU_METHOD
/* Scalar calibration for DDE 'V2gTxSaSchdlTupleIdOf_C'. */
/begin CHARACTERISTIC V2gTxSaSchdlTupleIdOf_C "Enables overriding Unique identifier within a charging session referring to the selected SAScheduleTuple element from the SAScheduleListType as described by J2847-2" VALUE 0x70019d8d RL_V2GTXSASCHDLTUPLEIDOF_C 1.000000 CU_V2GTXSASCHDLTUPLEIDOF_C 0.000000 1.000000 BYTE_ORDER MSB_LAST /end CHARACTERISTIC
/begin RECORD_LAYOUT RL_V2GTXSASCHDLTUPLEIDOF_C FNC_VALUES 1 UBYTE COLUMN_DIR DIRECT /end RECORD_LAYOUT
/begin COMPU_METHOD CU_V2GTXSASCHDLTUPLEIDOF_C "Conversion method for V2gTxSaSchdlTupleIdOf_C" RAT_FUNC "%10.0" "b" COEFFS 0.000000 1.000000 -0.000000 0.000000 0.000000 1.000000 /end COMPU_METHOD
/* Scalar calibration for DDE 'V2gTxSaSchdlTupleIdOv_C'. */
/begin CHARACTERISTIC V2gTxSaSchdlTupleIdOv_C "Override value for Unique identifier within a charging session referring to the selected SAScheduleTuple element from the SAScheduleListType as described by J2847-2" VALUE 0x700186ff RL_V2GTXSASCHDLTUPLEIDOV_C 255.000000 CU_V2GTXSASCHDLTUPLEIDOV_C 0.000000 255.000000 BYTE_ORDER MSB_LAST /end CHARACTERISTIC
/begin RECORD_LAYOUT RL_V2GTXSASCHDLTUPLEIDOV_C FNC_VALUES 1 UBYTE COLUMN_DIR DIRECT /end RECORD_LAYOUT
/begin COMPU_METHOD CU_V2GTXSASCHDLTUPLEIDOV_C "Conversion method for V2gTxSaSchdlTupleIdOv_C" RAT_FUNC "%10.0" "1" COEFFS 0.000000 1.000000 -0.000000 0.000000 0.000000 1.000000 /end COMPU_METHOD
/* Scalar calibration for DDE 'V2gTxServiceIdOf_C'. */
/begin CHARACTERISTIC V2gTxServiceIdOf_C "Enables overriding Unique identifier of the service as applicable to the SelectedServiceType described by J2847-2." VALUE 0x700185b6 RL_V2GTXSERVICEIDOF_C 1.000000 CU_V2GTXSERVICEIDOF_C 0.000000 1.000000 BYTE_ORDER MSB_LAST /end CHARACTERISTIC
/begin RECORD_LAYOUT RL_V2GTXSERVICEIDOF_C FNC_VALUES 1 UBYTE COLUMN_DIR DIRECT /end RECORD_LAYOUT
/begin COMPU_METHOD CU_V2GTXSERVICEIDOF_C "Conversion method for V2gTxServiceIdOf_C" RAT_FUNC "%10.0" "b" COEFFS 0.000000 1.000000 -0.000000 0.000000 0.000000 1.000000 /end COMPU_METHOD
/* Scalar calibration for DDE 'V2gTxServiceIdOv_C'. */
/begin CHARACTERISTIC V2gTxServiceIdOv_C "Override value for Unique identifier of the service as applicable to the SelectedServiceType described by J2847-2." VALUE 0x70019742 RL_V2GTXSERVICEIDOV_C 65535.000000 CU_V2GTXSERVICEIDOV_C 0.000000 65535.000000 BYTE_ORDER MSB_LAST /end CHARACTERISTIC
/begin RECORD_LAYOUT RL_V2GTXSERVICEIDOV_C FNC_VALUES 1 UWORD COLUMN_DIR DIRECT /end RECORD_LAYOUT
/begin COMPU_METHOD CU_V2GTXSERVICEIDOV_C "Conversion method for V2gTxServiceIdOv_C" RAT_FUNC "%10.0" "1" COEFFS 0.000000 1.000000 -0.000000 0.000000 0.000000 1.000000 /end COMPU_METHOD
/* Scalar calibration for DDE 'V2gTxSupSvcIdsLenOf_C'. */
/begin CHARACTERISTIC V2gTxSupSvcIdsLenOf_C "Enables overriding Number of service IDs supported by the EV" VALUE 0x700185c8 RL_V2GTXSUPSVCIDSLENOF_C 1.000000 CU_V2GTXSUPSVCIDSLENOF_C 0.000000 1.000000 BYTE_ORDER MSB_LAST /end CHARACTERISTIC
/begin RECORD_LAYOUT RL_V2GTXSUPSVCIDSLENOF_C FNC_VALUES 1 UBYTE COLUMN_DIR DIRECT /end RECORD_LAYOUT
/begin COMPU_METHOD CU_V2GTXSUPSVCIDSLENOF_C "Conversion method for V2gTxSupSvcIdsLenOf_C" RAT_FUNC "%10.0" "b" COEFFS 0.000000 1.000000 -0.000000 0.000000 0.000000 1.000000 /end COMPU_METHOD
/* Scalar calibration for DDE 'V2gTxSupSvcIdsLenOv_C'. */
/begin CHARACTERISTIC V2gTxSupSvcIdsLenOv_C "Override value for Number of service IDs supported by the EV" VALUE 0x7001976e RL_V2GTXSUPSVCIDSLENOV_C 10.000000 CU_V2GTXSUPSVCIDSLENOV_C 0.000000 10.000000 BYTE_ORDER MSB_LAST /end CHARACTERISTIC
/begin RECORD_LAYOUT RL_V2GTXSUPSVCIDSLENOV_C FNC_VALUES 1 UBYTE COLUMN_DIR DIRECT /end RECORD_LAYOUT
/begin COMPU_METHOD CU_V2GTXSUPSVCIDSLENOV_C "Conversion method for V2gTxSupSvcIdsLenOv_C" RAT_FUNC "%10.0" "1" COEFFS 0.000000 1.000000 -0.000000 0.000000 0.000000 1.000000 /end COMPU_METHOD
/* Scalar calibration for DDE 'V2gTxSupSvcIdsOf_C'. */
/begin CHARACTERISTIC V2gTxSupSvcIdsOf_C "Enables overriding List of all service IDs supported by the EV" VALUE 0x70018528 RL_V2GTXSUPSVCIDSOF_C 1.000000 CU_V2GTXSUPSVCIDSOF_C 0.000000 1.000000 BYTE_ORDER MSB_LAST /end CHARACTERISTIC
/begin RECORD_LAYOUT RL_V2GTXSUPSVCIDSOF_C FNC_VALUES 1 UBYTE COLUMN_DIR DIRECT /end RECORD_LAYOUT
/begin COMPU_METHOD CU_V2GTXSUPSVCIDSOF_C "Conversion method for V2gTxSupSvcIdsOf_C" RAT_FUNC "%10.0" "b" COEFFS 0.000000 1.000000 -0.000000 0.000000 0.000000 1.000000 /end COMPU_METHOD
/* Vector/array calibration for DDE 'V2gTxSupSvcIdsOv_C'. */
/begin CHARACTERISTIC V2gTxSupSvcIdsOv_C "Override value for List of all service IDs supported by the EV" VAL_BLK 0x700195f8 RL_V2GTXSUPSVCIDSOV_C 65535.000000 CU_V2GTXSUPSVCIDSOV_C 0.000000 65535.000000 NUMBER 10 BYTE_ORDER MSB_LAST /end CHARACTERISTIC
/begin RECORD_LAYOUT RL_V2GTXSUPSVCIDSOV_C FNC_VALUES 1 UWORD COLUMN_DIR DIRECT /end RECORD_LAYOUT
/begin COMPU_METHOD CU_V2GTXSUPSVCIDSOV_C "Conversion method for V2gTxSupSvcIdsOv_C" RAT_FUNC "%10.0" "1" COEFFS 0.000000 1.000000 -0.000000 0.000000 0.000000 1.000000 /end COMPU_METHOD
/* Scalar calibration for DDE 'V2gTxTargetSocOf_C'. */
/begin CHARACTERISTIC V2gTxTargetSocOf_C "Enables overriding State of charge desired by the EV" VALUE 0x700186fd RL_V2GTXTARGETSOCOF_C 1.000000 CU_V2GTXTARGETSOCOF_C 0.000000 1.000000 BYTE_ORDER MSB_LAST /end CHARACTERISTIC
/begin RECORD_LAYOUT RL_V2GTXTARGETSOCOF_C FNC_VALUES 1 UBYTE COLUMN_DIR DIRECT /end RECORD_LAYOUT
/begin COMPU_METHOD CU_V2GTXTARGETSOCOF_C "Conversion method for V2gTxTargetSocOf_C" RAT_FUNC "%10.0" "b" COEFFS 0.000000 1.000000 -0.000000 0.000000 0.000000 1.000000 /end COMPU_METHOD
/* Scalar calibration for DDE 'V2gTxTargetSocOv_C'. */
/begin CHARACTERISTIC V2gTxTargetSocOv_C "Override value for State of charge desired by the EV" VALUE 0x70019e48 RL_V2GTXTARGETSOCOV_C 100.000000 CU_V2GTXTARGETSOCOV_C 0.000000 100.000000 BYTE_ORDER MSB_LAST /end CHARACTERISTIC
/begin RECORD_LAYOUT RL_V2GTXTARGETSOCOV_C FNC_VALUES 1 FLOAT32_IEEE COLUMN_DIR DIRECT /end RECORD_LAYOUT
/begin COMPU_METHOD CU_V2GTXTARGETSOCOV_C "Conversion method for V2gTxTargetSocOv_C" RAT_FUNC "%10.0" "%" COEFFS 0.000000 1.000000 -0.000000 0.000000 0.000000 1.000000 /end COMPU_METHOD
/* Scalar calibration for DDE 'Vbat_FltMax_C'. */
/begin CHARACTERISTIC Vbat_FltMax_C "Vbat Max Fault Limit Cal" VALUE 0xa0108520 RL_VBAT_FLTMAX_C 40.000000 CU_VBAT_FLTMAX_C 0.000000 40.000000 BYTE_ORDER MSB_LAST /end CHARACTERISTIC
/begin RECORD_LAYOUT RL_VBAT_FLTMAX_C FNC_VALUES 1 FLOAT32_IEEE COLUMN_DIR DIRECT /end RECORD_LAYOUT
/begin COMPU_METHOD CU_VBAT_FLTMAX_C "Conversion method for Vbat_FltMax_C" RAT_FUNC "%10.3" "V" COEFFS 0.000000 1.000000 -0.000000 0.000000 0.000000 1.000000 /end COMPU_METHOD
/* Scalar calibration for DDE 'Vbat_FltMin_C'. */
/begin CHARACTERISTIC Vbat_FltMin_C "Vbat Min Fault Limit Cal" VALUE 0xa010851c RL_VBAT_FLTMIN_C 40.000000 CU_VBAT_FLTMIN_C 0.000000 40.000000 BYTE_ORDER MSB_LAST /end CHARACTERISTIC
/begin RECORD_LAYOUT RL_VBAT_FLTMIN_C FNC_VALUES 1 FLOAT32_IEEE COLUMN_DIR DIRECT /end RECORD_LAYOUT
/begin COMPU_METHOD CU_VBAT_FLTMIN_C "Conversion method for Vbat_FltMin_C" RAT_FUNC "%10.3" "V" COEFFS 0.000000 1.000000 -0.000000 0.000000 0.000000 1.000000 /end COMPU_METHOD
/* Scalar calibration for DDE 'Vbat_ScaleFactor_C'. */
/begin CHARACTERISTIC Vbat_ScaleFactor_C "Vbat Scale value (raw divided by this value to get pin voltage)" VALUE 0xa0108518 RL_VBAT_SCALEFACTOR_C 39.999000 CU_VBAT_SCALEFACTOR_C 0.001000 40.000000 BYTE_ORDER MSB_LAST /end CHARACTERISTIC
/begin RECORD_LAYOUT RL_VBAT_SCALEFACTOR_C FNC_VALUES 1 FLOAT32_IEEE COLUMN_DIR DIRECT /end RECORD_LAYOUT
/begin COMPU_METHOD CU_VBAT_SCALEFACTOR_C "Conversion method for Vbat_ScaleFactor_C" RAT_FUNC "%10.3" "(not defined)" COEFFS 0.000000 1.000000 -0.000000 0.000000 0.000000 1.000000 /end COMPU_METHOD
/* Scalar calibration for DDE 'VrefA_FltMax_C'. */
/begin CHARACTERISTIC VrefA_FltMax_C "VrefA Max Fault Limit Cal" VALUE 0xa0108514 RL_VREFA_FLTMAX_C 40.000000 CU_VREFA_FLTMAX_C 0.000000 40.000000 BYTE_ORDER MSB_LAST /end CHARACTERISTIC
/begin RECORD_LAYOUT RL_VREFA_FLTMAX_C FNC_VALUES 1 FLOAT32_IEEE COLUMN_DIR DIRECT /end RECORD_LAYOUT
/begin COMPU_METHOD CU_VREFA_FLTMAX_C "Conversion method for VrefA_FltMax_C" RAT_FUNC "%10.3" "V" COEFFS 0.000000 1.000000 -0.000000 0.000000 0.000000 1.000000 /end COMPU_METHOD
/* Scalar calibration for DDE 'VrefA_FltMin_C'. */
/begin CHARACTERISTIC VrefA_FltMin_C "VrefA Min Fault Limit Cal" VALUE 0xa0108510 RL_VREFA_FLTMIN_C 40.000000 CU_VREFA_FLTMIN_C 0.000000 40.000000 BYTE_ORDER MSB_LAST /end CHARACTERISTIC
/begin RECORD_LAYOUT RL_VREFA_FLTMIN_C FNC_VALUES 1 FLOAT32_IEEE COLUMN_DIR DIRECT /end RECORD_LAYOUT
/begin COMPU_METHOD CU_VREFA_FLTMIN_C "Conversion method for VrefA_FltMin_C" RAT_FUNC "%10.3" "V" COEFFS 0.000000 1.000000 -0.000000 0.000000 0.000000 1.000000 /end COMPU_METHOD
/* Scalar calibration for DDE 'VrefA_ScaleFactor_C'. */
/begin CHARACTERISTIC VrefA_ScaleFactor_C "VrefA Scale value (raw divided by this value to get pin voltage)" VALUE 0xa010850c RL_VREFA_SCALEFACTOR_C 39.999000 CU_VREFA_SCALEFACTOR_C 0.001000 40.000000 BYTE_ORDER MSB_LAST /end CHARACTERISTIC
/begin RECORD_LAYOUT RL_VREFA_SCALEFACTOR_C FNC_VALUES 1 FLOAT32_IEEE COLUMN_DIR DIRECT /end RECORD_LAYOUT
/begin COMPU_METHOD CU_VREFA_SCALEFACTOR_C "Conversion method for VrefA_ScaleFactor_C" RAT_FUNC "%10.3" "(not defined)" COEFFS 0.000000 1.000000 -0.000000 0.000000 0.000000 1.000000 /end COMPU_METHOD
/* Scalar calibration for DDE 'VrefB_FltMax_C'. */
/begin CHARACTERISTIC VrefB_FltMax_C "VrefB Max Fault Limit Cal" VALUE 0xa0108508 RL_VREFB_FLTMAX_C 40.000000 CU_VREFB_FLTMAX_C 0.000000 40.000000 BYTE_ORDER MSB_LAST /end CHARACTERISTIC
/begin RECORD_LAYOUT RL_VREFB_FLTMAX_C FNC_VALUES 1 FLOAT32_IEEE COLUMN_DIR DIRECT /end RECORD_LAYOUT
/begin COMPU_METHOD CU_VREFB_FLTMAX_C "Conversion method for VrefB_FltMax_C" RAT_FUNC "%10.3" "V" COEFFS 0.000000 1.000000 -0.000000 0.000000 0.000000 1.000000 /end COMPU_METHOD
/* Scalar calibration for DDE 'VrefB_FltMin_C'. */
/begin CHARACTERISTIC VrefB_FltMin_C "VrefB Min Fault Limit Cal" VALUE 0xa0108504 RL_VREFB_FLTMIN_C 40.000000 CU_VREFB_FLTMIN_C 0.000000 40.000000 BYTE_ORDER MSB_LAST /end CHARACTERISTIC
/begin RECORD_LAYOUT RL_VREFB_FLTMIN_C FNC_VALUES 1 FLOAT32_IEEE COLUMN_DIR DIRECT /end RECORD_LAYOUT
/begin COMPU_METHOD CU_VREFB_FLTMIN_C "Conversion method for VrefB_FltMin_C" RAT_FUNC "%10.3" "V" COEFFS 0.000000 1.000000 -0.000000 0.000000 0.000000 1.000000 /end COMPU_METHOD
/* Scalar calibration for DDE 'VrefB_ScaleFactor_C'. */
/begin CHARACTERISTIC VrefB_ScaleFactor_C "VrefB Scale value (raw divided by this value to get pin voltage)" VALUE 0xa0108500 RL_VREFB_SCALEFACTOR_C 39.999000 CU_VREFB_SCALEFACTOR_C 0.001000 40.000000 BYTE_ORDER MSB_LAST /end CHARACTERISTIC
/begin RECORD_LAYOUT RL_VREFB_SCALEFACTOR_C FNC_VALUES 1 FLOAT32_IEEE COLUMN_DIR DIRECT /end RECORD_LAYOUT
/begin COMPU_METHOD CU_VREFB_SCALEFACTOR_C "Conversion method for VrefB_ScaleFactor_C" RAT_FUNC "%10.3" "(not defined)" COEFFS 0.000000 1.000000 -0.000000 0.000000 0.000000 1.000000 /end COMPU_METHOD
/* Scalar calibration for DDE 'ainc_an15_vtempa_a_max'. */
/begin CHARACTERISTIC ainc_an15_vtempa_a_max "Thermistor sensor A un-scaled filtered maximum voltage (CCU pin B2)" VALUE 0xa01084fc RL_AINC_AN15_VTEMPA_A_MAX 50.000000 CU_AINC_AN15_VTEMPA_A_MAX 0.000000 50.000000 BYTE_ORDER MSB_LAST /end CHARACTERISTIC
/begin RECORD_LAYOUT RL_AINC_AN15_VTEMPA_A_MAX FNC_VALUES 1 FLOAT32_IEEE COLUMN_DIR DIRECT /end RECORD_LAYOUT
/begin COMPU_METHOD CU_AINC_AN15_VTEMPA_A_MAX "Conversion method for ainc_an15_vtempa_a_max" RAT_FUNC "%10.2" "V" COEFFS 0.000000 1.000000 -0.000000 0.000000 0.000000 1.000000 /end COMPU_METHOD
/* Scalar calibration for DDE 'ainc_an15_vtempa_a_min'. */
/begin CHARACTERISTIC ainc_an15_vtempa_a_min "Thermistor sensor A un-scaled filtered minimum voltage (CCU pin B2)" VALUE 0xa01084f8 RL_AINC_AN15_VTEMPA_A_MIN 50.000000 CU_AINC_AN15_VTEMPA_A_MIN 0.000000 50.000000 BYTE_ORDER MSB_LAST /end CHARACTERISTIC
/begin RECORD_LAYOUT RL_AINC_AN15_VTEMPA_A_MIN FNC_VALUES 1 FLOAT32_IEEE COLUMN_DIR DIRECT /end RECORD_LAYOUT
/begin COMPU_METHOD CU_AINC_AN15_VTEMPA_A_MIN "Conversion method for ainc_an15_vtempa_a_min" RAT_FUNC "%10.2" "V" COEFFS 0.000000 1.000000 -0.000000 0.000000 0.000000 1.000000 /end COMPU_METHOD
/* Scalar calibration for DDE 'ainc_an17_vtempb_a_max'. */
/begin CHARACTERISTIC ainc_an17_vtempb_a_max "Thermistor sensor B un-scaled filtered maximum voltage (CCU pin B3)" VALUE 0xa01084f4 RL_AINC_AN17_VTEMPB_A_MAX 50.000000 CU_AINC_AN17_VTEMPB_A_MAX 0.000000 50.000000 BYTE_ORDER MSB_LAST /end CHARACTERISTIC
/begin RECORD_LAYOUT RL_AINC_AN17_VTEMPB_A_MAX FNC_VALUES 1 FLOAT32_IEEE COLUMN_DIR DIRECT /end RECORD_LAYOUT
/begin COMPU_METHOD CU_AINC_AN17_VTEMPB_A_MAX "Conversion method for ainc_an17_vtempb_a_max" RAT_FUNC "%10.2" "V" COEFFS 0.000000 1.000000 -0.000000 0.000000 0.000000 1.000000 /end COMPU_METHOD
/* Scalar calibration for DDE 'ainc_an17_vtempb_a_min'. */
/begin CHARACTERISTIC ainc_an17_vtempb_a_min "Thermistor sensor B un-scaled filtered minimum voltage (CCU pin B3)" VALUE 0xa01084f0 RL_AINC_AN17_VTEMPB_A_MIN 50.000000 CU_AINC_AN17_VTEMPB_A_MIN 0.000000 50.000000 BYTE_ORDER MSB_LAST /end CHARACTERISTIC
/begin RECORD_LAYOUT RL_AINC_AN17_VTEMPB_A_MIN FNC_VALUES 1 FLOAT32_IEEE COLUMN_DIR DIRECT /end RECORD_LAYOUT
/begin COMPU_METHOD CU_AINC_AN17_VTEMPB_A_MIN "Conversion method for ainc_an17_vtempb_a_min" RAT_FUNC "%10.2" "V" COEFFS 0.000000 1.000000 -0.000000 0.000000 0.000000 1.000000 /end COMPU_METHOD
/* Scalar calibration for DDE 'dotc_DsblPowerHold'. */
/begin CHARACTERISTIC dotc_DsblPowerHold "Requests that the power supply shuts down.  This should probably not be set if any of the other wake sources are present" VALUE 0xa01084ec RL_DOTC_DSBLPOWERHOLD 1.000000 CU_DOTC_DSBLPOWERHOLD 0.000000 1.000000 BYTE_ORDER MSB_LAST /end CHARACTERISTIC
/begin RECORD_LAYOUT RL_DOTC_DSBLPOWERHOLD FNC_VALUES 1 UBYTE COLUMN_DIR DIRECT /end RECORD_LAYOUT
/begin COMPU_METHOD CU_DOTC_DSBLPOWERHOLD "Conversion method for dotc_DsblPowerHold" RAT_FUNC "%10.0" "(not defined)" COEFFS 0.000000 1.000000 -0.000000 0.000000 0.000000 1.000000 /end COMPU_METHOD
/* Scalar calibration for DDE 'dotc_Enbl_OverrideCanawake'. */
/begin CHARACTERISTIC dotc_Enbl_OverrideCanawake "Override enable for CANAWAKE signal" VALUE 0xa01084eb RL_DOTC_ENBL_OVERRIDECANAWAKE 1.000000 CU_DOTC_ENBL_OVERRIDECANAWAKE 0.000000 1.000000 BYTE_ORDER MSB_LAST /end CHARACTERISTIC
/begin RECORD_LAYOUT RL_DOTC_ENBL_OVERRIDECANAWAKE FNC_VALUES 1 UBYTE COLUMN_DIR DIRECT /end RECORD_LAYOUT
/begin COMPU_METHOD CU_DOTC_ENBL_OVERRIDECANAWAKE "Conversion method for dotc_Enbl_OverrideCanawake" RAT_FUNC "%10.0" "(not defined)" COEFFS 0.000000 1.000000 -0.000000 0.000000 0.000000 1.000000 /end COMPU_METHOD
/* Scalar calibration for DDE 'dotc_Enbl_OverrideDsblPwrHld'. */
/begin CHARACTERISTIC dotc_Enbl_OverrideDsblPwrHld "Override enable for Disable Power Hold signal" VALUE 0xa01084ea RL_DOTC_ENBL_OVERRIDEDSBLPWRHLD 1.000000 CU_DOTC_ENBL_OVERRIDEDSBLPWRHLD 0.000000 1.000000 BYTE_ORDER MSB_LAST /end CHARACTERISTIC
/begin RECORD_LAYOUT RL_DOTC_ENBL_OVERRIDEDSBLPWRHLD FNC_VALUES 1 UBYTE COLUMN_DIR DIRECT /end RECORD_LAYOUT
/begin COMPU_METHOD CU_DOTC_ENBL_OVERRIDEDSBLPWRHLD "Conversion method for dotc_Enbl_OverrideDsblPwrHld" RAT_FUNC "%10.0" "(not defined)" COEFFS 0.000000 1.000000 -0.000000 0.000000 0.000000 1.000000 /end COMPU_METHOD
/* Scalar calibration for DDE 'dotc_Enbl_OverrideShutdown'. */
/begin CHARACTERISTIC dotc_Enbl_OverrideShutdown "Override for shutdowdn signal" VALUE 0xa01084e9 RL_DOTC_ENBL_OVERRIDESHUTDOWN 1.000000 CU_DOTC_ENBL_OVERRIDESHUTDOWN 0.000000 1.000000 BYTE_ORDER MSB_LAST /end CHARACTERISTIC
/begin RECORD_LAYOUT RL_DOTC_ENBL_OVERRIDESHUTDOWN FNC_VALUES 1 UBYTE COLUMN_DIR DIRECT /end RECORD_LAYOUT
/begin COMPU_METHOD CU_DOTC_ENBL_OVERRIDESHUTDOWN "Conversion method for dotc_Enbl_OverrideShutdown" RAT_FUNC "%10.0" "(not defined)" COEFFS 0.000000 1.000000 -0.000000 0.000000 0.000000 1.000000 /end COMPU_METHOD
/* Scalar calibration for DDE 'dotc_Enbl_OverrideTlt9255'. */
/begin CHARACTERISTIC dotc_Enbl_OverrideTlt9255 "Override enbable for TLT9255 shutdown request" VALUE 0xa01084e8 RL_DOTC_ENBL_OVERRIDETLT9255 1.000000 CU_DOTC_ENBL_OVERRIDETLT9255 0.000000 1.000000 BYTE_ORDER MSB_LAST /end CHARACTERISTIC
/begin RECORD_LAYOUT RL_DOTC_ENBL_OVERRIDETLT9255 FNC_VALUES 1 UBYTE COLUMN_DIR DIRECT /end RECORD_LAYOUT
/begin COMPU_METHOD CU_DOTC_ENBL_OVERRIDETLT9255 "Conversion method for dotc_Enbl_OverrideTlt9255" RAT_FUNC "%10.0" "(not defined)" COEFFS 0.000000 1.000000 -0.000000 0.000000 0.000000 1.000000 /end COMPU_METHOD
/* Scalar calibration for DDE 'dotc_Enbl_OverrideVpkClr'. */
/begin CHARACTERISTIC dotc_Enbl_OverrideVpkClr "Override enable for pilot peak reset" VALUE 0xa01084e7 RL_DOTC_ENBL_OVERRIDEVPKCLR 1.000000 CU_DOTC_ENBL_OVERRIDEVPKCLR 0.000000 1.000000 BYTE_ORDER MSB_LAST /end CHARACTERISTIC
/begin RECORD_LAYOUT RL_DOTC_ENBL_OVERRIDEVPKCLR FNC_VALUES 1 UBYTE COLUMN_DIR DIRECT /end RECORD_LAYOUT
/begin COMPU_METHOD CU_DOTC_ENBL_OVERRIDEVPKCLR "Conversion method for dotc_Enbl_OverrideVpkClr" RAT_FUNC "%10.0" "(not defined)" COEFFS 0.000000 1.000000 -0.000000 0.000000 0.000000 1.000000 /end COMPU_METHOD
/* Scalar calibration for DDE 'dotc_OverrideVpilpeakClear'. */
/begin CHARACTERISTIC dotc_OverrideVpilpeakClear "Internal override for pilot peak reset" VALUE 0xa01084e6 RL_DOTC_OVERRIDEVPILPEAKCLEAR 1.000000 CU_DOTC_OVERRIDEVPILPEAKCLEAR 0.000000 1.000000 BYTE_ORDER MSB_LAST /end CHARACTERISTIC
/begin RECORD_LAYOUT RL_DOTC_OVERRIDEVPILPEAKCLEAR FNC_VALUES 1 UBYTE COLUMN_DIR DIRECT /end RECORD_LAYOUT
/begin COMPU_METHOD CU_DOTC_OVERRIDEVPILPEAKCLEAR "Conversion method for dotc_OverrideVpilpeakClear" RAT_FUNC "%10.0" "(not defined)" COEFFS 0.000000 1.000000 -0.000000 0.000000 0.000000 1.000000 /end COMPU_METHOD
/* Scalar calibration for DDE 'dotc_PowerHold'. */
/begin CHARACTERISTIC dotc_PowerHold "Internal software power hold signal" VALUE 0xa01084e5 RL_DOTC_POWERHOLD 1.000000 CU_DOTC_POWERHOLD 0.000000 1.000000 BYTE_ORDER MSB_LAST /end CHARACTERISTIC
/begin RECORD_LAYOUT RL_DOTC_POWERHOLD FNC_VALUES 1 UBYTE COLUMN_DIR DIRECT /end RECORD_LAYOUT
/begin COMPU_METHOD CU_DOTC_POWERHOLD "Conversion method for dotc_PowerHold" RAT_FUNC "%10.0" "(not defined)" COEFFS 0.000000 1.000000 -0.000000 0.000000 0.000000 1.000000 /end COMPU_METHOD
/* Scalar calibration for DDE 'dotc_ShutdownSignal'. */
/begin CHARACTERISTIC dotc_ShutdownSignal "Shutdown Signal to force TLT9255 and Disable Power Hold low." VALUE 0xa01084e4 RL_DOTC_SHUTDOWNSIGNAL 1.000000 CU_DOTC_SHUTDOWNSIGNAL 0.000000 1.000000 BYTE_ORDER MSB_LAST /end CHARACTERISTIC
/begin RECORD_LAYOUT RL_DOTC_SHUTDOWNSIGNAL FNC_VALUES 1 UBYTE COLUMN_DIR DIRECT /end RECORD_LAYOUT
/begin COMPU_METHOD CU_DOTC_SHUTDOWNSIGNAL "Conversion method for dotc_ShutdownSignal" RAT_FUNC "%10.0" "(not defined)" COEFFS 0.000000 1.000000 -0.000000 0.000000 0.000000 1.000000 /end COMPU_METHOD
/* Scalar calibration for DDE 'dotc_leda_dcycle'. */
/begin CHARACTERISTIC dotc_leda_dcycle "LED A dutycycle proportion (CCU pin F2)" VALUE 0xa01084e0 RL_DOTC_LEDA_DCYCLE 1.000000 CU_DOTC_LEDA_DCYCLE 0.000000 1.000000 BYTE_ORDER MSB_LAST /end CHARACTERISTIC
/begin RECORD_LAYOUT RL_DOTC_LEDA_DCYCLE FNC_VALUES 1 FLOAT32_IEEE COLUMN_DIR DIRECT /end RECORD_LAYOUT
/begin COMPU_METHOD CU_DOTC_LEDA_DCYCLE "Conversion method for dotc_leda_dcycle" RAT_FUNC "%10.0" "proportional" COEFFS 0.000000 1.000000 -0.000000 0.000000 0.000000 1.000000 /end COMPU_METHOD
/* Scalar calibration for DDE 'dotc_leda_freq'. */
/begin CHARACTERISTIC dotc_leda_freq "LED A frequency (CCU pin F2)" VALUE 0xa01084dc RL_DOTC_LEDA_FREQ 9999.500000 CU_DOTC_LEDA_FREQ 0.500000 10000.000000 BYTE_ORDER MSB_LAST /end CHARACTERISTIC
/begin RECORD_LAYOUT RL_DOTC_LEDA_FREQ FNC_VALUES 1 FLOAT32_IEEE COLUMN_DIR DIRECT /end RECORD_LAYOUT
/begin COMPU_METHOD CU_DOTC_LEDA_FREQ "Conversion method for dotc_leda_freq" RAT_FUNC "%10.1" "Hz" COEFFS 0.000000 1.000000 -0.000000 0.000000 0.000000 1.000000 /end COMPU_METHOD
/* Scalar calibration for DDE 'dotc_ledb_dcycle'. */
/begin CHARACTERISTIC dotc_ledb_dcycle "LED B dutycycle proportion (CCU pin F3)" VALUE 0xa01084d8 RL_DOTC_LEDB_DCYCLE 1.000000 CU_DOTC_LEDB_DCYCLE 0.000000 1.000000 BYTE_ORDER MSB_LAST /end CHARACTERISTIC
/begin RECORD_LAYOUT RL_DOTC_LEDB_DCYCLE FNC_VALUES 1 FLOAT32_IEEE COLUMN_DIR DIRECT /end RECORD_LAYOUT
/begin COMPU_METHOD CU_DOTC_LEDB_DCYCLE "Conversion method for dotc_ledb_dcycle" RAT_FUNC "%10.0" "proportion" COEFFS 0.000000 1.000000 -0.000000 0.000000 0.000000 1.000000 /end COMPU_METHOD
/* Scalar calibration for DDE 'dotc_ledb_freq'. */
/begin CHARACTERISTIC dotc_ledb_freq "LED B frequency (CCU pin F3)" VALUE 0xa01084d4 RL_DOTC_LEDB_FREQ 9999.500000 CU_DOTC_LEDB_FREQ 0.500000 10000.000000 BYTE_ORDER MSB_LAST /end CHARACTERISTIC
/begin RECORD_LAYOUT RL_DOTC_LEDB_FREQ FNC_VALUES 1 FLOAT32_IEEE COLUMN_DIR DIRECT /end RECORD_LAYOUT
/begin COMPU_METHOD CU_DOTC_LEDB_FREQ "Conversion method for dotc_ledb_freq" RAT_FUNC "%10.1" "Hz" COEFFS 0.000000 1.000000 -0.000000 0.000000 0.000000 1.000000 /end COMPU_METHOD
/* Scalar calibration for DDE 'dotc_ledc_dcycle'. */
/begin CHARACTERISTIC dotc_ledc_dcycle "LED C dutycycle proportion (CCU pin F4)" VALUE 0xa01084d0 RL_DOTC_LEDC_DCYCLE 1.000000 CU_DOTC_LEDC_DCYCLE 0.000000 1.000000 BYTE_ORDER MSB_LAST /end CHARACTERISTIC
/begin RECORD_LAYOUT RL_DOTC_LEDC_DCYCLE FNC_VALUES 1 FLOAT32_IEEE COLUMN_DIR DIRECT /end RECORD_LAYOUT
/begin COMPU_METHOD CU_DOTC_LEDC_DCYCLE "Conversion method for dotc_ledc_dcycle" RAT_FUNC "%10.0" "(not defined)" COEFFS 0.000000 1.000000 -0.000000 0.000000 0.000000 1.000000 /end COMPU_METHOD
/* Scalar calibration for DDE 'dotc_ledc_freq'. */
/begin CHARACTERISTIC dotc_ledc_freq "LED C frequency (CCU pin F4)" VALUE 0xa01084cc RL_DOTC_LEDC_FREQ 9999.500000 CU_DOTC_LEDC_FREQ 0.500000 10000.000000 BYTE_ORDER MSB_LAST /end CHARACTERISTIC
/begin RECORD_LAYOUT RL_DOTC_LEDC_FREQ FNC_VALUES 1 FLOAT32_IEEE COLUMN_DIR DIRECT /end RECORD_LAYOUT
/begin COMPU_METHOD CU_DOTC_LEDC_FREQ "Conversion method for dotc_ledc_freq" RAT_FUNC "%10.1" "Hz" COEFFS 0.000000 1.000000 -0.000000 0.000000 0.000000 1.000000 /end COMPU_METHOD
/* Scalar calibration for DDE 'dotc_p00_6_canawake'. */
/begin CHARACTERISTIC dotc_p00_6_canawake "CANAWAKE state" VALUE 0xa01084c8 RL_DOTC_P00_6_CANAWAKE 1.000000 CU_DOTC_P00_6_CANAWAKE 0.000000 1.000000 BYTE_ORDER MSB_LAST /end CHARACTERISTIC
/begin RECORD_LAYOUT RL_DOTC_P00_6_CANAWAKE FNC_VALUES 1 UBYTE COLUMN_DIR DIRECT /end RECORD_LAYOUT
/begin COMPU_METHOD CU_DOTC_P00_6_CANAWAKE "Conversion method for dotc_p00_6_canawake" RAT_FUNC "%10.0" "(not defined)" COEFFS 0.000000 1.000000 -0.000000 0.000000 0.000000 1.000000 /end COMPU_METHOD
/* Scalar calibration for DDE 'dotc_p11_1_pilots2'. */
/begin CHARACTERISTIC dotc_p11_1_pilots2 "PILOTS2 state (CCCU pin A3)" VALUE 0xa01084c7 RL_DOTC_P11_1_PILOTS2 1.000000 CU_DOTC_P11_1_PILOTS2 0.000000 1.000000 BYTE_ORDER MSB_LAST /end CHARACTERISTIC
/begin RECORD_LAYOUT RL_DOTC_P11_1_PILOTS2 FNC_VALUES 1 UBYTE COLUMN_DIR DIRECT /end RECORD_LAYOUT
/begin COMPU_METHOD CU_DOTC_P11_1_PILOTS2 "Conversion method for dotc_p11_1_pilots2" RAT_FUNC "%10.0" "(not defined)" COEFFS 0.000000 1.000000 -0.000000 0.000000 0.000000 1.000000 /end COMPU_METHOD
/* Scalar calibration for DDE 'dotc_p11_9_hpenab'. */
/begin CHARACTERISTIC dotc_p11_9_hpenab "HPENAB state (CCU pin A3)" VALUE 0xa01084c6 RL_DOTC_P11_9_HPENAB 1.000000 CU_DOTC_P11_9_HPENAB 0.000000 1.000000 BYTE_ORDER MSB_LAST /end CHARACTERISTIC
/begin RECORD_LAYOUT RL_DOTC_P11_9_HPENAB FNC_VALUES 1 UBYTE COLUMN_DIR DIRECT /end RECORD_LAYOUT
/begin COMPU_METHOD CU_DOTC_P11_9_HPENAB "Conversion method for dotc_p11_9_hpenab" RAT_FUNC "%10.0" "(not defined)" COEFFS 0.000000 1.000000 -0.000000 0.000000 0.000000 1.000000 /end COMPU_METHOD
/* Scalar calibration for DDE 'dotc_p22_1_qbootsel'. */
/begin CHARACTERISTIC dotc_p22_1_qbootsel "QBOOTSEL state" VALUE 0xa01084c5 RL_DOTC_P22_1_QBOOTSEL 1.000000 CU_DOTC_P22_1_QBOOTSEL 0.000000 1.000000 BYTE_ORDER MSB_LAST /end CHARACTERISTIC
/begin RECORD_LAYOUT RL_DOTC_P22_1_QBOOTSEL FNC_VALUES 1 UBYTE COLUMN_DIR DIRECT /end RECORD_LAYOUT
/begin COMPU_METHOD CU_DOTC_P22_1_QBOOTSEL "Conversion method for dotc_p22_1_qbootsel" RAT_FUNC "%10.0" "(not defined)" COEFFS 0.000000 1.000000 -0.000000 0.000000 0.000000 1.000000 /end COMPU_METHOD
/* Scalar calibration for DDE 'dotc_p22_2_qspisel'. */
/begin CHARACTERISTIC dotc_p22_2_qspisel "QSPISEL state" VALUE 0xa01084c4 RL_DOTC_P22_2_QSPISEL 1.000000 CU_DOTC_P22_2_QSPISEL 0.000000 1.000000 BYTE_ORDER MSB_LAST /end CHARACTERISTIC
/begin RECORD_LAYOUT RL_DOTC_P22_2_QSPISEL FNC_VALUES 1 UBYTE COLUMN_DIR DIRECT /end RECORD_LAYOUT
/begin COMPU_METHOD CU_DOTC_P22_2_QSPISEL "Conversion method for dotc_p22_2_qspisel" RAT_FUNC "%10.0" "(not defined)" COEFFS 0.000000 1.000000 -0.000000 0.000000 0.000000 1.000000 /end COMPU_METHOD
/* Scalar calibration for DDE 'dotc_p33_2_pilwkclr'. */
/begin CHARACTERISTIC dotc_p33_2_pilwkclr "PILWCLR state(CCCU pin A3)" VALUE 0xa01084c3 RL_DOTC_P33_2_PILWKCLR 1.000000 CU_DOTC_P33_2_PILWKCLR 0.000000 1.000000 BYTE_ORDER MSB_LAST /end CHARACTERISTIC
/begin RECORD_LAYOUT RL_DOTC_P33_2_PILWKCLR FNC_VALUES 1 UBYTE COLUMN_DIR DIRECT /end RECORD_LAYOUT
/begin COMPU_METHOD CU_DOTC_P33_2_PILWKCLR "Conversion method for dotc_p33_2_pilwkclr" RAT_FUNC "%10.0" "(not defined)" COEFFS 0.000000 1.000000 -0.000000 0.000000 0.000000 1.000000 /end COMPU_METHOD
/* Scalar calibration for DDE 'dotc_p33_3_pilwkdis'. */
/begin CHARACTERISTIC dotc_p33_3_pilwkdis "PILWDIS state(CCCU pin A3)" VALUE 0xa01084c2 RL_DOTC_P33_3_PILWKDIS 1.000000 CU_DOTC_P33_3_PILWKDIS 0.000000 1.000000 BYTE_ORDER MSB_LAST /end CHARACTERISTIC
/begin RECORD_LAYOUT RL_DOTC_P33_3_PILWKDIS FNC_VALUES 1 UBYTE COLUMN_DIR DIRECT /end RECORD_LAYOUT
/begin COMPU_METHOD CU_DOTC_P33_3_PILWKDIS "Conversion method for dotc_p33_3_pilwkdis" RAT_FUNC "%10.0" "(not defined)" COEFFS 0.000000 1.000000 -0.000000 0.000000 0.000000 1.000000 /end COMPU_METHOD
/* Scalar calibration for DDE 'dotc_qca_enable'. */
/begin CHARACTERISTIC dotc_qca_enable "QCA ENable internal (use in place of dotc_p11_9_hpenab)" VALUE 0xa01084c1 RL_DOTC_QCA_ENABLE 1.000000 CU_DOTC_QCA_ENABLE 0.000000 1.000000 BYTE_ORDER MSB_LAST /end CHARACTERISTIC
/begin RECORD_LAYOUT RL_DOTC_QCA_ENABLE FNC_VALUES 1 UBYTE COLUMN_DIR DIRECT /end RECORD_LAYOUT
/begin COMPU_METHOD CU_DOTC_QCA_ENABLE "Conversion method for dotc_qca_enable" RAT_FUNC "%10.0" "(not defined)" COEFFS 0.000000 1.000000 -0.000000 0.000000 0.000000 1.000000 /end COMPU_METHOD
/* Scalar calibration for DDE 'dotc_tlt9255_SleepRequest'. */
/begin CHARACTERISTIC dotc_tlt9255_SleepRequest "Internal TLT9255 sleep request. This updates the CAN transceiver configuration with the current wake configuration, then gently asks it to go to sleep" VALUE 0xa01084c0 RL_DOTC_TLT9255_SLEEPREQUEST 1.000000 CU_DOTC_TLT9255_SLEEPREQUEST 0.000000 1.000000 BYTE_ORDER MSB_LAST /end CHARACTERISTIC
/begin RECORD_LAYOUT RL_DOTC_TLT9255_SLEEPREQUEST FNC_VALUES 1 UBYTE COLUMN_DIR DIRECT /end RECORD_LAYOUT
/begin COMPU_METHOD CU_DOTC_TLT9255_SLEEPREQUEST "Conversion method for dotc_tlt9255_SleepRequest" RAT_FUNC "%10.0" "(not defined)" COEFFS 0.000000 1.000000 -0.000000 0.000000 0.000000 1.000000 /end COMPU_METHOD
/* Scalar calibration for DDE 'genc_IgnitionEnableThreshold'. */
/begin CHARACTERISTIC genc_IgnitionEnableThreshold "Threshold for ignition to keep the ECU from trying to shutdown" VALUE 0xa01084bc RL_GENC_IGNITIONENABLETHRESHOLD 100.000000 CU_GENC_IGNITIONENABLETHRESHOLD 0.000000 100.000000 BYTE_ORDER MSB_LAST /end CHARACTERISTIC
/begin RECORD_LAYOUT RL_GENC_IGNITIONENABLETHRESHOLD FNC_VALUES 1 FLOAT32_IEEE COLUMN_DIR DIRECT /end RECORD_LAYOUT
/begin COMPU_METHOD CU_GENC_IGNITIONENABLETHRESHOLD "Conversion method for genc_IgnitionEnableThreshold" RAT_FUNC "%10.2" "V" COEFFS 0.000000 1.000000 -0.000000 0.000000 0.000000 1.000000 /end COMPU_METHOD
/* Scalar calibration for DDE 'genc_ShutdownDelay'. */
/begin CHARACTERISTIC genc_ShutdownDelay "Delay time for shutdown" VALUE 0xa01084b8 RL_GENC_SHUTDOWNDELAY 10.000000 CU_GENC_SHUTDOWNDELAY 0.000000 10.000000 BYTE_ORDER MSB_LAST /end CHARACTERISTIC
/begin RECORD_LAYOUT RL_GENC_SHUTDOWNDELAY FNC_VALUES 1 FLOAT32_IEEE COLUMN_DIR DIRECT /end RECORD_LAYOUT
/begin COMPU_METHOD CU_GENC_SHUTDOWNDELAY "Conversion method for genc_ShutdownDelay" RAT_FUNC "%10.3" "s" COEFFS 0.000000 1.000000 -0.000000 0.000000 0.000000 1.000000 /end COMPU_METHOD
/* Scalar calibration for DDE 'genc_VBatShutdownThreshold'. */
/begin CHARACTERISTIC genc_VBatShutdownThreshold "(not defined)" VALUE 0xa01084b4 RL_GENC_VBATSHUTDOWNTHRESHOLD 680564693277057719623408366969033850880.000000 CU_GENC_VBATSHUTDOWNTHRESHOLD -340282346638528859811704183484516925440.000000 340282346638528859811704183484516925440.000000 BYTE_ORDER MSB_LAST /end CHARACTERISTIC
/begin RECORD_LAYOUT RL_GENC_VBATSHUTDOWNTHRESHOLD FNC_VALUES 1 FLOAT32_IEEE COLUMN_DIR DIRECT /end RECORD_LAYOUT
/begin COMPU_METHOD CU_GENC_VBATSHUTDOWNTHRESHOLD "Conversion method for genc_VBatShutdownThreshold" RAT_FUNC "%10.3" "(not defined)" COEFFS 0.000000 1.000000 -0.000000 0.000000 0.000000 1.000000 /end COMPU_METHOD
/* Scalar calibration for DDE 'ihbr_FltMax_C'. */
/begin CHARACTERISTIC ihbr_FltMax_C "M3/M2 Hbr imon Max Fault Limit Cal" VALUE 0xa01084b0 RL_IHBR_FLTMAX_C 10.000000 CU_IHBR_FLTMAX_C 0.000000 10.000000 BYTE_ORDER MSB_LAST /end CHARACTERISTIC
/begin RECORD_LAYOUT RL_IHBR_FLTMAX_C FNC_VALUES 1 FLOAT32_IEEE COLUMN_DIR DIRECT /end RECORD_LAYOUT
/begin COMPU_METHOD CU_IHBR_FLTMAX_C "Conversion method for ihbr_FltMax_C" RAT_FUNC "%10.3" "A" COEFFS 0.000000 1.000000 -0.000000 0.000000 0.000000 1.000000 /end COMPU_METHOD
/* Scalar calibration for DDE 'ihbr_FltMin_C'. */
/begin CHARACTERISTIC ihbr_FltMin_C "M3/M2 Hbr imon Min Fault Limit Cal" VALUE 0xa01084ac RL_IHBR_FLTMIN_C 10.000000 CU_IHBR_FLTMIN_C 0.000000 10.000000 BYTE_ORDER MSB_LAST /end CHARACTERISTIC
/begin RECORD_LAYOUT RL_IHBR_FLTMIN_C FNC_VALUES 1 FLOAT32_IEEE COLUMN_DIR DIRECT /end RECORD_LAYOUT
/begin COMPU_METHOD CU_IHBR_FLTMIN_C "Conversion method for ihbr_FltMin_C" RAT_FUNC "%10.3" "A" COEFFS 0.000000 1.000000 -0.000000 0.000000 0.000000 1.000000 /end COMPU_METHOD
/* Scalar calibration for DDE 'ihbr_ScaleFactor_C'. */
/begin CHARACTERISTIC ihbr_ScaleFactor_C "M3/M2 Hbr imon Scale value (raw divided by this value to get pin voltage)" VALUE 0xa01084a8 RL_IHBR_SCALEFACTOR_C 39.999000 CU_IHBR_SCALEFACTOR_C 0.001000 40.000000 BYTE_ORDER MSB_LAST /end CHARACTERISTIC
/begin RECORD_LAYOUT RL_IHBR_SCALEFACTOR_C FNC_VALUES 1 FLOAT32_IEEE COLUMN_DIR DIRECT /end RECORD_LAYOUT
/begin COMPU_METHOD CU_IHBR_SCALEFACTOR_C "Conversion method for ihbr_ScaleFactor_C" RAT_FUNC "%10.3" "(not defined)" COEFFS 0.000000 1.000000 -0.000000 0.000000 0.000000 1.000000 /end COMPU_METHOD
/* Scalar calibration for DDE 'isoc_emissions_report_min_sev'. */
/begin CHARACTERISTIC isoc_emissions_report_min_sev "Emissions severity report status" VALUE 0xa0108694 RL_ISOC_EMISSIONS_REPORT_MIN_S0 5.000000 CU_ISOC_EMISSIONS_REPORT_MIN_S0 0.000000 5.000000 BYTE_ORDER MSB_LAST /end CHARACTERISTIC
/begin RECORD_LAYOUT RL_ISOC_EMISSIONS_REPORT_MIN_S0 FNC_VALUES 1 UBYTE COLUMN_DIR DIRECT /end RECORD_LAYOUT
/begin COMPU_METHOD CU_ISOC_EMISSIONS_REPORT_MIN_S0 "Conversion method for isoc_emissions_report_min_sev" RAT_FUNC "%10.0" "n/a" COEFFS 0.000000 1.000000 -0.000000 0.000000 0.000000 1.000000 /end COMPU_METHOD
/* Scalar calibration for DDE 'isoc_override_service_03'. */
/begin CHARACTERISTIC isoc_override_service_03 "J1979 calibration to override service $03 response.  Set this to 1 to add Previously Active DTCs to the message" VALUE 0xa010868f RL_ISOC_OVERRIDE_SERVICE_03 1.000000 CU_ISOC_OVERRIDE_SERVICE_03 0.000000 1.000000 BYTE_ORDER MSB_LAST /end CHARACTERISTIC
/begin RECORD_LAYOUT RL_ISOC_OVERRIDE_SERVICE_03 FNC_VALUES 1 UBYTE COLUMN_DIR DIRECT /end RECORD_LAYOUT
/begin COMPU_METHOD CU_ISOC_OVERRIDE_SERVICE_03 "Conversion method for isoc_override_service_03" RAT_FUNC "%10.0" "n/a" COEFFS 0.000000 1.000000 -0.000000 0.000000 0.000000 1.000000 /end COMPU_METHOD
/* Scalar calibration for DDE 'isoc_override_service_07'. */
/begin CHARACTERISTIC isoc_override_service_07 "J1979 calibration to override service $07 response.  Set this to 1 to add Active DTCs to the message" VALUE 0xa010868e RL_ISOC_OVERRIDE_SERVICE_07 1.000000 CU_ISOC_OVERRIDE_SERVICE_07 0.000000 1.000000 BYTE_ORDER MSB_LAST /end CHARACTERISTIC
/begin RECORD_LAYOUT RL_ISOC_OVERRIDE_SERVICE_07 FNC_VALUES 1 UBYTE COLUMN_DIR DIRECT /end RECORD_LAYOUT
/begin COMPU_METHOD CU_ISOC_OVERRIDE_SERVICE_07 "Conversion method for isoc_override_service_07" RAT_FUNC "%10.0" "n/a" COEFFS 0.000000 1.000000 -0.000000 0.000000 0.000000 1.000000 /end COMPU_METHOD
/* Scalar calibration for DDE 'isoc_override_service_0a'. */
/begin CHARACTERISTIC isoc_override_service_0a "J1979 calibration to override service $0A response.  Set this to 1 to add Previously Active DTCs to the message" VALUE 0xa010868d RL_ISOC_OVERRIDE_SERVICE_0A 1.000000 CU_ISOC_OVERRIDE_SERVICE_0A 0.000000 1.000000 BYTE_ORDER MSB_LAST /end CHARACTERISTIC
/begin RECORD_LAYOUT RL_ISOC_OVERRIDE_SERVICE_0A FNC_VALUES 1 UBYTE COLUMN_DIR DIRECT /end RECORD_LAYOUT
/begin COMPU_METHOD CU_ISOC_OVERRIDE_SERVICE_0A "Conversion method for isoc_override_service_0a" RAT_FUNC "%10.0" "n/a" COEFFS 0.000000 1.000000 -0.000000 0.000000 0.000000 1.000000 /end COMPU_METHOD
/* Scalar calibration for DDE 'isoc_uds_dtc_format_id'. */
/begin CHARACTERISTIC isoc_uds_dtc_format_id "Value used for DTCFormatID in NumberOfDtc UDS $19 response messages" VALUE 0xa010868c RL_ISOC_UDS_DTC_FORMAT_ID 255.000000 CU_ISOC_UDS_DTC_FORMAT_ID 0.000000 255.000000 BYTE_ORDER MSB_LAST /end CHARACTERISTIC
/begin RECORD_LAYOUT RL_ISOC_UDS_DTC_FORMAT_ID FNC_VALUES 1 UBYTE COLUMN_DIR DIRECT /end RECORD_LAYOUT
/begin COMPU_METHOD CU_ISOC_UDS_DTC_FORMAT_ID "Conversion method for isoc_uds_dtc_format_id" RAT_FUNC "%10.0" "n/a" COEFFS 0.000000 1.000000 -0.000000 0.000000 0.000000 1.000000 /end COMPU_METHOD
/* Scalar calibration for DDE 'lpfc_tc_3V3io'. */
/begin CHARACTERISTIC lpfc_tc_3V3io "Low pass filter constant for 3V3 IO" VALUE 0xa01084a4 RL_LPFC_TC_3V3IO 10.000000 CU_LPFC_TC_3V3IO 0.000000 10.000000 BYTE_ORDER MSB_LAST /end CHARACTERISTIC
/begin RECORD_LAYOUT RL_LPFC_TC_3V3IO FNC_VALUES 1 FLOAT32_IEEE COLUMN_DIR DIRECT /end RECORD_LAYOUT
/begin COMPU_METHOD CU_LPFC_TC_3V3IO "Conversion method for lpfc_tc_3V3io" RAT_FUNC "%10.3" "s" COEFFS 0.000000 1.000000 -0.000000 0.000000 0.000000 1.000000 /end COMPU_METHOD
/* Scalar calibration for DDE 'lpfc_tc_3V3qca'. */
/begin CHARACTERISTIC lpfc_tc_3V3qca "Low pass filter constant for 3V3 QCA" VALUE 0xa01084a0 RL_LPFC_TC_3V3QCA 10.000000 CU_LPFC_TC_3V3QCA 0.000000 10.000000 BYTE_ORDER MSB_LAST /end CHARACTERISTIC
/begin RECORD_LAYOUT RL_LPFC_TC_3V3QCA FNC_VALUES 1 FLOAT32_IEEE COLUMN_DIR DIRECT /end RECORD_LAYOUT
/begin COMPU_METHOD CU_LPFC_TC_3V3QCA "Conversion method for lpfc_tc_3V3qca" RAT_FUNC "%10.3" "s" COEFFS 0.000000 1.000000 -0.000000 0.000000 0.000000 1.000000 /end COMPU_METHOD
/* Scalar calibration for DDE 'lpfc_tc_3V3uc'. */
/begin CHARACTERISTIC lpfc_tc_3V3uc "Low pass filter constant for 3V3 Micro" VALUE 0xa010849c RL_LPFC_TC_3V3UC 10.000000 CU_LPFC_TC_3V3UC 0.000000 10.000000 BYTE_ORDER MSB_LAST /end CHARACTERISTIC
/begin RECORD_LAYOUT RL_LPFC_TC_3V3UC FNC_VALUES 1 FLOAT32_IEEE COLUMN_DIR DIRECT /end RECORD_LAYOUT
/begin COMPU_METHOD CU_LPFC_TC_3V3UC "Conversion method for lpfc_tc_3V3uc" RAT_FUNC "%10.3" "s" COEFFS 0.000000 1.000000 -0.000000 0.000000 0.000000 1.000000 /end COMPU_METHOD
/* Scalar calibration for DDE 'lpfc_tc_5vdd'. */
/begin CHARACTERISTIC lpfc_tc_5vdd "Low pass filter constant for 5VDD" VALUE 0xa0108498 RL_LPFC_TC_5VDD 10.000000 CU_LPFC_TC_5VDD 0.000000 10.000000 BYTE_ORDER MSB_LAST /end CHARACTERISTIC
/begin RECORD_LAYOUT RL_LPFC_TC_5VDD FNC_VALUES 1 FLOAT32_IEEE COLUMN_DIR DIRECT /end RECORD_LAYOUT
/begin COMPU_METHOD CU_LPFC_TC_5VDD "Conversion method for lpfc_tc_5vdd" RAT_FUNC "%10.3" "s" COEFFS 0.000000 1.000000 -0.000000 0.000000 0.000000 1.000000 /end COMPU_METHOD
/* Scalar calibration for DDE 'lpfc_tc_A2_vproxim'. */
/begin CHARACTERISTIC lpfc_tc_A2_vproxim "Low pass filter constant for A2 Proximity" VALUE 0xa0108494 RL_LPFC_TC_A2_VPROXIM 10.000000 CU_LPFC_TC_A2_VPROXIM 0.000000 10.000000 BYTE_ORDER MSB_LAST /end CHARACTERISTIC
/begin RECORD_LAYOUT RL_LPFC_TC_A2_VPROXIM FNC_VALUES 1 FLOAT32_IEEE COLUMN_DIR DIRECT /end RECORD_LAYOUT
/begin COMPU_METHOD CU_LPFC_TC_A2_VPROXIM "Conversion method for lpfc_tc_A2_vproxim" RAT_FUNC "%10.3" "s" COEFFS 0.000000 1.000000 -0.000000 0.000000 0.000000 1.000000 /end COMPU_METHOD
/* Scalar calibration for DDE 'lpfc_tc_A3_vpilot'. */
/begin CHARACTERISTIC lpfc_tc_A3_vpilot "Low pass filter constant for A3 Pilot" VALUE 0xa0108490 RL_LPFC_TC_A3_VPILOT 10.000000 CU_LPFC_TC_A3_VPILOT 0.000000 10.000000 BYTE_ORDER MSB_LAST /end CHARACTERISTIC
/begin RECORD_LAYOUT RL_LPFC_TC_A3_VPILOT FNC_VALUES 1 FLOAT32_IEEE COLUMN_DIR DIRECT /end RECORD_LAYOUT
/begin COMPU_METHOD CU_LPFC_TC_A3_VPILOT "Conversion method for lpfc_tc_A3_vpilot" RAT_FUNC "%10.3" "s" COEFFS 0.000000 1.000000 -0.000000 0.000000 0.000000 1.000000 /end COMPU_METHOD
/* Scalar calibration for DDE 'lpfc_tc_A3_vpilpeak'. */
/begin CHARACTERISTIC lpfc_tc_A3_vpilpeak "Low pass filter constant for A3 Pilot Peak" VALUE 0xa010848c RL_LPFC_TC_A3_VPILPEAK 10.000000 CU_LPFC_TC_A3_VPILPEAK 0.000000 10.000000 BYTE_ORDER MSB_LAST /end CHARACTERISTIC
/begin RECORD_LAYOUT RL_LPFC_TC_A3_VPILPEAK FNC_VALUES 1 FLOAT32_IEEE COLUMN_DIR DIRECT /end RECORD_LAYOUT
/begin COMPU_METHOD CU_LPFC_TC_A3_VPILPEAK "Conversion method for lpfc_tc_A3_vpilpeak" RAT_FUNC "%10.3" "s" COEFFS 0.000000 1.000000 -0.000000 0.000000 0.000000 1.000000 /end COMPU_METHOD
/* Scalar calibration for DDE 'lpfc_tc_B2_vtempa'. */
/begin CHARACTERISTIC lpfc_tc_B2_vtempa "Low pass filter constant for pin B2 VtempA" VALUE 0xa0108488 RL_LPFC_TC_B2_VTEMPA 10.000000 CU_LPFC_TC_B2_VTEMPA 0.000000 10.000000 BYTE_ORDER MSB_LAST /end CHARACTERISTIC
/begin RECORD_LAYOUT RL_LPFC_TC_B2_VTEMPA FNC_VALUES 1 FLOAT32_IEEE COLUMN_DIR DIRECT /end RECORD_LAYOUT
/begin COMPU_METHOD CU_LPFC_TC_B2_VTEMPA "Conversion method for lpfc_tc_B2_vtempa" RAT_FUNC "%10.3" "s" COEFFS 0.000000 1.000000 -0.000000 0.000000 0.000000 1.000000 /end COMPU_METHOD
/* Scalar calibration for DDE 'lpfc_tc_B3_vtempb'. */
/begin CHARACTERISTIC lpfc_tc_B3_vtempb "Low pass filter constant for pin B3 VtempB" VALUE 0xa0108484 RL_LPFC_TC_B3_VTEMPB 10.000000 CU_LPFC_TC_B3_VTEMPB 0.000000 10.000000 BYTE_ORDER MSB_LAST /end CHARACTERISTIC
/begin RECORD_LAYOUT RL_LPFC_TC_B3_VTEMPB FNC_VALUES 1 FLOAT32_IEEE COLUMN_DIR DIRECT /end RECORD_LAYOUT
/begin COMPU_METHOD CU_LPFC_TC_B3_VTEMPB "Conversion method for lpfc_tc_B3_vtempb" RAT_FUNC "%10.3" "s" COEFFS 0.000000 1.000000 -0.000000 0.000000 0.000000 1.000000 /end COMPU_METHOD
/* Scalar calibration for DDE 'lpfc_tc_B4_vtempc'. */
/begin CHARACTERISTIC lpfc_tc_B4_vtempc "Low pass filter constant for pin B4 VtempC" VALUE 0xa0108480 RL_LPFC_TC_B4_VTEMPC 10.000000 CU_LPFC_TC_B4_VTEMPC 0.000000 10.000000 BYTE_ORDER MSB_LAST /end CHARACTERISTIC
/begin RECORD_LAYOUT RL_LPFC_TC_B4_VTEMPC FNC_VALUES 1 FLOAT32_IEEE COLUMN_DIR DIRECT /end RECORD_LAYOUT
/begin COMPU_METHOD CU_LPFC_TC_B4_VTEMPC "Conversion method for lpfc_tc_B4_vtempc" RAT_FUNC "%10.3" "s" COEFFS 0.000000 1.000000 -0.000000 0.000000 0.000000 1.000000 /end COMPU_METHOD
/* Scalar calibration for DDE 'lpfc_tc_C2_vtempd'. */
/begin CHARACTERISTIC lpfc_tc_C2_vtempd "Low pass filter constant for pin C2 VtempD" VALUE 0xa010847c RL_LPFC_TC_C2_VTEMPD 10.000000 CU_LPFC_TC_C2_VTEMPD 0.000000 10.000000 BYTE_ORDER MSB_LAST /end CHARACTERISTIC
/begin RECORD_LAYOUT RL_LPFC_TC_C2_VTEMPD FNC_VALUES 1 FLOAT32_IEEE COLUMN_DIR DIRECT /end RECORD_LAYOUT
/begin COMPU_METHOD CU_LPFC_TC_C2_VTEMPD "Conversion method for lpfc_tc_C2_vtempd" RAT_FUNC "%10.3" "s" COEFFS 0.000000 1.000000 -0.000000 0.000000 0.000000 1.000000 /end COMPU_METHOD
/* Scalar calibration for DDE 'lpfc_tc_D3_AinE'. */
/begin CHARACTERISTIC lpfc_tc_D3_AinE "Low pass filter constant for D3 AinE/ChgLck" VALUE 0xa0108478 RL_LPFC_TC_D3_AINE 10.000000 CU_LPFC_TC_D3_AINE 0.000000 10.000000 BYTE_ORDER MSB_LAST /end CHARACTERISTIC
/begin RECORD_LAYOUT RL_LPFC_TC_D3_AINE FNC_VALUES 1 FLOAT32_IEEE COLUMN_DIR DIRECT /end RECORD_LAYOUT
/begin COMPU_METHOD CU_LPFC_TC_D3_AINE "Conversion method for lpfc_tc_D3_AinE" RAT_FUNC "%10.3" "s" COEFFS 0.000000 1.000000 -0.000000 0.000000 0.000000 1.000000 /end COMPU_METHOD
/* Scalar calibration for DDE 'lpfc_tc_F2_VLEDA'. */
/begin CHARACTERISTIC lpfc_tc_F2_VLEDA "Low pass filter constant for F2 LEDA" VALUE 0xa0108474 RL_LPFC_TC_F2_VLEDA 10.000000 CU_LPFC_TC_F2_VLEDA 0.000000 10.000000 BYTE_ORDER MSB_LAST /end CHARACTERISTIC
/begin RECORD_LAYOUT RL_LPFC_TC_F2_VLEDA FNC_VALUES 1 FLOAT32_IEEE COLUMN_DIR DIRECT /end RECORD_LAYOUT
/begin COMPU_METHOD CU_LPFC_TC_F2_VLEDA "Conversion method for lpfc_tc_F2_VLEDA" RAT_FUNC "%10.3" "s" COEFFS 0.000000 1.000000 -0.000000 0.000000 0.000000 1.000000 /end COMPU_METHOD
/* Scalar calibration for DDE 'lpfc_tc_F3_VLEDB'. */
/begin CHARACTERISTIC lpfc_tc_F3_VLEDB "Low pass filter constant for F3 LEDB" VALUE 0xa0108470 RL_LPFC_TC_F3_VLEDB 10.000000 CU_LPFC_TC_F3_VLEDB 0.000000 10.000000 BYTE_ORDER MSB_LAST /end CHARACTERISTIC
/begin RECORD_LAYOUT RL_LPFC_TC_F3_VLEDB FNC_VALUES 1 FLOAT32_IEEE COLUMN_DIR DIRECT /end RECORD_LAYOUT
/begin COMPU_METHOD CU_LPFC_TC_F3_VLEDB "Conversion method for lpfc_tc_F3_VLEDB" RAT_FUNC "%10.3" "s" COEFFS 0.000000 1.000000 -0.000000 0.000000 0.000000 1.000000 /end COMPU_METHOD
/* Scalar calibration for DDE 'lpfc_tc_F4_VLEDC'. */
/begin CHARACTERISTIC lpfc_tc_F4_VLEDC "Low pass filter constant for F4 LEDC" VALUE 0xa010846c RL_LPFC_TC_F4_VLEDC 10.000000 CU_LPFC_TC_F4_VLEDC 0.000000 10.000000 BYTE_ORDER MSB_LAST /end CHARACTERISTIC
/begin RECORD_LAYOUT RL_LPFC_TC_F4_VLEDC FNC_VALUES 1 FLOAT32_IEEE COLUMN_DIR DIRECT /end RECORD_LAYOUT
/begin COMPU_METHOD CU_LPFC_TC_F4_VLEDC "Conversion method for lpfc_tc_F4_VLEDC" RAT_FUNC "%10.3" "s" COEFFS 0.000000 1.000000 -0.000000 0.000000 0.000000 1.000000 /end COMPU_METHOD
/* Scalar calibration for DDE 'lpfc_tc_K3_ignition'. */
/begin CHARACTERISTIC lpfc_tc_K3_ignition "Low pass filter constant for pin K3 Ignition" VALUE 0xa0108468 RL_LPFC_TC_K3_IGNITION 10.000000 CU_LPFC_TC_K3_IGNITION 0.000000 10.000000 BYTE_ORDER MSB_LAST /end CHARACTERISTIC
/begin RECORD_LAYOUT RL_LPFC_TC_K3_IGNITION FNC_VALUES 1 FLOAT32_IEEE COLUMN_DIR DIRECT /end RECORD_LAYOUT
/begin COMPU_METHOD CU_LPFC_TC_K3_IGNITION "Conversion method for lpfc_tc_K3_ignition" RAT_FUNC "%10.3" "s" COEFFS 0.000000 1.000000 -0.000000 0.000000 0.000000 1.000000 /end COMPU_METHOD
/* Scalar calibration for DDE 'lpfc_tc_M2_HbrNVmon'. */
/begin CHARACTERISTIC lpfc_tc_M2_HbrNVmon "Low pass filter constant for M2 HbrN vmon" VALUE 0xa0108464 RL_LPFC_TC_M2_HBRNVMON 10.000000 CU_LPFC_TC_M2_HBRNVMON 0.000000 10.000000 BYTE_ORDER MSB_LAST /end CHARACTERISTIC
/begin RECORD_LAYOUT RL_LPFC_TC_M2_HBRNVMON FNC_VALUES 1 FLOAT32_IEEE COLUMN_DIR DIRECT /end RECORD_LAYOUT
/begin COMPU_METHOD CU_LPFC_TC_M2_HBRNVMON "Conversion method for lpfc_tc_M2_HbrNVmon" RAT_FUNC "%10.3" "s" COEFFS 0.000000 1.000000 -0.000000 0.000000 0.000000 1.000000 /end COMPU_METHOD
/* Scalar calibration for DDE 'lpfc_tc_M3_HbrPVmon'. */
/begin CHARACTERISTIC lpfc_tc_M3_HbrPVmon "Low pass filter constant for M3 HbrP vmon" VALUE 0xa0108460 RL_LPFC_TC_M3_HBRPVMON 10.000000 CU_LPFC_TC_M3_HBRPVMON 0.000000 10.000000 BYTE_ORDER MSB_LAST /end CHARACTERISTIC
/begin RECORD_LAYOUT RL_LPFC_TC_M3_HBRPVMON FNC_VALUES 1 FLOAT32_IEEE COLUMN_DIR DIRECT /end RECORD_LAYOUT
/begin COMPU_METHOD CU_LPFC_TC_M3_HBRPVMON "Conversion method for lpfc_tc_M3_HbrPVmon" RAT_FUNC "%10.3" "s" COEFFS 0.000000 1.000000 -0.000000 0.000000 0.000000 1.000000 /end COMPU_METHOD
/* Scalar calibration for DDE 'lpfc_tc_TempInt'. */
/begin CHARACTERISTIC lpfc_tc_TempInt "Low pass filter constant for Internal Temp" VALUE 0xa010845c RL_LPFC_TC_TEMPINT 10.000000 CU_LPFC_TC_TEMPINT 0.000000 10.000000 BYTE_ORDER MSB_LAST /end CHARACTERISTIC
/begin RECORD_LAYOUT RL_LPFC_TC_TEMPINT FNC_VALUES 1 FLOAT32_IEEE COLUMN_DIR DIRECT /end RECORD_LAYOUT
/begin COMPU_METHOD CU_LPFC_TC_TEMPINT "Conversion method for lpfc_tc_TempInt" RAT_FUNC "%10.3" "s" COEFFS 0.000000 1.000000 -0.000000 0.000000 0.000000 1.000000 /end COMPU_METHOD
/* Scalar calibration for DDE 'lpfc_tc_Vbat'. */
/begin CHARACTERISTIC lpfc_tc_Vbat "Low pass filter constant for pin Vbat" VALUE 0xa0108458 RL_LPFC_TC_VBAT 10.000000 CU_LPFC_TC_VBAT 0.000000 10.000000 BYTE_ORDER MSB_LAST /end CHARACTERISTIC
/begin RECORD_LAYOUT RL_LPFC_TC_VBAT FNC_VALUES 1 FLOAT32_IEEE COLUMN_DIR DIRECT /end RECORD_LAYOUT
/begin COMPU_METHOD CU_LPFC_TC_VBAT "Conversion method for lpfc_tc_Vbat" RAT_FUNC "%10.3" "s" COEFFS 0.000000 1.000000 -0.000000 0.000000 0.000000 1.000000 /end COMPU_METHOD
/* Scalar calibration for DDE 'lpfc_tc_VrefA'. */
/begin CHARACTERISTIC lpfc_tc_VrefA "Low pass filter constant for VrefA" VALUE 0xa0108454 RL_LPFC_TC_VREFA 10.000000 CU_LPFC_TC_VREFA 0.000000 10.000000 BYTE_ORDER MSB_LAST /end CHARACTERISTIC
/begin RECORD_LAYOUT RL_LPFC_TC_VREFA FNC_VALUES 1 FLOAT32_IEEE COLUMN_DIR DIRECT /end RECORD_LAYOUT
/begin COMPU_METHOD CU_LPFC_TC_VREFA "Conversion method for lpfc_tc_VrefA" RAT_FUNC "%10.3" "s" COEFFS 0.000000 1.000000 -0.000000 0.000000 0.000000 1.000000 /end COMPU_METHOD
/* Scalar calibration for DDE 'lpfc_tc_VrefB'. */
/begin CHARACTERISTIC lpfc_tc_VrefB "Low pass filter constant for VrefB" VALUE 0xa0108450 RL_LPFC_TC_VREFB 10.000000 CU_LPFC_TC_VREFB 0.000000 10.000000 BYTE_ORDER MSB_LAST /end CHARACTERISTIC
/begin RECORD_LAYOUT RL_LPFC_TC_VREFB FNC_VALUES 1 FLOAT32_IEEE COLUMN_DIR DIRECT /end RECORD_LAYOUT
/begin COMPU_METHOD CU_LPFC_TC_VREFB "Conversion method for lpfc_tc_VrefB" RAT_FUNC "%10.3" "s" COEFFS 0.000000 1.000000 -0.000000 0.000000 0.000000 1.000000 /end COMPU_METHOD
/* Scalar calibration for DDE 'lpfc_tc_ihbr'. */
/begin CHARACTERISTIC lpfc_tc_ihbr "Low pass filter constant for M3/M2 Hbr imon" VALUE 0xa010844c RL_LPFC_TC_IHBR 10.000000 CU_LPFC_TC_IHBR 0.000000 10.000000 BYTE_ORDER MSB_LAST /end CHARACTERISTIC
/begin RECORD_LAYOUT RL_LPFC_TC_IHBR FNC_VALUES 1 FLOAT32_IEEE COLUMN_DIR DIRECT /end RECORD_LAYOUT
/begin COMPU_METHOD CU_LPFC_TC_IHBR "Conversion method for lpfc_tc_ihbr" RAT_FUNC "%10.3" "s" COEFFS 0.000000 1.000000 -0.000000 0.000000 0.000000 1.000000 /end COMPU_METHOD
/* Scalar calibration for DDE 'mbec_b_clearfault'. */
/begin CHARACTERISTIC mbec_b_clearfault "Boolean to clear ain faults" VALUE 0xa0108448 RL_MBEC_B_CLEARFAULT 1.000000 CU_MBEC_B_CLEARFAULT 0.000000 1.000000 BYTE_ORDER MSB_LAST /end CHARACTERISTIC
/begin RECORD_LAYOUT RL_MBEC_B_CLEARFAULT FNC_VALUES 1 UBYTE COLUMN_DIR DIRECT /end RECORD_LAYOUT
/begin COMPU_METHOD CU_MBEC_B_CLEARFAULT "Conversion method for mbec_b_clearfault" RAT_FUNC "%10.0" "Bool" COEFFS 0.000000 1.000000 -0.000000 0.000000 0.000000 1.000000 /end COMPU_METHOD
/* Scalar calibration for DDE 'mbec_s_fltdebounce'. */
/begin CHARACTERISTIC mbec_s_fltdebounce "Debounce delay for AIN fault" VALUE 0xa0108444 RL_MBEC_S_FLTDEBOUNCE 100.000000 CU_MBEC_S_FLTDEBOUNCE 0.000000 100.000000 BYTE_ORDER MSB_LAST /end CHARACTERISTIC
/begin RECORD_LAYOUT RL_MBEC_S_FLTDEBOUNCE FNC_VALUES 1 FLOAT32_IEEE COLUMN_DIR DIRECT /end RECORD_LAYOUT
/begin COMPU_METHOD CU_MBEC_S_FLTDEBOUNCE "Conversion method for mbec_s_fltdebounce" RAT_FUNC "%10.2" "s" COEFFS 0.000000 1.000000 -0.000000 0.000000 0.000000 1.000000 /end COMPU_METHOD
/* String calibration for DDE 'mpls_app_build_time'. */
/begin CHARACTERISTIC mpls_app_build_time "Date and time of app build." ASCII 0x0 RL_MPLS_APP_BUILD_TIME 0 CU_MPLS_APP_BUILD_TIME 0 255 NUMBER 26 /end CHARACTERISTIC
/begin RECORD_LAYOUT RL_MPLS_APP_BUILD_TIME FNC_VALUES 1 UBYTE COLUMN_DIR DIRECT /end RECORD_LAYOUT
/begin COMPU_METHOD CU_MPLS_APP_BUILD_TIME "Conversion method for mpls_app_build_time" RAT_FUNC "%10.0" "" COEFFS 0.0 1.0 0.0 0.0 0.0 1.0 /end COMPU_METHOD
/* String calibration for DDE 'mpls_app_copyright'. */
/begin CHARACTERISTIC mpls_app_copyright "The application copyright text." ASCII 0x80136ac0 RL_MPLS_APP_COPYRIGHT 0 CU_MPLS_APP_COPYRIGHT 0 255 NUMBER 4 /end CHARACTERISTIC
/begin RECORD_LAYOUT RL_MPLS_APP_COPYRIGHT FNC_VALUES 1 UBYTE COLUMN_DIR DIRECT /end RECORD_LAYOUT
/begin COMPU_METHOD CU_MPLS_APP_COPYRIGHT "Conversion method for mpls_app_copyright" RAT_FUNC "%10.0" "" COEFFS 0.0 1.0 0.0 0.0 0.0 1.0 /end COMPU_METHOD
/* String calibration for DDE 'mpls_app_description'. */
/begin CHARACTERISTIC mpls_app_description "Description from the application." ASCII 0x80136abf RL_MPLS_APP_DESCRIPTION 0 CU_MPLS_APP_DESCRIPTION 0 255 NUMBER 34 /end CHARACTERISTIC
/begin RECORD_LAYOUT RL_MPLS_APP_DESCRIPTION FNC_VALUES 1 UBYTE COLUMN_DIR DIRECT /end RECORD_LAYOUT
/begin COMPU_METHOD CU_MPLS_APP_DESCRIPTION "Conversion method for mpls_app_description" RAT_FUNC "%10.0" "" COEFFS 0.0 1.0 0.0 0.0 0.0 1.0 /end COMPU_METHOD
/* String calibration for DDE 'mpls_app_name'. */
/begin CHARACTERISTIC mpls_app_name "The application name." ASCII 0x80136aab RL_MPLS_APP_NAME 0 CU_MPLS_APP_NAME 0 255 NUMBER 19 /end CHARACTERISTIC
/begin RECORD_LAYOUT RL_MPLS_APP_NAME FNC_VALUES 1 UBYTE COLUMN_DIR DIRECT /end RECORD_LAYOUT
/begin COMPU_METHOD CU_MPLS_APP_NAME "Conversion method for mpls_app_name" RAT_FUNC "%10.0" "" COEFFS 0.0 1.0 0.0 0.0 0.0 1.0 /end COMPU_METHOD
/* String calibration for DDE 'mpls_app_version'. */
/begin CHARACTERISTIC mpls_app_version "The application version." ASCII 0x0 RL_MPLS_APP_VERSION 0 CU_MPLS_APP_VERSION 0 255 NUMBER 5 /end CHARACTERISTIC
/begin RECORD_LAYOUT RL_MPLS_APP_VERSION FNC_VALUES 1 UBYTE COLUMN_DIR DIRECT /end RECORD_LAYOUT
/begin COMPU_METHOD CU_MPLS_APP_VERSION "Conversion method for mpls_app_version" RAT_FUNC "%10.0" "" COEFFS 0.0 1.0 0.0 0.0 0.0 1.0 /end COMPU_METHOD
/* String calibration for DDE 'mpls_plat_build_time'. */
/begin CHARACTERISTIC mpls_plat_build_time "Date and time of platform build." ASCII 0x0 RL_MPLS_PLAT_BUILD_TIME 0 CU_MPLS_PLAT_BUILD_TIME 0 255 NUMBER 30 /end CHARACTERISTIC
/begin RECORD_LAYOUT RL_MPLS_PLAT_BUILD_TIME FNC_VALUES 1 UBYTE COLUMN_DIR DIRECT /end RECORD_LAYOUT
/begin COMPU_METHOD CU_MPLS_PLAT_BUILD_TIME "Conversion method for mpls_plat_build_time" RAT_FUNC "%10.0" "" COEFFS 0.0 1.0 0.0 0.0 0.0 1.0 /end COMPU_METHOD
/* String calibration for DDE 'mpls_plat_copyright'. */
/begin CHARACTERISTIC mpls_plat_copyright "Date and time of platform build." ASCII 0x0 RL_MPLS_PLAT_COPYRIGHT 0 CU_MPLS_PLAT_COPYRIGHT 0 255 NUMBER 29 /end CHARACTERISTIC
/begin RECORD_LAYOUT RL_MPLS_PLAT_COPYRIGHT FNC_VALUES 1 UBYTE COLUMN_DIR DIRECT /end RECORD_LAYOUT
/begin COMPU_METHOD CU_MPLS_PLAT_COPYRIGHT "Conversion method for mpls_plat_copyright" RAT_FUNC "%10.0" "" COEFFS 0.0 1.0 0.0 0.0 0.0 1.0 /end COMPU_METHOD
/* String calibration for DDE 'mpls_plat_target'. */
/begin CHARACTERISTIC mpls_plat_target "Target platform." ASCII 0x0 RL_MPLS_PLAT_TARGET 0 CU_MPLS_PLAT_TARGET 0 255 NUMBER 5 /end CHARACTERISTIC
/begin RECORD_LAYOUT RL_MPLS_PLAT_TARGET FNC_VALUES 1 UBYTE COLUMN_DIR DIRECT /end RECORD_LAYOUT
/begin COMPU_METHOD CU_MPLS_PLAT_TARGET "Conversion method for mpls_plat_target" RAT_FUNC "%10.0" "" COEFFS 0.0 1.0 0.0 0.0 0.0 1.0 /end COMPU_METHOD
/* String calibration for DDE 'mpls_plat_version'. */
/begin CHARACTERISTIC mpls_plat_version "Version of platform." ASCII 0x0 RL_MPLS_PLAT_VERSION 0 CU_MPLS_PLAT_VERSION 0 255 NUMBER 12 /end CHARACTERISTIC
/begin RECORD_LAYOUT RL_MPLS_PLAT_VERSION FNC_VALUES 1 UBYTE COLUMN_DIR DIRECT /end RECORD_LAYOUT
/begin COMPU_METHOD CU_MPLS_PLAT_VERSION "Conversion method for mpls_plat_version" RAT_FUNC "%10.0" "" COEFFS 0.0 1.0 0.0 0.0 0.0 1.0 /end COMPU_METHOD
/* Scalar calibration for DDE 'outc_hbrcmd1_dcycle'. */
/begin CHARACTERISTIC outc_hbrcmd1_dcycle "H-bridge command 1 actuator 1 duty cycle (CCU pins M2)" VALUE 0xa0108440 RL_OUTC_HBRCMD1_DCYCLE 1.000000 CU_OUTC_HBRCMD1_DCYCLE 0.000000 1.000000 BYTE_ORDER MSB_LAST /end CHARACTERISTIC
/begin RECORD_LAYOUT RL_OUTC_HBRCMD1_DCYCLE FNC_VALUES 1 FLOAT32_IEEE COLUMN_DIR DIRECT /end RECORD_LAYOUT
/begin COMPU_METHOD CU_OUTC_HBRCMD1_DCYCLE "Conversion method for outc_hbrcmd1_dcycle" RAT_FUNC "%10.2" "proportional" COEFFS 0.000000 1.000000 -0.000000 0.000000 0.000000 1.000000 /end COMPU_METHOD
/* Scalar calibration for DDE 'outc_hbrcmd1_freq'. */
/begin CHARACTERISTIC outc_hbrcmd1_freq "H-bridge command 1 actuator 1 frequency (CCU pins M2)" VALUE 0xa010843c RL_OUTC_HBRCMD1_FREQ 9999.500000 CU_OUTC_HBRCMD1_FREQ 0.500000 10000.000000 BYTE_ORDER MSB_LAST /end CHARACTERISTIC
/begin RECORD_LAYOUT RL_OUTC_HBRCMD1_FREQ FNC_VALUES 1 FLOAT32_IEEE COLUMN_DIR DIRECT /end RECORD_LAYOUT
/begin COMPU_METHOD CU_OUTC_HBRCMD1_FREQ "Conversion method for outc_hbrcmd1_freq" RAT_FUNC "%10.1" "Hz" COEFFS 0.000000 1.000000 -0.000000 0.000000 0.000000 1.000000 /end COMPU_METHOD
/* Scalar calibration for DDE 'outc_hbrcmd2_dcycle'. */
/begin CHARACTERISTIC outc_hbrcmd2_dcycle "H-bridge command 2 actuator 1 duty cycle (CCU pins M2)" VALUE 0xa0108438 RL_OUTC_HBRCMD2_DCYCLE 1.000000 CU_OUTC_HBRCMD2_DCYCLE 0.000000 1.000000 BYTE_ORDER MSB_LAST /end CHARACTERISTIC
/begin RECORD_LAYOUT RL_OUTC_HBRCMD2_DCYCLE FNC_VALUES 1 FLOAT32_IEEE COLUMN_DIR DIRECT /end RECORD_LAYOUT
/begin COMPU_METHOD CU_OUTC_HBRCMD2_DCYCLE "Conversion method for outc_hbrcmd2_dcycle" RAT_FUNC "%10.2" "proportional" COEFFS 0.000000 1.000000 -0.000000 0.000000 0.000000 1.000000 /end COMPU_METHOD
/* Scalar calibration for DDE 'outc_hbrcmd2_freq'. */
/begin CHARACTERISTIC outc_hbrcmd2_freq "H-bridge command 2 actuator 1 frequency (CCU pins M2)" VALUE 0xa0108434 RL_OUTC_HBRCMD2_FREQ 9999.500000 CU_OUTC_HBRCMD2_FREQ 0.500000 10000.000000 BYTE_ORDER MSB_LAST /end CHARACTERISTIC
/begin RECORD_LAYOUT RL_OUTC_HBRCMD2_FREQ FNC_VALUES 1 FLOAT32_IEEE COLUMN_DIR DIRECT /end RECORD_LAYOUT
/begin COMPU_METHOD CU_OUTC_HBRCMD2_FREQ "Conversion method for outc_hbrcmd2_freq" RAT_FUNC "%10.1" "Hz" COEFFS 0.000000 1.000000 -0.000000 0.000000 0.000000 1.000000 /end COMPU_METHOD
/* Scalar calibration for DDE 'outc_p11_7_sleep'. */
/begin CHARACTERISTIC outc_p11_7_sleep "H-bridge actuator 1 sleep (CCU pins M2)" VALUE 0xa0108431 RL_OUTC_P11_7_SLEEP 1.000000 CU_OUTC_P11_7_SLEEP 0.000000 1.000000 BYTE_ORDER MSB_LAST /end CHARACTERISTIC
/begin RECORD_LAYOUT RL_OUTC_P11_7_SLEEP FNC_VALUES 1 UBYTE COLUMN_DIR DIRECT /end RECORD_LAYOUT
/begin COMPU_METHOD CU_OUTC_P11_7_SLEEP "Conversion method for outc_p11_7_sleep" RAT_FUNC "%10.0" "(not defined)" COEFFS 0.000000 1.000000 -0.000000 0.000000 0.000000 1.000000 /end COMPU_METHOD
/* Scalar calibration for DDE 'outc_p14_7_hbrmode'. */
/begin CHARACTERISTIC outc_p14_7_hbrmode "H-bridge actuator 1 mode (CCU pins M2)" VALUE 0xa0108430 RL_OUTC_P14_7_HBRMODE 1.000000 CU_OUTC_P14_7_HBRMODE 0.000000 1.000000 BYTE_ORDER MSB_LAST /end CHARACTERISTIC
/begin RECORD_LAYOUT RL_OUTC_P14_7_HBRMODE FNC_VALUES 1 UBYTE COLUMN_DIR DIRECT /end RECORD_LAYOUT
/begin COMPU_METHOD CU_OUTC_P14_7_HBRMODE "Conversion method for outc_p14_7_hbrmode" RAT_FUNC "%10.0" "(not defined)" COEFFS 0.000000 1.000000 -0.000000 0.000000 0.000000 1.000000 /end COMPU_METHOD
/* Scalar calibration for DDE 'pj1939c_node_addr_0'. */
/begin CHARACTERISTIC pj1939c_node_addr_0 "J1939 node address set up during initialisation" VALUE 0xa01086b0 RL_PJ1939C_NODE_ADDR_0 253.000000 CU_PJ1939C_NODE_ADDR_0 0.000000 253.000000 BYTE_ORDER MSB_LAST /end CHARACTERISTIC
/begin RECORD_LAYOUT RL_PJ1939C_NODE_ADDR_0 FNC_VALUES 1 UBYTE COLUMN_DIR DIRECT /end RECORD_LAYOUT
/begin COMPU_METHOD CU_PJ1939C_NODE_ADDR_0 "Conversion method for pj1939c_node_addr_0" RAT_FUNC "%10.0" "none" COEFFS 0.000000 1.000000 -0.000000 0.000000 0.000000 1.000000 /end COMPU_METHOD
/* Scalar calibration for DDE 'v3V3io_FltMax_C'. */
/begin CHARACTERISTIC v3V3io_FltMax_C "3V3 IO Max Fault Limit Cal" VALUE 0xa010842c RL_V3V3IO_FLTMAX_C 40.000000 CU_V3V3IO_FLTMAX_C 0.000000 40.000000 BYTE_ORDER MSB_LAST /end CHARACTERISTIC
/begin RECORD_LAYOUT RL_V3V3IO_FLTMAX_C FNC_VALUES 1 FLOAT32_IEEE COLUMN_DIR DIRECT /end RECORD_LAYOUT
/begin COMPU_METHOD CU_V3V3IO_FLTMAX_C "Conversion method for v3V3io_FltMax_C" RAT_FUNC "%10.3" "V" COEFFS 0.000000 1.000000 -0.000000 0.000000 0.000000 1.000000 /end COMPU_METHOD
/* Scalar calibration for DDE 'v3V3io_FltMin_C'. */
/begin CHARACTERISTIC v3V3io_FltMin_C "3V3 IO Min Fault Limit Cal" VALUE 0xa0108428 RL_V3V3IO_FLTMIN_C 40.000000 CU_V3V3IO_FLTMIN_C 0.000000 40.000000 BYTE_ORDER MSB_LAST /end CHARACTERISTIC
/begin RECORD_LAYOUT RL_V3V3IO_FLTMIN_C FNC_VALUES 1 FLOAT32_IEEE COLUMN_DIR DIRECT /end RECORD_LAYOUT
/begin COMPU_METHOD CU_V3V3IO_FLTMIN_C "Conversion method for v3V3io_FltMin_C" RAT_FUNC "%10.3" "V" COEFFS 0.000000 1.000000 -0.000000 0.000000 0.000000 1.000000 /end COMPU_METHOD
/* Scalar calibration for DDE 'v3V3io_ScaleFactor_C'. */
/begin CHARACTERISTIC v3V3io_ScaleFactor_C "3V3 IO Scale value (raw divided by this value to get pin voltage)" VALUE 0xa0108424 RL_V3V3IO_SCALEFACTOR_C 39.999000 CU_V3V3IO_SCALEFACTOR_C 0.001000 40.000000 BYTE_ORDER MSB_LAST /end CHARACTERISTIC
/begin RECORD_LAYOUT RL_V3V3IO_SCALEFACTOR_C FNC_VALUES 1 FLOAT32_IEEE COLUMN_DIR DIRECT /end RECORD_LAYOUT
/begin COMPU_METHOD CU_V3V3IO_SCALEFACTOR_C "Conversion method for v3V3io_ScaleFactor_C" RAT_FUNC "%10.3" "(not defined)" COEFFS 0.000000 1.000000 -0.000000 0.000000 0.000000 1.000000 /end COMPU_METHOD
/* Scalar calibration for DDE 'v3V3qca_FltMax_C'. */
/begin CHARACTERISTIC v3V3qca_FltMax_C "3V3 QCA Max Fault Limit Cal" VALUE 0xa0108420 RL_V3V3QCA_FLTMAX_C 40.000000 CU_V3V3QCA_FLTMAX_C 0.000000 40.000000 BYTE_ORDER MSB_LAST /end CHARACTERISTIC
/begin RECORD_LAYOUT RL_V3V3QCA_FLTMAX_C FNC_VALUES 1 FLOAT32_IEEE COLUMN_DIR DIRECT /end RECORD_LAYOUT
/begin COMPU_METHOD CU_V3V3QCA_FLTMAX_C "Conversion method for v3V3qca_FltMax_C" RAT_FUNC "%10.3" "V" COEFFS 0.000000 1.000000 -0.000000 0.000000 0.000000 1.000000 /end COMPU_METHOD
/* Scalar calibration for DDE 'v3V3qca_FltMin_C'. */
/begin CHARACTERISTIC v3V3qca_FltMin_C "3V3 QCA Min Fault Limit Cal" VALUE 0xa010841c RL_V3V3QCA_FLTMIN_C 40.000000 CU_V3V3QCA_FLTMIN_C 0.000000 40.000000 BYTE_ORDER MSB_LAST /end CHARACTERISTIC
/begin RECORD_LAYOUT RL_V3V3QCA_FLTMIN_C FNC_VALUES 1 FLOAT32_IEEE COLUMN_DIR DIRECT /end RECORD_LAYOUT
/begin COMPU_METHOD CU_V3V3QCA_FLTMIN_C "Conversion method for v3V3qca_FltMin_C" RAT_FUNC "%10.3" "V" COEFFS 0.000000 1.000000 -0.000000 0.000000 0.000000 1.000000 /end COMPU_METHOD
/* Scalar calibration for DDE 'v3V3qca_ScaleFactor_C'. */
/begin CHARACTERISTIC v3V3qca_ScaleFactor_C "3V3 QCA Scale value (raw divided by this value to get pin voltage)" VALUE 0xa0108418 RL_V3V3QCA_SCALEFACTOR_C 39.999000 CU_V3V3QCA_SCALEFACTOR_C 0.001000 40.000000 BYTE_ORDER MSB_LAST /end CHARACTERISTIC
/begin RECORD_LAYOUT RL_V3V3QCA_SCALEFACTOR_C FNC_VALUES 1 FLOAT32_IEEE COLUMN_DIR DIRECT /end RECORD_LAYOUT
/begin COMPU_METHOD CU_V3V3QCA_SCALEFACTOR_C "Conversion method for v3V3qca_ScaleFactor_C" RAT_FUNC "%10.3" "(not defined)" COEFFS 0.000000 1.000000 -0.000000 0.000000 0.000000 1.000000 /end COMPU_METHOD
/* Scalar calibration for DDE 'v3V3uc_FltMax_C'. */
/begin CHARACTERISTIC v3V3uc_FltMax_C "3V3 Micro Max Fault Limit Cal" VALUE 0xa0108414 RL_V3V3UC_FLTMAX_C 40.000000 CU_V3V3UC_FLTMAX_C 0.000000 40.000000 BYTE_ORDER MSB_LAST /end CHARACTERISTIC
/begin RECORD_LAYOUT RL_V3V3UC_FLTMAX_C FNC_VALUES 1 FLOAT32_IEEE COLUMN_DIR DIRECT /end RECORD_LAYOUT
/begin COMPU_METHOD CU_V3V3UC_FLTMAX_C "Conversion method for v3V3uc_FltMax_C" RAT_FUNC "%10.3" "V" COEFFS 0.000000 1.000000 -0.000000 0.000000 0.000000 1.000000 /end COMPU_METHOD
/* Scalar calibration for DDE 'v3V3uc_FltMin_C'. */
/begin CHARACTERISTIC v3V3uc_FltMin_C "3V3 Micro Min Fault Limit Cal" VALUE 0xa0108410 RL_V3V3UC_FLTMIN_C 40.000000 CU_V3V3UC_FLTMIN_C 0.000000 40.000000 BYTE_ORDER MSB_LAST /end CHARACTERISTIC
/begin RECORD_LAYOUT RL_V3V3UC_FLTMIN_C FNC_VALUES 1 FLOAT32_IEEE COLUMN_DIR DIRECT /end RECORD_LAYOUT
/begin COMPU_METHOD CU_V3V3UC_FLTMIN_C "Conversion method for v3V3uc_FltMin_C" RAT_FUNC "%10.3" "V" COEFFS 0.000000 1.000000 -0.000000 0.000000 0.000000 1.000000 /end COMPU_METHOD
/* Scalar calibration for DDE 'v3V3uc_ScaleFactor_C'. */
/begin CHARACTERISTIC v3V3uc_ScaleFactor_C "3V3 Micro Scale value (raw divided by this value to get pin voltage)" VALUE 0xa010840c RL_V3V3UC_SCALEFACTOR_C 39.999000 CU_V3V3UC_SCALEFACTOR_C 0.001000 40.000000 BYTE_ORDER MSB_LAST /end CHARACTERISTIC
/begin RECORD_LAYOUT RL_V3V3UC_SCALEFACTOR_C FNC_VALUES 1 FLOAT32_IEEE COLUMN_DIR DIRECT /end RECORD_LAYOUT
/begin COMPU_METHOD CU_V3V3UC_SCALEFACTOR_C "Conversion method for v3V3uc_ScaleFactor_C" RAT_FUNC "%10.3" "(not defined)" COEFFS 0.000000 1.000000 -0.000000 0.000000 0.000000 1.000000 /end COMPU_METHOD
/* Scalar calibration for DDE 'v5vdd_FltMax_C'. */
/begin CHARACTERISTIC v5vdd_FltMax_C "5VDD Max Fault Limit Cal" VALUE 0xa0108408 RL_V5VDD_FLTMAX_C 40.000000 CU_V5VDD_FLTMAX_C 0.000000 40.000000 BYTE_ORDER MSB_LAST /end CHARACTERISTIC
/begin RECORD_LAYOUT RL_V5VDD_FLTMAX_C FNC_VALUES 1 FLOAT32_IEEE COLUMN_DIR DIRECT /end RECORD_LAYOUT
/begin COMPU_METHOD CU_V5VDD_FLTMAX_C "Conversion method for v5vdd_FltMax_C" RAT_FUNC "%10.3" "V" COEFFS 0.000000 1.000000 -0.000000 0.000000 0.000000 1.000000 /end COMPU_METHOD
/* Scalar calibration for DDE 'v5vdd_FltMin_C'. */
/begin CHARACTERISTIC v5vdd_FltMin_C "5VDD Min Fault Limit Cal" VALUE 0xa0108404 RL_V5VDD_FLTMIN_C 40.000000 CU_V5VDD_FLTMIN_C 0.000000 40.000000 BYTE_ORDER MSB_LAST /end CHARACTERISTIC
/begin RECORD_LAYOUT RL_V5VDD_FLTMIN_C FNC_VALUES 1 FLOAT32_IEEE COLUMN_DIR DIRECT /end RECORD_LAYOUT
/begin COMPU_METHOD CU_V5VDD_FLTMIN_C "Conversion method for v5vdd_FltMin_C" RAT_FUNC "%10.3" "V" COEFFS 0.000000 1.000000 -0.000000 0.000000 0.000000 1.000000 /end COMPU_METHOD
/* Scalar calibration for DDE 'v5vdd_ScaleFactor_C'. */
/begin CHARACTERISTIC v5vdd_ScaleFactor_C "5VDD Scale value (raw divided by this value to get pin voltage)" VALUE 0xa0108400 RL_V5VDD_SCALEFACTOR_C 39.999000 CU_V5VDD_SCALEFACTOR_C 0.001000 40.000000 BYTE_ORDER MSB_LAST /end CHARACTERISTIC
/begin RECORD_LAYOUT RL_V5VDD_SCALEFACTOR_C FNC_VALUES 1 FLOAT32_IEEE COLUMN_DIR DIRECT /end RECORD_LAYOUT
/begin COMPU_METHOD CU_V5VDD_SCALEFACTOR_C "Conversion method for v5vdd_ScaleFactor_C" RAT_FUNC "%10.3" "(not defined)" COEFFS 0.000000 1.000000 -0.000000 0.000000 0.000000 1.000000 /end COMPU_METHOD
/end MODULE
/end PROJECT
