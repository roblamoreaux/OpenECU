ASAP2_VERSION 1 31
/begin PROJECT LaForge_CCU_TestApp "Test Application for LaForge TC367"
/begin HEADER "Dana" VERSION "0_3_1" /end HEADER
/begin MODULE OpenECU_TC367_001 ""
/* Scalar measurable for DDE 'CcsCtlEcuHoldEcuPwrReq'. */
/begin MEASUREMENT CcsCtlEcuHoldEcuPwrReq "TRUE is a Request from PiCCS to Host software to Hold ECU power (when TRUE) due to Wake-by-Pilot" UBYTE CU_CCSCTLECUHOLDECUPWRREQ 1 100 0.0 1.0 ECU_ADDRESS 0x70017e36 BYTE_ORDER MSB_LAST /end MEASUREMENT
/begin COMPU_METHOD CU_CCSCTLECUHOLDECUPWRREQ "Conversion method for CcsCtlEcuHoldEcuPwrReq" RAT_FUNC "%10.0" "b" COEFFS 0.000000 1.000000 -0.000000 0.000000 0.000000 1.000000 /end COMPU_METHOD
/* Scalar measurable for DDE 'CcsCtlEcuHoldQcaPwrReq'. */
/begin MEASUREMENT CcsCtlEcuHoldQcaPwrReq "TRUE is a Request from PiCCS to Host software to Hold QCA chip (PowerLine Communication modem) power" UBYTE CU_CCSCTLECUHOLDQCAPWRREQ 1 100 0.0 1.0 ECU_ADDRESS 0x70017e68 BYTE_ORDER MSB_LAST /end MEASUREMENT
/begin COMPU_METHOD CU_CCSCTLECUHOLDQCAPWRREQ "Conversion method for CcsCtlEcuHoldQcaPwrReq" RAT_FUNC "%10.0" "b" COEFFS 0.000000 1.000000 -0.000000 0.000000 0.000000 1.000000 /end COMPU_METHOD
/* Scalar measurable for DDE 'CcsCtlStopCpEStop'. */
/begin MEASUREMENT CcsCtlStopCpEStop "Flag that indicates an emergency shutdown triggered by CcsFltCpWrd faults" UBYTE CU_CCSCTLSTOPCPESTOP 1 100 0.0 1.0 ECU_ADDRESS 0x700182b2 BYTE_ORDER MSB_LAST /end MEASUREMENT
/begin COMPU_METHOD CU_CCSCTLSTOPCPESTOP "Conversion method for CcsCtlStopCpEStop" RAT_FUNC "%10.0" "b" COEFFS 0.000000 1.000000 -0.000000 0.000000 0.000000 1.000000 /end COMPU_METHOD
/* Scalar measurable for DDE 'CcsCtlStopCpNStop'. */
/begin MEASUREMENT CcsCtlStopCpNStop "Flag that indicates a normal shutdown triggered by CcsFltCpWrd faults" UBYTE CU_CCSCTLSTOPCPNSTOP 1 100 0.0 1.0 ECU_ADDRESS 0x70017db9 BYTE_ORDER MSB_LAST /end MEASUREMENT
/begin COMPU_METHOD CU_CCSCTLSTOPCPNSTOP "Conversion method for CcsCtlStopCpNStop" RAT_FUNC "%10.0" "b" COEFFS 0.000000 1.000000 -0.000000 0.000000 0.000000 1.000000 /end COMPU_METHOD
/* Scalar measurable for DDE 'CcsCtlStopCpRStop'. */
/begin MEASUREMENT CcsCtlStopCpRStop "Flag that indicates a rapid shutdown triggered by CcsFltCpWrd faults" UBYTE CU_CCSCTLSTOPCPRSTOP 1 100 0.0 1.0 ECU_ADDRESS 0x700181fe BYTE_ORDER MSB_LAST /end MEASUREMENT
/begin COMPU_METHOD CU_CCSCTLSTOPCPRSTOP "Conversion method for CcsCtlStopCpRStop" RAT_FUNC "%10.0" "b" COEFFS 0.000000 1.000000 -0.000000 0.000000 0.000000 1.000000 /end COMPU_METHOD
/* Scalar measurable for DDE 'CcsCtlStopIntFltEStop'. */
/begin MEASUREMENT CcsCtlStopIntFltEStop "Flag that indicates an emergency shutdown triggered by CcsFltInternalFaultsWrd faults" UBYTE CU_CCSCTLSTOPINTFLTESTOP 1 100 0.0 1.0 ECU_ADDRESS 0x70017d1a BYTE_ORDER MSB_LAST /end MEASUREMENT
/begin COMPU_METHOD CU_CCSCTLSTOPINTFLTESTOP "Conversion method for CcsCtlStopIntFltEStop" RAT_FUNC "%10.0" "b" COEFFS 0.000000 1.000000 -0.000000 0.000000 0.000000 1.000000 /end COMPU_METHOD
/* Scalar measurable for DDE 'CcsCtlStopIntFltNStop'. */
/begin MEASUREMENT CcsCtlStopIntFltNStop "Flag that indicates a normal shutdown triggered by CcsFltInternalFaultsWrd faults" UBYTE CU_CCSCTLSTOPINTFLTNSTOP 1 100 0.0 1.0 ECU_ADDRESS 0x70018170 BYTE_ORDER MSB_LAST /end MEASUREMENT
/begin COMPU_METHOD CU_CCSCTLSTOPINTFLTNSTOP "Conversion method for CcsCtlStopIntFltNStop" RAT_FUNC "%10.0" "b" COEFFS 0.000000 1.000000 -0.000000 0.000000 0.000000 1.000000 /end COMPU_METHOD
/* Scalar measurable for DDE 'CcsCtlStopIntFltRStop'. */
/begin MEASUREMENT CcsCtlStopIntFltRStop "Flag that indicates a rapid shutdown triggered by CcsFltInternalFaultsWrd faults" UBYTE CU_CCSCTLSTOPINTFLTRSTOP 1 100 0.0 1.0 ECU_ADDRESS 0x70017c45 BYTE_ORDER MSB_LAST /end MEASUREMENT
/begin COMPU_METHOD CU_CCSCTLSTOPINTFLTRSTOP "Conversion method for CcsCtlStopIntFltRStop" RAT_FUNC "%10.0" "b" COEFFS 0.000000 1.000000 -0.000000 0.000000 0.000000 1.000000 /end COMPU_METHOD
/* Scalar measurable for DDE 'CcsCtlStopPpEStop'. */
/begin MEASUREMENT CcsCtlStopPpEStop "Flag that indicates an emergency shutdown triggered by CcsFltPpWrd faults" UBYTE CU_CCSCTLSTOPPPESTOP 1 100 0.0 1.0 ECU_ADDRESS 0x70018009 BYTE_ORDER MSB_LAST /end MEASUREMENT
/begin COMPU_METHOD CU_CCSCTLSTOPPPESTOP "Conversion method for CcsCtlStopPpEStop" RAT_FUNC "%10.0" "b" COEFFS 0.000000 1.000000 -0.000000 0.000000 0.000000 1.000000 /end COMPU_METHOD
/* Scalar measurable for DDE 'CcsCtlStopPpNStop'. */
/begin MEASUREMENT CcsCtlStopPpNStop "Flag that indicates a normal shutdown triggered by CcsFltPpWrd faults" UBYTE CU_CCSCTLSTOPPPNSTOP 1 100 0.0 1.0 ECU_ADDRESS 0x70018470 BYTE_ORDER MSB_LAST /end MEASUREMENT
/begin COMPU_METHOD CU_CCSCTLSTOPPPNSTOP "Conversion method for CcsCtlStopPpNStop" RAT_FUNC "%10.0" "b" COEFFS 0.000000 1.000000 -0.000000 0.000000 0.000000 1.000000 /end COMPU_METHOD
/* Scalar measurable for DDE 'CcsCtlStopPpRStop'. */
/begin MEASUREMENT CcsCtlStopPpRStop "Flag that indicates a rapid shutdown triggered by CcsFltPpWrd faults" UBYTE CU_CCSCTLSTOPPPRSTOP 1 100 0.0 1.0 ECU_ADDRESS 0x70017f65 BYTE_ORDER MSB_LAST /end MEASUREMENT
/begin COMPU_METHOD CU_CCSCTLSTOPPPRSTOP "Conversion method for CcsCtlStopPpRStop" RAT_FUNC "%10.0" "b" COEFFS 0.000000 1.000000 -0.000000 0.000000 0.000000 1.000000 /end COMPU_METHOD
/* Scalar measurable for DDE 'CcsCtlStopRxEgyTypeEStop'. */
/begin MEASUREMENT CcsCtlStopRxEgyTypeEStop "Flag that indicates an emergency shutdown triggered by CcsFltRxEgyTrnsTypeWrd faults" UBYTE CU_CCSCTLSTOPRXEGYTYPEESTOP 1 100 0.0 1.0 ECU_ADDRESS 0x700183aa BYTE_ORDER MSB_LAST /end MEASUREMENT
/begin COMPU_METHOD CU_CCSCTLSTOPRXEGYTYPEESTOP "Conversion method for CcsCtlStopRxEgyTypeEStop" RAT_FUNC "%10.0" "b" COEFFS 0.000000 1.000000 -0.000000 0.000000 0.000000 1.000000 /end COMPU_METHOD
/* Scalar measurable for DDE 'CcsCtlStopRxEgyTypeNStop'. */
/begin MEASUREMENT CcsCtlStopRxEgyTypeNStop "Flag that indicates a normal shutdown triggered by CcsFltRxEgyTrnsTypeWrd faults" UBYTE CU_CCSCTLSTOPRXEGYTYPENSTOP 1 100 0.0 1.0 ECU_ADDRESS 0x70017eb5 BYTE_ORDER MSB_LAST /end MEASUREMENT
/begin COMPU_METHOD CU_CCSCTLSTOPRXEGYTYPENSTOP "Conversion method for CcsCtlStopRxEgyTypeNStop" RAT_FUNC "%10.0" "b" COEFFS 0.000000 1.000000 -0.000000 0.000000 0.000000 1.000000 /end COMPU_METHOD
/* Scalar measurable for DDE 'CcsCtlStopRxEgyTypeRStop'. */
/begin MEASUREMENT CcsCtlStopRxEgyTypeRStop "Flag that indicates a rapid shutdown triggered by CcsFltRxEgyTrnsTypeWrd faults" UBYTE CU_CCSCTLSTOPRXEGYTYPERSTOP 1 100 0.0 1.0 ECU_ADDRESS 0x70018316 BYTE_ORDER MSB_LAST /end MEASUREMENT
/begin COMPU_METHOD CU_CCSCTLSTOPRXEGYTYPERSTOP "Conversion method for CcsCtlStopRxEgyTypeRStop" RAT_FUNC "%10.0" "b" COEFFS 0.000000 1.000000 -0.000000 0.000000 0.000000 1.000000 /end COMPU_METHOD
/* Scalar measurable for DDE 'CcsCtlStopRxEvVoltEStop'. */
/begin MEASUREMENT CcsCtlStopRxEvVoltEStop "Flag that indicates an emergency shutdown triggered by CcsFltRxEvVoltWrd faults" UBYTE CU_CCSCTLSTOPRXEVVOLTESTOP 1 100 0.0 1.0 ECU_ADDRESS 0x70017e1a BYTE_ORDER MSB_LAST /end MEASUREMENT
/begin COMPU_METHOD CU_CCSCTLSTOPRXEVVOLTESTOP "Conversion method for CcsCtlStopRxEvVoltEStop" RAT_FUNC "%10.0" "b" COEFFS 0.000000 1.000000 -0.000000 0.000000 0.000000 1.000000 /end COMPU_METHOD
/* Scalar measurable for DDE 'CcsCtlStopRxEvVoltNStop'. */
/begin MEASUREMENT CcsCtlStopRxEvVoltNStop "Flag that indicates a normal shutdown triggered by CcsFltRxEvVoltWrd faults" UBYTE CU_CCSCTLSTOPRXEVVOLTNSTOP 1 100 0.0 1.0 ECU_ADDRESS 0x7001826e BYTE_ORDER MSB_LAST /end MEASUREMENT
/begin COMPU_METHOD CU_CCSCTLSTOPRXEVVOLTNSTOP "Conversion method for CcsCtlStopRxEvVoltNStop" RAT_FUNC "%10.0" "b" COEFFS 0.000000 1.000000 -0.000000 0.000000 0.000000 1.000000 /end COMPU_METHOD
/* Scalar measurable for DDE 'CcsCtlStopRxEvVoltRStop'. */
/begin MEASUREMENT CcsCtlStopRxEvVoltRStop "Flag that indicates a rapid shutdown triggered by CcsFltRxEvVoltWrd faults" UBYTE CU_CCSCTLSTOPRXEVVOLTRSTOP 1 100 0.0 1.0 ECU_ADDRESS 0x70017d7c BYTE_ORDER MSB_LAST /end MEASUREMENT
/begin COMPU_METHOD CU_CCSCTLSTOPRXEVVOLTRSTOP "Conversion method for CcsCtlStopRxEvVoltRStop" RAT_FUNC "%10.0" "b" COEFFS 0.000000 1.000000 -0.000000 0.000000 0.000000 1.000000 /end COMPU_METHOD
/* Scalar measurable for DDE 'CcsCtlStopRxEvseCrntEStop'. */
/begin MEASUREMENT CcsCtlStopRxEvseCrntEStop "Flag that indicates an emergency shutdown triggered by CcsFltRxEvseCrntWrd faults" UBYTE CU_CCSCTLSTOPRXEVSECRNTESTOP 1 100 0.0 1.0 ECU_ADDRESS 0x700181ad BYTE_ORDER MSB_LAST /end MEASUREMENT
/begin COMPU_METHOD CU_CCSCTLSTOPRXEVSECRNTESTOP "Conversion method for CcsCtlStopRxEvseCrntEStop" RAT_FUNC "%10.0" "b" COEFFS 0.000000 1.000000 -0.000000 0.000000 0.000000 1.000000 /end COMPU_METHOD
/* Scalar measurable for DDE 'CcsCtlStopRxEvseCrntNStop'. */
/begin MEASUREMENT CcsCtlStopRxEvseCrntNStop "Flag that indicates a normal shutdown triggered by CcsFltRxEvseCrntWrd faults" UBYTE CU_CCSCTLSTOPRXEVSECRNTNSTOP 1 100 0.0 1.0 ECU_ADDRESS 0x70017c8c BYTE_ORDER MSB_LAST /end MEASUREMENT
/begin COMPU_METHOD CU_CCSCTLSTOPRXEVSECRNTNSTOP "Conversion method for CcsCtlStopRxEvseCrntNStop" RAT_FUNC "%10.0" "b" COEFFS 0.000000 1.000000 -0.000000 0.000000 0.000000 1.000000 /end COMPU_METHOD
/* Scalar measurable for DDE 'CcsCtlStopRxEvseCrntRStop'. */
/begin MEASUREMENT CcsCtlStopRxEvseCrntRStop "Flag that indicates a rapid shutdown triggered by CcsFltRxEvseCrntWrd faults" UBYTE CU_CCSCTLSTOPRXEVSECRNTRSTOP 1 100 0.0 1.0 ECU_ADDRESS 0x700180e1 BYTE_ORDER MSB_LAST /end MEASUREMENT
/begin COMPU_METHOD CU_CCSCTLSTOPRXEVSECRNTRSTOP "Conversion method for CcsCtlStopRxEvseCrntRStop" RAT_FUNC "%10.0" "b" COEFFS 0.000000 1.000000 -0.000000 0.000000 0.000000 1.000000 /end COMPU_METHOD
/* Scalar measurable for DDE 'CcsCtlStopRxEvseIsolEStop'. */
/begin MEASUREMENT CcsCtlStopRxEvseIsolEStop "Flag that indicates an emergency shutdown triggered by CcsFltRxEvseIsolWrd faults" UBYTE CU_CCSCTLSTOPRXEVSEISOLESTOP 1 100 0.0 1.0 ECU_ADDRESS 0x700184bc BYTE_ORDER MSB_LAST /end MEASUREMENT
/begin COMPU_METHOD CU_CCSCTLSTOPRXEVSEISOLESTOP "Conversion method for CcsCtlStopRxEvseIsolEStop" RAT_FUNC "%10.0" "b" COEFFS 0.000000 1.000000 -0.000000 0.000000 0.000000 1.000000 /end COMPU_METHOD
/* Scalar measurable for DDE 'CcsCtlStopRxEvseIsolNStop'. */
/begin MEASUREMENT CcsCtlStopRxEvseIsolNStop "Flag that indicates a normal shutdown triggered by CcsFltRxEvseIsolWrd faults" UBYTE CU_CCSCTLSTOPRXEVSEISOLNSTOP 1 100 0.0 1.0 ECU_ADDRESS 0x70017fa8 BYTE_ORDER MSB_LAST /end MEASUREMENT
/begin COMPU_METHOD CU_CCSCTLSTOPRXEVSEISOLNSTOP "Conversion method for CcsCtlStopRxEvseIsolNStop" RAT_FUNC "%10.0" "b" COEFFS 0.000000 1.000000 -0.000000 0.000000 0.000000 1.000000 /end COMPU_METHOD
/* Scalar measurable for DDE 'CcsCtlStopRxEvseIsolRStop'. */
/begin MEASUREMENT CcsCtlStopRxEvseIsolRStop "Flag that indicates a rapid shutdown triggered by CcsFltRxEvseIsolWrd faults" UBYTE CU_CCSCTLSTOPRXEVSEISOLRSTOP 1 100 0.0 1.0 ECU_ADDRESS 0x70018427 BYTE_ORDER MSB_LAST /end MEASUREMENT
/begin COMPU_METHOD CU_CCSCTLSTOPRXEVSEISOLRSTOP "Conversion method for CcsCtlStopRxEvseIsolRStop" RAT_FUNC "%10.0" "b" COEFFS 0.000000 1.000000 -0.000000 0.000000 0.000000 1.000000 /end COMPU_METHOD
/* Scalar measurable for DDE 'CcsCtlStopRxEvseProcEStop'. */
/begin MEASUREMENT CcsCtlStopRxEvseProcEStop "Flag that indicates an emergency shutdown triggered by CcsFltRxEvseProcStWrd faults" UBYTE CU_CCSCTLSTOPRXEVSEPROCESTOP 1 100 0.0 1.0 ECU_ADDRESS 0x70017ef4 BYTE_ORDER MSB_LAST /end MEASUREMENT
/begin COMPU_METHOD CU_CCSCTLSTOPRXEVSEPROCESTOP "Conversion method for CcsCtlStopRxEvseProcEStop" RAT_FUNC "%10.0" "b" COEFFS 0.000000 1.000000 -0.000000 0.000000 0.000000 1.000000 /end COMPU_METHOD
/* Scalar measurable for DDE 'CcsCtlStopRxEvseProcNStop'. */
/begin MEASUREMENT CcsCtlStopRxEvseProcNStop "Flag that indicates a normal shutdown triggered by CcsFltRxEvseProcStWrd faults" UBYTE CU_CCSCTLSTOPRXEVSEPROCNSTOP 1 100 0.0 1.0 ECU_ADDRESS 0x7001836c BYTE_ORDER MSB_LAST /end MEASUREMENT
/begin COMPU_METHOD CU_CCSCTLSTOPRXEVSEPROCNSTOP "Conversion method for CcsCtlStopRxEvseProcNStop" RAT_FUNC "%10.0" "b" COEFFS 0.000000 1.000000 -0.000000 0.000000 0.000000 1.000000 /end COMPU_METHOD
/* Scalar measurable for DDE 'CcsCtlStopRxEvseProcRStop'. */
/begin MEASUREMENT CcsCtlStopRxEvseProcRStop "Flag that indicates a rapid shutdown triggered by CcsFltRxEvseProcStWrd faults" UBYTE CU_CCSCTLSTOPRXEVSEPROCRSTOP 1 100 0.0 1.0 ECU_ADDRESS 0x70017e69 BYTE_ORDER MSB_LAST /end MEASUREMENT
/begin COMPU_METHOD CU_CCSCTLSTOPRXEVSEPROCRSTOP "Conversion method for CcsCtlStopRxEvseProcRStop" RAT_FUNC "%10.0" "b" COEFFS 0.000000 1.000000 -0.000000 0.000000 0.000000 1.000000 /end COMPU_METHOD
/* Scalar measurable for DDE 'CcsCtlStopRxEvsePwrEStop'. */
/begin MEASUREMENT CcsCtlStopRxEvsePwrEStop "Flag that indicates an emergency shutdown triggered by CcsFltRxEvsePwrWrd faults" UBYTE CU_CCSCTLSTOPRXEVSEPWRESTOP 1 100 0.0 1.0 ECU_ADDRESS 0x700182b3 BYTE_ORDER MSB_LAST /end MEASUREMENT
/begin COMPU_METHOD CU_CCSCTLSTOPRXEVSEPWRESTOP "Conversion method for CcsCtlStopRxEvsePwrEStop" RAT_FUNC "%10.0" "b" COEFFS 0.000000 1.000000 -0.000000 0.000000 0.000000 1.000000 /end COMPU_METHOD
/* Scalar measurable for DDE 'CcsCtlStopRxEvsePwrNStop'. */
/begin MEASUREMENT CcsCtlStopRxEvsePwrNStop "Flag that indicates a normal shutdown triggered by CcsFltRxEvsePwrWrd faults" UBYTE CU_CCSCTLSTOPRXEVSEPWRNSTOP 1 100 0.0 1.0 ECU_ADDRESS 0x70017dba BYTE_ORDER MSB_LAST /end MEASUREMENT
/begin COMPU_METHOD CU_CCSCTLSTOPRXEVSEPWRNSTOP "Conversion method for CcsCtlStopRxEvsePwrNStop" RAT_FUNC "%10.0" "b" COEFFS 0.000000 1.000000 -0.000000 0.000000 0.000000 1.000000 /end COMPU_METHOD
/* Scalar measurable for DDE 'CcsCtlStopRxEvsePwrRStop'. */
/begin MEASUREMENT CcsCtlStopRxEvsePwrRStop "Flag that indicates a rapid shutdown triggered by CcsFltRxEvsePwrWrd faults" UBYTE CU_CCSCTLSTOPRXEVSEPWRRSTOP 1 100 0.0 1.0 ECU_ADDRESS 0x700181ff BYTE_ORDER MSB_LAST /end MEASUREMENT
/begin COMPU_METHOD CU_CCSCTLSTOPRXEVSEPWRRSTOP "Conversion method for CcsCtlStopRxEvsePwrRStop" RAT_FUNC "%10.0" "b" COEFFS 0.000000 1.000000 -0.000000 0.000000 0.000000 1.000000 /end COMPU_METHOD
/* Scalar measurable for DDE 'CcsCtlStopRxEvseStEStop'. */
/begin MEASUREMENT CcsCtlStopRxEvseStEStop "Flag that indicates an emergency shutdown triggered by CcsFltRxEvseStCodeWrd faults" UBYTE CU_CCSCTLSTOPRXEVSESTESTOP 1 100 0.0 1.0 ECU_ADDRESS 0x70017d1b BYTE_ORDER MSB_LAST /end MEASUREMENT
/begin COMPU_METHOD CU_CCSCTLSTOPRXEVSESTESTOP "Conversion method for CcsCtlStopRxEvseStEStop" RAT_FUNC "%10.0" "b" COEFFS 0.000000 1.000000 -0.000000 0.000000 0.000000 1.000000 /end COMPU_METHOD
/* Scalar measurable for DDE 'CcsCtlStopRxEvseStNStop'. */
/begin MEASUREMENT CcsCtlStopRxEvseStNStop "Flag that indicates a normal shutdown triggered by CcsFltRxEvseStCodeWrd faults" UBYTE CU_CCSCTLSTOPRXEVSESTNSTOP 1 100 0.0 1.0 ECU_ADDRESS 0x70018171 BYTE_ORDER MSB_LAST /end MEASUREMENT
/begin COMPU_METHOD CU_CCSCTLSTOPRXEVSESTNSTOP "Conversion method for CcsCtlStopRxEvseStNStop" RAT_FUNC "%10.0" "b" COEFFS 0.000000 1.000000 -0.000000 0.000000 0.000000 1.000000 /end COMPU_METHOD
/* Scalar measurable for DDE 'CcsCtlStopRxEvseStRStop'. */
/begin MEASUREMENT CcsCtlStopRxEvseStRStop "Flag that indicates a rapid shutdown triggered by CcsFltRxEvseStCodeWrd faults" UBYTE CU_CCSCTLSTOPRXEVSESTRSTOP 1 100 0.0 1.0 ECU_ADDRESS 0x70017c46 BYTE_ORDER MSB_LAST /end MEASUREMENT
/begin COMPU_METHOD CU_CCSCTLSTOPRXEVSESTRSTOP "Conversion method for CcsCtlStopRxEvseStRStop" RAT_FUNC "%10.0" "b" COEFFS 0.000000 1.000000 -0.000000 0.000000 0.000000 1.000000 /end COMPU_METHOD
/* Scalar measurable for DDE 'CcsCtlStopRxEvseVoltEStop'. */
/begin MEASUREMENT CcsCtlStopRxEvseVoltEStop "Flag that indicates an emergency shutdown triggered by CcsFltRxEvseVoltWrd faults" UBYTE CU_CCSCTLSTOPRXEVSEVOLTESTOP 1 100 0.0 1.0 ECU_ADDRESS 0x7001800a BYTE_ORDER MSB_LAST /end MEASUREMENT
/begin COMPU_METHOD CU_CCSCTLSTOPRXEVSEVOLTESTOP "Conversion method for CcsCtlStopRxEvseVoltEStop" RAT_FUNC "%10.0" "b" COEFFS 0.000000 1.000000 -0.000000 0.000000 0.000000 1.000000 /end COMPU_METHOD
/* Scalar measurable for DDE 'CcsCtlStopRxEvseVoltNStop'. */
/begin MEASUREMENT CcsCtlStopRxEvseVoltNStop "Flag that indicates a normal shutdown triggered by CcsFltRxEvseVoltWrd faults" UBYTE CU_CCSCTLSTOPRXEVSEVOLTNSTOP 1 100 0.0 1.0 ECU_ADDRESS 0x70018471 BYTE_ORDER MSB_LAST /end MEASUREMENT
/begin COMPU_METHOD CU_CCSCTLSTOPRXEVSEVOLTNSTOP "Conversion method for CcsCtlStopRxEvseVoltNStop" RAT_FUNC "%10.0" "b" COEFFS 0.000000 1.000000 -0.000000 0.000000 0.000000 1.000000 /end COMPU_METHOD
/* Scalar measurable for DDE 'CcsCtlStopRxEvseVoltRStop'. */
/begin MEASUREMENT CcsCtlStopRxEvseVoltRStop "Flag that indicates a rapid shutdown triggered by CcsFltRxEvseVoltWrd faults" UBYTE CU_CCSCTLSTOPRXEVSEVOLTRSTOP 1 100 0.0 1.0 ECU_ADDRESS 0x70017f66 BYTE_ORDER MSB_LAST /end MEASUREMENT
/begin COMPU_METHOD CU_CCSCTLSTOPRXEVSEVOLTRSTOP "Conversion method for CcsCtlStopRxEvseVoltRStop" RAT_FUNC "%10.0" "b" COEFFS 0.000000 1.000000 -0.000000 0.000000 0.000000 1.000000 /end COMPU_METHOD
/* Scalar measurable for DDE 'CcsCtlStopSeqEStop'. */
/begin MEASUREMENT CcsCtlStopSeqEStop "Flag that indicates an emergency shutdown triggered by CcsFltSeqWrd faults" UBYTE CU_CCSCTLSTOPSEQESTOP 1 100 0.0 1.0 ECU_ADDRESS 0x700183ab BYTE_ORDER MSB_LAST /end MEASUREMENT
/begin COMPU_METHOD CU_CCSCTLSTOPSEQESTOP "Conversion method for CcsCtlStopSeqEStop" RAT_FUNC "%10.0" "b" COEFFS 0.000000 1.000000 -0.000000 0.000000 0.000000 1.000000 /end COMPU_METHOD
/* Scalar measurable for DDE 'CcsCtlStopSeqNStop'. */
/begin MEASUREMENT CcsCtlStopSeqNStop "Flag that indicates a normal shutdown triggered by CcsFltSeqWrd faults" UBYTE CU_CCSCTLSTOPSEQNSTOP 1 100 0.0 1.0 ECU_ADDRESS 0x70017eb6 BYTE_ORDER MSB_LAST /end MEASUREMENT
/begin COMPU_METHOD CU_CCSCTLSTOPSEQNSTOP "Conversion method for CcsCtlStopSeqNStop" RAT_FUNC "%10.0" "b" COEFFS 0.000000 1.000000 -0.000000 0.000000 0.000000 1.000000 /end COMPU_METHOD
/* Scalar measurable for DDE 'CcsCtlStopSeqRStop'. */
/begin MEASUREMENT CcsCtlStopSeqRStop "Flag that indicates a rapid shutdown triggered by CcsFltSeqWrd faults" UBYTE CU_CCSCTLSTOPSEQRSTOP 1 100 0.0 1.0 ECU_ADDRESS 0x70018317 BYTE_ORDER MSB_LAST /end MEASUREMENT
/begin COMPU_METHOD CU_CCSCTLSTOPSEQRSTOP "Conversion method for CcsCtlStopSeqRStop" RAT_FUNC "%10.0" "b" COEFFS 0.000000 1.000000 -0.000000 0.000000 0.000000 1.000000 /end COMPU_METHOD
/* Scalar measurable for DDE 'CcsCtlStopSupPrtclEStop'. */
/begin MEASUREMENT CcsCtlStopSupPrtclEStop "Flag that indicates a emergency shutdown triggered by CcsFltEvseSupPrtclWrd faults" UBYTE CU_CCSCTLSTOPSUPPRTCLESTOP 1 100 0.0 1.0 ECU_ADDRESS 0x70017e1b BYTE_ORDER MSB_LAST /end MEASUREMENT
/begin COMPU_METHOD CU_CCSCTLSTOPSUPPRTCLESTOP "Conversion method for CcsCtlStopSupPrtclEStop" RAT_FUNC "%10.0" "b" COEFFS 0.000000 1.000000 -0.000000 0.000000 0.000000 1.000000 /end COMPU_METHOD
/* Scalar measurable for DDE 'CcsCtlStopSupPrtclNStop'. */
/begin MEASUREMENT CcsCtlStopSupPrtclNStop "Flag that indicates a normal shutdown triggered by CcsFltEvseSupPrtclWrd faults" UBYTE CU_CCSCTLSTOPSUPPRTCLNSTOP 1 100 0.0 1.0 ECU_ADDRESS 0x7001826f BYTE_ORDER MSB_LAST /end MEASUREMENT
/begin COMPU_METHOD CU_CCSCTLSTOPSUPPRTCLNSTOP "Conversion method for CcsCtlStopSupPrtclNStop" RAT_FUNC "%10.0" "b" COEFFS 0.000000 1.000000 -0.000000 0.000000 0.000000 1.000000 /end COMPU_METHOD
/* Scalar measurable for DDE 'CcsCtlStopSupPrtclRStop'. */
/begin MEASUREMENT CcsCtlStopSupPrtclRStop "Flag that indicates a rapid shutdown triggered by CcsFltSupPrtclWrd faults" UBYTE CU_CCSCTLSTOPSUPPRTCLRSTOP 1 100 0.0 1.0 ECU_ADDRESS 0x70017d7d BYTE_ORDER MSB_LAST /end MEASUREMENT
/begin COMPU_METHOD CU_CCSCTLSTOPSUPPRTCLRSTOP "Conversion method for CcsCtlStopSupPrtclRStop" RAT_FUNC "%10.0" "b" COEFFS 0.000000 1.000000 -0.000000 0.000000 0.000000 1.000000 /end COMPU_METHOD
/* Scalar measurable for DDE 'CcsCtlStopV2gMsgEStop'. */
/begin MEASUREMENT CcsCtlStopV2gMsgEStop "Flag that indicates an emergency shutdown triggered by CcsFltV2gMsgWrd faults" UBYTE CU_CCSCTLSTOPV2GMSGESTOP 1 100 0.0 1.0 ECU_ADDRESS 0x700181ae BYTE_ORDER MSB_LAST /end MEASUREMENT
/begin COMPU_METHOD CU_CCSCTLSTOPV2GMSGESTOP "Conversion method for CcsCtlStopV2gMsgEStop" RAT_FUNC "%10.0" "b" COEFFS 0.000000 1.000000 -0.000000 0.000000 0.000000 1.000000 /end COMPU_METHOD
/* Scalar measurable for DDE 'CcsCtlStopV2gMsgNStop'. */
/begin MEASUREMENT CcsCtlStopV2gMsgNStop "Flag that indicates a normal shutdown triggered by CcsFltV2gMsgWrd faults" UBYTE CU_CCSCTLSTOPV2GMSGNSTOP 1 100 0.0 1.0 ECU_ADDRESS 0x70017c8d BYTE_ORDER MSB_LAST /end MEASUREMENT
/begin COMPU_METHOD CU_CCSCTLSTOPV2GMSGNSTOP "Conversion method for CcsCtlStopV2gMsgNStop" RAT_FUNC "%10.0" "b" COEFFS 0.000000 1.000000 -0.000000 0.000000 0.000000 1.000000 /end COMPU_METHOD
/* Scalar measurable for DDE 'CcsCtlStopV2gMsgRStop'. */
/begin MEASUREMENT CcsCtlStopV2gMsgRStop "Flag that indicates a rapid shutdown triggered by CcsFltV2gMsgWrd faults" UBYTE CU_CCSCTLSTOPV2GMSGRSTOP 1 100 0.0 1.0 ECU_ADDRESS 0x700180e2 BYTE_ORDER MSB_LAST /end MEASUREMENT
/begin COMPU_METHOD CU_CCSCTLSTOPV2GMSGRSTOP "Conversion method for CcsCtlStopV2gMsgRStop" RAT_FUNC "%10.0" "b" COEFFS 0.000000 1.000000 -0.000000 0.000000 0.000000 1.000000 /end COMPU_METHOD
/* Scalar measurable for DDE 'CcsFltStopFltResponse'. */
/begin MEASUREMENT CcsFltStopFltResponse "Identifies the the state machine fault reaction" SLONG CU_CCSFLTSTOPFLTRESPONSE 1 100 -2147483648.0 2147483647.0 ECU_ADDRESS 0x70017f68 BYTE_ORDER MSB_LAST /end MEASUREMENT
/begin COMPU_METHOD CU_CCSFLTSTOPFLTRESPONSE "Conversion method for CcsFltStopFltResponse" TAB_VERB "%12.0" "enum" COMPU_TAB_REF CT_CCSFLTSTOPFLTRESPONSE /end COMPU_METHOD
/begin COMPU_VTAB CT_CCSFLTSTOPFLTRESPONSE "Conversion method for CcsFltStopFltResponse" TAB_VERB 4 0 "NO_FAULT_CONTINUE" 1 "NO_FAULT_NORMAL_STOP" 2 "FAULT_NONCRITICAL_STOP" 3 "FAULT_EMERGENCY_STOP" /end COMPU_VTAB
/* Scalar measurable for DDE 'CcsOprHvEvTargetCrnt'. */
/begin MEASUREMENT CcsOprHvEvTargetCrnt "Final Target Current requested from EVSE" FLOAT32_IEEE CU_CCSOPRHVEVTARGETCRNT 1 100 -1000.0 1000.0 ECU_ADDRESS 0x70018204 BYTE_ORDER MSB_LAST /end MEASUREMENT
/begin COMPU_METHOD CU_CCSOPRHVEVTARGETCRNT "Conversion method for CcsOprHvEvTargetCrnt" RAT_FUNC "%10.0" "A" COEFFS 0.000000 1.000000 -0.000000 0.000000 0.000000 1.000000 /end COMPU_METHOD
/* Scalar measurable for DDE 'CcsOprHvEvTargetVolt'. */
/begin MEASUREMENT CcsOprHvEvTargetVolt "Final Target Voltage requested from EVSE" FLOAT32_IEEE CU_CCSOPRHVEVTARGETVOLT 1 100 0.0 1000.0 ECU_ADDRESS 0x70017d20 BYTE_ORDER MSB_LAST /end MEASUREMENT
/begin COMPU_METHOD CU_CCSOPRHVEVTARGETVOLT "Conversion method for CcsOprHvEvTargetVolt" RAT_FUNC "%10.0" "V" COEFFS 0.000000 1.000000 -0.000000 0.000000 0.000000 1.000000 /end COMPU_METHOD
/* Scalar measurable for DDE 'CcsOprTargetCrntChgLimByPwr'. */
/begin MEASUREMENT CcsOprTargetCrntChgLimByPwr "Target Current requested from EVSE that is limited by EV and EVSE maximum charge power" FLOAT32_IEEE CU_CCSOPRTARGETCRNTCHGLIMBYPWR 1 100 -1000.0 1000.0 ECU_ADDRESS 0x70018178 BYTE_ORDER MSB_LAST /end MEASUREMENT
/begin COMPU_METHOD CU_CCSOPRTARGETCRNTCHGLIMBYPWR "Conversion method for CcsOprTargetCrntChgLimByPwr" RAT_FUNC "%10.0" "A" COEFFS 0.000000 1.000000 -0.000000 0.000000 0.000000 1.000000 /end COMPU_METHOD
/* Scalar measurable for DDE 'CcsOprTargetCrntDchgLimByPwr'. */
/begin MEASUREMENT CcsOprTargetCrntDchgLimByPwr "Target Current requested from EVSE that is limited by EV and EVSE maximum charge power" FLOAT32_IEEE CU_CCSOPRTARGETCRNTDCHGLIMBYPWR 1 100 -1000.0 1000.0 ECU_ADDRESS 0x70017c4c BYTE_ORDER MSB_LAST /end MEASUREMENT
/begin COMPU_METHOD CU_CCSOPRTARGETCRNTDCHGLIMBYPWR "Conversion method for CcsOprTargetCrntDchgLimByPwr" RAT_FUNC "%10.0" "A" COEFFS 0.000000 1.000000 -0.000000 0.000000 0.000000 1.000000 /end COMPU_METHOD
/* Scalar measurable for DDE 'CcsOprV2gTxEvCabinCondition'. */
/begin MEASUREMENT CcsOprV2gTxEvCabinCondition "Vehicle Cabin Conditioning, The vehicle is using energy from the DC supply to heat or cool the passenger compartment" UBYTE CU_CCSOPRV2GTXEVCABINCONDITION1 1 100 0.0 1.0 ECU_ADDRESS 0x70018010 BYTE_ORDER MSB_LAST /end MEASUREMENT
/begin COMPU_METHOD CU_CCSOPRV2GTXEVCABINCONDITION1 "Conversion method for CcsOprV2gTxEvCabinCondition" RAT_FUNC "%10.0" "b" COEFFS 0.000000 1.000000 -0.000000 0.000000 0.000000 1.000000 /end COMPU_METHOD
/* Scalar measurable for DDE 'CcsOprV2gTxReadyToCharge'. */
/begin MEASUREMENT CcsOprV2gTxReadyToCharge "If set to TRUE, signals that the vehicle is ready for full energy transfer." UBYTE CU_CCSOPRV2GTXREADYTOCHARGE 1 100 0.0 1.0 ECU_ADDRESS 0x70018474 BYTE_ORDER MSB_LAST /end MEASUREMENT
/begin COMPU_METHOD CU_CCSOPRV2GTXREADYTOCHARGE "Conversion method for CcsOprV2gTxReadyToCharge" RAT_FUNC "%10.0" "b" COEFFS 0.000000 1.000000 -0.000000 0.000000 0.000000 1.000000 /end COMPU_METHOD
/* Scalar measurable for DDE 'CcsStmState'. */
/begin MEASUREMENT CcsStmState "enumerated state of state-machine that controls the sequence of charge seesion" SLONG CU_CCSSTMSTATE 1 100 -2147483648.0 2147483647.0 ECU_ADDRESS 0x70017dc8 BYTE_ORDER MSB_LAST /end MEASUREMENT
/begin COMPU_METHOD CU_CCSSTMSTATE "Conversion method for CcsStmState" TAB_VERB "%12.0" "enum" COMPU_TAB_REF CT_CCSSTMSTATE /end COMPU_METHOD
/begin COMPU_VTAB CT_CCSSTMSTATE "Conversion method for CcsStmState" TAB_VERB 45 0 "V2G_CHARGER_DISCON" 31 "V2G_WAITFOR_IDENTIFYING_CHG_MODE" 1 "V2G_ENABLE_QCA" 2 "V2G_INIT_SLAC_ASSOC" 3 "V2G_INIT_APP_PROTOCOL" 4 "V2G_INIT_SESSION_SETUP" 5 "V2G_INIT_SERVICE_DISCOV" 40 "V2G_INIT_SERVICE_DETAIL" 6 "V2G_INIT_PAYMENT_SEL" 7 "V2G_INIT_CONTRACT_AUTHEN" 8 "V2G_INIT_CHG_PARAM_DISCOV" 9 "V2G_INIT_CHG_INLET_LOCK_ENABLE" 10 "V2G_ISOL_EV_STOP_ISOL_MONITOR" 11 "V2G_ISOL_CABLE_CHECK" 12 "V2G_PRECHG_PRECHARGING" 13 "V2G_PRECHG_CLOSE_CHARGE_RELAYS" 14 "V2G_PRECHG_POWERDELIVERY" 15 "V2G_ENGYTRNSF_CRNT_DEMAND" 16 "V2G_NORMSHUTDN_POWERDELIVERY" 17 "V2G_NORMSHUTDN_WAIT_ZEROCURRENT" 18 "V2G_NORMSHUTDN_PILOT_B2" 19 "V2G_NORMSHUTDN_WELD_DETECT" 20 "V2G_NORMSHUTDN_OPEN_CHARGE_RELAYS" 21 "V2G_NORMSHUTDN_SESSION_STOP" 22 "V2G_NORMSHUTDN_TERMINATE_TCP_LINK" 23 "V2G_NORMSHUTDN_INLET_VOLT_SAFELEVEL" 24 "V2G_NORMSHUTDN_CHG_SESSION_COMPLETE" 25 "V2G_VEHSHUTDN_SESSION_STOP" 26 "V2G_VEHSHUTDN_TERMINATE_TCP_LINK" 27 "V2G_VEHSHUTDN_OPEN_CHARGE_RELAYS" 28 "V2G_VEHSHUTDN_COMPLETE" 29 "V2G_EVSESHUTDN_TERMINATE_TCP_LINK" 30 "V2G_EVSESHUTDN_OPEN_CHARGE_RELAYS" 32 "V2G_EVSESHUTDN_COMPLETE" 33 "V2G_AC_VERIFY_PROX_S3_CLOSED" 34 "V2G_AC_CLOSE_PILOT_S2_READY" 35 "V2G_AC_WAIT_EVSE_COTACTOR_CLOSE" 36 "V2G_AC_DRAW_ENERGY" 37 "V2G_AC_SHUTDN_WAIT_CRNT_ZERO" 38 "V2G_AC_SHUTDN_COMPLETE_WAIT_UNPLUG" 39 "V2G_AC_SHUTDN_UNEXPECTED_ERR" 41 "V2G_ENGYTRNSF_BPT" 42 "V2G_POWERDELIVERY_RENEG" 43 "V2G_CHG_PARAM_DISC_RENEG" 44 "V2G_ENGYTRNSF_ZEROCURRENT" /end COMPU_VTAB
/* Scalar measurable for DDE 'CcsStmV2gConnectInit'. */
/begin MEASUREMENT CcsStmV2gConnectInit "command for establishing the communication link with EVSE (EV-EVSE assosiation)." UBYTE CU_CCSSTMV2GCONNECTINIT 1 100 0.0 1.0 ECU_ADDRESS 0x70018209 BYTE_ORDER MSB_LAST /end MEASUREMENT
/begin COMPU_METHOD CU_CCSSTMV2GCONNECTINIT "Conversion method for CcsStmV2gConnectInit" RAT_FUNC "%10.0" "b" COEFFS 0.000000 1.000000 -0.000000 0.000000 0.000000 1.000000 /end COMPU_METHOD
/* Scalar measurable for DDE 'CcsStmV2gConnectTerminate'. */
/begin MEASUREMENT CcsStmV2gConnectTerminate "command for terminating the communication link with EVSE." UBYTE CU_CCSSTMV2GCONNECTTERMINATE 1 100 0.0 1.0 ECU_ADDRESS 0x70017d25 BYTE_ORDER MSB_LAST /end MEASUREMENT
/begin COMPU_METHOD CU_CCSSTMV2GCONNECTTERMINATE "Conversion method for CcsStmV2gConnectTerminate" RAT_FUNC "%10.0" "b" COEFFS 0.000000 1.000000 -0.000000 0.000000 0.000000 1.000000 /end COMPU_METHOD
/* Scalar measurable for DDE 'CcsStmV2gPilotPulldownEn'. */
/begin MEASUREMENT CcsStmV2gPilotPulldownEn "command for enabling the internal digital output for Pilot pulldown (According to SAE J1772 F.1.8 this means entering C or D mode for Piliot signal)" UBYTE CU_CCSSTMV2GPILOTPULLDOWNEN 1 100 0.0 1.0 ECU_ADDRESS 0x7001817d BYTE_ORDER MSB_LAST /end MEASUREMENT
/begin COMPU_METHOD CU_CCSSTMV2GPILOTPULLDOWNEN "Conversion method for CcsStmV2gPilotPulldownEn" RAT_FUNC "%10.0" "b" COEFFS 0.000000 1.000000 -0.000000 0.000000 0.000000 1.000000 /end COMPU_METHOD
/* Scalar measurable for DDE 'CcsStmV2gQcaEn'. */
/begin MEASUREMENT CcsStmV2gQcaEn "command for enabling the V2G QCA chip on the PCB board" UBYTE CU_CCSSTMV2GQCAEN 1 100 0.0 1.0 ECU_ADDRESS 0x70017c51 BYTE_ORDER MSB_LAST /end MEASUREMENT
/begin COMPU_METHOD CU_CCSSTMV2GQCAEN "Conversion method for CcsStmV2gQcaEn" RAT_FUNC "%10.0" "b" COEFFS 0.000000 1.000000 -0.000000 0.000000 0.000000 1.000000 /end COMPU_METHOD
/* Scalar measurable for DDE 'CcsStmV2gStMsgTx'. */
/begin MEASUREMENT CcsStmV2gStMsgTx "enumerated state of state-machine that controls the transmission of PLC messages to the EVSE" SLONG CU_CCSSTMV2GSTMSGTX 1 100 -2147483648.0 2147483647.0 ECU_ADDRESS 0x70018014 BYTE_ORDER MSB_LAST /end MEASUREMENT
/begin COMPU_METHOD CU_CCSSTMV2GSTMSGTX "Conversion method for CcsStmV2gStMsgTx" TAB_VERB "%12.0" "enum" COMPU_TAB_REF CT_CCSSTMV2GSTMSGTX /end COMPU_METHOD
/begin COMPU_VTAB CT_CCSSTMV2GSTMSGTX "Conversion method for CcsStmV2gStMsgTx" TAB_VERB 16 0 "V2G_MSGTX_RESEND" 1 "V2G_MSGTX_SEND_SESSETUP" 2 "V2G_MSGTX_SEND_SVCDISCV" 15 "V2G_MSGTX_SEND_SVCDETAIL" 3 "V2G_MSGTX_SEND_PMTSEL" 4 "V2G_MSGTX_SEND_AUTH" 5 "V2G_MSGTX_SEND_CHGPARDISC" 6 "V2G_MSGTX_SEND_CBLCHK" 7 "V2G_MSGTX_SEND_PRECHG" 8 "V2G_MSGTX_SEND_PWRDELIV" 9 "V2G_MSGTX_SEND_CRNTDMD" 10 "V2G_MSGTX_SEND_PWRDELIV_SHUTDN" 11 "V2G_MSGTX_SEND_WELDDET" 12 "V2G_MSGTX_SEND_SESSTOP" 13 "V2G_SEND_SUPPORTEDPROTO" 14 "V2G_SEND_ISO2_BPTCTRL" /end COMPU_VTAB
/* Scalar measurable for DDE 'CcsVersionMajor'. */
/begin MEASUREMENT CcsVersionMajor "Pi-CCS Major Version Number" UBYTE CU_CCSVERSIONMAJOR 1 100 0.0 255.0 ECU_ADDRESS 0x70018476 BYTE_ORDER MSB_LAST /end MEASUREMENT
/begin COMPU_METHOD CU_CCSVERSIONMAJOR "Conversion method for CcsVersionMajor" RAT_FUNC "%10.0" "1" COEFFS 0.000000 1.000000 -0.000000 0.000000 0.000000 1.000000 /end COMPU_METHOD
/* Scalar measurable for DDE 'CcsVersionMinor'. */
/begin MEASUREMENT CcsVersionMinor "Pi-CCS Minor Version Number" UBYTE CU_CCSVERSIONMINOR 1 100 0.0 255.0 ECU_ADDRESS 0x70017f6f BYTE_ORDER MSB_LAST /end MEASUREMENT
/begin COMPU_METHOD CU_CCSVERSIONMINOR "Conversion method for CcsVersionMinor" RAT_FUNC "%10.0" "1" COEFFS 0.000000 1.000000 -0.000000 0.000000 0.000000 1.000000 /end COMPU_METHOD
/* Scalar measurable for DDE 'CcsVersionSubMinor'. */
/begin MEASUREMENT CcsVersionSubMinor "Pi-CCS Sub minor Version Number" UBYTE CU_CCSVERSIONSUBMINOR 1 100 0.0 255.0 ECU_ADDRESS 0x700183b6 BYTE_ORDER MSB_LAST /end MEASUREMENT
/begin COMPU_METHOD CU_CCSVERSIONSUBMINOR "Conversion method for CcsVersionSubMinor" RAT_FUNC "%10.0" "1" COEFFS 0.000000 1.000000 -0.000000 0.000000 0.000000 1.000000 /end COMPU_METHOD
/* Scalar measurable for DDE 'V2gRxMsgCrntDmdCrntLimReached'. */
/begin MEASUREMENT V2gRxMsgCrntDmdCrntLimReached "If set to TRUE, the EVSE has reached its current limit." UBYTE CU_V2GRXMSGCRNTDMDCRNTLIMREACH0 1 100 0.0 1.0 ECU_ADDRESS 0x70017f20 BYTE_ORDER MSB_LAST /end MEASUREMENT
/begin COMPU_METHOD CU_V2GRXMSGCRNTDMDCRNTLIMREACH0 "Conversion method for V2gRxMsgCrntDmdCrntLimReached" RAT_FUNC "%10.0" "b" COEFFS 0.000000 1.000000 -0.000000 0.000000 0.000000 1.000000 /end COMPU_METHOD
/* Scalar measurable for DDE 'V2gRxMsgCrntDmdEvseCurrent'. */
/begin MEASUREMENT V2gRxMsgCrntDmdEvseCurrent "Present output current of the EVSE." FLOAT32_IEEE CU_V2GRXMSGCRNTDMDEVSECURRENT 1 100 0.0 196605.0 ECU_ADDRESS 0x700182ac BYTE_ORDER MSB_LAST /end MEASUREMENT
/begin COMPU_METHOD CU_V2GRXMSGCRNTDMDEVSECURRENT "Conversion method for V2gRxMsgCrntDmdEvseCurrent" RAT_FUNC "%10.0" "A" COEFFS 0.000000 1.000000 -0.000000 0.000000 0.000000 1.000000 /end COMPU_METHOD
/* Scalar measurable for DDE 'V2gRxMsgCrntDmdEvseIdLen'. */
/begin MEASUREMENT V2gRxMsgCrntDmdEvseIdLen "Number of bytes in EVSE ID" UBYTE CU_V2GRXMSGCRNTDMDEVSEIDLEN 1 100 0.0 37.0 ECU_ADDRESS 0x700183a2 BYTE_ORDER MSB_LAST /end MEASUREMENT
/begin COMPU_METHOD CU_V2GRXMSGCRNTDMDEVSEIDLEN "Conversion method for V2gRxMsgCrntDmdEvseIdLen" RAT_FUNC "%10.0" "1" COEFFS 0.000000 1.000000 -0.000000 0.000000 0.000000 1.000000 /end COMPU_METHOD
/* Scalar measurable for DDE 'V2gRxMsgCrntDmdEvseId[0]'. */
/begin MEASUREMENT V2gRxMsgCrntDmdEvseId[0] "The ID that uniquely identifies the EVSE. Format is defined in DIN SPEC 91286" UBYTE CU_V2GRXMSGCRNTDMDEVSEID[0] 1 100 0.0 255.0 ECU_ADDRESS 0x7001805c BYTE_ORDER MSB_LAST /end MEASUREMENT
/begin COMPU_METHOD CU_V2GRXMSGCRNTDMDEVSEID[0] "Conversion method for V2gRxMsgCrntDmdEvseId[0]" RAT_FUNC "%10.0" "1" COEFFS 0.000000 1.000000 -0.000000 0.000000 0.000000 1.000000 /end COMPU_METHOD
/* Scalar measurable for DDE 'V2gRxMsgCrntDmdEvseId[10]'. */
/begin MEASUREMENT V2gRxMsgCrntDmdEvseId[10] "The ID that uniquely identifies the EVSE. Format is defined in DIN SPEC 91286" UBYTE CU_V2GRXMSGCRNTDMDEVSEID[10] 1 100 0.0 255.0 ECU_ADDRESS 0x70018066 BYTE_ORDER MSB_LAST /end MEASUREMENT
/begin COMPU_METHOD CU_V2GRXMSGCRNTDMDEVSEID[10] "Conversion method for V2gRxMsgCrntDmdEvseId[10]" RAT_FUNC "%10.0" "1" COEFFS 0.000000 1.000000 -0.000000 0.000000 0.000000 1.000000 /end COMPU_METHOD
/* Scalar measurable for DDE 'V2gRxMsgCrntDmdEvseId[11]'. */
/begin MEASUREMENT V2gRxMsgCrntDmdEvseId[11] "The ID that uniquely identifies the EVSE. Format is defined in DIN SPEC 91286" UBYTE CU_V2GRXMSGCRNTDMDEVSEID[11] 1 100 0.0 255.0 ECU_ADDRESS 0x70018067 BYTE_ORDER MSB_LAST /end MEASUREMENT
/begin COMPU_METHOD CU_V2GRXMSGCRNTDMDEVSEID[11] "Conversion method for V2gRxMsgCrntDmdEvseId[11]" RAT_FUNC "%10.0" "1" COEFFS 0.000000 1.000000 -0.000000 0.000000 0.000000 1.000000 /end COMPU_METHOD
/* Scalar measurable for DDE 'V2gRxMsgCrntDmdEvseId[12]'. */
/begin MEASUREMENT V2gRxMsgCrntDmdEvseId[12] "The ID that uniquely identifies the EVSE. Format is defined in DIN SPEC 91286" UBYTE CU_V2GRXMSGCRNTDMDEVSEID[12] 1 100 0.0 255.0 ECU_ADDRESS 0x70018068 BYTE_ORDER MSB_LAST /end MEASUREMENT
/begin COMPU_METHOD CU_V2GRXMSGCRNTDMDEVSEID[12] "Conversion method for V2gRxMsgCrntDmdEvseId[12]" RAT_FUNC "%10.0" "1" COEFFS 0.000000 1.000000 -0.000000 0.000000 0.000000 1.000000 /end COMPU_METHOD
/* Scalar measurable for DDE 'V2gRxMsgCrntDmdEvseId[13]'. */
/begin MEASUREMENT V2gRxMsgCrntDmdEvseId[13] "The ID that uniquely identifies the EVSE. Format is defined in DIN SPEC 91286" UBYTE CU_V2GRXMSGCRNTDMDEVSEID[13] 1 100 0.0 255.0 ECU_ADDRESS 0x70018069 BYTE_ORDER MSB_LAST /end MEASUREMENT
/begin COMPU_METHOD CU_V2GRXMSGCRNTDMDEVSEID[13] "Conversion method for V2gRxMsgCrntDmdEvseId[13]" RAT_FUNC "%10.0" "1" COEFFS 0.000000 1.000000 -0.000000 0.000000 0.000000 1.000000 /end COMPU_METHOD
/* Scalar measurable for DDE 'V2gRxMsgCrntDmdEvseId[14]'. */
/begin MEASUREMENT V2gRxMsgCrntDmdEvseId[14] "The ID that uniquely identifies the EVSE. Format is defined in DIN SPEC 91286" UBYTE CU_V2GRXMSGCRNTDMDEVSEID[14] 1 100 0.0 255.0 ECU_ADDRESS 0x7001806a BYTE_ORDER MSB_LAST /end MEASUREMENT
/begin COMPU_METHOD CU_V2GRXMSGCRNTDMDEVSEID[14] "Conversion method for V2gRxMsgCrntDmdEvseId[14]" RAT_FUNC "%10.0" "1" COEFFS 0.000000 1.000000 -0.000000 0.000000 0.000000 1.000000 /end COMPU_METHOD
/* Scalar measurable for DDE 'V2gRxMsgCrntDmdEvseId[15]'. */
/begin MEASUREMENT V2gRxMsgCrntDmdEvseId[15] "The ID that uniquely identifies the EVSE. Format is defined in DIN SPEC 91286" UBYTE CU_V2GRXMSGCRNTDMDEVSEID[15] 1 100 0.0 255.0 ECU_ADDRESS 0x7001806b BYTE_ORDER MSB_LAST /end MEASUREMENT
/begin COMPU_METHOD CU_V2GRXMSGCRNTDMDEVSEID[15] "Conversion method for V2gRxMsgCrntDmdEvseId[15]" RAT_FUNC "%10.0" "1" COEFFS 0.000000 1.000000 -0.000000 0.000000 0.000000 1.000000 /end COMPU_METHOD
/* Scalar measurable for DDE 'V2gRxMsgCrntDmdEvseId[16]'. */
/begin MEASUREMENT V2gRxMsgCrntDmdEvseId[16] "The ID that uniquely identifies the EVSE. Format is defined in DIN SPEC 91286" UBYTE CU_V2GRXMSGCRNTDMDEVSEID[16] 1 100 0.0 255.0 ECU_ADDRESS 0x7001806c BYTE_ORDER MSB_LAST /end MEASUREMENT
/begin COMPU_METHOD CU_V2GRXMSGCRNTDMDEVSEID[16] "Conversion method for V2gRxMsgCrntDmdEvseId[16]" RAT_FUNC "%10.0" "1" COEFFS 0.000000 1.000000 -0.000000 0.000000 0.000000 1.000000 /end COMPU_METHOD
/* Scalar measurable for DDE 'V2gRxMsgCrntDmdEvseId[17]'. */
/begin MEASUREMENT V2gRxMsgCrntDmdEvseId[17] "The ID that uniquely identifies the EVSE. Format is defined in DIN SPEC 91286" UBYTE CU_V2GRXMSGCRNTDMDEVSEID[17] 1 100 0.0 255.0 ECU_ADDRESS 0x7001806d BYTE_ORDER MSB_LAST /end MEASUREMENT
/begin COMPU_METHOD CU_V2GRXMSGCRNTDMDEVSEID[17] "Conversion method for V2gRxMsgCrntDmdEvseId[17]" RAT_FUNC "%10.0" "1" COEFFS 0.000000 1.000000 -0.000000 0.000000 0.000000 1.000000 /end COMPU_METHOD
/* Scalar measurable for DDE 'V2gRxMsgCrntDmdEvseId[18]'. */
/begin MEASUREMENT V2gRxMsgCrntDmdEvseId[18] "The ID that uniquely identifies the EVSE. Format is defined in DIN SPEC 91286" UBYTE CU_V2GRXMSGCRNTDMDEVSEID[18] 1 100 0.0 255.0 ECU_ADDRESS 0x7001806e BYTE_ORDER MSB_LAST /end MEASUREMENT
/begin COMPU_METHOD CU_V2GRXMSGCRNTDMDEVSEID[18] "Conversion method for V2gRxMsgCrntDmdEvseId[18]" RAT_FUNC "%10.0" "1" COEFFS 0.000000 1.000000 -0.000000 0.000000 0.000000 1.000000 /end COMPU_METHOD
/* Scalar measurable for DDE 'V2gRxMsgCrntDmdEvseId[19]'. */
/begin MEASUREMENT V2gRxMsgCrntDmdEvseId[19] "The ID that uniquely identifies the EVSE. Format is defined in DIN SPEC 91286" UBYTE CU_V2GRXMSGCRNTDMDEVSEID[19] 1 100 0.0 255.0 ECU_ADDRESS 0x7001806f BYTE_ORDER MSB_LAST /end MEASUREMENT
/begin COMPU_METHOD CU_V2GRXMSGCRNTDMDEVSEID[19] "Conversion method for V2gRxMsgCrntDmdEvseId[19]" RAT_FUNC "%10.0" "1" COEFFS 0.000000 1.000000 -0.000000 0.000000 0.000000 1.000000 /end COMPU_METHOD
/* Scalar measurable for DDE 'V2gRxMsgCrntDmdEvseId[1]'. */
/begin MEASUREMENT V2gRxMsgCrntDmdEvseId[1] "The ID that uniquely identifies the EVSE. Format is defined in DIN SPEC 91286" UBYTE CU_V2GRXMSGCRNTDMDEVSEID[1] 1 100 0.0 255.0 ECU_ADDRESS 0x7001805d BYTE_ORDER MSB_LAST /end MEASUREMENT
/begin COMPU_METHOD CU_V2GRXMSGCRNTDMDEVSEID[1] "Conversion method for V2gRxMsgCrntDmdEvseId[1]" RAT_FUNC "%10.0" "1" COEFFS 0.000000 1.000000 -0.000000 0.000000 0.000000 1.000000 /end COMPU_METHOD
/* Scalar measurable for DDE 'V2gRxMsgCrntDmdEvseId[20]'. */
/begin MEASUREMENT V2gRxMsgCrntDmdEvseId[20] "The ID that uniquely identifies the EVSE. Format is defined in DIN SPEC 91286" UBYTE CU_V2GRXMSGCRNTDMDEVSEID[20] 1 100 0.0 255.0 ECU_ADDRESS 0x70018070 BYTE_ORDER MSB_LAST /end MEASUREMENT
/begin COMPU_METHOD CU_V2GRXMSGCRNTDMDEVSEID[20] "Conversion method for V2gRxMsgCrntDmdEvseId[20]" RAT_FUNC "%10.0" "1" COEFFS 0.000000 1.000000 -0.000000 0.000000 0.000000 1.000000 /end COMPU_METHOD
/* Scalar measurable for DDE 'V2gRxMsgCrntDmdEvseId[21]'. */
/begin MEASUREMENT V2gRxMsgCrntDmdEvseId[21] "The ID that uniquely identifies the EVSE. Format is defined in DIN SPEC 91286" UBYTE CU_V2GRXMSGCRNTDMDEVSEID[21] 1 100 0.0 255.0 ECU_ADDRESS 0x70018071 BYTE_ORDER MSB_LAST /end MEASUREMENT
/begin COMPU_METHOD CU_V2GRXMSGCRNTDMDEVSEID[21] "Conversion method for V2gRxMsgCrntDmdEvseId[21]" RAT_FUNC "%10.0" "1" COEFFS 0.000000 1.000000 -0.000000 0.000000 0.000000 1.000000 /end COMPU_METHOD
/* Scalar measurable for DDE 'V2gRxMsgCrntDmdEvseId[22]'. */
/begin MEASUREMENT V2gRxMsgCrntDmdEvseId[22] "The ID that uniquely identifies the EVSE. Format is defined in DIN SPEC 91286" UBYTE CU_V2GRXMSGCRNTDMDEVSEID[22] 1 100 0.0 255.0 ECU_ADDRESS 0x70018072 BYTE_ORDER MSB_LAST /end MEASUREMENT
/begin COMPU_METHOD CU_V2GRXMSGCRNTDMDEVSEID[22] "Conversion method for V2gRxMsgCrntDmdEvseId[22]" RAT_FUNC "%10.0" "1" COEFFS 0.000000 1.000000 -0.000000 0.000000 0.000000 1.000000 /end COMPU_METHOD
/* Scalar measurable for DDE 'V2gRxMsgCrntDmdEvseId[23]'. */
/begin MEASUREMENT V2gRxMsgCrntDmdEvseId[23] "The ID that uniquely identifies the EVSE. Format is defined in DIN SPEC 91286" UBYTE CU_V2GRXMSGCRNTDMDEVSEID[23] 1 100 0.0 255.0 ECU_ADDRESS 0x70018073 BYTE_ORDER MSB_LAST /end MEASUREMENT
/begin COMPU_METHOD CU_V2GRXMSGCRNTDMDEVSEID[23] "Conversion method for V2gRxMsgCrntDmdEvseId[23]" RAT_FUNC "%10.0" "1" COEFFS 0.000000 1.000000 -0.000000 0.000000 0.000000 1.000000 /end COMPU_METHOD
/* Scalar measurable for DDE 'V2gRxMsgCrntDmdEvseId[24]'. */
/begin MEASUREMENT V2gRxMsgCrntDmdEvseId[24] "The ID that uniquely identifies the EVSE. Format is defined in DIN SPEC 91286" UBYTE CU_V2GRXMSGCRNTDMDEVSEID[24] 1 100 0.0 255.0 ECU_ADDRESS 0x70018074 BYTE_ORDER MSB_LAST /end MEASUREMENT
/begin COMPU_METHOD CU_V2GRXMSGCRNTDMDEVSEID[24] "Conversion method for V2gRxMsgCrntDmdEvseId[24]" RAT_FUNC "%10.0" "1" COEFFS 0.000000 1.000000 -0.000000 0.000000 0.000000 1.000000 /end COMPU_METHOD
/* Scalar measurable for DDE 'V2gRxMsgCrntDmdEvseId[25]'. */
/begin MEASUREMENT V2gRxMsgCrntDmdEvseId[25] "The ID that uniquely identifies the EVSE. Format is defined in DIN SPEC 91286" UBYTE CU_V2GRXMSGCRNTDMDEVSEID[25] 1 100 0.0 255.0 ECU_ADDRESS 0x70018075 BYTE_ORDER MSB_LAST /end MEASUREMENT
/begin COMPU_METHOD CU_V2GRXMSGCRNTDMDEVSEID[25] "Conversion method for V2gRxMsgCrntDmdEvseId[25]" RAT_FUNC "%10.0" "1" COEFFS 0.000000 1.000000 -0.000000 0.000000 0.000000 1.000000 /end COMPU_METHOD
/* Scalar measurable for DDE 'V2gRxMsgCrntDmdEvseId[26]'. */
/begin MEASUREMENT V2gRxMsgCrntDmdEvseId[26] "The ID that uniquely identifies the EVSE. Format is defined in DIN SPEC 91286" UBYTE CU_V2GRXMSGCRNTDMDEVSEID[26] 1 100 0.0 255.0 ECU_ADDRESS 0x70018076 BYTE_ORDER MSB_LAST /end MEASUREMENT
/begin COMPU_METHOD CU_V2GRXMSGCRNTDMDEVSEID[26] "Conversion method for V2gRxMsgCrntDmdEvseId[26]" RAT_FUNC "%10.0" "1" COEFFS 0.000000 1.000000 -0.000000 0.000000 0.000000 1.000000 /end COMPU_METHOD
/* Scalar measurable for DDE 'V2gRxMsgCrntDmdEvseId[27]'. */
/begin MEASUREMENT V2gRxMsgCrntDmdEvseId[27] "The ID that uniquely identifies the EVSE. Format is defined in DIN SPEC 91286" UBYTE CU_V2GRXMSGCRNTDMDEVSEID[27] 1 100 0.0 255.0 ECU_ADDRESS 0x70018077 BYTE_ORDER MSB_LAST /end MEASUREMENT
/begin COMPU_METHOD CU_V2GRXMSGCRNTDMDEVSEID[27] "Conversion method for V2gRxMsgCrntDmdEvseId[27]" RAT_FUNC "%10.0" "1" COEFFS 0.000000 1.000000 -0.000000 0.000000 0.000000 1.000000 /end COMPU_METHOD
/* Scalar measurable for DDE 'V2gRxMsgCrntDmdEvseId[28]'. */
/begin MEASUREMENT V2gRxMsgCrntDmdEvseId[28] "The ID that uniquely identifies the EVSE. Format is defined in DIN SPEC 91286" UBYTE CU_V2GRXMSGCRNTDMDEVSEID[28] 1 100 0.0 255.0 ECU_ADDRESS 0x70018078 BYTE_ORDER MSB_LAST /end MEASUREMENT
/begin COMPU_METHOD CU_V2GRXMSGCRNTDMDEVSEID[28] "Conversion method for V2gRxMsgCrntDmdEvseId[28]" RAT_FUNC "%10.0" "1" COEFFS 0.000000 1.000000 -0.000000 0.000000 0.000000 1.000000 /end COMPU_METHOD
/* Scalar measurable for DDE 'V2gRxMsgCrntDmdEvseId[29]'. */
/begin MEASUREMENT V2gRxMsgCrntDmdEvseId[29] "The ID that uniquely identifies the EVSE. Format is defined in DIN SPEC 91286" UBYTE CU_V2GRXMSGCRNTDMDEVSEID[29] 1 100 0.0 255.0 ECU_ADDRESS 0x70018079 BYTE_ORDER MSB_LAST /end MEASUREMENT
/begin COMPU_METHOD CU_V2GRXMSGCRNTDMDEVSEID[29] "Conversion method for V2gRxMsgCrntDmdEvseId[29]" RAT_FUNC "%10.0" "1" COEFFS 0.000000 1.000000 -0.000000 0.000000 0.000000 1.000000 /end COMPU_METHOD
/* Scalar measurable for DDE 'V2gRxMsgCrntDmdEvseId[2]'. */
/begin MEASUREMENT V2gRxMsgCrntDmdEvseId[2] "The ID that uniquely identifies the EVSE. Format is defined in DIN SPEC 91286" UBYTE CU_V2GRXMSGCRNTDMDEVSEID[2] 1 100 0.0 255.0 ECU_ADDRESS 0x7001805e BYTE_ORDER MSB_LAST /end MEASUREMENT
/begin COMPU_METHOD CU_V2GRXMSGCRNTDMDEVSEID[2] "Conversion method for V2gRxMsgCrntDmdEvseId[2]" RAT_FUNC "%10.0" "1" COEFFS 0.000000 1.000000 -0.000000 0.000000 0.000000 1.000000 /end COMPU_METHOD
/* Scalar measurable for DDE 'V2gRxMsgCrntDmdEvseId[30]'. */
/begin MEASUREMENT V2gRxMsgCrntDmdEvseId[30] "The ID that uniquely identifies the EVSE. Format is defined in DIN SPEC 91286" UBYTE CU_V2GRXMSGCRNTDMDEVSEID[30] 1 100 0.0 255.0 ECU_ADDRESS 0x7001807a BYTE_ORDER MSB_LAST /end MEASUREMENT
/begin COMPU_METHOD CU_V2GRXMSGCRNTDMDEVSEID[30] "Conversion method for V2gRxMsgCrntDmdEvseId[30]" RAT_FUNC "%10.0" "1" COEFFS 0.000000 1.000000 -0.000000 0.000000 0.000000 1.000000 /end COMPU_METHOD
/* Scalar measurable for DDE 'V2gRxMsgCrntDmdEvseId[31]'. */
/begin MEASUREMENT V2gRxMsgCrntDmdEvseId[31] "The ID that uniquely identifies the EVSE. Format is defined in DIN SPEC 91286" UBYTE CU_V2GRXMSGCRNTDMDEVSEID[31] 1 100 0.0 255.0 ECU_ADDRESS 0x7001807b BYTE_ORDER MSB_LAST /end MEASUREMENT
/begin COMPU_METHOD CU_V2GRXMSGCRNTDMDEVSEID[31] "Conversion method for V2gRxMsgCrntDmdEvseId[31]" RAT_FUNC "%10.0" "1" COEFFS 0.000000 1.000000 -0.000000 0.000000 0.000000 1.000000 /end COMPU_METHOD
/* Scalar measurable for DDE 'V2gRxMsgCrntDmdEvseId[32]'. */
/begin MEASUREMENT V2gRxMsgCrntDmdEvseId[32] "The ID that uniquely identifies the EVSE. Format is defined in DIN SPEC 91286" UBYTE CU_V2GRXMSGCRNTDMDEVSEID[32] 1 100 0.0 255.0 ECU_ADDRESS 0x7001807c BYTE_ORDER MSB_LAST /end MEASUREMENT
/begin COMPU_METHOD CU_V2GRXMSGCRNTDMDEVSEID[32] "Conversion method for V2gRxMsgCrntDmdEvseId[32]" RAT_FUNC "%10.0" "1" COEFFS 0.000000 1.000000 -0.000000 0.000000 0.000000 1.000000 /end COMPU_METHOD
/* Scalar measurable for DDE 'V2gRxMsgCrntDmdEvseId[33]'. */
/begin MEASUREMENT V2gRxMsgCrntDmdEvseId[33] "The ID that uniquely identifies the EVSE. Format is defined in DIN SPEC 91286" UBYTE CU_V2GRXMSGCRNTDMDEVSEID[33] 1 100 0.0 255.0 ECU_ADDRESS 0x7001807d BYTE_ORDER MSB_LAST /end MEASUREMENT
/begin COMPU_METHOD CU_V2GRXMSGCRNTDMDEVSEID[33] "Conversion method for V2gRxMsgCrntDmdEvseId[33]" RAT_FUNC "%10.0" "1" COEFFS 0.000000 1.000000 -0.000000 0.000000 0.000000 1.000000 /end COMPU_METHOD
/* Scalar measurable for DDE 'V2gRxMsgCrntDmdEvseId[34]'. */
/begin MEASUREMENT V2gRxMsgCrntDmdEvseId[34] "The ID that uniquely identifies the EVSE. Format is defined in DIN SPEC 91286" UBYTE CU_V2GRXMSGCRNTDMDEVSEID[34] 1 100 0.0 255.0 ECU_ADDRESS 0x7001807e BYTE_ORDER MSB_LAST /end MEASUREMENT
/begin COMPU_METHOD CU_V2GRXMSGCRNTDMDEVSEID[34] "Conversion method for V2gRxMsgCrntDmdEvseId[34]" RAT_FUNC "%10.0" "1" COEFFS 0.000000 1.000000 -0.000000 0.000000 0.000000 1.000000 /end COMPU_METHOD
/* Scalar measurable for DDE 'V2gRxMsgCrntDmdEvseId[35]'. */
/begin MEASUREMENT V2gRxMsgCrntDmdEvseId[35] "The ID that uniquely identifies the EVSE. Format is defined in DIN SPEC 91286" UBYTE CU_V2GRXMSGCRNTDMDEVSEID[35] 1 100 0.0 255.0 ECU_ADDRESS 0x7001807f BYTE_ORDER MSB_LAST /end MEASUREMENT
/begin COMPU_METHOD CU_V2GRXMSGCRNTDMDEVSEID[35] "Conversion method for V2gRxMsgCrntDmdEvseId[35]" RAT_FUNC "%10.0" "1" COEFFS 0.000000 1.000000 -0.000000 0.000000 0.000000 1.000000 /end COMPU_METHOD
/* Scalar measurable for DDE 'V2gRxMsgCrntDmdEvseId[36]'. */
/begin MEASUREMENT V2gRxMsgCrntDmdEvseId[36] "The ID that uniquely identifies the EVSE. Format is defined in DIN SPEC 91286" UBYTE CU_V2GRXMSGCRNTDMDEVSEID[36] 1 100 0.0 255.0 ECU_ADDRESS 0x70018080 BYTE_ORDER MSB_LAST /end MEASUREMENT
/begin COMPU_METHOD CU_V2GRXMSGCRNTDMDEVSEID[36] "Conversion method for V2gRxMsgCrntDmdEvseId[36]" RAT_FUNC "%10.0" "1" COEFFS 0.000000 1.000000 -0.000000 0.000000 0.000000 1.000000 /end COMPU_METHOD
/* Scalar measurable for DDE 'V2gRxMsgCrntDmdEvseId[37]'. */
/begin MEASUREMENT V2gRxMsgCrntDmdEvseId[37] "The ID that uniquely identifies the EVSE. Format is defined in DIN SPEC 91286" UBYTE CU_V2GRXMSGCRNTDMDEVSEID[37] 1 100 0.0 255.0 ECU_ADDRESS 0x70018081 BYTE_ORDER MSB_LAST /end MEASUREMENT
/begin COMPU_METHOD CU_V2GRXMSGCRNTDMDEVSEID[37] "Conversion method for V2gRxMsgCrntDmdEvseId[37]" RAT_FUNC "%10.0" "1" COEFFS 0.000000 1.000000 -0.000000 0.000000 0.000000 1.000000 /end COMPU_METHOD
/* Scalar measurable for DDE 'V2gRxMsgCrntDmdEvseId[3]'. */
/begin MEASUREMENT V2gRxMsgCrntDmdEvseId[3] "The ID that uniquely identifies the EVSE. Format is defined in DIN SPEC 91286" UBYTE CU_V2GRXMSGCRNTDMDEVSEID[3] 1 100 0.0 255.0 ECU_ADDRESS 0x7001805f BYTE_ORDER MSB_LAST /end MEASUREMENT
/begin COMPU_METHOD CU_V2GRXMSGCRNTDMDEVSEID[3] "Conversion method for V2gRxMsgCrntDmdEvseId[3]" RAT_FUNC "%10.0" "1" COEFFS 0.000000 1.000000 -0.000000 0.000000 0.000000 1.000000 /end COMPU_METHOD
/* Scalar measurable for DDE 'V2gRxMsgCrntDmdEvseId[4]'. */
/begin MEASUREMENT V2gRxMsgCrntDmdEvseId[4] "The ID that uniquely identifies the EVSE. Format is defined in DIN SPEC 91286" UBYTE CU_V2GRXMSGCRNTDMDEVSEID[4] 1 100 0.0 255.0 ECU_ADDRESS 0x70018060 BYTE_ORDER MSB_LAST /end MEASUREMENT
/begin COMPU_METHOD CU_V2GRXMSGCRNTDMDEVSEID[4] "Conversion method for V2gRxMsgCrntDmdEvseId[4]" RAT_FUNC "%10.0" "1" COEFFS 0.000000 1.000000 -0.000000 0.000000 0.000000 1.000000 /end COMPU_METHOD
/* Scalar measurable for DDE 'V2gRxMsgCrntDmdEvseId[5]'. */
/begin MEASUREMENT V2gRxMsgCrntDmdEvseId[5] "The ID that uniquely identifies the EVSE. Format is defined in DIN SPEC 91286" UBYTE CU_V2GRXMSGCRNTDMDEVSEID[5] 1 100 0.0 255.0 ECU_ADDRESS 0x70018061 BYTE_ORDER MSB_LAST /end MEASUREMENT
/begin COMPU_METHOD CU_V2GRXMSGCRNTDMDEVSEID[5] "Conversion method for V2gRxMsgCrntDmdEvseId[5]" RAT_FUNC "%10.0" "1" COEFFS 0.000000 1.000000 -0.000000 0.000000 0.000000 1.000000 /end COMPU_METHOD
/* Scalar measurable for DDE 'V2gRxMsgCrntDmdEvseId[6]'. */
/begin MEASUREMENT V2gRxMsgCrntDmdEvseId[6] "The ID that uniquely identifies the EVSE. Format is defined in DIN SPEC 91286" UBYTE CU_V2GRXMSGCRNTDMDEVSEID[6] 1 100 0.0 255.0 ECU_ADDRESS 0x70018062 BYTE_ORDER MSB_LAST /end MEASUREMENT
/begin COMPU_METHOD CU_V2GRXMSGCRNTDMDEVSEID[6] "Conversion method for V2gRxMsgCrntDmdEvseId[6]" RAT_FUNC "%10.0" "1" COEFFS 0.000000 1.000000 -0.000000 0.000000 0.000000 1.000000 /end COMPU_METHOD
/* Scalar measurable for DDE 'V2gRxMsgCrntDmdEvseId[7]'. */
/begin MEASUREMENT V2gRxMsgCrntDmdEvseId[7] "The ID that uniquely identifies the EVSE. Format is defined in DIN SPEC 91286" UBYTE CU_V2GRXMSGCRNTDMDEVSEID[7] 1 100 0.0 255.0 ECU_ADDRESS 0x70018063 BYTE_ORDER MSB_LAST /end MEASUREMENT
/begin COMPU_METHOD CU_V2GRXMSGCRNTDMDEVSEID[7] "Conversion method for V2gRxMsgCrntDmdEvseId[7]" RAT_FUNC "%10.0" "1" COEFFS 0.000000 1.000000 -0.000000 0.000000 0.000000 1.000000 /end COMPU_METHOD
/* Scalar measurable for DDE 'V2gRxMsgCrntDmdEvseId[8]'. */
/begin MEASUREMENT V2gRxMsgCrntDmdEvseId[8] "The ID that uniquely identifies the EVSE. Format is defined in DIN SPEC 91286" UBYTE CU_V2GRXMSGCRNTDMDEVSEID[8] 1 100 0.0 255.0 ECU_ADDRESS 0x70018064 BYTE_ORDER MSB_LAST /end MEASUREMENT
/begin COMPU_METHOD CU_V2GRXMSGCRNTDMDEVSEID[8] "Conversion method for V2gRxMsgCrntDmdEvseId[8]" RAT_FUNC "%10.0" "1" COEFFS 0.000000 1.000000 -0.000000 0.000000 0.000000 1.000000 /end COMPU_METHOD
/* Scalar measurable for DDE 'V2gRxMsgCrntDmdEvseId[9]'. */
/begin MEASUREMENT V2gRxMsgCrntDmdEvseId[9] "The ID that uniquely identifies the EVSE. Format is defined in DIN SPEC 91286" UBYTE CU_V2GRXMSGCRNTDMDEVSEID[9] 1 100 0.0 255.0 ECU_ADDRESS 0x70018065 BYTE_ORDER MSB_LAST /end MEASUREMENT
/begin COMPU_METHOD CU_V2GRXMSGCRNTDMDEVSEID[9] "Conversion method for V2gRxMsgCrntDmdEvseId[9]" RAT_FUNC "%10.0" "1" COEFFS 0.000000 1.000000 -0.000000 0.000000 0.000000 1.000000 /end COMPU_METHOD
/* Scalar measurable for DDE 'V2gRxMsgCrntDmdEvseStatus'. */
/begin MEASUREMENT V2gRxMsgCrntDmdEvseStatus "Indicates the internal state of the EVSE." SLONG CU_V2GRXMSGCRNTDMDEVSESTATUS 1 100 -2147483648.0 2147483647.0 ECU_ADDRESS 0x700181d4 BYTE_ORDER MSB_LAST /end MEASUREMENT
/begin COMPU_METHOD CU_V2GRXMSGCRNTDMDEVSESTATUS "Conversion method for V2gRxMsgCrntDmdEvseStatus" TAB_VERB "%12.0" "enum" COMPU_TAB_REF CT_V2GRXMSGCRNTDMDEVSESTATUS /end COMPU_METHOD
/begin COMPU_VTAB CT_V2GRXMSGCRNTDMDEVSESTATUS "Conversion method for V2gRxMsgCrntDmdEvseStatus" TAB_VERB 12 0 "EVSE_NOT_READY" 1 "EVSE_READY" 2 "EVSE_SHUTDOWN" 3 "EVSE_UTILITY_INTERRUPT" 4 "EVSE_ISOLATION_MONITOR_ACTV" 5 "EVSE_EMERGENCY_SHUTDOWN" 6 "EVSE_MALFUNCTION" 7 "EVSE_STATUS_RESERVED1" 8 "EVSE_STATUS_RESERVED2" 9 "EVSE_STATUS_RESERVED3" 10 "EVSE_STATUS_RESERVED4" 11 "EVSE_STATUS_RESERVED5" /end COMPU_VTAB
/* Scalar measurable for DDE 'V2gRxMsgCrntDmdEvseVoltage'. */
/begin MEASUREMENT V2gRxMsgCrntDmdEvseVoltage "Present voltage of EVSE" FLOAT32_IEEE CU_V2GRXMSGCRNTDMDEVSEVOLTAGE 1 100 0.0 196605.0 ECU_ADDRESS 0x700184a0 BYTE_ORDER MSB_LAST /end MEASUREMENT
/begin COMPU_METHOD CU_V2GRXMSGCRNTDMDEVSEVOLTAGE "Conversion method for V2gRxMsgCrntDmdEvseVoltage" RAT_FUNC "%10.0" "V" COEFFS 0.000000 1.000000 -0.000000 0.000000 0.000000 1.000000 /end COMPU_METHOD
/* Scalar measurable for DDE 'V2gRxMsgCrntDmdIsolStatus'. */
/begin MEASUREMENT V2gRxMsgCrntDmdIsolStatus "Indicates the isolation condition" SLONG CU_V2GRXMSGCRNTDMDISOLSTATUS 1 100 -2147483648.0 2147483647.0 ECU_ADDRESS 0x700182dc BYTE_ORDER MSB_LAST /end MEASUREMENT
/begin COMPU_METHOD CU_V2GRXMSGCRNTDMDISOLSTATUS "Conversion method for V2gRxMsgCrntDmdIsolStatus" TAB_VERB "%12.0" "enum" COMPU_TAB_REF CT_V2GRXMSGCRNTDMDISOLSTATUS /end COMPU_METHOD
/begin COMPU_VTAB CT_V2GRXMSGCRNTDMDISOLSTATUS "Conversion method for V2gRxMsgCrntDmdIsolStatus" TAB_VERB 4 0 "ISOLATION_INVALID" 1 "ISOLATION_VALID" 2 "ISOLATION_WARNING" 3 "ISOLATION_FAULT" /end COMPU_VTAB
/* Scalar measurable for DDE 'V2gRxMsgCrntDmdIsolStatus_flg'. */
/begin MEASUREMENT V2gRxMsgCrntDmdIsolStatus_flg "Identifies the presence of the EVSEIsolationStatus parameter." UBYTE CU_V2GRXMSGCRNTDMDISOLSTATUS_F0 1 100 0.0 1.0 ECU_ADDRESS 0x70017db2 BYTE_ORDER MSB_LAST /end MEASUREMENT
/begin COMPU_METHOD CU_V2GRXMSGCRNTDMDISOLSTATUS_F0 "Conversion method for V2gRxMsgCrntDmdIsolStatus_flg" RAT_FUNC "%10.0" "b" COEFFS 0.000000 1.000000 -0.000000 0.000000 0.000000 1.000000 /end COMPU_METHOD
/* Scalar measurable for DDE 'V2gRxMsgCrntDmdMaxCrnt'. */
/begin MEASUREMENT V2gRxMsgCrntDmdMaxCrnt "Maximum current the EVSE can deliver" FLOAT32_IEEE CU_V2GRXMSGCRNTDMDMAXCRNT 1 100 0.0 196605.0 ECU_ADDRESS 0x7001848c BYTE_ORDER MSB_LAST /end MEASUREMENT
/begin COMPU_METHOD CU_V2GRXMSGCRNTDMDMAXCRNT "Conversion method for V2gRxMsgCrntDmdMaxCrnt" RAT_FUNC "%10.0" "A" COEFFS 0.000000 1.000000 -0.000000 0.000000 0.000000 1.000000 /end COMPU_METHOD
/* Scalar measurable for DDE 'V2gRxMsgCrntDmdMaxCrnt_flg'. */
/begin MEASUREMENT V2gRxMsgCrntDmdMaxCrnt_flg "Indicates that the EVSEMaximumCurrentLimit parameter is available." UBYTE CU_V2GRXMSGCRNTDMDMAXCRNT_FLG 1 100 0.0 1.0 ECU_ADDRESS 0x700183a0 BYTE_ORDER MSB_LAST /end MEASUREMENT
/begin COMPU_METHOD CU_V2GRXMSGCRNTDMDMAXCRNT_FLG "Conversion method for V2gRxMsgCrntDmdMaxCrnt_flg" RAT_FUNC "%10.0" "b" COEFFS 0.000000 1.000000 -0.000000 0.000000 0.000000 1.000000 /end COMPU_METHOD
/* Scalar measurable for DDE 'V2gRxMsgCrntDmdMaxPwr'. */
/begin MEASUREMENT V2gRxMsgCrntDmdMaxPwr "Maximum power the EVSE can deliver" FLOAT32_IEEE CU_V2GRXMSGCRNTDMDMAXPWR 1 100 0.0 500000.0 ECU_ADDRESS 0x70017cac BYTE_ORDER MSB_LAST /end MEASUREMENT
/begin COMPU_METHOD CU_V2GRXMSGCRNTDMDMAXPWR "Conversion method for V2gRxMsgCrntDmdMaxPwr" RAT_FUNC "%10.0" "W" COEFFS 0.000000 1.000000 -0.000000 0.000000 0.000000 1.000000 /end COMPU_METHOD
/* Scalar measurable for DDE 'V2gRxMsgCrntDmdMaxPwr_flg'. */
/begin MEASUREMENT V2gRxMsgCrntDmdMaxPwr_flg "Indicates that the EVSEMaximumPowerLimit parameter is available." UBYTE CU_V2GRXMSGCRNTDMDMAXPWR_FLG 1 100 0.0 1.0 ECU_ADDRESS 0x7001849c BYTE_ORDER MSB_LAST /end MEASUREMENT
/begin COMPU_METHOD CU_V2GRXMSGCRNTDMDMAXPWR_FLG "Conversion method for V2gRxMsgCrntDmdMaxPwr_flg" RAT_FUNC "%10.0" "b" COEFFS 0.000000 1.000000 -0.000000 0.000000 0.000000 1.000000 /end COMPU_METHOD
/* Scalar measurable for DDE 'V2gRxMsgCrntDmdMaxVolt'. */
/begin MEASUREMENT V2gRxMsgCrntDmdMaxVolt "Maximum voltage the EVSE can deliver" FLOAT32_IEEE CU_V2GRXMSGCRNTDMDMAXVOLT 1 100 0.0 196605.0 ECU_ADDRESS 0x700184b8 BYTE_ORDER MSB_LAST /end MEASUREMENT
/begin COMPU_METHOD CU_V2GRXMSGCRNTDMDMAXVOLT "Conversion method for V2gRxMsgCrntDmdMaxVolt" RAT_FUNC "%10.0" "V" COEFFS 0.000000 1.000000 -0.000000 0.000000 0.000000 1.000000 /end COMPU_METHOD
/* Scalar measurable for DDE 'V2gRxMsgCrntDmdMaxVolt_flg'. */
/begin MEASUREMENT V2gRxMsgCrntDmdMaxVolt_flg "Indicates that the EVSEMaximumVoltageLimit parameter is available." UBYTE CU_V2GRXMSGCRNTDMDMAXVOLT_FLG 1 100 0.0 1.0 ECU_ADDRESS 0x70017e9c BYTE_ORDER MSB_LAST /end MEASUREMENT
/begin COMPU_METHOD CU_V2GRXMSGCRNTDMDMAXVOLT_FLG "Conversion method for V2gRxMsgCrntDmdMaxVolt_flg" RAT_FUNC "%10.0" "b" COEFFS 0.000000 1.000000 -0.000000 0.000000 0.000000 1.000000 /end COMPU_METHOD
/* Scalar measurable for DDE 'V2gRxMsgCrntDmdNotif'. */
/begin MEASUREMENT V2gRxMsgCrntDmdNotif "The arbitrated Notification Max Delay parameter in the received message from EVSE" SLONG CU_V2GRXMSGCRNTDMDNOTIF 1 100 -2147483648.0 2147483647.0 ECU_ADDRESS 0x700181f8 BYTE_ORDER MSB_LAST /end MEASUREMENT
/begin COMPU_METHOD CU_V2GRXMSGCRNTDMDNOTIF "Conversion method for V2gRxMsgCrntDmdNotif" TAB_VERB "%12.0" "1" COMPU_TAB_REF CT_V2GRXMSGCRNTDMDNOTIF /end COMPU_METHOD
/begin COMPU_VTAB CT_V2GRXMSGCRNTDMDNOTIF "Conversion method for V2gRxMsgCrntDmdNotif" TAB_VERB 3 0 "NONE" 1 "STOPCHARGING" 2 "RENEGOTIATION" /end COMPU_VTAB
/* Scalar measurable for DDE 'V2gRxMsgCrntDmdNotifFlg'. */
/begin MEASUREMENT V2gRxMsgCrntDmdNotifFlg "The arbitrated Notification parameter in the received message from EVSE" UBYTE CU_V2GRXMSGCRNTDMDNOTIFFLG 1 100 0.0 1.0 ECU_ADDRESS 0x70018082 BYTE_ORDER MSB_LAST /end MEASUREMENT
/begin COMPU_METHOD CU_V2GRXMSGCRNTDMDNOTIFFLG "Conversion method for V2gRxMsgCrntDmdNotifFlg" RAT_FUNC "%10.0" "b" COEFFS 0.000000 1.000000 -0.000000 0.000000 0.000000 1.000000 /end COMPU_METHOD
/* Scalar measurable for DDE 'V2gRxMsgCrntDmdNotifMaxDelay'. */
/begin MEASUREMENT V2gRxMsgCrntDmdNotifMaxDelay "The arbitrated Notification Max Delay parameter in the received message from EVSE" UWORD CU_V2GRXMSGCRNTDMDNOTIFMAXDELAY 1 100 0.0 65535.0 ECU_ADDRESS 0x70017f5a BYTE_ORDER MSB_LAST /end MEASUREMENT
/begin COMPU_METHOD CU_V2GRXMSGCRNTDMDNOTIFMAXDELAY "Conversion method for V2gRxMsgCrntDmdNotifMaxDelay" RAT_FUNC "%10.0" "s" COEFFS 0.000000 1.000000 -0.000000 0.000000 0.000000 1.000000 /end COMPU_METHOD
/* Scalar measurable for DDE 'V2gRxMsgCrntDmdPwrLimReached'. */
/begin MEASUREMENT V2gRxMsgCrntDmdPwrLimReached "If set to TRUE, the EVSE has reached its power limit." UBYTE CU_V2GRXMSGCRNTDMDPWRLIMREACHED 1 100 0.0 1.0 ECU_ADDRESS 0x70017da4 BYTE_ORDER MSB_LAST /end MEASUREMENT
/begin COMPU_METHOD CU_V2GRXMSGCRNTDMDPWRLIMREACHED "Conversion method for V2gRxMsgCrntDmdPwrLimReached" RAT_FUNC "%10.0" "b" COEFFS 0.000000 1.000000 -0.000000 0.000000 0.000000 1.000000 /end COMPU_METHOD
/* Scalar measurable for DDE 'V2gRxMsgCrntDmdRescode'. */
/begin MEASUREMENT V2gRxMsgCrntDmdRescode "for message 7b: indicates the acknowledgment status of  this V2G messages received by the SECC." UBYTE CU_V2GRXMSGCRNTDMDRESCODE 1 100 0.0 255.0 ECU_ADDRESS 0x70018096 BYTE_ORDER MSB_LAST /end MEASUREMENT
/begin COMPU_METHOD CU_V2GRXMSGCRNTDMDRESCODE "Conversion method for V2gRxMsgCrntDmdRescode" RAT_FUNC "%10.0" "1" COEFFS 0.000000 1.000000 -0.000000 0.000000 0.000000 1.000000 /end COMPU_METHOD
/* Scalar measurable for DDE 'V2gRxMsgCrntDmdSASchTupId'. */
/begin MEASUREMENT V2gRxMsgCrntDmdSASchTupId "The SaSchedule Tuple ID message received from the EVSE" UBYTE CU_V2GRXMSGCRNTDMDSASCHTUPID 1 100 0.0 255.0 ECU_ADDRESS 0x70018388 BYTE_ORDER MSB_LAST /end MEASUREMENT
/begin COMPU_METHOD CU_V2GRXMSGCRNTDMDSASCHTUPID "Conversion method for V2gRxMsgCrntDmdSASchTupId" RAT_FUNC "%10.0" "1" COEFFS 0.000000 1.000000 -0.000000 0.000000 0.000000 1.000000 /end COMPU_METHOD
/* Scalar measurable for DDE 'V2gRxMsgCrntDmdSASchTupIdFlg'. */
/begin MEASUREMENT V2gRxMsgCrntDmdSASchTupIdFlg "Identifies the presence of the SaSchedule Tuple ID message received from the EVSE" UBYTE CU_V2GRXMSGCRNTDMDSASCHTUPIDFLG 1 100 0.0 1.0 ECU_ADDRESS 0x70017e5a BYTE_ORDER MSB_LAST /end MEASUREMENT
/begin COMPU_METHOD CU_V2GRXMSGCRNTDMDSASCHTUPIDFLG "Conversion method for V2gRxMsgCrntDmdSASchTupIdFlg" RAT_FUNC "%10.0" "b" COEFFS 0.000000 1.000000 -0.000000 0.000000 0.000000 1.000000 /end COMPU_METHOD
/* Scalar measurable for DDE 'V2gRxMsgCrntDmdTrg'. */
/begin MEASUREMENT V2gRxMsgCrntDmdTrg "Trigger falg that on a rising edge indicates the event for receiving the PLC (V2G) message response 7b from EVSE" UBYTE CU_V2GRXMSGCRNTDMDTRG 1 100 0.0 1.0 ECU_ADDRESS 0x70017c68 BYTE_ORDER MSB_LAST /end MEASUREMENT
/begin COMPU_METHOD CU_V2GRXMSGCRNTDMDTRG "Conversion method for V2gRxMsgCrntDmdTrg" RAT_FUNC "%10.0" "b" COEFFS 0.000000 1.000000 -0.000000 0.000000 0.000000 1.000000 /end COMPU_METHOD
/* Scalar measurable for DDE 'V2gRxMsgCrntDmdVoltLimReached'. */
/begin MEASUREMENT V2gRxMsgCrntDmdVoltLimReached "f set to TRUE, the EVSE has reached its voltage limit." UBYTE CU_V2GRXMSGCRNTDMDVOLTLIMREACH0 1 100 0.0 1.0 ECU_ADDRESS 0x70018464 BYTE_ORDER MSB_LAST /end MEASUREMENT
/begin COMPU_METHOD CU_V2GRXMSGCRNTDMDVOLTLIMREACH0 "Conversion method for V2gRxMsgCrntDmdVoltLimReached" RAT_FUNC "%10.0" "b" COEFFS 0.000000 1.000000 -0.000000 0.000000 0.000000 1.000000 /end COMPU_METHOD
/* Scalar measurable for DDE 'V2gRxMsgPreChgEvseStatus'. */
/begin MEASUREMENT V2gRxMsgPreChgEvseStatus "Indicates the internal state of the EVSE." SLONG CU_V2GRXMSGPRECHGEVSESTATUS 1 100 -2147483648.0 2147483647.0 ECU_ADDRESS 0x70017f50 BYTE_ORDER MSB_LAST /end MEASUREMENT
/begin COMPU_METHOD CU_V2GRXMSGPRECHGEVSESTATUS "Conversion method for V2gRxMsgPreChgEvseStatus" TAB_VERB "%12.0" "enum" COMPU_TAB_REF CT_V2GRXMSGPRECHGEVSESTATUS /end COMPU_METHOD
/begin COMPU_VTAB CT_V2GRXMSGPRECHGEVSESTATUS "Conversion method for V2gRxMsgPreChgEvseStatus" TAB_VERB 12 0 "EVSE_NOT_READY" 1 "EVSE_READY" 2 "EVSE_SHUTDOWN" 3 "EVSE_UTILITY_INTERRUPT" 4 "EVSE_ISOLATION_MONITOR_ACTV" 5 "EVSE_EMERGENCY_SHUTDOWN" 6 "EVSE_MALFUNCTION" 7 "EVSE_STATUS_RESERVED1" 8 "EVSE_STATUS_RESERVED2" 9 "EVSE_STATUS_RESERVED3" 10 "EVSE_STATUS_RESERVED4" 11 "EVSE_STATUS_RESERVED5" /end COMPU_VTAB
/* Scalar measurable for DDE 'V2gRxMsgPreChgEvseVoltage'. */
/begin MEASUREMENT V2gRxMsgPreChgEvseVoltage "Present voltage of EVSE" FLOAT32_IEEE CU_V2GRXMSGPRECHGEVSEVOLTAGE 1 100 0.0 196605.0 ECU_ADDRESS 0x700181c4 BYTE_ORDER MSB_LAST /end MEASUREMENT
/begin COMPU_METHOD CU_V2GRXMSGPRECHGEVSEVOLTAGE "Conversion method for V2gRxMsgPreChgEvseVoltage" RAT_FUNC "%10.0" "V" COEFFS 0.000000 1.000000 -0.000000 0.000000 0.000000 1.000000 /end COMPU_METHOD
/* Scalar measurable for DDE 'V2gRxMsgPreChgIsolStatus'. */
/begin MEASUREMENT V2gRxMsgPreChgIsolStatus "Indicates the isolation condition" SLONG CU_V2GRXMSGPRECHGISOLSTATUS 1 100 -2147483648.0 2147483647.0 ECU_ADDRESS 0x70017c7c BYTE_ORDER MSB_LAST /end MEASUREMENT
/begin COMPU_METHOD CU_V2GRXMSGPRECHGISOLSTATUS "Conversion method for V2gRxMsgPreChgIsolStatus" TAB_VERB "%12.0" "enum" COMPU_TAB_REF CT_V2GRXMSGPRECHGISOLSTATUS /end COMPU_METHOD
/begin COMPU_VTAB CT_V2GRXMSGPRECHGISOLSTATUS "Conversion method for V2gRxMsgPreChgIsolStatus" TAB_VERB 4 0 "ISOLATION_INVALID" 1 "ISOLATION_VALID" 2 "ISOLATION_WARNING" 3 "ISOLATION_FAULT" /end COMPU_VTAB
/* Scalar measurable for DDE 'V2gRxMsgPreChgIsolStatus_flg'. */
/begin MEASUREMENT V2gRxMsgPreChgIsolStatus_flg "Identifies the presence of the EVSEIsolationStatus parameter." UBYTE CU_V2GRXMSGPRECHGISOLSTATUS_FLG 1 100 0.0 1.0 ECU_ADDRESS 0x700183a9 BYTE_ORDER MSB_LAST /end MEASUREMENT
/begin COMPU_METHOD CU_V2GRXMSGPRECHGISOLSTATUS_FLG "Conversion method for V2gRxMsgPreChgIsolStatus_flg" RAT_FUNC "%10.0" "b" COEFFS 0.000000 1.000000 -0.000000 0.000000 0.000000 1.000000 /end COMPU_METHOD
/* Scalar measurable for DDE 'V2gRxMsgPreChgNotif'. */
/begin MEASUREMENT V2gRxMsgPreChgNotif "The arbitrated Notification Max Delay parameter in the received message from EVSE" SLONG CU_V2GRXMSGPRECHGNOTIF 1 100 -2147483648.0 2147483647.0 ECU_ADDRESS 0x70017da8 BYTE_ORDER MSB_LAST /end MEASUREMENT
/begin COMPU_METHOD CU_V2GRXMSGPRECHGNOTIF "Conversion method for V2gRxMsgPreChgNotif" TAB_VERB "%12.0" "1" COMPU_TAB_REF CT_V2GRXMSGPRECHGNOTIF /end COMPU_METHOD
/begin COMPU_VTAB CT_V2GRXMSGPRECHGNOTIF "Conversion method for V2gRxMsgPreChgNotif" TAB_VERB 3 0 "NONE" 1 "STOPCHARGING" 2 "RENEGOTIATION" /end COMPU_VTAB
/* Scalar measurable for DDE 'V2gRxMsgPreChgNotifFlg'. */
/begin MEASUREMENT V2gRxMsgPreChgNotifFlg "The arbitrated Notification parameter in the received message from EVSE" UBYTE CU_V2GRXMSGPRECHGNOTIFFLG 1 100 0.0 1.0 ECU_ADDRESS 0x70017db3 BYTE_ORDER MSB_LAST /end MEASUREMENT
/begin COMPU_METHOD CU_V2GRXMSGPRECHGNOTIFFLG "Conversion method for V2gRxMsgPreChgNotifFlg" RAT_FUNC "%10.0" "b" COEFFS 0.000000 1.000000 -0.000000 0.000000 0.000000 1.000000 /end COMPU_METHOD
/* Scalar measurable for DDE 'V2gRxMsgPreChgNotifMaxDelay'. */
/begin MEASUREMENT V2gRxMsgPreChgNotifMaxDelay "The arbitrated Notification Max Delay parameter in the received message from EVSE" UWORD CU_V2GRXMSGPRECHGNOTIFMAXDELAY 1 100 0.0 65535.0 ECU_ADDRESS 0x70018490 BYTE_ORDER MSB_LAST /end MEASUREMENT
/begin COMPU_METHOD CU_V2GRXMSGPRECHGNOTIFMAXDELAY "Conversion method for V2gRxMsgPreChgNotifMaxDelay" RAT_FUNC "%10.0" "s" COEFFS 0.000000 1.000000 -0.000000 0.000000 0.000000 1.000000 /end COMPU_METHOD
/* Scalar measurable for DDE 'V2gRxMsgPreChgRescode'. */
/begin MEASUREMENT V2gRxMsgPreChgRescode "for message 5b: indicates the acknowledgment status of  this V2G messages received by the SECC." UBYTE CU_V2GRXMSGPRECHGRESCODE 1 100 0.0 255.0 ECU_ADDRESS 0x700183a1 BYTE_ORDER MSB_LAST /end MEASUREMENT
/begin COMPU_METHOD CU_V2GRXMSGPRECHGRESCODE "Conversion method for V2gRxMsgPreChgRescode" RAT_FUNC "%10.0" "1" COEFFS 0.000000 1.000000 -0.000000 0.000000 0.000000 1.000000 /end COMPU_METHOD
/* Scalar measurable for DDE 'V2gRxMsgPreChgTrg'. */
/begin MEASUREMENT V2gRxMsgPreChgTrg "Trigger falg that on a rising edge indicates the event for receiving the PLC (V2G) message response 5b from EVSE" UBYTE CU_V2GRXMSGPRECHGTRG 1 100 0.0 1.0 ECU_ADDRESS 0x70017d9c BYTE_ORDER MSB_LAST /end MEASUREMENT
/begin COMPU_METHOD CU_V2GRXMSGPRECHGTRG "Conversion method for V2gRxMsgPreChgTrg" RAT_FUNC "%10.0" "b" COEFFS 0.000000 1.000000 -0.000000 0.000000 0.000000 1.000000 /end COMPU_METHOD
/* Scalar measurable for DDE 'V2gRxMsgPwrDelivEvseProcessing'. */
/begin MEASUREMENT V2gRxMsgPwrDelivEvseProcessing "Message 4b: Parameter indicating that the EVSE has finished the processing that was initiated after the ContractAuthenticationReq or that the EVSE is still processing at the time the response message was sent." SLONG CU_V2GRXMSGPWRDELIVEVSEPROCESS0 1 100 -2147483648.0 2147483647.0 ECU_ADDRESS 0x700181a4 BYTE_ORDER MSB_LAST /end MEASUREMENT
/begin COMPU_METHOD CU_V2GRXMSGPWRDELIVEVSEPROCESS0 "Conversion method for V2gRxMsgPwrDelivEvseProcessing" TAB_VERB "%12.0" "enum" COMPU_TAB_REF CT_V2GRXMSGPWRDELIVEVSEPROCESS0 /end COMPU_METHOD
/begin COMPU_VTAB CT_V2GRXMSGPWRDELIVEVSEPROCESS0 "Conversion method for V2gRxMsgPwrDelivEvseProcessing" TAB_VERB 3 0 "FINISHED" 1 "ONGOING" 2 "ONGOING_WAITINGFORCUSTOMERINTERACTION" /end COMPU_VTAB
/* Scalar measurable for DDE 'V2gRxMsgPwrDelivEvseStatus'. */
/begin MEASUREMENT V2gRxMsgPwrDelivEvseStatus "Indicates the internal state of the EVSE." SLONG CU_V2GRXMSGPWRDELIVEVSESTATUS 1 100 -2147483648.0 2147483647.0 ECU_ADDRESS 0x70018384 BYTE_ORDER MSB_LAST /end MEASUREMENT
/begin COMPU_METHOD CU_V2GRXMSGPWRDELIVEVSESTATUS "Conversion method for V2gRxMsgPwrDelivEvseStatus" TAB_VERB "%12.0" "enum" COMPU_TAB_REF CT_V2GRXMSGPWRDELIVEVSESTATUS /end COMPU_METHOD
/begin COMPU_VTAB CT_V2GRXMSGPWRDELIVEVSESTATUS "Conversion method for V2gRxMsgPwrDelivEvseStatus" TAB_VERB 12 0 "EVSE_NOT_READY" 1 "EVSE_READY" 2 "EVSE_SHUTDOWN" 3 "EVSE_UTILITY_INTERRUPT" 4 "EVSE_ISOLATION_MONITOR_ACTV" 5 "EVSE_EMERGENCY_SHUTDOWN" 6 "EVSE_MALFUNCTION" 7 "EVSE_STATUS_RESERVED1" 8 "EVSE_STATUS_RESERVED2" 9 "EVSE_STATUS_RESERVED3" 10 "EVSE_STATUS_RESERVED4" 11 "EVSE_STATUS_RESERVED5" /end COMPU_VTAB
/* Scalar measurable for DDE 'V2gRxMsgPwrDelivEvseStatus_flg'. */
/begin MEASUREMENT V2gRxMsgPwrDelivEvseStatus_flg "Identifies the presence of the EVSEStatusCode_present, and EVSEStatusCode parameters." UBYTE CU_V2GRXMSGPWRDELIVEVSESTATUS_0 1 100 0.0 1.0 ECU_ADDRESS 0x700182a5 BYTE_ORDER MSB_LAST /end MEASUREMENT
/begin COMPU_METHOD CU_V2GRXMSGPWRDELIVEVSESTATUS_0 "Conversion method for V2gRxMsgPwrDelivEvseStatus_flg" RAT_FUNC "%10.0" "b" COEFFS 0.000000 1.000000 -0.000000 0.000000 0.000000 1.000000 /end COMPU_METHOD
/* Scalar measurable for DDE 'V2gRxMsgPwrDelivIsolStatus'. */
/begin MEASUREMENT V2gRxMsgPwrDelivIsolStatus "Indicates the isolation condition" SLONG CU_V2GRXMSGPWRDELIVISOLSTATUS 1 100 -2147483648.0 2147483647.0 ECU_ADDRESS 0x70018050 BYTE_ORDER MSB_LAST /end MEASUREMENT
/begin COMPU_METHOD CU_V2GRXMSGPWRDELIVISOLSTATUS "Conversion method for V2gRxMsgPwrDelivIsolStatus" TAB_VERB "%12.0" "enum" COMPU_TAB_REF CT_V2GRXMSGPWRDELIVISOLSTATUS /end COMPU_METHOD
/begin COMPU_VTAB CT_V2GRXMSGPWRDELIVISOLSTATUS "Conversion method for V2gRxMsgPwrDelivIsolStatus" TAB_VERB 4 0 "ISOLATION_INVALID" 1 "ISOLATION_VALID" 2 "ISOLATION_WARNING" 3 "ISOLATION_FAULT" /end COMPU_VTAB
/* Scalar measurable for DDE 'V2gRxMsgPwrDelivIsolStatus_flg'. */
/begin MEASUREMENT V2gRxMsgPwrDelivIsolStatus_flg "Identifies the presence of the EVSEIsolationStatus_present, EVSEIsolationStatus" UBYTE CU_V2GRXMSGPWRDELIVISOLSTATUS_0 1 100 0.0 1.0 ECU_ADDRESS 0x70017fe5 BYTE_ORDER MSB_LAST /end MEASUREMENT
/begin COMPU_METHOD CU_V2GRXMSGPWRDELIVISOLSTATUS_0 "Conversion method for V2gRxMsgPwrDelivIsolStatus_flg" RAT_FUNC "%10.0" "b" COEFFS 0.000000 1.000000 -0.000000 0.000000 0.000000 1.000000 /end COMPU_METHOD
/* Scalar measurable for DDE 'V2gRxMsgPwrDelivNotif'. */
/begin MEASUREMENT V2gRxMsgPwrDelivNotif "The arbitrated Notification Max Delay parameter in the received message from EVSE" SLONG CU_V2GRXMSGPWRDELIVNOTIF 1 100 -2147483648.0 2147483647.0 ECU_ADDRESS 0x70018288 BYTE_ORDER MSB_LAST /end MEASUREMENT
/begin COMPU_METHOD CU_V2GRXMSGPWRDELIVNOTIF "Conversion method for V2gRxMsgPwrDelivNotif" TAB_VERB "%12.0" "1" COMPU_TAB_REF CT_V2GRXMSGPWRDELIVNOTIF /end COMPU_METHOD
/begin COMPU_VTAB CT_V2GRXMSGPWRDELIVNOTIF "Conversion method for V2gRxMsgPwrDelivNotif" TAB_VERB 3 0 "NONE" 1 "STOPCHARGING" 2 "RENEGOTIATION" /end COMPU_VTAB
/* Scalar measurable for DDE 'V2gRxMsgPwrDelivNotifFlg'. */
/begin MEASUREMENT V2gRxMsgPwrDelivNotifFlg "The arbitrated Notification parameter in the received message from EVSE" UBYTE CU_V2GRXMSGPWRDELIVNOTIFFLG 1 100 0.0 1.0 ECU_ADDRESS 0x70017d50 BYTE_ORDER MSB_LAST /end MEASUREMENT
/begin COMPU_METHOD CU_V2GRXMSGPWRDELIVNOTIFFLG "Conversion method for V2gRxMsgPwrDelivNotifFlg" RAT_FUNC "%10.0" "b" COEFFS 0.000000 1.000000 -0.000000 0.000000 0.000000 1.000000 /end COMPU_METHOD
/* Scalar measurable for DDE 'V2gRxMsgPwrDelivNotifMaxDelay'. */
/begin MEASUREMENT V2gRxMsgPwrDelivNotifMaxDelay "The arbitrated Notification Max Delay parameter in the received message from EVSE" UWORD CU_V2GRXMSGPWRDELIVNOTIFMAXDEL0 1 100 0.0 65535.0 ECU_ADDRESS 0x7001846e BYTE_ORDER MSB_LAST /end MEASUREMENT
/begin COMPU_METHOD CU_V2GRXMSGPWRDELIVNOTIFMAXDEL0 "Conversion method for V2gRxMsgPwrDelivNotifMaxDelay" RAT_FUNC "%10.0" "s" COEFFS 0.000000 1.000000 -0.000000 0.000000 0.000000 1.000000 /end COMPU_METHOD
/* Scalar measurable for DDE 'V2gRxMsgPwrDelivRescode'. */
/begin MEASUREMENT V2gRxMsgPwrDelivRescode "for message 6b: indicates the acknowledgment status of  this V2G messages received by the SECC." UBYTE CU_V2GRXMSGPWRDELIVRESCODE 1 100 0.0 255.0 ECU_ADDRESS 0x70017e40 BYTE_ORDER MSB_LAST /end MEASUREMENT
/begin COMPU_METHOD CU_V2GRXMSGPWRDELIVRESCODE "Conversion method for V2gRxMsgPwrDelivRescode" RAT_FUNC "%10.0" "1" COEFFS 0.000000 1.000000 -0.000000 0.000000 0.000000 1.000000 /end COMPU_METHOD
/* Scalar measurable for DDE 'V2gRxMsgPwrDelivTrg'. */
/begin MEASUREMENT V2gRxMsgPwrDelivTrg "Trigger falg that on a rising edge indicates the event for receiving the PLC (V2G) message response 6b from EVSE" UBYTE CU_V2GRXMSGPWRDELIVTRG 1 100 0.0 1.0 ECU_ADDRESS 0x70017c8a BYTE_ORDER MSB_LAST /end MEASUREMENT
/begin COMPU_METHOD CU_V2GRXMSGPWRDELIVTRG "Conversion method for V2gRxMsgPwrDelivTrg" RAT_FUNC "%10.0" "b" COEFFS 0.000000 1.000000 -0.000000 0.000000 0.000000 1.000000 /end COMPU_METHOD
/* Scalar measurable for DDE 'V2gRxMsgWeldDetEvseStatus'. */
/begin MEASUREMENT V2gRxMsgWeldDetEvseStatus "Indicates the internal state of the EVSE." SLONG CU_V2GRXMSGWELDDETEVSESTATUS 1 100 -2147483648.0 2147483647.0 ECU_ADDRESS 0x700182d8 BYTE_ORDER MSB_LAST /end MEASUREMENT
/begin COMPU_METHOD CU_V2GRXMSGWELDDETEVSESTATUS "Conversion method for V2gRxMsgWeldDetEvseStatus" TAB_VERB "%12.0" "enum" COMPU_TAB_REF CT_V2GRXMSGWELDDETEVSESTATUS /end COMPU_METHOD
/begin COMPU_VTAB CT_V2GRXMSGWELDDETEVSESTATUS "Conversion method for V2gRxMsgWeldDetEvseStatus" TAB_VERB 12 0 "EVSE_NOT_READY" 1 "EVSE_READY" 2 "EVSE_SHUTDOWN" 3 "EVSE_UTILITY_INTERRUPT" 4 "EVSE_ISOLATION_MONITOR_ACTV" 5 "EVSE_EMERGENCY_SHUTDOWN" 6 "EVSE_MALFUNCTION" 7 "EVSE_STATUS_RESERVED1" 8 "EVSE_STATUS_RESERVED2" 9 "EVSE_STATUS_RESERVED3" 10 "EVSE_STATUS_RESERVED4" 11 "EVSE_STATUS_RESERVED5" /end COMPU_VTAB
/* Scalar measurable for DDE 'V2gRxMsgWeldDetEvseVoltage'. */
/begin MEASUREMENT V2gRxMsgWeldDetEvseVoltage "Present voltage of EVSE" FLOAT32_IEEE CU_V2GRXMSGWELDDETEVSEVOLTAGE 1 100 0.0 196605.0 ECU_ADDRESS 0x70017ee0 BYTE_ORDER MSB_LAST /end MEASUREMENT
/begin COMPU_METHOD CU_V2GRXMSGWELDDETEVSEVOLTAGE "Conversion method for V2gRxMsgWeldDetEvseVoltage" RAT_FUNC "%10.0" "V" COEFFS 0.000000 1.000000 -0.000000 0.000000 0.000000 1.000000 /end COMPU_METHOD
/* Scalar measurable for DDE 'V2gRxMsgWeldDetIsolStatus'. */
/begin MEASUREMENT V2gRxMsgWeldDetIsolStatus "Indicates the isolation condition" SLONG CU_V2GRXMSGWELDDETISOLSTATUS 1 100 -2147483648.0 2147483647.0 ECU_ADDRESS 0x7001830c BYTE_ORDER MSB_LAST /end MEASUREMENT
/begin COMPU_METHOD CU_V2GRXMSGWELDDETISOLSTATUS "Conversion method for V2gRxMsgWeldDetIsolStatus" TAB_VERB "%12.0" "enum" COMPU_TAB_REF CT_V2GRXMSGWELDDETISOLSTATUS /end COMPU_METHOD
/begin COMPU_VTAB CT_V2GRXMSGWELDDETISOLSTATUS "Conversion method for V2gRxMsgWeldDetIsolStatus" TAB_VERB 4 0 "ISOLATION_INVALID" 1 "ISOLATION_VALID" 2 "ISOLATION_WARNING" 3 "ISOLATION_FAULT" /end COMPU_VTAB
/* Scalar measurable for DDE 'V2gRxMsgWeldDetIsolStatus_flg'. */
/begin MEASUREMENT V2gRxMsgWeldDetIsolStatus_flg "Identifies the presence of the EVSEIsolationStatus parameter." UBYTE CU_V2GRXMSGWELDDETISOLSTATUS_F0 1 100 0.0 1.0 ECU_ADDRESS 0x70018340 BYTE_ORDER MSB_LAST /end MEASUREMENT
/begin COMPU_METHOD CU_V2GRXMSGWELDDETISOLSTATUS_F0 "Conversion method for V2gRxMsgWeldDetIsolStatus_flg" RAT_FUNC "%10.0" "b" COEFFS 0.000000 1.000000 -0.000000 0.000000 0.000000 1.000000 /end COMPU_METHOD
/* Scalar measurable for DDE 'V2gRxMsgWeldDetNotif'. */
/begin MEASUREMENT V2gRxMsgWeldDetNotif "The arbitrated Notification Max Delay parameter in the received message from EVSE" SLONG CU_V2GRXMSGWELDDETNOTIF 1 100 -2147483648.0 2147483647.0 ECU_ADDRESS 0x70017d44 BYTE_ORDER MSB_LAST /end MEASUREMENT
/begin COMPU_METHOD CU_V2GRXMSGWELDDETNOTIF "Conversion method for V2gRxMsgWeldDetNotif" TAB_VERB "%12.0" "1" COMPU_TAB_REF CT_V2GRXMSGWELDDETNOTIF /end COMPU_METHOD
/begin COMPU_VTAB CT_V2GRXMSGWELDDETNOTIF "Conversion method for V2gRxMsgWeldDetNotif" TAB_VERB 3 0 "NONE" 1 "STOPCHARGING" 2 "RENEGOTIATION" /end COMPU_VTAB
/* Scalar measurable for DDE 'V2gRxMsgWeldDetNotifFlg'. */
/begin MEASUREMENT V2gRxMsgWeldDetNotifFlg "The arbitrated Notification parameter in the received message from EVSE" UBYTE CU_V2GRXMSGWELDDETNOTIFFLG 1 100 0.0 1.0 ECU_ADDRESS 0x70017ce6 BYTE_ORDER MSB_LAST /end MEASUREMENT
/begin COMPU_METHOD CU_V2GRXMSGWELDDETNOTIFFLG "Conversion method for V2gRxMsgWeldDetNotifFlg" RAT_FUNC "%10.0" "b" COEFFS 0.000000 1.000000 -0.000000 0.000000 0.000000 1.000000 /end COMPU_METHOD
/* Scalar measurable for DDE 'V2gRxMsgWeldDetNotifMaxDelay'. */
/begin MEASUREMENT V2gRxMsgWeldDetNotifMaxDelay "The arbitrated Notification Max Delay parameter in the received message from EVSE" UWORD CU_V2GRXMSGWELDDETNOTIFMAXDELAY 1 100 0.0 65535.0 ECU_ADDRESS 0x70017eb0 BYTE_ORDER MSB_LAST /end MEASUREMENT
/begin COMPU_METHOD CU_V2GRXMSGWELDDETNOTIFMAXDELAY "Conversion method for V2gRxMsgWeldDetNotifMaxDelay" RAT_FUNC "%10.0" "s" COEFFS 0.000000 1.000000 -0.000000 0.000000 0.000000 1.000000 /end COMPU_METHOD
/* Scalar measurable for DDE 'V2gRxMsgWeldDetRescode'. */
/begin MEASUREMENT V2gRxMsgWeldDetRescode "for message 9b: indicates the acknowledgment status of  this V2G messages received by the SECC." UBYTE CU_V2GRXMSGWELDDETRESCODE 1 100 0.0 255.0 ECU_ADDRESS 0x70017d51 BYTE_ORDER MSB_LAST /end MEASUREMENT
/begin COMPU_METHOD CU_V2GRXMSGWELDDETRESCODE "Conversion method for V2gRxMsgWeldDetRescode" RAT_FUNC "%10.0" "1" COEFFS 0.000000 1.000000 -0.000000 0.000000 0.000000 1.000000 /end COMPU_METHOD
/* Scalar measurable for DDE 'V2gRxMsgWeldDetTrg'. */
/begin MEASUREMENT V2gRxMsgWeldDetTrg "Trigger falg that on a rising edge indicates the event for receiving the PLC (V2G) message response 9b from EVSE" UBYTE CU_V2GRXMSGWELDDETTRG 1 100 0.0 1.0 ECU_ADDRESS 0x70017c21 BYTE_ORDER MSB_LAST /end MEASUREMENT
/begin COMPU_METHOD CU_V2GRXMSGWELDDETTRG "Conversion method for V2gRxMsgWeldDetTrg" RAT_FUNC "%10.0" "b" COEFFS 0.000000 1.000000 -0.000000 0.000000 0.000000 1.000000 /end COMPU_METHOD
/* Scalar measurable for DDE 'V2gRxSigCrntLimReached'. */
/begin MEASUREMENT V2gRxSigCrntLimReached "If set to TRUE, the EVSE has reached its current limit." UBYTE CU_V2GRXSIGCRNTLIMREACHED 1 100 0.0 1.0 ECU_ADDRESS 0x70017d49 BYTE_ORDER MSB_LAST /end MEASUREMENT
/begin COMPU_METHOD CU_V2GRXSIGCRNTLIMREACHED "Conversion method for V2gRxSigCrntLimReached" RAT_FUNC "%10.0" "b" COEFFS 0.000000 1.000000 -0.000000 0.000000 0.000000 1.000000 /end COMPU_METHOD
/* Scalar measurable for DDE 'V2gRxSigEvseCurrent'. */
/begin MEASUREMENT V2gRxSigEvseCurrent "Present current of EVSE" FLOAT32_IEEE CU_V2GRXSIGEVSECURRENT 1 100 -32768000.0 32767000.0 ECU_ADDRESS 0x700181f4 BYTE_ORDER MSB_LAST /end MEASUREMENT
/begin COMPU_METHOD CU_V2GRXSIGEVSECURRENT "Conversion method for V2gRxSigEvseCurrent" RAT_FUNC "%10.0" "A" COEFFS 0.000000 1.000000 -0.000000 0.000000 0.000000 1.000000 /end COMPU_METHOD
/* Scalar measurable for DDE 'V2gRxSigEvseIdLen'. */
/begin MEASUREMENT V2gRxSigEvseIdLen "Number of bytes in EVSE ID" UBYTE CU_V2GRXSIGEVSEIDLEN 1 100 0.0 37.0 ECU_ADDRESS 0x70017c20 BYTE_ORDER MSB_LAST /end MEASUREMENT
/begin COMPU_METHOD CU_V2GRXSIGEVSEIDLEN "Conversion method for V2gRxSigEvseIdLen" RAT_FUNC "%10.0" "1" COEFFS 0.000000 1.000000 -0.000000 0.000000 0.000000 1.000000 /end COMPU_METHOD
/* Scalar measurable for DDE 'V2gRxSigEvseId[0]'. */
/begin MEASUREMENT V2gRxSigEvseId[0] "The ID that uniquely identifies the EVSE. Format is defined in DIN SPEC 91286" UBYTE CU_V2GRXSIGEVSEID[0] 1 100 0.0 255.0 ECU_ADDRESS 0x70018400 BYTE_ORDER MSB_LAST /end MEASUREMENT
/begin COMPU_METHOD CU_V2GRXSIGEVSEID[0] "Conversion method for V2gRxSigEvseId[0]" RAT_FUNC "%10.0" "1" COEFFS 0.000000 1.000000 -0.000000 0.000000 0.000000 1.000000 /end COMPU_METHOD
/* Scalar measurable for DDE 'V2gRxSigEvseId[10]'. */
/begin MEASUREMENT V2gRxSigEvseId[10] "The ID that uniquely identifies the EVSE. Format is defined in DIN SPEC 91286" UBYTE CU_V2GRXSIGEVSEID[10] 1 100 0.0 255.0 ECU_ADDRESS 0x7001840a BYTE_ORDER MSB_LAST /end MEASUREMENT
/begin COMPU_METHOD CU_V2GRXSIGEVSEID[10] "Conversion method for V2gRxSigEvseId[10]" RAT_FUNC "%10.0" "1" COEFFS 0.000000 1.000000 -0.000000 0.000000 0.000000 1.000000 /end COMPU_METHOD
/* Scalar measurable for DDE 'V2gRxSigEvseId[11]'. */
/begin MEASUREMENT V2gRxSigEvseId[11] "The ID that uniquely identifies the EVSE. Format is defined in DIN SPEC 91286" UBYTE CU_V2GRXSIGEVSEID[11] 1 100 0.0 255.0 ECU_ADDRESS 0x7001840b BYTE_ORDER MSB_LAST /end MEASUREMENT
/begin COMPU_METHOD CU_V2GRXSIGEVSEID[11] "Conversion method for V2gRxSigEvseId[11]" RAT_FUNC "%10.0" "1" COEFFS 0.000000 1.000000 -0.000000 0.000000 0.000000 1.000000 /end COMPU_METHOD
/* Scalar measurable for DDE 'V2gRxSigEvseId[12]'. */
/begin MEASUREMENT V2gRxSigEvseId[12] "The ID that uniquely identifies the EVSE. Format is defined in DIN SPEC 91286" UBYTE CU_V2GRXSIGEVSEID[12] 1 100 0.0 255.0 ECU_ADDRESS 0x7001840c BYTE_ORDER MSB_LAST /end MEASUREMENT
/begin COMPU_METHOD CU_V2GRXSIGEVSEID[12] "Conversion method for V2gRxSigEvseId[12]" RAT_FUNC "%10.0" "1" COEFFS 0.000000 1.000000 -0.000000 0.000000 0.000000 1.000000 /end COMPU_METHOD
/* Scalar measurable for DDE 'V2gRxSigEvseId[13]'. */
/begin MEASUREMENT V2gRxSigEvseId[13] "The ID that uniquely identifies the EVSE. Format is defined in DIN SPEC 91286" UBYTE CU_V2GRXSIGEVSEID[13] 1 100 0.0 255.0 ECU_ADDRESS 0x7001840d BYTE_ORDER MSB_LAST /end MEASUREMENT
/begin COMPU_METHOD CU_V2GRXSIGEVSEID[13] "Conversion method for V2gRxSigEvseId[13]" RAT_FUNC "%10.0" "1" COEFFS 0.000000 1.000000 -0.000000 0.000000 0.000000 1.000000 /end COMPU_METHOD
/* Scalar measurable for DDE 'V2gRxSigEvseId[14]'. */
/begin MEASUREMENT V2gRxSigEvseId[14] "The ID that uniquely identifies the EVSE. Format is defined in DIN SPEC 91286" UBYTE CU_V2GRXSIGEVSEID[14] 1 100 0.0 255.0 ECU_ADDRESS 0x7001840e BYTE_ORDER MSB_LAST /end MEASUREMENT
/begin COMPU_METHOD CU_V2GRXSIGEVSEID[14] "Conversion method for V2gRxSigEvseId[14]" RAT_FUNC "%10.0" "1" COEFFS 0.000000 1.000000 -0.000000 0.000000 0.000000 1.000000 /end COMPU_METHOD
/* Scalar measurable for DDE 'V2gRxSigEvseId[15]'. */
/begin MEASUREMENT V2gRxSigEvseId[15] "The ID that uniquely identifies the EVSE. Format is defined in DIN SPEC 91286" UBYTE CU_V2GRXSIGEVSEID[15] 1 100 0.0 255.0 ECU_ADDRESS 0x7001840f BYTE_ORDER MSB_LAST /end MEASUREMENT
/begin COMPU_METHOD CU_V2GRXSIGEVSEID[15] "Conversion method for V2gRxSigEvseId[15]" RAT_FUNC "%10.0" "1" COEFFS 0.000000 1.000000 -0.000000 0.000000 0.000000 1.000000 /end COMPU_METHOD
/* Scalar measurable for DDE 'V2gRxSigEvseId[16]'. */
/begin MEASUREMENT V2gRxSigEvseId[16] "The ID that uniquely identifies the EVSE. Format is defined in DIN SPEC 91286" UBYTE CU_V2GRXSIGEVSEID[16] 1 100 0.0 255.0 ECU_ADDRESS 0x70018410 BYTE_ORDER MSB_LAST /end MEASUREMENT
/begin COMPU_METHOD CU_V2GRXSIGEVSEID[16] "Conversion method for V2gRxSigEvseId[16]" RAT_FUNC "%10.0" "1" COEFFS 0.000000 1.000000 -0.000000 0.000000 0.000000 1.000000 /end COMPU_METHOD
/* Scalar measurable for DDE 'V2gRxSigEvseId[17]'. */
/begin MEASUREMENT V2gRxSigEvseId[17] "The ID that uniquely identifies the EVSE. Format is defined in DIN SPEC 91286" UBYTE CU_V2GRXSIGEVSEID[17] 1 100 0.0 255.0 ECU_ADDRESS 0x70018411 BYTE_ORDER MSB_LAST /end MEASUREMENT
/begin COMPU_METHOD CU_V2GRXSIGEVSEID[17] "Conversion method for V2gRxSigEvseId[17]" RAT_FUNC "%10.0" "1" COEFFS 0.000000 1.000000 -0.000000 0.000000 0.000000 1.000000 /end COMPU_METHOD
/* Scalar measurable for DDE 'V2gRxSigEvseId[18]'. */
/begin MEASUREMENT V2gRxSigEvseId[18] "The ID that uniquely identifies the EVSE. Format is defined in DIN SPEC 91286" UBYTE CU_V2GRXSIGEVSEID[18] 1 100 0.0 255.0 ECU_ADDRESS 0x70018412 BYTE_ORDER MSB_LAST /end MEASUREMENT
/begin COMPU_METHOD CU_V2GRXSIGEVSEID[18] "Conversion method for V2gRxSigEvseId[18]" RAT_FUNC "%10.0" "1" COEFFS 0.000000 1.000000 -0.000000 0.000000 0.000000 1.000000 /end COMPU_METHOD
/* Scalar measurable for DDE 'V2gRxSigEvseId[19]'. */
/begin MEASUREMENT V2gRxSigEvseId[19] "The ID that uniquely identifies the EVSE. Format is defined in DIN SPEC 91286" UBYTE CU_V2GRXSIGEVSEID[19] 1 100 0.0 255.0 ECU_ADDRESS 0x70018413 BYTE_ORDER MSB_LAST /end MEASUREMENT
/begin COMPU_METHOD CU_V2GRXSIGEVSEID[19] "Conversion method for V2gRxSigEvseId[19]" RAT_FUNC "%10.0" "1" COEFFS 0.000000 1.000000 -0.000000 0.000000 0.000000 1.000000 /end COMPU_METHOD
/* Scalar measurable for DDE 'V2gRxSigEvseId[1]'. */
/begin MEASUREMENT V2gRxSigEvseId[1] "The ID that uniquely identifies the EVSE. Format is defined in DIN SPEC 91286" UBYTE CU_V2GRXSIGEVSEID[1] 1 100 0.0 255.0 ECU_ADDRESS 0x70018401 BYTE_ORDER MSB_LAST /end MEASUREMENT
/begin COMPU_METHOD CU_V2GRXSIGEVSEID[1] "Conversion method for V2gRxSigEvseId[1]" RAT_FUNC "%10.0" "1" COEFFS 0.000000 1.000000 -0.000000 0.000000 0.000000 1.000000 /end COMPU_METHOD
/* Scalar measurable for DDE 'V2gRxSigEvseId[20]'. */
/begin MEASUREMENT V2gRxSigEvseId[20] "The ID that uniquely identifies the EVSE. Format is defined in DIN SPEC 91286" UBYTE CU_V2GRXSIGEVSEID[20] 1 100 0.0 255.0 ECU_ADDRESS 0x70018414 BYTE_ORDER MSB_LAST /end MEASUREMENT
/begin COMPU_METHOD CU_V2GRXSIGEVSEID[20] "Conversion method for V2gRxSigEvseId[20]" RAT_FUNC "%10.0" "1" COEFFS 0.000000 1.000000 -0.000000 0.000000 0.000000 1.000000 /end COMPU_METHOD
/* Scalar measurable for DDE 'V2gRxSigEvseId[21]'. */
/begin MEASUREMENT V2gRxSigEvseId[21] "The ID that uniquely identifies the EVSE. Format is defined in DIN SPEC 91286" UBYTE CU_V2GRXSIGEVSEID[21] 1 100 0.0 255.0 ECU_ADDRESS 0x70018415 BYTE_ORDER MSB_LAST /end MEASUREMENT
/begin COMPU_METHOD CU_V2GRXSIGEVSEID[21] "Conversion method for V2gRxSigEvseId[21]" RAT_FUNC "%10.0" "1" COEFFS 0.000000 1.000000 -0.000000 0.000000 0.000000 1.000000 /end COMPU_METHOD
/* Scalar measurable for DDE 'V2gRxSigEvseId[22]'. */
/begin MEASUREMENT V2gRxSigEvseId[22] "The ID that uniquely identifies the EVSE. Format is defined in DIN SPEC 91286" UBYTE CU_V2GRXSIGEVSEID[22] 1 100 0.0 255.0 ECU_ADDRESS 0x70018416 BYTE_ORDER MSB_LAST /end MEASUREMENT
/begin COMPU_METHOD CU_V2GRXSIGEVSEID[22] "Conversion method for V2gRxSigEvseId[22]" RAT_FUNC "%10.0" "1" COEFFS 0.000000 1.000000 -0.000000 0.000000 0.000000 1.000000 /end COMPU_METHOD
/* Scalar measurable for DDE 'V2gRxSigEvseId[23]'. */
/begin MEASUREMENT V2gRxSigEvseId[23] "The ID that uniquely identifies the EVSE. Format is defined in DIN SPEC 91286" UBYTE CU_V2GRXSIGEVSEID[23] 1 100 0.0 255.0 ECU_ADDRESS 0x70018417 BYTE_ORDER MSB_LAST /end MEASUREMENT
/begin COMPU_METHOD CU_V2GRXSIGEVSEID[23] "Conversion method for V2gRxSigEvseId[23]" RAT_FUNC "%10.0" "1" COEFFS 0.000000 1.000000 -0.000000 0.000000 0.000000 1.000000 /end COMPU_METHOD
/* Scalar measurable for DDE 'V2gRxSigEvseId[24]'. */
/begin MEASUREMENT V2gRxSigEvseId[24] "The ID that uniquely identifies the EVSE. Format is defined in DIN SPEC 91286" UBYTE CU_V2GRXSIGEVSEID[24] 1 100 0.0 255.0 ECU_ADDRESS 0x70018418 BYTE_ORDER MSB_LAST /end MEASUREMENT
/begin COMPU_METHOD CU_V2GRXSIGEVSEID[24] "Conversion method for V2gRxSigEvseId[24]" RAT_FUNC "%10.0" "1" COEFFS 0.000000 1.000000 -0.000000 0.000000 0.000000 1.000000 /end COMPU_METHOD
/* Scalar measurable for DDE 'V2gRxSigEvseId[25]'. */
/begin MEASUREMENT V2gRxSigEvseId[25] "The ID that uniquely identifies the EVSE. Format is defined in DIN SPEC 91286" UBYTE CU_V2GRXSIGEVSEID[25] 1 100 0.0 255.0 ECU_ADDRESS 0x70018419 BYTE_ORDER MSB_LAST /end MEASUREMENT
/begin COMPU_METHOD CU_V2GRXSIGEVSEID[25] "Conversion method for V2gRxSigEvseId[25]" RAT_FUNC "%10.0" "1" COEFFS 0.000000 1.000000 -0.000000 0.000000 0.000000 1.000000 /end COMPU_METHOD
/* Scalar measurable for DDE 'V2gRxSigEvseId[26]'. */
/begin MEASUREMENT V2gRxSigEvseId[26] "The ID that uniquely identifies the EVSE. Format is defined in DIN SPEC 91286" UBYTE CU_V2GRXSIGEVSEID[26] 1 100 0.0 255.0 ECU_ADDRESS 0x7001841a BYTE_ORDER MSB_LAST /end MEASUREMENT
/begin COMPU_METHOD CU_V2GRXSIGEVSEID[26] "Conversion method for V2gRxSigEvseId[26]" RAT_FUNC "%10.0" "1" COEFFS 0.000000 1.000000 -0.000000 0.000000 0.000000 1.000000 /end COMPU_METHOD
/* Scalar measurable for DDE 'V2gRxSigEvseId[27]'. */
/begin MEASUREMENT V2gRxSigEvseId[27] "The ID that uniquely identifies the EVSE. Format is defined in DIN SPEC 91286" UBYTE CU_V2GRXSIGEVSEID[27] 1 100 0.0 255.0 ECU_ADDRESS 0x7001841b BYTE_ORDER MSB_LAST /end MEASUREMENT
/begin COMPU_METHOD CU_V2GRXSIGEVSEID[27] "Conversion method for V2gRxSigEvseId[27]" RAT_FUNC "%10.0" "1" COEFFS 0.000000 1.000000 -0.000000 0.000000 0.000000 1.000000 /end COMPU_METHOD
/* Scalar measurable for DDE 'V2gRxSigEvseId[28]'. */
/begin MEASUREMENT V2gRxSigEvseId[28] "The ID that uniquely identifies the EVSE. Format is defined in DIN SPEC 91286" UBYTE CU_V2GRXSIGEVSEID[28] 1 100 0.0 255.0 ECU_ADDRESS 0x7001841c BYTE_ORDER MSB_LAST /end MEASUREMENT
/begin COMPU_METHOD CU_V2GRXSIGEVSEID[28] "Conversion method for V2gRxSigEvseId[28]" RAT_FUNC "%10.0" "1" COEFFS 0.000000 1.000000 -0.000000 0.000000 0.000000 1.000000 /end COMPU_METHOD
/* Scalar measurable for DDE 'V2gRxSigEvseId[29]'. */
/begin MEASUREMENT V2gRxSigEvseId[29] "The ID that uniquely identifies the EVSE. Format is defined in DIN SPEC 91286" UBYTE CU_V2GRXSIGEVSEID[29] 1 100 0.0 255.0 ECU_ADDRESS 0x7001841d BYTE_ORDER MSB_LAST /end MEASUREMENT
/begin COMPU_METHOD CU_V2GRXSIGEVSEID[29] "Conversion method for V2gRxSigEvseId[29]" RAT_FUNC "%10.0" "1" COEFFS 0.000000 1.000000 -0.000000 0.000000 0.000000 1.000000 /end COMPU_METHOD
/* Scalar measurable for DDE 'V2gRxSigEvseId[2]'. */
/begin MEASUREMENT V2gRxSigEvseId[2] "The ID that uniquely identifies the EVSE. Format is defined in DIN SPEC 91286" UBYTE CU_V2GRXSIGEVSEID[2] 1 100 0.0 255.0 ECU_ADDRESS 0x70018402 BYTE_ORDER MSB_LAST /end MEASUREMENT
/begin COMPU_METHOD CU_V2GRXSIGEVSEID[2] "Conversion method for V2gRxSigEvseId[2]" RAT_FUNC "%10.0" "1" COEFFS 0.000000 1.000000 -0.000000 0.000000 0.000000 1.000000 /end COMPU_METHOD
/* Scalar measurable for DDE 'V2gRxSigEvseId[30]'. */
/begin MEASUREMENT V2gRxSigEvseId[30] "The ID that uniquely identifies the EVSE. Format is defined in DIN SPEC 91286" UBYTE CU_V2GRXSIGEVSEID[30] 1 100 0.0 255.0 ECU_ADDRESS 0x7001841e BYTE_ORDER MSB_LAST /end MEASUREMENT
/begin COMPU_METHOD CU_V2GRXSIGEVSEID[30] "Conversion method for V2gRxSigEvseId[30]" RAT_FUNC "%10.0" "1" COEFFS 0.000000 1.000000 -0.000000 0.000000 0.000000 1.000000 /end COMPU_METHOD
/* Scalar measurable for DDE 'V2gRxSigEvseId[31]'. */
/begin MEASUREMENT V2gRxSigEvseId[31] "The ID that uniquely identifies the EVSE. Format is defined in DIN SPEC 91286" UBYTE CU_V2GRXSIGEVSEID[31] 1 100 0.0 255.0 ECU_ADDRESS 0x7001841f BYTE_ORDER MSB_LAST /end MEASUREMENT
/begin COMPU_METHOD CU_V2GRXSIGEVSEID[31] "Conversion method for V2gRxSigEvseId[31]" RAT_FUNC "%10.0" "1" COEFFS 0.000000 1.000000 -0.000000 0.000000 0.000000 1.000000 /end COMPU_METHOD
/* Scalar measurable for DDE 'V2gRxSigEvseId[32]'. */
/begin MEASUREMENT V2gRxSigEvseId[32] "The ID that uniquely identifies the EVSE. Format is defined in DIN SPEC 91286" UBYTE CU_V2GRXSIGEVSEID[32] 1 100 0.0 255.0 ECU_ADDRESS 0x70018420 BYTE_ORDER MSB_LAST /end MEASUREMENT
/begin COMPU_METHOD CU_V2GRXSIGEVSEID[32] "Conversion method for V2gRxSigEvseId[32]" RAT_FUNC "%10.0" "1" COEFFS 0.000000 1.000000 -0.000000 0.000000 0.000000 1.000000 /end COMPU_METHOD
/* Scalar measurable for DDE 'V2gRxSigEvseId[33]'. */
/begin MEASUREMENT V2gRxSigEvseId[33] "The ID that uniquely identifies the EVSE. Format is defined in DIN SPEC 91286" UBYTE CU_V2GRXSIGEVSEID[33] 1 100 0.0 255.0 ECU_ADDRESS 0x70018421 BYTE_ORDER MSB_LAST /end MEASUREMENT
/begin COMPU_METHOD CU_V2GRXSIGEVSEID[33] "Conversion method for V2gRxSigEvseId[33]" RAT_FUNC "%10.0" "1" COEFFS 0.000000 1.000000 -0.000000 0.000000 0.000000 1.000000 /end COMPU_METHOD
/* Scalar measurable for DDE 'V2gRxSigEvseId[34]'. */
/begin MEASUREMENT V2gRxSigEvseId[34] "The ID that uniquely identifies the EVSE. Format is defined in DIN SPEC 91286" UBYTE CU_V2GRXSIGEVSEID[34] 1 100 0.0 255.0 ECU_ADDRESS 0x70018422 BYTE_ORDER MSB_LAST /end MEASUREMENT
/begin COMPU_METHOD CU_V2GRXSIGEVSEID[34] "Conversion method for V2gRxSigEvseId[34]" RAT_FUNC "%10.0" "1" COEFFS 0.000000 1.000000 -0.000000 0.000000 0.000000 1.000000 /end COMPU_METHOD
/* Scalar measurable for DDE 'V2gRxSigEvseId[35]'. */
/begin MEASUREMENT V2gRxSigEvseId[35] "The ID that uniquely identifies the EVSE. Format is defined in DIN SPEC 91286" UBYTE CU_V2GRXSIGEVSEID[35] 1 100 0.0 255.0 ECU_ADDRESS 0x70018423 BYTE_ORDER MSB_LAST /end MEASUREMENT
/begin COMPU_METHOD CU_V2GRXSIGEVSEID[35] "Conversion method for V2gRxSigEvseId[35]" RAT_FUNC "%10.0" "1" COEFFS 0.000000 1.000000 -0.000000 0.000000 0.000000 1.000000 /end COMPU_METHOD
/* Scalar measurable for DDE 'V2gRxSigEvseId[36]'. */
/begin MEASUREMENT V2gRxSigEvseId[36] "The ID that uniquely identifies the EVSE. Format is defined in DIN SPEC 91286" UBYTE CU_V2GRXSIGEVSEID[36] 1 100 0.0 255.0 ECU_ADDRESS 0x70018424 BYTE_ORDER MSB_LAST /end MEASUREMENT
/begin COMPU_METHOD CU_V2GRXSIGEVSEID[36] "Conversion method for V2gRxSigEvseId[36]" RAT_FUNC "%10.0" "1" COEFFS 0.000000 1.000000 -0.000000 0.000000 0.000000 1.000000 /end COMPU_METHOD
/* Scalar measurable for DDE 'V2gRxSigEvseId[37]'. */
/begin MEASUREMENT V2gRxSigEvseId[37] "The ID that uniquely identifies the EVSE. Format is defined in DIN SPEC 91286" UBYTE CU_V2GRXSIGEVSEID[37] 1 100 0.0 255.0 ECU_ADDRESS 0x70018425 BYTE_ORDER MSB_LAST /end MEASUREMENT
/begin COMPU_METHOD CU_V2GRXSIGEVSEID[37] "Conversion method for V2gRxSigEvseId[37]" RAT_FUNC "%10.0" "1" COEFFS 0.000000 1.000000 -0.000000 0.000000 0.000000 1.000000 /end COMPU_METHOD
/* Scalar measurable for DDE 'V2gRxSigEvseId[3]'. */
/begin MEASUREMENT V2gRxSigEvseId[3] "The ID that uniquely identifies the EVSE. Format is defined in DIN SPEC 91286" UBYTE CU_V2GRXSIGEVSEID[3] 1 100 0.0 255.0 ECU_ADDRESS 0x70018403 BYTE_ORDER MSB_LAST /end MEASUREMENT
/begin COMPU_METHOD CU_V2GRXSIGEVSEID[3] "Conversion method for V2gRxSigEvseId[3]" RAT_FUNC "%10.0" "1" COEFFS 0.000000 1.000000 -0.000000 0.000000 0.000000 1.000000 /end COMPU_METHOD
/* Scalar measurable for DDE 'V2gRxSigEvseId[4]'. */
/begin MEASUREMENT V2gRxSigEvseId[4] "The ID that uniquely identifies the EVSE. Format is defined in DIN SPEC 91286" UBYTE CU_V2GRXSIGEVSEID[4] 1 100 0.0 255.0 ECU_ADDRESS 0x70018404 BYTE_ORDER MSB_LAST /end MEASUREMENT
/begin COMPU_METHOD CU_V2GRXSIGEVSEID[4] "Conversion method for V2gRxSigEvseId[4]" RAT_FUNC "%10.0" "1" COEFFS 0.000000 1.000000 -0.000000 0.000000 0.000000 1.000000 /end COMPU_METHOD
/* Scalar measurable for DDE 'V2gRxSigEvseId[5]'. */
/begin MEASUREMENT V2gRxSigEvseId[5] "The ID that uniquely identifies the EVSE. Format is defined in DIN SPEC 91286" UBYTE CU_V2GRXSIGEVSEID[5] 1 100 0.0 255.0 ECU_ADDRESS 0x70018405 BYTE_ORDER MSB_LAST /end MEASUREMENT
/begin COMPU_METHOD CU_V2GRXSIGEVSEID[5] "Conversion method for V2gRxSigEvseId[5]" RAT_FUNC "%10.0" "1" COEFFS 0.000000 1.000000 -0.000000 0.000000 0.000000 1.000000 /end COMPU_METHOD
/* Scalar measurable for DDE 'V2gRxSigEvseId[6]'. */
/begin MEASUREMENT V2gRxSigEvseId[6] "The ID that uniquely identifies the EVSE. Format is defined in DIN SPEC 91286" UBYTE CU_V2GRXSIGEVSEID[6] 1 100 0.0 255.0 ECU_ADDRESS 0x70018406 BYTE_ORDER MSB_LAST /end MEASUREMENT
/begin COMPU_METHOD CU_V2GRXSIGEVSEID[6] "Conversion method for V2gRxSigEvseId[6]" RAT_FUNC "%10.0" "1" COEFFS 0.000000 1.000000 -0.000000 0.000000 0.000000 1.000000 /end COMPU_METHOD
/* Scalar measurable for DDE 'V2gRxSigEvseId[7]'. */
/begin MEASUREMENT V2gRxSigEvseId[7] "The ID that uniquely identifies the EVSE. Format is defined in DIN SPEC 91286" UBYTE CU_V2GRXSIGEVSEID[7] 1 100 0.0 255.0 ECU_ADDRESS 0x70018407 BYTE_ORDER MSB_LAST /end MEASUREMENT
/begin COMPU_METHOD CU_V2GRXSIGEVSEID[7] "Conversion method for V2gRxSigEvseId[7]" RAT_FUNC "%10.0" "1" COEFFS 0.000000 1.000000 -0.000000 0.000000 0.000000 1.000000 /end COMPU_METHOD
/* Scalar measurable for DDE 'V2gRxSigEvseId[8]'. */
/begin MEASUREMENT V2gRxSigEvseId[8] "The ID that uniquely identifies the EVSE. Format is defined in DIN SPEC 91286" UBYTE CU_V2GRXSIGEVSEID[8] 1 100 0.0 255.0 ECU_ADDRESS 0x70018408 BYTE_ORDER MSB_LAST /end MEASUREMENT
/begin COMPU_METHOD CU_V2GRXSIGEVSEID[8] "Conversion method for V2gRxSigEvseId[8]" RAT_FUNC "%10.0" "1" COEFFS 0.000000 1.000000 -0.000000 0.000000 0.000000 1.000000 /end COMPU_METHOD
/* Scalar measurable for DDE 'V2gRxSigEvseId[9]'. */
/begin MEASUREMENT V2gRxSigEvseId[9] "The ID that uniquely identifies the EVSE. Format is defined in DIN SPEC 91286" UBYTE CU_V2GRXSIGEVSEID[9] 1 100 0.0 255.0 ECU_ADDRESS 0x70018409 BYTE_ORDER MSB_LAST /end MEASUREMENT
/begin COMPU_METHOD CU_V2GRXSIGEVSEID[9] "Conversion method for V2gRxSigEvseId[9]" RAT_FUNC "%10.0" "1" COEFFS 0.000000 1.000000 -0.000000 0.000000 0.000000 1.000000 /end COMPU_METHOD
/* Scalar measurable for DDE 'V2gRxSigEvseMaxDchgCrnt'. */
/begin MEASUREMENT V2gRxSigEvseMaxDchgCrnt "Maximum discharge current the EVSE can deliver with the expected accuracy" FLOAT32_IEEE CU_V2GRXSIGEVSEMAXDCHGCRNT 1 100 -196604.0 0.0 ECU_ADDRESS 0x70018498 BYTE_ORDER MSB_LAST /end MEASUREMENT
/begin COMPU_METHOD CU_V2GRXSIGEVSEMAXDCHGCRNT "Conversion method for V2gRxSigEvseMaxDchgCrnt" RAT_FUNC "%10.0" "A" COEFFS 0.000000 1.000000 -0.000000 0.000000 0.000000 1.000000 /end COMPU_METHOD
/* Scalar measurable for DDE 'V2gRxSigEvseMaxDchgCrnt_flg'. */
/begin MEASUREMENT V2gRxSigEvseMaxDchgCrnt_flg "Indicates that the EVSE Maximum Discharge Current parameter is available." UBYTE CU_V2GRXSIGEVSEMAXDCHGCRNT_FLG1 1 100 0.0 1.0 ECU_ADDRESS 0x70018161 BYTE_ORDER MSB_LAST /end MEASUREMENT
/begin COMPU_METHOD CU_V2GRXSIGEVSEMAXDCHGCRNT_FLG1 "Conversion method for V2gRxSigEvseMaxDchgCrnt_flg" RAT_FUNC "%10.0" "b" COEFFS 0.000000 1.000000 -0.000000 0.000000 0.000000 1.000000 /end COMPU_METHOD
/* Scalar measurable for DDE 'V2gRxSigEvseMaxDchgPwr'. */
/begin MEASUREMENT V2gRxSigEvseMaxDchgPwr "Maximum discharge power the EVSE can accept" FLOAT32_IEEE CU_V2GRXSIGEVSEMAXDCHGPWR 1 100 -499999.0 0.0 ECU_ADDRESS 0x70017d78 BYTE_ORDER MSB_LAST /end MEASUREMENT
/begin COMPU_METHOD CU_V2GRXSIGEVSEMAXDCHGPWR "Conversion method for V2gRxSigEvseMaxDchgPwr" RAT_FUNC "%10.0" "W" COEFFS 0.000000 1.000000 -0.000000 0.000000 0.000000 1.000000 /end COMPU_METHOD
/* Scalar measurable for DDE 'V2gRxSigEvseMaxDchgPwr_flg'. */
/begin MEASUREMENT V2gRxSigEvseMaxDchgPwr_flg "Indicates that the EVSEMaximumDischargePowerLimit parameter is available." UBYTE CU_V2GRXSIGEVSEMAXDCHGPWR_FLG 1 100 0.0 1.0 ECU_ADDRESS 0x700181e4 BYTE_ORDER MSB_LAST /end MEASUREMENT
/begin COMPU_METHOD CU_V2GRXSIGEVSEMAXDCHGPWR_FLG "Conversion method for V2gRxSigEvseMaxDchgPwr_flg" RAT_FUNC "%10.0" "b" COEFFS 0.000000 1.000000 -0.000000 0.000000 0.000000 1.000000 /end COMPU_METHOD
/* Scalar measurable for DDE 'V2gRxSigEvseMinCrnt'. */
/begin MEASUREMENT V2gRxSigEvseMinCrnt "Minimum current the EVSE can deliver with the expected accuracy" FLOAT32_IEEE CU_V2GRXSIGEVSEMINCRNT 1 100 0.0 196605.0 ECU_ADDRESS 0x70018354 BYTE_ORDER MSB_LAST /end MEASUREMENT
/begin COMPU_METHOD CU_V2GRXSIGEVSEMINCRNT "Conversion method for V2gRxSigEvseMinCrnt" RAT_FUNC "%10.0" "A" COEFFS 0.000000 1.000000 -0.000000 0.000000 0.000000 1.000000 /end COMPU_METHOD
/* Scalar measurable for DDE 'V2gRxSigEvseMinCrnt_flg'. */
/begin MEASUREMENT V2gRxSigEvseMinCrnt_flg "Indicates that the EVSEMinimumCurrentLimit parameter is available." UBYTE CU_V2GRXSIGEVSEMINCRNT_FLG 1 100 0.0 1.0 ECU_ADDRESS 0x7001814d BYTE_ORDER MSB_LAST /end MEASUREMENT
/begin COMPU_METHOD CU_V2GRXSIGEVSEMINCRNT_FLG "Conversion method for V2gRxSigEvseMinCrnt_flg" RAT_FUNC "%10.0" "b" COEFFS 0.000000 1.000000 -0.000000 0.000000 0.000000 1.000000 /end COMPU_METHOD
/* Scalar measurable for DDE 'V2gRxSigEvseMinDchgCrnt'. */
/begin MEASUREMENT V2gRxSigEvseMinDchgCrnt "Minimum discharge current the EVSE can deliver with the expected accuracy" FLOAT32_IEEE CU_V2GRXSIGEVSEMINDCHGCRNT 1 100 -196604.0 0.0 ECU_ADDRESS 0x70018304 BYTE_ORDER MSB_LAST /end MEASUREMENT
/begin COMPU_METHOD CU_V2GRXSIGEVSEMINDCHGCRNT "Conversion method for V2gRxSigEvseMinDchgCrnt" RAT_FUNC "%10.0" "A" COEFFS 0.000000 1.000000 -0.000000 0.000000 0.000000 1.000000 /end COMPU_METHOD
/* Scalar measurable for DDE 'V2gRxSigEvseMinDchgCrnt_flg'. */
/begin MEASUREMENT V2gRxSigEvseMinDchgCrnt_flg "Indicates that the EVSE minimum discharge current parameter is available." UBYTE CU_V2GRXSIGEVSEMINDCHGCRNT_FLG 1 100 0.0 1.0 ECU_ADDRESS 0x70017ef3 BYTE_ORDER MSB_LAST /end MEASUREMENT
/begin COMPU_METHOD CU_V2GRXSIGEVSEMINDCHGCRNT_FLG "Conversion method for V2gRxSigEvseMinDchgCrnt_flg" RAT_FUNC "%10.0" "b" COEFFS 0.000000 1.000000 -0.000000 0.000000 0.000000 1.000000 /end COMPU_METHOD
/* Scalar measurable for DDE 'V2gRxSigEvseProcessing'. */
/begin MEASUREMENT V2gRxSigEvseProcessing "Parameter indicating that the EVSE has finished the processing that was initiated after the ContractAuthenticationReq or that the EVSE is still processing at the time the response message was sent." SLONG CU_V2GRXSIGEVSEPROCESSING 1 100 -2147483648.0 2147483647.0 ECU_ADDRESS 0x70018394 BYTE_ORDER MSB_LAST /end MEASUREMENT
/begin COMPU_METHOD CU_V2GRXSIGEVSEPROCESSING "Conversion method for V2gRxSigEvseProcessing" TAB_VERB "%12.0" "enum" COMPU_TAB_REF CT_V2GRXSIGEVSEPROCESSING /end COMPU_METHOD
/begin COMPU_VTAB CT_V2GRXSIGEVSEPROCESSING "Conversion method for V2gRxSigEvseProcessing" TAB_VERB 3 0 "FINISHED" 1 "ONGOING" 2 "ONGOING_WAITINGFORCUSTOMERINTERACTION" /end COMPU_VTAB
/* Scalar measurable for DDE 'V2gRxSigEvseStatus'. */
/begin MEASUREMENT V2gRxSigEvseStatus "Indicates the internal state of the EVSE." SLONG CU_V2GRXSIGEVSESTATUS 1 100 -2147483648.0 2147483647.0 ECU_ADDRESS 0x70017f94 BYTE_ORDER MSB_LAST /end MEASUREMENT
/begin COMPU_METHOD CU_V2GRXSIGEVSESTATUS "Conversion method for V2gRxSigEvseStatus" TAB_VERB "%12.0" "enum" COMPU_TAB_REF CT_V2GRXSIGEVSESTATUS /end COMPU_METHOD
/begin COMPU_VTAB CT_V2GRXSIGEVSESTATUS "Conversion method for V2gRxSigEvseStatus" TAB_VERB 12 0 "EVSE_NOT_READY" 1 "EVSE_READY" 2 "EVSE_SHUTDOWN" 3 "EVSE_UTILITY_INTERRUPT" 4 "EVSE_ISOLATION_MONITOR_ACTV" 5 "EVSE_EMERGENCY_SHUTDOWN" 6 "EVSE_MALFUNCTION" 7 "EVSE_STATUS_RESERVED1" 8 "EVSE_STATUS_RESERVED2" 9 "EVSE_STATUS_RESERVED3" 10 "EVSE_STATUS_RESERVED4" 11 "EVSE_STATUS_RESERVED5" /end COMPU_VTAB
/* Scalar measurable for DDE 'V2gRxSigEvseStatus_flg'. */
/begin MEASUREMENT V2gRxSigEvseStatus_flg "Identifies the presence of the DC_EVSEChargeParameter and its sub-parameters." UBYTE CU_V2GRXSIGEVSESTATUS_FLG 1 100 0.0 1.0 ECU_ADDRESS 0x700181a8 BYTE_ORDER MSB_LAST /end MEASUREMENT
/begin COMPU_METHOD CU_V2GRXSIGEVSESTATUS_FLG "Conversion method for V2gRxSigEvseStatus_flg" RAT_FUNC "%10.0" "b" COEFFS 0.000000 1.000000 -0.000000 0.000000 0.000000 1.000000 /end COMPU_METHOD
/* Scalar measurable for DDE 'V2gRxSigEvseVoltage'. */
/begin MEASUREMENT V2gRxSigEvseVoltage "Present voltage of EVSE" FLOAT32_IEEE CU_V2GRXSIGEVSEVOLTAGE 1 100 -32768000.0 32767000.0 ECU_ADDRESS 0x700183f0 BYTE_ORDER MSB_LAST /end MEASUREMENT
/begin COMPU_METHOD CU_V2GRXSIGEVSEVOLTAGE "Conversion method for V2gRxSigEvseVoltage" RAT_FUNC "%10.0" "V" COEFFS 0.000000 1.000000 -0.000000 0.000000 0.000000 1.000000 /end COMPU_METHOD
/* Scalar measurable for DDE 'V2gRxSigIsolStatus'. */
/begin MEASUREMENT V2gRxSigIsolStatus "Indicates the isolation condition" SLONG CU_V2GRXSIGISOLSTATUS 1 100 -2147483648.0 2147483647.0 ECU_ADDRESS 0x70017df8 BYTE_ORDER MSB_LAST /end MEASUREMENT
/begin COMPU_METHOD CU_V2GRXSIGISOLSTATUS "Conversion method for V2gRxSigIsolStatus" TAB_VERB "%12.0" "enum" COMPU_TAB_REF CT_V2GRXSIGISOLSTATUS /end COMPU_METHOD
/begin COMPU_VTAB CT_V2GRXSIGISOLSTATUS "Conversion method for V2gRxSigIsolStatus" TAB_VERB 4 0 "ISOLATION_INVALID" 1 "ISOLATION_VALID" 2 "ISOLATION_WARNING" 3 "ISOLATION_FAULT" /end COMPU_VTAB
/* Scalar measurable for DDE 'V2gRxSigIsolStatus_flg'. */
/begin MEASUREMENT V2gRxSigIsolStatus_flg "Identifies the presence of the EVSEIsolationStatus parameter." UBYTE CU_V2GRXSIGISOLSTATUS_FLG 1 100 0.0 1.0 ECU_ADDRESS 0x7001818c BYTE_ORDER MSB_LAST /end MEASUREMENT
/begin COMPU_METHOD CU_V2GRXSIGISOLSTATUS_FLG "Conversion method for V2gRxSigIsolStatus_flg" RAT_FUNC "%10.0" "b" COEFFS 0.000000 1.000000 -0.000000 0.000000 0.000000 1.000000 /end COMPU_METHOD
/* Scalar measurable for DDE 'V2gRxSigMaxCrnt'. */
/begin MEASUREMENT V2gRxSigMaxCrnt "Minimum discharge current that the EVSE can deliver" FLOAT32_IEEE CU_V2GRXSIGMAXCRNT 1 100 -32768000.0 32767000.0 ECU_ADDRESS 0x700181ec BYTE_ORDER MSB_LAST /end MEASUREMENT
/begin COMPU_METHOD CU_V2GRXSIGMAXCRNT "Conversion method for V2gRxSigMaxCrnt" RAT_FUNC "%10.0" "A" COEFFS 0.000000 1.000000 -0.000000 0.000000 0.000000 1.000000 /end COMPU_METHOD
/* Scalar measurable for DDE 'V2gRxSigMaxCrnt_flg'. */
/begin MEASUREMENT V2gRxSigMaxCrnt_flg "Identifies the presence of the maximum current to the EVSE" UBYTE CU_V2GRXSIGMAXCRNT_FLG 1 100 0.0 1.0 ECU_ADDRESS 0x70017e10 BYTE_ORDER MSB_LAST /end MEASUREMENT
/begin COMPU_METHOD CU_V2GRXSIGMAXCRNT_FLG "Conversion method for V2gRxSigMaxCrnt_flg" RAT_FUNC "%10.0" "b" COEFFS 0.000000 1.000000 -0.000000 0.000000 0.000000 1.000000 /end COMPU_METHOD
/* Scalar measurable for DDE 'V2gRxSigMaxPwr'. */
/begin MEASUREMENT V2gRxSigMaxPwr "Minimum discharge power that the EVSE can deliver" FLOAT32_IEEE CU_V2GRXSIGMAXPWR 1 100 -32768000.0 32767000.0 ECU_ADDRESS 0x70017cb8 BYTE_ORDER MSB_LAST /end MEASUREMENT
/begin COMPU_METHOD CU_V2GRXSIGMAXPWR "Conversion method for V2gRxSigMaxPwr" RAT_FUNC "%10.0" "W" COEFFS 0.000000 1.000000 -0.000000 0.000000 0.000000 1.000000 /end COMPU_METHOD
/* Scalar measurable for DDE 'V2gRxSigMaxPwr_flg'. */
/begin MEASUREMENT V2gRxSigMaxPwr_flg "Identifies the presence of the maximum power to the EVSE" UBYTE CU_V2GRXSIGMAXPWR_FLG 1 100 0.0 1.0 ECU_ADDRESS 0x7001825c BYTE_ORDER MSB_LAST /end MEASUREMENT
/begin COMPU_METHOD CU_V2GRXSIGMAXPWR_FLG "Conversion method for V2gRxSigMaxPwr_flg" RAT_FUNC "%10.0" "b" COEFFS 0.000000 1.000000 -0.000000 0.000000 0.000000 1.000000 /end COMPU_METHOD
/* Scalar measurable for DDE 'V2gRxSigMaxVolt'. */
/begin MEASUREMENT V2gRxSigMaxVolt "Maximum voltage the EVSE can deliver" FLOAT32_IEEE CU_V2GRXSIGMAXVOLT 1 100 -32768000.0 32767000.0 ECU_ADDRESS 0x70017c34 BYTE_ORDER MSB_LAST /end MEASUREMENT
/begin COMPU_METHOD CU_V2GRXSIGMAXVOLT "Conversion method for V2gRxSigMaxVolt" RAT_FUNC "%10.0" "V" COEFFS 0.000000 1.000000 -0.000000 0.000000 0.000000 1.000000 /end COMPU_METHOD
/* Scalar measurable for DDE 'V2gRxSigMaxVolt_flg'. */
/begin MEASUREMENT V2gRxSigMaxVolt_flg "Indicates that the EVSEMaximumVoltage parameter is available." UBYTE CU_V2GRXSIGMAXVOLT_FLG 1 100 0.0 1.0 ECU_ADDRESS 0x70017f84 BYTE_ORDER MSB_LAST /end MEASUREMENT
/begin COMPU_METHOD CU_V2GRXSIGMAXVOLT_FLG "Conversion method for V2gRxSigMaxVolt_flg" RAT_FUNC "%10.0" "b" COEFFS 0.000000 1.000000 -0.000000 0.000000 0.000000 1.000000 /end COMPU_METHOD
/* Scalar measurable for DDE 'V2gRxSigMinVolt'. */
/begin MEASUREMENT V2gRxSigMinVolt "Maximum voltage the EVSE can deliver" FLOAT32_IEEE CU_V2GRXSIGMINVOLT 1 100 -32768000.0 32767000.0 ECU_ADDRESS 0x70017cb4 BYTE_ORDER MSB_LAST /end MEASUREMENT
/begin COMPU_METHOD CU_V2GRXSIGMINVOLT "Conversion method for V2gRxSigMinVolt" RAT_FUNC "%10.0" "V" COEFFS 0.000000 1.000000 -0.000000 0.000000 0.000000 1.000000 /end COMPU_METHOD
/* Scalar measurable for DDE 'V2gRxSigMinVolt_flg'. */
/begin MEASUREMENT V2gRxSigMinVolt_flg "Indicates that the EVSEMaximumVoltage parameter is available." UBYTE CU_V2GRXSIGMINVOLT_FLG 1 100 0.0 1.0 ECU_ADDRESS 0x70018448 BYTE_ORDER MSB_LAST /end MEASUREMENT
/begin COMPU_METHOD CU_V2GRXSIGMINVOLT_FLG "Conversion method for V2gRxSigMinVolt_flg" RAT_FUNC "%10.0" "b" COEFFS 0.000000 1.000000 -0.000000 0.000000 0.000000 1.000000 /end COMPU_METHOD
/* Scalar measurable for DDE 'V2gRxSigNotif'. */
/begin MEASUREMENT V2gRxSigNotif "The arbitrated Notification parameter in the received message from EVSE" SLONG CU_V2GRXSIGNOTIF 1 100 -2147483648.0 2147483647.0 ECU_ADDRESS 0x700183f8 BYTE_ORDER MSB_LAST /end MEASUREMENT
/begin COMPU_METHOD CU_V2GRXSIGNOTIF "Conversion method for V2gRxSigNotif" TAB_VERB "%12.0" "1" COMPU_TAB_REF CT_V2GRXSIGNOTIF /end COMPU_METHOD
/begin COMPU_VTAB CT_V2GRXSIGNOTIF "Conversion method for V2gRxSigNotif" TAB_VERB 3 0 "NONE" 1 "STOPCHARGING" 2 "RENEGOTIATION" /end COMPU_VTAB
/* Scalar measurable for DDE 'V2gRxSigNotifFlg'. */
/begin MEASUREMENT V2gRxSigNotifFlg "The arbitrated Notification parameter in the received message from EVSE" UBYTE CU_V2GRXSIGNOTIFFLG 1 100 0.0 1.0 ECU_ADDRESS 0x70017ffe BYTE_ORDER MSB_LAST /end MEASUREMENT
/begin COMPU_METHOD CU_V2GRXSIGNOTIFFLG "Conversion method for V2gRxSigNotifFlg" RAT_FUNC "%10.0" "b" COEFFS 0.000000 1.000000 -0.000000 0.000000 0.000000 1.000000 /end COMPU_METHOD
/* Scalar measurable for DDE 'V2gRxSigNotifMaxDelay'. */
/begin MEASUREMENT V2gRxSigNotifMaxDelay "The arbitrated Notification Max Delay parameter in the received message from EVSE" UWORD CU_V2GRXSIGNOTIFMAXDELAY 1 100 0.0 65535.0 ECU_ADDRESS 0x70017f8c BYTE_ORDER MSB_LAST /end MEASUREMENT
/begin COMPU_METHOD CU_V2GRXSIGNOTIFMAXDELAY "Conversion method for V2gRxSigNotifMaxDelay" RAT_FUNC "%10.0" "s" COEFFS 0.000000 1.000000 -0.000000 0.000000 0.000000 1.000000 /end COMPU_METHOD
/* Scalar measurable for DDE 'V2gRxSigPwrLimReached'. */
/begin MEASUREMENT V2gRxSigPwrLimReached "If set to TRUE, the EVSE has reached its power limit." UBYTE CU_V2GRXSIGPWRLIMREACHED 1 100 0.0 1.0 ECU_ADDRESS 0x700182e4 BYTE_ORDER MSB_LAST /end MEASUREMENT
/begin COMPU_METHOD CU_V2GRXSIGPWRLIMREACHED "Conversion method for V2gRxSigPwrLimReached" RAT_FUNC "%10.0" "b" COEFFS 0.000000 1.000000 -0.000000 0.000000 0.000000 1.000000 /end COMPU_METHOD
/* Scalar measurable for DDE 'V2gRxSigRescode'. */
/begin MEASUREMENT V2gRxSigRescode "for message BidirectionalControlRes: indicates the acknowledgment status of  this V2G messages received by the SECC." UBYTE CU_V2GRXSIGRESCODE 1 100 0.0 255.0 ECU_ADDRESS 0x70017f90 BYTE_ORDER MSB_LAST /end MEASUREMENT
/begin COMPU_METHOD CU_V2GRXSIGRESCODE "Conversion method for V2gRxSigRescode" RAT_FUNC "%10.0" "1" COEFFS 0.000000 1.000000 -0.000000 0.000000 0.000000 1.000000 /end COMPU_METHOD
/* Scalar measurable for DDE 'V2gRxSigSASchTupId'. */
/begin MEASUREMENT V2gRxSigSASchTupId "The SaSchedule Tuple ID message received from the EVSE" UBYTE CU_V2GRXSIGSASCHTUPID 1 100 0.0 255.0 ECU_ADDRESS 0x700182d1 BYTE_ORDER MSB_LAST /end MEASUREMENT
/begin COMPU_METHOD CU_V2GRXSIGSASCHTUPID "Conversion method for V2gRxSigSASchTupId" RAT_FUNC "%10.0" "1" COEFFS 0.000000 1.000000 -0.000000 0.000000 0.000000 1.000000 /end COMPU_METHOD
/* Scalar measurable for DDE 'V2gRxSigSASchTupIdFlg'. */
/begin MEASUREMENT V2gRxSigSASchTupIdFlg "Identifies the presence of the SaSchedule Tuple ID message received from the EVSE" UBYTE CU_V2GRXSIGSASCHTUPIDFLG 1 100 0.0 1.0 ECU_ADDRESS 0x70017eda BYTE_ORDER MSB_LAST /end MEASUREMENT
/begin COMPU_METHOD CU_V2GRXSIGSASCHTUPIDFLG "Conversion method for V2gRxSigSASchTupIdFlg" RAT_FUNC "%10.0" "b" COEFFS 0.000000 1.000000 -0.000000 0.000000 0.000000 1.000000 /end COMPU_METHOD
/* Scalar measurable for DDE 'V2gRxSigTrg'. */
/begin MEASUREMENT V2gRxSigTrg "Trigger falg that on a rising edge indicates the event for receiving any PLC (V2G) message from EVSE" UBYTE CU_V2GRXSIGTRG 1 100 0.0 1.0 ECU_ADDRESS 0x70018094 BYTE_ORDER MSB_LAST /end MEASUREMENT
/begin COMPU_METHOD CU_V2GRXSIGTRG "Conversion method for V2gRxSigTrg" RAT_FUNC "%10.0" "b" COEFFS 0.000000 1.000000 -0.000000 0.000000 0.000000 1.000000 /end COMPU_METHOD
/* Scalar measurable for DDE 'V2gRxSigVoltLimReached'. */
/begin MEASUREMENT V2gRxSigVoltLimReached "f set to TRUE, the EVSE has reached its voltage limit." UBYTE CU_V2GRXSIGVOLTLIMREACHED 1 100 0.0 1.0 ECU_ADDRESS 0x700183fe BYTE_ORDER MSB_LAST /end MEASUREMENT
/begin COMPU_METHOD CU_V2GRXSIGVOLTLIMREACHED "Conversion method for V2gRxSigVoltLimReached" RAT_FUNC "%10.0" "b" COEFFS 0.000000 1.000000 -0.000000 0.000000 0.000000 1.000000 /end COMPU_METHOD
/* Scalar measurable for DDE 'V2gTxBptParamEnable'. */
/begin MEASUREMENT V2gTxBptParamEnable "If EV bidirectional parameter is enabled by the EV" UBYTE CU_V2GTXBPTPARAMENABLE 1 100 0.0 1.0 ECU_ADDRESS 0x7001826c BYTE_ORDER MSB_LAST /end MEASUREMENT
/begin COMPU_METHOD CU_V2GTXBPTPARAMENABLE "Conversion method for V2gTxBptParamEnable" RAT_FUNC "%10.0" "b" COEFFS 0.000000 1.000000 -0.000000 0.000000 0.000000 1.000000 /end COMPU_METHOD
/* Scalar measurable for DDE 'V2gTxBulkChargingComplete'. */
/begin MEASUREMENT V2gTxBulkChargingComplete "If set to TRUE, the vehicle indicates that bulk charge is complete." UBYTE CU_V2GTXBULKCHARGINGCOMPLETE 1 100 0.0 1.0 ECU_ADDRESS 0x700182fc BYTE_ORDER MSB_LAST /end MEASUREMENT
/begin COMPU_METHOD CU_V2GTXBULKCHARGINGCOMPLETE "Conversion method for V2gTxBulkChargingComplete" RAT_FUNC "%10.0" "b" COEFFS 0.000000 1.000000 -0.000000 0.000000 0.000000 1.000000 /end COMPU_METHOD
/* Scalar measurable for DDE 'V2gTxBulkSoc'. */
/begin MEASUREMENT V2gTxBulkSoc "State of charge at which the vehicle considers a fast charge process to be complete" FLOAT32_IEEE CU_V2GTXBULKSOC 1 100 0.0 100.0 ECU_ADDRESS 0x70017ea4 BYTE_ORDER MSB_LAST /end MEASUREMENT
/begin COMPU_METHOD CU_V2GTXBULKSOC "Conversion method for V2gTxBulkSoc" RAT_FUNC "%10.0" "%" COEFFS 0.000000 1.000000 -0.000000 0.000000 0.000000 1.000000 /end COMPU_METHOD
/* Scalar measurable for DDE 'V2gTxChargeProgress'. */
/begin MEASUREMENT V2gTxChargeProgress "Charge Progress signal determined for ISO15118 Power Delivery Req message." SLONG CU_V2GTXCHARGEPROGRESS 1 100 -2147483648.0 2147483647.0 ECU_ADDRESS 0x70017e98 BYTE_ORDER MSB_LAST /end MEASUREMENT
/begin COMPU_METHOD CU_V2GTXCHARGEPROGRESS "Conversion method for V2gTxChargeProgress" TAB_VERB "%12.0" "1" COMPU_TAB_REF CT_V2GTXCHARGEPROGRESS /end COMPU_METHOD
/begin COMPU_VTAB CT_V2GTXCHARGEPROGRESS "Conversion method for V2gTxChargeProgress" TAB_VERB 3 0 "START" 1 "STOP" 2 "RENEGOTIATE" /end COMPU_VTAB
/* Scalar measurable for DDE 'V2gTxChargingComplete'. */
/begin MEASUREMENT V2gTxChargingComplete "If set to TRUE, the vehicle indicates that full charge is complete." UBYTE CU_V2GTXCHARGINGCOMPLETE 1 100 0.0 1.0 ECU_ADDRESS 0x70017ee8 BYTE_ORDER MSB_LAST /end MEASUREMENT
/begin COMPU_METHOD CU_V2GTXCHARGINGCOMPLETE "Conversion method for V2gTxChargingComplete" RAT_FUNC "%10.0" "b" COEFFS 0.000000 1.000000 -0.000000 0.000000 0.000000 1.000000 /end COMPU_METHOD
/* Scalar measurable for DDE 'V2gTxDcChgParamEnable'. */
/begin MEASUREMENT V2gTxDcChgParamEnable "If the Charge parmeter is enabled by the EV" UBYTE CU_V2GTXDCCHGPARAMENABLE 1 100 0.0 1.0 ECU_ADDRESS 0x70017dfc BYTE_ORDER MSB_LAST /end MEASUREMENT
/begin COMPU_METHOD CU_V2GTXDCCHGPARAMENABLE "Conversion method for V2gTxDcChgParamEnable" RAT_FUNC "%10.0" "b" COEFFS 0.000000 1.000000 -0.000000 0.000000 0.000000 1.000000 /end COMPU_METHOD
/* Scalar measurable for DDE 'V2gTxEvCrntMaxLim'. */
/begin MEASUREMENT V2gTxEvCrntMaxLim "Maximum current supported by the vehicle." FLOAT32_IEEE CU_V2GTXEVCRNTMAXLIM 1 100 0.0 196605.0 ECU_ADDRESS 0x7001844c BYTE_ORDER MSB_LAST /end MEASUREMENT
/begin COMPU_METHOD CU_V2GTXEVCRNTMAXLIM "Conversion method for V2gTxEvCrntMaxLim" RAT_FUNC "%10.0" "A" COEFFS 0.000000 1.000000 -0.000000 0.000000 0.000000 1.000000 /end COMPU_METHOD
/* Scalar measurable for DDE 'V2gTxEvCrntMinLim'. */
/begin MEASUREMENT V2gTxEvCrntMinLim "Minimum current supported by the vehicle." FLOAT32_IEEE CU_V2GTXEVCRNTMINLIM 1 100 0.0 196605.0 ECU_ADDRESS 0x70017dec BYTE_ORDER MSB_LAST /end MEASUREMENT
/begin COMPU_METHOD CU_V2GTXEVCRNTMINLIM "Conversion method for V2gTxEvCrntMinLim" RAT_FUNC "%10.0" "A" COEFFS 0.000000 1.000000 -0.000000 0.000000 0.000000 1.000000 /end COMPU_METHOD
/* Scalar measurable for DDE 'V2gTxEvDisChgCrntMaxLim'. */
/begin MEASUREMENT V2gTxEvDisChgCrntMaxLim "Maximum discharge current supported by the EV" FLOAT32_IEEE CU_V2GTXEVDISCHGCRNTMAXLIM 1 100 0.0 196605.0 ECU_ADDRESS 0x70017cec BYTE_ORDER MSB_LAST /end MEASUREMENT
/begin COMPU_METHOD CU_V2GTXEVDISCHGCRNTMAXLIM "Conversion method for V2gTxEvDisChgCrntMaxLim" RAT_FUNC "%10.0" "A" COEFFS 0.000000 1.000000 -0.000000 0.000000 0.000000 1.000000 /end COMPU_METHOD
/* Scalar measurable for DDE 'V2gTxEvDisChgCrntMinLim'. */
/begin MEASUREMENT V2gTxEvDisChgCrntMinLim "Minimum discharge current supported by the EV" FLOAT32_IEEE CU_V2GTXEVDISCHGCRNTMINLIM 1 100 0.0 196605.0 ECU_ADDRESS 0x70017ed0 BYTE_ORDER MSB_LAST /end MEASUREMENT
/begin COMPU_METHOD CU_V2GTXEVDISCHGCRNTMINLIM "Conversion method for V2gTxEvDisChgCrntMinLim" RAT_FUNC "%10.0" "A" COEFFS 0.000000 1.000000 -0.000000 0.000000 0.000000 1.000000 /end COMPU_METHOD
/* Scalar measurable for DDE 'V2gTxEvDisChgPwrMaxLim'. */
/begin MEASUREMENT V2gTxEvDisChgPwrMaxLim "Maximum discharge power supported by the EV" FLOAT32_IEEE CU_V2GTXEVDISCHGPWRMAXLIM 1 100 0.0 196605.0 ECU_ADDRESS 0x700182a0 BYTE_ORDER MSB_LAST /end MEASUREMENT
/begin COMPU_METHOD CU_V2GTXEVDISCHGPWRMAXLIM "Conversion method for V2gTxEvDisChgPwrMaxLim" RAT_FUNC "%10.0" "A" COEFFS 0.000000 1.000000 -0.000000 0.000000 0.000000 1.000000 /end COMPU_METHOD
/* Scalar measurable for DDE 'V2gTxEvDisChgPwrMinLim'. */
/begin MEASUREMENT V2gTxEvDisChgPwrMinLim "Minimum discharge power supported by the EV" FLOAT32_IEEE CU_V2GTXEVDISCHGPWRMINLIM 1 100 0.0 196605.0 ECU_ADDRESS 0x70017e04 BYTE_ORDER MSB_LAST /end MEASUREMENT
/begin COMPU_METHOD CU_V2GTXEVDISCHGPWRMINLIM "Conversion method for V2gTxEvDisChgPwrMinLim" RAT_FUNC "%10.0" "A" COEFFS 0.000000 1.000000 -0.000000 0.000000 0.000000 1.000000 /end COMPU_METHOD
/* Scalar measurable for DDE 'V2gTxEvEgyCapacity'. */
/begin MEASUREMENT V2gTxEvEgyCapacity "Maximum energy capacity supported by the vehicle" FLOAT32_IEEE CU_V2GTXEVEGYCAPACITY 1 100 0.0 196605.0 ECU_ADDRESS 0x70017e64 BYTE_ORDER MSB_LAST /end MEASUREMENT
/begin COMPU_METHOD CU_V2GTXEVEGYCAPACITY "Conversion method for V2gTxEvEgyCapacity" RAT_FUNC "%10.0" "Wh" COEFFS 0.000000 1.000000 -0.000000 0.000000 0.000000 1.000000 /end COMPU_METHOD
/* Scalar measurable for DDE 'V2gTxEvEgyReqAmount'. */
/begin MEASUREMENT V2gTxEvEgyReqAmount "Amount of energy requested by the vehicle" FLOAT32_IEEE CU_V2GTXEVEGYREQAMOUNT 1 100 0.0 196605.0 ECU_ADDRESS 0x7001824c BYTE_ORDER MSB_LAST /end MEASUREMENT
/begin COMPU_METHOD CU_V2GTXEVEGYREQAMOUNT "Conversion method for V2gTxEvEgyReqAmount" RAT_FUNC "%10.0" "Wh" COEFFS 0.000000 1.000000 -0.000000 0.000000 0.000000 1.000000 /end COMPU_METHOD
/* Scalar measurable for DDE 'V2gTxEvErrorCode'. */
/begin MEASUREMENT V2gTxEvErrorCode "Indicates the EV internal status" SLONG CU_V2GTXEVERRORCODE 1 100 -2147483648.0 2147483647.0 ECU_ADDRESS 0x70018154 BYTE_ORDER MSB_LAST /end MEASUREMENT
/begin COMPU_METHOD CU_V2GTXEVERRORCODE "Conversion method for V2gTxEvErrorCode" TAB_VERB "%12.0" "enum" COMPU_TAB_REF CT_V2GTXEVERRORCODE /end COMPU_METHOD
/begin COMPU_VTAB CT_V2GTXEVERRORCODE "Conversion method for V2gTxEvErrorCode" TAB_VERB 12 0 "EVERRORCODE_NO_ERROR" 1 "FAILED_RESS_TEMP_INHIBIT" 2 "FAILED_EV_SHIFT_POSITION" 3 "FAILED_CHARGER_CONNECTOR_LOCK_FLT" 4 "FAILED_RESS_MALFUNCTION" 5 "FAILED_CHARGE_CRNT_DIFFERENTIAL" 6 "FAILED_CHARGE_VOLT_OOR" 7 "Reserved_A_C1" 8 "Reserved_A_C2" 9 "Reserved_A_C3" 10 "FAILED_CHARGE_SYSTEM_INCOMPATIBLE" 11 "EVERRORCODE_NO_DATA" /end COMPU_VTAB
/* Scalar measurable for DDE 'V2gTxEvMaxEgyReq'. */
/begin MEASUREMENT V2gTxEvMaxEgyReq "Maximum energy energy level accepted by the EV at any given time during the energy transfer loop" FLOAT32_IEEE CU_V2GTXEVMAXEGYREQ 1 100 0.0 196605.0 ECU_ADDRESS 0x70018240 BYTE_ORDER MSB_LAST /end MEASUREMENT
/begin COMPU_METHOD CU_V2GTXEVMAXEGYREQ "Conversion method for V2gTxEvMaxEgyReq" RAT_FUNC "%10.0" "Wh" COEFFS 0.000000 1.000000 -0.000000 0.000000 0.000000 1.000000 /end COMPU_METHOD
/* Scalar measurable for DDE 'V2gTxEvMinEgyReq'. */
/begin MEASUREMENT V2gTxEvMinEgyReq "Minimum energy requested by the EV at any given time during the energy transfer loop" FLOAT32_IEEE CU_V2GTXEVMINEGYREQ 1 100 0.0 196605.0 ECU_ADDRESS 0x70018004 BYTE_ORDER MSB_LAST /end MEASUREMENT
/begin COMPU_METHOD CU_V2GTXEVMINEGYREQ "Conversion method for V2gTxEvMinEgyReq" RAT_FUNC "%10.0" "Wh" COEFFS 0.000000 1.000000 -0.000000 0.000000 0.000000 1.000000 /end COMPU_METHOD
/* Scalar measurable for DDE 'V2gTxEvOperation'. */
/begin MEASUREMENT V2gTxEvOperation "If set to 1, the vehicle indicates that EV is operating in Charge Mode, 0 indicates BPT Mode" UBYTE CU_V2GTXEVOPERATION 1 100 0.0 1.0 ECU_ADDRESS 0x70017fe4 BYTE_ORDER MSB_LAST /end MEASUREMENT
/begin COMPU_METHOD CU_V2GTXEVOPERATION "Conversion method for V2gTxEvOperation" RAT_FUNC "%10.0" "1" COEFFS 0.000000 1.000000 -0.000000 0.000000 0.000000 1.000000 /end COMPU_METHOD
/* Scalar measurable for DDE 'V2gTxEvOperationEn'. */
/begin MEASUREMENT V2gTxEvOperationEn "Enable of the EV Operation signal" UBYTE CU_V2GTXEVOPERATIONEN 1 100 0.0 1.0 ECU_ADDRESS 0x70017cb0 BYTE_ORDER MSB_LAST /end MEASUREMENT
/begin COMPU_METHOD CU_V2GTXEVOPERATIONEN "Conversion method for V2gTxEvOperationEn" RAT_FUNC "%10.0" "b" COEFFS 0.000000 1.000000 -0.000000 0.000000 0.000000 1.000000 /end COMPU_METHOD
/* Scalar measurable for DDE 'V2gTxEvPwrMaxLim'. */
/begin MEASUREMENT V2gTxEvPwrMaxLim "Maximum power supported by the vehicle." FLOAT32_IEEE CU_V2GTXEVPWRMAXLIM 1 100 0.0 196605.0 ECU_ADDRESS 0x70018454 BYTE_ORDER MSB_LAST /end MEASUREMENT
/begin COMPU_METHOD CU_V2GTXEVPWRMAXLIM "Conversion method for V2gTxEvPwrMaxLim" RAT_FUNC "%10.0" "W" COEFFS 0.000000 1.000000 -0.000000 0.000000 0.000000 1.000000 /end COMPU_METHOD
/* Scalar measurable for DDE 'V2gTxEvPwrMinLim'. */
/begin MEASUREMENT V2gTxEvPwrMinLim "Minimum power supported by the vehicle." FLOAT32_IEEE CU_V2GTXEVPWRMINLIM 1 100 0.0 196605.0 ECU_ADDRESS 0x700184b4 BYTE_ORDER MSB_LAST /end MEASUREMENT
/begin COMPU_METHOD CU_V2GTXEVPWRMINLIM "Conversion method for V2gTxEvPwrMinLim" RAT_FUNC "%10.0" "W" COEFFS 0.000000 1.000000 -0.000000 0.000000 0.000000 1.000000 /end COMPU_METHOD
/* Scalar measurable for DDE 'V2gTxEvReady'. */
/begin MEASUREMENT V2gTxEvReady "If set to TRUE, the vehicle is ready to charge." UBYTE CU_V2GTXEVREADY 1 100 0.0 1.0 ECU_ADDRESS 0x7001828c BYTE_ORDER MSB_LAST /end MEASUREMENT
/begin COMPU_METHOD CU_V2GTXEVREADY "Conversion method for V2gTxEvReady" RAT_FUNC "%10.0" "b" COEFFS 0.000000 1.000000 -0.000000 0.000000 0.000000 1.000000 /end COMPU_METHOD
/* Scalar measurable for DDE 'V2gTxEvReqEgyTransferType'. */
/begin MEASUREMENT V2gTxEvReqEgyTransferType "final V2G value of the energy transfer type for charging to be sent to EVSE" UBYTE CU_V2GTXEVREQEGYTRANSFERTYPE 1 100 0.0 255.0 ECU_ADDRESS 0x70017c2c BYTE_ORDER MSB_LAST /end MEASUREMENT
/begin COMPU_METHOD CU_V2GTXEVREQEGYTRANSFERTYPE "Conversion method for V2gTxEvReqEgyTransferType" RAT_FUNC "%10.0" "1" COEFFS 0.000000 1.000000 -0.000000 0.000000 0.000000 1.000000 /end COMPU_METHOD
/* Scalar measurable for DDE 'V2gTxEvRessCondition'. */
/begin MEASUREMENT V2gTxEvRessCondition "The vehicle is using energy from the DC charger to condition the RESS to a target temperature" UBYTE CU_V2GTXEVRESSCONDITION 1 100 0.0 1.0 ECU_ADDRESS 0x70018308 BYTE_ORDER MSB_LAST /end MEASUREMENT
/begin COMPU_METHOD CU_V2GTXEVRESSCONDITION "Conversion method for V2gTxEvRessCondition" RAT_FUNC "%10.0" "b" COEFFS 0.000000 1.000000 -0.000000 0.000000 0.000000 1.000000 /end COMPU_METHOD
/* Scalar measurable for DDE 'V2gTxEvRessSoc'. */
/begin MEASUREMENT V2gTxEvRessSoc "State of charge of the vehicle’s battery" FLOAT32_IEEE CU_V2GTXEVRESSSOC 1 100 0.0 100.0 ECU_ADDRESS 0x70018260 BYTE_ORDER MSB_LAST /end MEASUREMENT
/begin COMPU_METHOD CU_V2GTXEVRESSSOC "Conversion method for V2gTxEvRessSoc" RAT_FUNC "%10.0" "%" COEFFS 0.000000 1.000000 -0.000000 0.000000 0.000000 1.000000 /end COMPU_METHOD
/* Scalar measurable for DDE 'V2gTxEvTargetCrnt'. */
/begin MEASUREMENT V2gTxEvTargetCrnt "Instantaneous current requested by the vehicle" FLOAT32_IEEE CU_V2GTXEVTARGETCRNT 1 100 0.0 196605.0 ECU_ADDRESS 0x70017fd0 BYTE_ORDER MSB_LAST /end MEASUREMENT
/begin COMPU_METHOD CU_V2GTXEVTARGETCRNT "Conversion method for V2gTxEvTargetCrnt" RAT_FUNC "%10.0" "A" COEFFS 0.000000 1.000000 -0.000000 0.000000 0.000000 1.000000 /end COMPU_METHOD
/* Scalar measurable for DDE 'V2gTxEvTargetVolt'. */
/begin MEASUREMENT V2gTxEvTargetVolt "Target Voltage requested by EV" FLOAT32_IEEE CU_V2GTXEVTARGETVOLT 1 100 0.0 196605.0 ECU_ADDRESS 0x70018244 BYTE_ORDER MSB_LAST /end MEASUREMENT
/begin COMPU_METHOD CU_V2GTXEVTARGETVOLT "Conversion method for V2gTxEvTargetVolt" RAT_FUNC "%10.0" "V" COEFFS 0.000000 1.000000 -0.000000 0.000000 0.000000 1.000000 /end COMPU_METHOD
/* Scalar measurable for DDE 'V2gTxEvVoltMaxLim'. */
/begin MEASUREMENT V2gTxEvVoltMaxLim "Maximum voltage supported by the vehicle." FLOAT32_IEEE CU_V2GTXEVVOLTMAXLIM 1 100 0.0 196605.0 ECU_ADDRESS 0x70017c28 BYTE_ORDER MSB_LAST /end MEASUREMENT
/begin COMPU_METHOD CU_V2GTXEVVOLTMAXLIM "Conversion method for V2gTxEvVoltMaxLim" RAT_FUNC "%10.0" "V" COEFFS 0.000000 1.000000 -0.000000 0.000000 0.000000 1.000000 /end COMPU_METHOD
/* Scalar measurable for DDE 'V2gTxEvVoltMinLim'. */
/begin MEASUREMENT V2gTxEvVoltMinLim "Minimum voltage supported by the vehicle." FLOAT32_IEEE CU_V2GTXEVVOLTMINLIM 1 100 0.0 196605.0 ECU_ADDRESS 0x70017f9c BYTE_ORDER MSB_LAST /end MEASUREMENT
/begin COMPU_METHOD CU_V2GTXEVVOLTMINLIM "Conversion method for V2gTxEvVoltMinLim" RAT_FUNC "%10.0" "V" COEFFS 0.000000 1.000000 -0.000000 0.000000 0.000000 1.000000 /end COMPU_METHOD
/* Scalar measurable for DDE 'V2gTxFullSoc'. */
/begin MEASUREMENT V2gTxFullSoc "State of charge at which the vehicle considers the battery fully charged." FLOAT32_IEEE CU_V2GTXFULLSOC 1 100 0.0 100.0 ECU_ADDRESS 0x70018144 BYTE_ORDER MSB_LAST /end MEASUREMENT
/begin COMPU_METHOD CU_V2GTXFULLSOC "Conversion method for V2gTxFullSoc" RAT_FUNC "%10.0" "%" COEFFS 0.000000 1.000000 -0.000000 0.000000 0.000000 1.000000 /end COMPU_METHOD
/* Scalar measurable for DDE 'V2gTxParameterSetId'. */
/begin MEASUREMENT V2gTxParameterSetId "Used to select a specific parameter set for a specific ServiceID when selecting a service" UWORD CU_V2GTXPARAMETERSETID 1 100 0.0 65535.0 ECU_ADDRESS 0x7001818a BYTE_ORDER MSB_LAST /end MEASUREMENT
/begin COMPU_METHOD CU_V2GTXPARAMETERSETID "Conversion method for V2gTxParameterSetId" RAT_FUNC "%10.0" "1" COEFFS 0.000000 1.000000 -0.000000 0.000000 0.000000 1.000000 /end COMPU_METHOD
/* Scalar measurable for DDE 'V2gTxProfileEntryCnt'. */
/begin MEASUREMENT V2gTxProfileEntryCnt "Identifies the number of charging profile entries that have been provided in the ChargingProfileEntryStart and ChargingProfileEntryMaxPower parameters." UWORD CU_V2GTXPROFILEENTRYCNT 1 100 0.0 24.0 ECU_ADDRESS 0x700181fc BYTE_ORDER MSB_LAST /end MEASUREMENT
/begin COMPU_METHOD CU_V2GTXPROFILEENTRYCNT "Conversion method for V2gTxProfileEntryCnt" RAT_FUNC "%10.0" "1" COEFFS 0.000000 1.000000 -0.000000 0.000000 0.000000 1.000000 /end COMPU_METHOD
/* Scalar measurable for DDE 'V2gTxRemainTimeToFullSoc'. */
/begin MEASUREMENT V2gTxRemainTimeToFullSoc "Estimated or calculated time until full charge is complete. For displaying on EVSE for user only." FLOAT32_IEEE CU_V2GTXREMAINTIMETOFULLSOC 1 100 0.0 196605.0 ECU_ADDRESS 0x70017fe8 BYTE_ORDER MSB_LAST /end MEASUREMENT
/begin COMPU_METHOD CU_V2GTXREMAINTIMETOFULLSOC "Conversion method for V2gTxRemainTimeToFullSoc" RAT_FUNC "%10.0" "s" COEFFS 0.000000 1.000000 -0.000000 0.000000 0.000000 1.000000 /end COMPU_METHOD
/* Scalar measurable for DDE 'V2gTxRemainTimetoBulkSoc'. */
/begin MEASUREMENT V2gTxRemainTimetoBulkSoc "Estimated or calculated time until bulk charge is complete. For displaying on EVSE for user only." FLOAT32_IEEE CU_V2GTXREMAINTIMETOBULKSOC 1 100 0.0 196605.0 ECU_ADDRESS 0x70017eec BYTE_ORDER MSB_LAST /end MEASUREMENT
/begin COMPU_METHOD CU_V2GTXREMAINTIMETOBULKSOC "Conversion method for V2gTxRemainTimetoBulkSoc" RAT_FUNC "%10.0" "s" COEFFS 0.000000 1.000000 -0.000000 0.000000 0.000000 1.000000 /end COMPU_METHOD
/* Scalar measurable for DDE 'V2gTxSaSchdlTupleId'. */
/begin MEASUREMENT V2gTxSaSchdlTupleId "Unique identifier within a charging session referring to the selected SAScheduleTuple element from the SAScheduleListType as described by J2847-2" UBYTE CU_V2GTXSASCHDLTUPLEID 1 100 0.0 255.0 ECU_ADDRESS 0x70017ef1 BYTE_ORDER MSB_LAST /end MEASUREMENT
/begin COMPU_METHOD CU_V2GTXSASCHDLTUPLEID "Conversion method for V2gTxSaSchdlTupleId" RAT_FUNC "%10.0" "1" COEFFS 0.000000 1.000000 -0.000000 0.000000 0.000000 1.000000 /end COMPU_METHOD
/* Scalar measurable for DDE 'V2gTxSaSchdlTupleIdEn'. */
/begin MEASUREMENT V2gTxSaSchdlTupleIdEn "Flag to indicate if SASchedule Tuple ID is enabled (1) or disabled (0) as a message element during power delivery request" UBYTE CU_V2GTXSASCHDLTUPLEIDEN 1 100 0.0 1.0 ECU_ADDRESS 0x70018239 BYTE_ORDER MSB_LAST /end MEASUREMENT
/begin COMPU_METHOD CU_V2GTXSASCHDLTUPLEIDEN "Conversion method for V2gTxSaSchdlTupleIdEn" RAT_FUNC "%10.0" "b" COEFFS 0.000000 1.000000 -0.000000 0.000000 0.000000 1.000000 /end COMPU_METHOD
/* Scalar measurable for DDE 'V2gTxServiceId'. */
/begin MEASUREMENT V2gTxServiceId "Unique identifier of the service as applicable to the SelectedServiceType described by J2847-2." UWORD CU_V2GTXSERVICEID 1 100 0.0 65535.0 ECU_ADDRESS 0x70017e18 BYTE_ORDER MSB_LAST /end MEASUREMENT
/begin COMPU_METHOD CU_V2GTXSERVICEID "Conversion method for V2gTxServiceId" RAT_FUNC "%10.0" "1" COEFFS 0.000000 1.000000 -0.000000 0.000000 0.000000 1.000000 /end COMPU_METHOD
/* Scalar measurable for DDE 'V2gTxSupSvcIdsLen'. */
/begin MEASUREMENT V2gTxSupSvcIdsLen "Number of service IDs supported by the EV" UBYTE CU_V2GTXSUPSVCIDSLEN 1 100 0.0 10.0 ECU_ADDRESS 0x70018494 BYTE_ORDER MSB_LAST /end MEASUREMENT
/begin COMPU_METHOD CU_V2GTXSUPSVCIDSLEN "Conversion method for V2gTxSupSvcIdsLen" RAT_FUNC "%10.0" "1" COEFFS 0.000000 1.000000 -0.000000 0.000000 0.000000 1.000000 /end COMPU_METHOD
/* Scalar measurable for DDE 'V2gTxSupSvcIds[0]'. */
/begin MEASUREMENT V2gTxSupSvcIds[0] "List of all service IDs supported by the EV" UWORD CU_V2GTXSUPSVCIDS[0] 1 100 0.0 65535.0 ECU_ADDRESS 0x700182e6 BYTE_ORDER MSB_LAST /end MEASUREMENT
/begin COMPU_METHOD CU_V2GTXSUPSVCIDS[0] "Conversion method for V2gTxSupSvcIds[0]" RAT_FUNC "%10.0" "1" COEFFS 0.000000 1.000000 -0.000000 0.000000 0.000000 1.000000 /end COMPU_METHOD
/* Scalar measurable for DDE 'V2gTxSupSvcIds[1]'. */
/begin MEASUREMENT V2gTxSupSvcIds[1] "List of all service IDs supported by the EV" UWORD CU_V2GTXSUPSVCIDS[1] 1 100 0.0 65535.0 ECU_ADDRESS 0x700182e8 BYTE_ORDER MSB_LAST /end MEASUREMENT
/begin COMPU_METHOD CU_V2GTXSUPSVCIDS[1] "Conversion method for V2gTxSupSvcIds[1]" RAT_FUNC "%10.0" "1" COEFFS 0.000000 1.000000 -0.000000 0.000000 0.000000 1.000000 /end COMPU_METHOD
/* Scalar measurable for DDE 'V2gTxSupSvcIds[2]'. */
/begin MEASUREMENT V2gTxSupSvcIds[2] "List of all service IDs supported by the EV" UWORD CU_V2GTXSUPSVCIDS[2] 1 100 0.0 65535.0 ECU_ADDRESS 0x700182ea BYTE_ORDER MSB_LAST /end MEASUREMENT
/begin COMPU_METHOD CU_V2GTXSUPSVCIDS[2] "Conversion method for V2gTxSupSvcIds[2]" RAT_FUNC "%10.0" "1" COEFFS 0.000000 1.000000 -0.000000 0.000000 0.000000 1.000000 /end COMPU_METHOD
/* Scalar measurable for DDE 'V2gTxSupSvcIds[3]'. */
/begin MEASUREMENT V2gTxSupSvcIds[3] "List of all service IDs supported by the EV" UWORD CU_V2GTXSUPSVCIDS[3] 1 100 0.0 65535.0 ECU_ADDRESS 0x700182ec BYTE_ORDER MSB_LAST /end MEASUREMENT
/begin COMPU_METHOD CU_V2GTXSUPSVCIDS[3] "Conversion method for V2gTxSupSvcIds[3]" RAT_FUNC "%10.0" "1" COEFFS 0.000000 1.000000 -0.000000 0.000000 0.000000 1.000000 /end COMPU_METHOD
/* Scalar measurable for DDE 'V2gTxSupSvcIds[4]'. */
/begin MEASUREMENT V2gTxSupSvcIds[4] "List of all service IDs supported by the EV" UWORD CU_V2GTXSUPSVCIDS[4] 1 100 0.0 65535.0 ECU_ADDRESS 0x700182ee BYTE_ORDER MSB_LAST /end MEASUREMENT
/begin COMPU_METHOD CU_V2GTXSUPSVCIDS[4] "Conversion method for V2gTxSupSvcIds[4]" RAT_FUNC "%10.0" "1" COEFFS 0.000000 1.000000 -0.000000 0.000000 0.000000 1.000000 /end COMPU_METHOD
/* Scalar measurable for DDE 'V2gTxSupSvcIds[5]'. */
/begin MEASUREMENT V2gTxSupSvcIds[5] "List of all service IDs supported by the EV" UWORD CU_V2GTXSUPSVCIDS[5] 1 100 0.0 65535.0 ECU_ADDRESS 0x700182f0 BYTE_ORDER MSB_LAST /end MEASUREMENT
/begin COMPU_METHOD CU_V2GTXSUPSVCIDS[5] "Conversion method for V2gTxSupSvcIds[5]" RAT_FUNC "%10.0" "1" COEFFS 0.000000 1.000000 -0.000000 0.000000 0.000000 1.000000 /end COMPU_METHOD
/* Scalar measurable for DDE 'V2gTxSupSvcIds[6]'. */
/begin MEASUREMENT V2gTxSupSvcIds[6] "List of all service IDs supported by the EV" UWORD CU_V2GTXSUPSVCIDS[6] 1 100 0.0 65535.0 ECU_ADDRESS 0x700182f2 BYTE_ORDER MSB_LAST /end MEASUREMENT
/begin COMPU_METHOD CU_V2GTXSUPSVCIDS[6] "Conversion method for V2gTxSupSvcIds[6]" RAT_FUNC "%10.0" "1" COEFFS 0.000000 1.000000 -0.000000 0.000000 0.000000 1.000000 /end COMPU_METHOD
/* Scalar measurable for DDE 'V2gTxSupSvcIds[7]'. */
/begin MEASUREMENT V2gTxSupSvcIds[7] "List of all service IDs supported by the EV" UWORD CU_V2GTXSUPSVCIDS[7] 1 100 0.0 65535.0 ECU_ADDRESS 0x700182f4 BYTE_ORDER MSB_LAST /end MEASUREMENT
/begin COMPU_METHOD CU_V2GTXSUPSVCIDS[7] "Conversion method for V2gTxSupSvcIds[7]" RAT_FUNC "%10.0" "1" COEFFS 0.000000 1.000000 -0.000000 0.000000 0.000000 1.000000 /end COMPU_METHOD
/* Scalar measurable for DDE 'V2gTxSupSvcIds[8]'. */
/begin MEASUREMENT V2gTxSupSvcIds[8] "List of all service IDs supported by the EV" UWORD CU_V2GTXSUPSVCIDS[8] 1 100 0.0 65535.0 ECU_ADDRESS 0x700182f6 BYTE_ORDER MSB_LAST /end MEASUREMENT
/begin COMPU_METHOD CU_V2GTXSUPSVCIDS[8] "Conversion method for V2gTxSupSvcIds[8]" RAT_FUNC "%10.0" "1" COEFFS 0.000000 1.000000 -0.000000 0.000000 0.000000 1.000000 /end COMPU_METHOD
/* Scalar measurable for DDE 'V2gTxSupSvcIds[9]'. */
/begin MEASUREMENT V2gTxSupSvcIds[9] "List of all service IDs supported by the EV" UWORD CU_V2GTXSUPSVCIDS[9] 1 100 0.0 65535.0 ECU_ADDRESS 0x700182f8 BYTE_ORDER MSB_LAST /end MEASUREMENT
/begin COMPU_METHOD CU_V2GTXSUPSVCIDS[9] "Conversion method for V2gTxSupSvcIds[9]" RAT_FUNC "%10.0" "1" COEFFS 0.000000 1.000000 -0.000000 0.000000 0.000000 1.000000 /end COMPU_METHOD
/* Scalar measurable for DDE 'V2gTxTargetSoc'. */
/begin MEASUREMENT V2gTxTargetSoc "State of charge desired by the EV, could be less than full SOC" FLOAT32_IEEE CU_V2GTXTARGETSOC 1 100 0.0 100.0 ECU_ADDRESS 0x70018164 BYTE_ORDER MSB_LAST /end MEASUREMENT
/begin COMPU_METHOD CU_V2GTXTARGETSOC "Conversion method for V2gTxTargetSoc" RAT_FUNC "%10.0" "%" COEFFS 0.000000 1.000000 -0.000000 0.000000 0.000000 1.000000 /end COMPU_METHOD
/begin FUNCTION PayloadArbitration9 "Group /ByModelHeirarchy/LaforgeTestApp_CCU/Core0-TestApp/V2G/OE_CCS/Arbitration/Arbit_V2gRxMsg_V2gRxMsgCrntDmd/PayloadArbitration"
 /begin LOC_MEASUREMENT V2gRxMsgCrntDmdCrntLimReached V2gRxMsgCrntDmdEvseCurrent V2gRxMsgCrntDmdEvseIdLen V2gRxMsgCrntDmdEvseId[0] V2gRxMsgCrntDmdEvseId[10] V2gRxMsgCrntDmdEvseId[11] V2gRxMsgCrntDmdEvseId[12] V2gRxMsgCrntDmdEvseId[13] V2gRxMsgCrntDmdEvseId[14] V2gRxMsgCrntDmdEvseId[15] V2gRxMsgCrntDmdEvseId[16] V2gRxMsgCrntDmdEvseId[17] V2gRxMsgCrntDmdEvseId[18] V2gRxMsgCrntDmdEvseId[19] V2gRxMsgCrntDmdEvseId[1] V2gRxMsgCrntDmdEvseId[20] V2gRxMsgCrntDmdEvseId[21] V2gRxMsgCrntDmdEvseId[22] V2gRxMsgCrntDmdEvseId[23] V2gRxMsgCrntDmdEvseId[24] V2gRxMsgCrntDmdEvseId[25] V2gRxMsgCrntDmdEvseId[26] V2gRxMsgCrntDmdEvseId[27] V2gRxMsgCrntDmdEvseId[28] V2gRxMsgCrntDmdEvseId[29] V2gRxMsgCrntDmdEvseId[2] V2gRxMsgCrntDmdEvseId[30] V2gRxMsgCrntDmdEvseId[31] V2gRxMsgCrntDmdEvseId[32] V2gRxMsgCrntDmdEvseId[33] V2gRxMsgCrntDmdEvseId[34] V2gRxMsgCrntDmdEvseId[35] V2gRxMsgCrntDmdEvseId[36] V2gRxMsgCrntDmdEvseId[37] V2gRxMsgCrntDmdEvseId[3] V2gRxMsgCrntDmdEvseId[4] V2gRxMsgCrntDmdEvseId[5] V2gRxMsgCrntDmdEvseId[6] V2gRxMsgCrntDmdEvseId[7] V2gRxMsgCrntDmdEvseId[8] V2gRxMsgCrntDmdEvseId[9] V2gRxMsgCrntDmdEvseStatus V2gRxMsgCrntDmdEvseVoltage V2gRxMsgCrntDmdIsolStatus V2gRxMsgCrntDmdIsolStatus_flg V2gRxMsgCrntDmdMaxCrnt V2gRxMsgCrntDmdMaxCrnt_flg V2gRxMsgCrntDmdMaxPwr V2gRxMsgCrntDmdMaxPwr_flg V2gRxMsgCrntDmdMaxVolt V2gRxMsgCrntDmdMaxVolt_flg V2gRxMsgCrntDmdNotif V2gRxMsgCrntDmdNotifFlg V2gRxMsgCrntDmdNotifMaxDelay V2gRxMsgCrntDmdPwrLimReached V2gRxMsgCrntDmdRescode V2gRxMsgCrntDmdSASchTupId V2gRxMsgCrntDmdSASchTupIdFlg V2gRxMsgCrntDmdVoltLimReached /end LOC_MEASUREMENT
/end FUNCTION
/begin FUNCTION Arbit_V2gRxMsg_V2gRxMsgCrntDmd "Group /ByModelHeirarchy/LaforgeTestApp_CCU/Core0-TestApp/V2G/OE_CCS/Arbitration/Arbit_V2gRxMsg_V2gRxMsgCrntDmd" /begin SUB_FUNCTION PayloadArbitration9 /end SUB_FUNCTION /begin LOC_MEASUREMENT V2gRxMsgCrntDmdTrg /end LOC_MEASUREMENT /end FUNCTION
/begin FUNCTION PayloadArbitratio00 "Group /ByModelHeirarchy/LaforgeTestApp_CCU/Core0-TestApp/V2G/OE_CCS/Arbitration/Arbit_V2gRxMsg_V2gRxMsgPreChg/PayloadArbitration"
 /begin LOC_MEASUREMENT V2gRxMsgPreChgEvseStatus V2gRxMsgPreChgEvseVoltage V2gRxMsgPreChgIsolStatus V2gRxMsgPreChgIsolStatus_flg V2gRxMsgPreChgNotif V2gRxMsgPreChgNotifFlg V2gRxMsgPreChgNotifMaxDelay V2gRxMsgPreChgRescode /end LOC_MEASUREMENT
/end FUNCTION
/begin FUNCTION Arbit_V2gRxMsg_V2gRxMsgPreChg "Group /ByModelHeirarchy/LaforgeTestApp_CCU/Core0-TestApp/V2G/OE_CCS/Arbitration/Arbit_V2gRxMsg_V2gRxMsgPreChg" /begin SUB_FUNCTION PayloadArbitratio00 /end SUB_FUNCTION /begin LOC_MEASUREMENT V2gRxMsgPreChgTrg /end LOC_MEASUREMENT /end FUNCTION
/begin FUNCTION PayloadArbitratio01 "Group /ByModelHeirarchy/LaforgeTestApp_CCU/Core0-TestApp/V2G/OE_CCS/Arbitration/Arbit_V2gRxMsg_V2gRxMsgPwrDeliv/PayloadArbitration"
 /begin LOC_MEASUREMENT V2gRxMsgPwrDelivEvseProcessing V2gRxMsgPwrDelivEvseStatus V2gRxMsgPwrDelivEvseStatus_flg V2gRxMsgPwrDelivIsolStatus V2gRxMsgPwrDelivIsolStatus_flg V2gRxMsgPwrDelivNotif V2gRxMsgPwrDelivNotifFlg V2gRxMsgPwrDelivNotifMaxDelay V2gRxMsgPwrDelivRescode /end LOC_MEASUREMENT
/end FUNCTION
/begin FUNCTION Arbit_V2gRxMsg_V2gRxMsgPwrDeliv "Group /ByModelHeirarchy/LaforgeTestApp_CCU/Core0-TestApp/V2G/OE_CCS/Arbitration/Arbit_V2gRxMsg_V2gRxMsgPwrDeliv" /begin SUB_FUNCTION PayloadArbitratio01 /end SUB_FUNCTION /begin LOC_MEASUREMENT V2gRxMsgPwrDelivTrg /end LOC_MEASUREMENT /end FUNCTION
/begin FUNCTION PayloadArbitratio02 "Group /ByModelHeirarchy/LaforgeTestApp_CCU/Core0-TestApp/V2G/OE_CCS/Arbitration/Arbit_V2gRxMsg_V2gRxMsgWeldDet/PayloadArbitration"
 /begin LOC_MEASUREMENT V2gRxMsgWeldDetEvseStatus V2gRxMsgWeldDetEvseVoltage V2gRxMsgWeldDetIsolStatus V2gRxMsgWeldDetIsolStatus_flg V2gRxMsgWeldDetNotif V2gRxMsgWeldDetNotifFlg V2gRxMsgWeldDetNotifMaxDelay V2gRxMsgWeldDetRescode /end LOC_MEASUREMENT
/end FUNCTION
/begin FUNCTION Arbit_V2gRxMsg_V2gRxMsgWeldDet "Group /ByModelHeirarchy/LaforgeTestApp_CCU/Core0-TestApp/V2G/OE_CCS/Arbitration/Arbit_V2gRxMsg_V2gRxMsgWeldDet" /begin SUB_FUNCTION PayloadArbitratio02 /end SUB_FUNCTION /begin LOC_MEASUREMENT V2gRxMsgWeldDetTrg /end LOC_MEASUREMENT /end FUNCTION
/begin FUNCTION OVR_AndExport11 "Group /ByModelHeirarchy/LaforgeTestApp_CCU/Core0-TestApp/V2G/OE_CCS/Arbitration/Arbit_V2gSharedSignals /OVR_AndExport1" /begin LOC_MEASUREMENT V2gRxSigTrg /end LOC_MEASUREMENT /begin REF_CHARACTERISTIC V2gRxSigTrgOf_C V2gRxSigTrgOv_C /end REF_CHARACTERISTIC /end FUNCTION
/begin FUNCTION OVR_AndExport10 "Group /ByModelHeirarchy/LaforgeTestApp_CCU/Core0-TestApp/V2G/OE_CCS/Arbitration/Arbit_V2gSharedSignals /OVR_AndExport10" /begin LOC_MEASUREMENT V2gRxSigMaxCrnt_flg /end LOC_MEASUREMENT /begin REF_CHARACTERISTIC V2gRxSigMaxCrnt_flgOf_C V2gRxSigMaxCrnt_flgOv_C /end REF_CHARACTERISTIC /end FUNCTION
/begin FUNCTION OVR_AndExport11 "Group /ByModelHeirarchy/LaforgeTestApp_CCU/Core0-TestApp/V2G/OE_CCS/Arbitration/Arbit_V2gSharedSignals /OVR_AndExport11" /begin LOC_MEASUREMENT V2gRxSigMaxCrnt /end LOC_MEASUREMENT /begin REF_CHARACTERISTIC V2gRxSigMaxCrntOf_C V2gRxSigMaxCrntOv_C /end REF_CHARACTERISTIC /end FUNCTION
/begin FUNCTION OVR_AndExport12 "Group /ByModelHeirarchy/LaforgeTestApp_CCU/Core0-TestApp/V2G/OE_CCS/Arbitration/Arbit_V2gSharedSignals /OVR_AndExport12" /begin LOC_MEASUREMENT V2gRxSigMaxPwr_flg /end LOC_MEASUREMENT /begin REF_CHARACTERISTIC V2gRxSigMaxPwr_flgOf_C V2gRxSigMaxPwr_flgOv_C /end REF_CHARACTERISTIC /end FUNCTION
/begin FUNCTION OVR_AndExport131 "Group /ByModelHeirarchy/LaforgeTestApp_CCU/Core0-TestApp/V2G/OE_CCS/Arbitration/Arbit_V2gSharedSignals /OVR_AndExport13" /begin LOC_MEASUREMENT V2gRxSigMaxPwr /end LOC_MEASUREMENT /begin REF_CHARACTERISTIC V2gRxSigMaxPwrOf_C V2gRxSigMaxPwrOv_C /end REF_CHARACTERISTIC /end FUNCTION
/begin FUNCTION OVR_AndExport14 "Group /ByModelHeirarchy/LaforgeTestApp_CCU/Core0-TestApp/V2G/OE_CCS/Arbitration/Arbit_V2gSharedSignals /OVR_AndExport14" /begin LOC_MEASUREMENT V2gRxSigMinVolt_flg /end LOC_MEASUREMENT /begin REF_CHARACTERISTIC V2gRxSigMinVolt_flgOf_C V2gRxSigMinVolt_flgOv_C /end REF_CHARACTERISTIC /end FUNCTION
/begin FUNCTION OVR_AndExport15 "Group /ByModelHeirarchy/LaforgeTestApp_CCU/Core0-TestApp/V2G/OE_CCS/Arbitration/Arbit_V2gSharedSignals /OVR_AndExport15" /begin LOC_MEASUREMENT V2gRxSigMinVolt /end LOC_MEASUREMENT /begin REF_CHARACTERISTIC V2gRxSigMinVoltOf_C V2gRxSigMinVoltOv_C /end REF_CHARACTERISTIC /end FUNCTION
/begin FUNCTION OVR_AndExport16 "Group /ByModelHeirarchy/LaforgeTestApp_CCU/Core0-TestApp/V2G/OE_CCS/Arbitration/Arbit_V2gSharedSignals /OVR_AndExport16" /begin LOC_MEASUREMENT V2gRxSigEvseVoltage /end LOC_MEASUREMENT /begin REF_CHARACTERISTIC V2gRxSigEvseVoltageOf_C V2gRxSigEvseVoltageOv_C /end REF_CHARACTERISTIC /end FUNCTION
/begin FUNCTION OVR_AndExport17 "Group /ByModelHeirarchy/LaforgeTestApp_CCU/Core0-TestApp/V2G/OE_CCS/Arbitration/Arbit_V2gSharedSignals /OVR_AndExport17" /begin LOC_MEASUREMENT V2gRxSigEvseIdLen /end LOC_MEASUREMENT /begin REF_CHARACTERISTIC V2gRxSigEvseIdLenOf_C V2gRxSigEvseIdLenOv_C /end REF_CHARACTERISTIC /end FUNCTION
/begin FUNCTION OVR_AndExport18 "Group /ByModelHeirarchy/LaforgeTestApp_CCU/Core0-TestApp/V2G/OE_CCS/Arbitration/Arbit_V2gSharedSignals /OVR_AndExport18"
 /begin LOC_MEASUREMENT V2gRxSigEvseId[0] V2gRxSigEvseId[10] V2gRxSigEvseId[11] V2gRxSigEvseId[12] V2gRxSigEvseId[13] V2gRxSigEvseId[14] V2gRxSigEvseId[15] V2gRxSigEvseId[16] V2gRxSigEvseId[17] V2gRxSigEvseId[18] V2gRxSigEvseId[19] V2gRxSigEvseId[1] V2gRxSigEvseId[20] V2gRxSigEvseId[21] V2gRxSigEvseId[22] V2gRxSigEvseId[23] V2gRxSigEvseId[24] V2gRxSigEvseId[25] V2gRxSigEvseId[26] V2gRxSigEvseId[27] V2gRxSigEvseId[28] V2gRxSigEvseId[29] V2gRxSigEvseId[2] V2gRxSigEvseId[30] V2gRxSigEvseId[31] V2gRxSigEvseId[32] V2gRxSigEvseId[33] V2gRxSigEvseId[34] V2gRxSigEvseId[35] V2gRxSigEvseId[36] V2gRxSigEvseId[37] V2gRxSigEvseId[3] V2gRxSigEvseId[4] V2gRxSigEvseId[5] V2gRxSigEvseId[6] V2gRxSigEvseId[7] V2gRxSigEvseId[8] V2gRxSigEvseId[9] /end LOC_MEASUREMENT
 /begin REF_CHARACTERISTIC V2gRxSigEvseIdOf_C V2gRxSigEvseIdOv_C /end REF_CHARACTERISTIC
/end FUNCTION
/begin FUNCTION OVR_AndExport19 "Group /ByModelHeirarchy/LaforgeTestApp_CCU/Core0-TestApp/V2G/OE_CCS/Arbitration/Arbit_V2gSharedSignals /OVR_AndExport19" /begin LOC_MEASUREMENT V2gRxSigNotifMaxDelay /end LOC_MEASUREMENT /begin REF_CHARACTERISTIC V2gRxSigNotifMaxDelayOf_C V2gRxSigNotifMaxDelayOv_C /end REF_CHARACTERISTIC /end FUNCTION
/begin FUNCTION OVR_AndExport2 "Group /ByModelHeirarchy/LaforgeTestApp_CCU/Core0-TestApp/V2G/OE_CCS/Arbitration/Arbit_V2gSharedSignals /OVR_AndExport2" /begin LOC_MEASUREMENT V2gRxSigRescode /end LOC_MEASUREMENT /begin REF_CHARACTERISTIC V2gRxSigRescodeOf_C V2gRxSigRescodeOv_C /end REF_CHARACTERISTIC /end FUNCTION
/begin FUNCTION OVR_AndExport20 "Group /ByModelHeirarchy/LaforgeTestApp_CCU/Core0-TestApp/V2G/OE_CCS/Arbitration/Arbit_V2gSharedSignals /OVR_AndExport20" /begin LOC_MEASUREMENT V2gRxSigNotif /end LOC_MEASUREMENT /begin REF_CHARACTERISTIC V2gRxSigNotifOf_C V2gRxSigNotifOv_C /end REF_CHARACTERISTIC /end FUNCTION
/begin FUNCTION OVR_AndExport21 "Group /ByModelHeirarchy/LaforgeTestApp_CCU/Core0-TestApp/V2G/OE_CCS/Arbitration/Arbit_V2gSharedSignals /OVR_AndExport21" /begin LOC_MEASUREMENT V2gRxSigNotifFlg /end LOC_MEASUREMENT /begin REF_CHARACTERISTIC V2gRxSigNotifFlgOf_C V2gRxSigNotifFlgOv_C /end REF_CHARACTERISTIC /end FUNCTION
/begin FUNCTION OVR_AndExport22 "Group /ByModelHeirarchy/LaforgeTestApp_CCU/Core0-TestApp/V2G/OE_CCS/Arbitration/Arbit_V2gSharedSignals /OVR_AndExport22" /begin LOC_MEASUREMENT V2gRxSigSASchTupIdFlg /end LOC_MEASUREMENT /begin REF_CHARACTERISTIC V2gRxSigSASchTupIdFlgOf_C V2gRxSigSASchTupIdFlgOv_C /end REF_CHARACTERISTIC /end FUNCTION
/begin FUNCTION OVR_AndExport23 "Group /ByModelHeirarchy/LaforgeTestApp_CCU/Core0-TestApp/V2G/OE_CCS/Arbitration/Arbit_V2gSharedSignals /OVR_AndExport23" /begin LOC_MEASUREMENT V2gRxSigSASchTupId /end LOC_MEASUREMENT /begin REF_CHARACTERISTIC V2gRxSigSASchTupIdOf_C V2gRxSigSASchTupIdOv_C /end REF_CHARACTERISTIC /end FUNCTION
/begin FUNCTION OVR_AndExport24 "Group /ByModelHeirarchy/LaforgeTestApp_CCU/Core0-TestApp/V2G/OE_CCS/Arbitration/Arbit_V2gSharedSignals /OVR_AndExport24" /begin LOC_MEASUREMENT V2gRxSigCrntLimReached /end LOC_MEASUREMENT /begin REF_CHARACTERISTIC V2gRxSigCrntLimReachedOf_C V2gRxSigCrntLimReachedOv_C /end REF_CHARACTERISTIC /end FUNCTION
/begin FUNCTION OVR_AndExport25 "Group /ByModelHeirarchy/LaforgeTestApp_CCU/Core0-TestApp/V2G/OE_CCS/Arbitration/Arbit_V2gSharedSignals /OVR_AndExport25" /begin LOC_MEASUREMENT V2gRxSigVoltLimReached /end LOC_MEASUREMENT /begin REF_CHARACTERISTIC V2gRxSigVoltLimReachedOf_C V2gRxSigVoltLimReachedOv_C /end REF_CHARACTERISTIC /end FUNCTION
/begin FUNCTION OVR_AndExport26 "Group /ByModelHeirarchy/LaforgeTestApp_CCU/Core0-TestApp/V2G/OE_CCS/Arbitration/Arbit_V2gSharedSignals /OVR_AndExport26" /begin LOC_MEASUREMENT V2gRxSigPwrLimReached /end LOC_MEASUREMENT /begin REF_CHARACTERISTIC V2gRxSigPwrLimReachedOf_C V2gRxSigPwrLimReachedOv_C /end REF_CHARACTERISTIC /end FUNCTION
/begin FUNCTION OVR_AndExport27 "Group /ByModelHeirarchy/LaforgeTestApp_CCU/Core0-TestApp/V2G/OE_CCS/Arbitration/Arbit_V2gSharedSignals /OVR_AndExport27" /begin LOC_MEASUREMENT V2gRxSigEvseCurrent /end LOC_MEASUREMENT /begin REF_CHARACTERISTIC V2gRxSigEvseCurrentOf_C V2gRxSigEvseCurrentOv_C /end REF_CHARACTERISTIC /end FUNCTION
/begin FUNCTION OVR_AndExport28 "Group /ByModelHeirarchy/LaforgeTestApp_CCU/Core0-TestApp/V2G/OE_CCS/Arbitration/Arbit_V2gSharedSignals /OVR_AndExport28" /begin LOC_MEASUREMENT V2gRxSigEvseMinCrnt_flg /end LOC_MEASUREMENT /begin REF_CHARACTERISTIC V2gRxSigEvseMinCrnt_flgOf_C V2gRxSigEvseMinCrnt_flgOv_C /end REF_CHARACTERISTIC /end FUNCTION
/begin FUNCTION OVR_AndExport29 "Group /ByModelHeirarchy/LaforgeTestApp_CCU/Core0-TestApp/V2G/OE_CCS/Arbitration/Arbit_V2gSharedSignals /OVR_AndExport29" /begin LOC_MEASUREMENT V2gRxSigEvseMinCrnt /end LOC_MEASUREMENT /begin REF_CHARACTERISTIC V2gRxSigEvseMinCrntOf_C V2gRxSigEvseMinCrntOv_C /end REF_CHARACTERISTIC /end FUNCTION
/begin FUNCTION OVR_AndExport3 "Group /ByModelHeirarchy/LaforgeTestApp_CCU/Core0-TestApp/V2G/OE_CCS/Arbitration/Arbit_V2gSharedSignals /OVR_AndExport3" /begin LOC_MEASUREMENT V2gRxSigEvseProcessing /end LOC_MEASUREMENT /begin REF_CHARACTERISTIC V2gRxSigEvseProcessingOf_C V2gRxSigEvseProcessingOv_C /end REF_CHARACTERISTIC /end FUNCTION
/begin FUNCTION OVR_AndExport30 "Group /ByModelHeirarchy/LaforgeTestApp_CCU/Core0-TestApp/V2G/OE_CCS/Arbitration/Arbit_V2gSharedSignals /OVR_AndExport30" /begin LOC_MEASUREMENT V2gRxSigEvseMinDchgCrnt_flg /end LOC_MEASUREMENT
 /begin REF_CHARACTERISTIC V2gRxSigEvseMinDchgCrnt_flgOf_C V2gRxSigEvseMinDchgCrnt_flgOv_C /end REF_CHARACTERISTIC
/end FUNCTION
/begin FUNCTION OVR_AndExport31 "Group /ByModelHeirarchy/LaforgeTestApp_CCU/Core0-TestApp/V2G/OE_CCS/Arbitration/Arbit_V2gSharedSignals /OVR_AndExport31" /begin LOC_MEASUREMENT V2gRxSigEvseMinDchgCrnt /end LOC_MEASUREMENT /begin REF_CHARACTERISTIC V2gRxSigEvseMinDchgCrntOf_C V2gRxSigEvseMinDchgCrntOv_C /end REF_CHARACTERISTIC /end FUNCTION
/begin FUNCTION OVR_AndExport32 "Group /ByModelHeirarchy/LaforgeTestApp_CCU/Core0-TestApp/V2G/OE_CCS/Arbitration/Arbit_V2gSharedSignals /OVR_AndExport32" /begin LOC_MEASUREMENT V2gRxSigEvseMaxDchgCrnt_flg /end LOC_MEASUREMENT
 /begin REF_CHARACTERISTIC V2gRxSigEvseMaxDchgCrnt_flgOf_C V2gRxSigEvseMaxDchgCrnt_flgOv_C /end REF_CHARACTERISTIC
/end FUNCTION
/begin FUNCTION OVR_AndExport33 "Group /ByModelHeirarchy/LaforgeTestApp_CCU/Core0-TestApp/V2G/OE_CCS/Arbitration/Arbit_V2gSharedSignals /OVR_AndExport33" /begin LOC_MEASUREMENT V2gRxSigEvseMaxDchgCrnt /end LOC_MEASUREMENT /begin REF_CHARACTERISTIC V2gRxSigEvseMaxDchgCrntOf_C V2gRxSigEvseMaxDchgCrntOv_C /end REF_CHARACTERISTIC /end FUNCTION
/begin FUNCTION OVR_AndExport34 "Group /ByModelHeirarchy/LaforgeTestApp_CCU/Core0-TestApp/V2G/OE_CCS/Arbitration/Arbit_V2gSharedSignals /OVR_AndExport34" /begin LOC_MEASUREMENT V2gRxSigEvseMaxDchgPwr_flg /end LOC_MEASUREMENT
 /begin REF_CHARACTERISTIC V2gRxSigEvseMaxDchgPwr_flgOf_C V2gRxSigEvseMaxDchgPwr_flgOv_C /end REF_CHARACTERISTIC
/end FUNCTION
/begin FUNCTION OVR_AndExport35 "Group /ByModelHeirarchy/LaforgeTestApp_CCU/Core0-TestApp/V2G/OE_CCS/Arbitration/Arbit_V2gSharedSignals /OVR_AndExport35" /begin LOC_MEASUREMENT V2gRxSigEvseMaxDchgPwr /end LOC_MEASUREMENT /begin REF_CHARACTERISTIC V2gRxSigEvseMaxDchgPwrOf_C V2gRxSigEvseMaxDchgPwrOv_C /end REF_CHARACTERISTIC /end FUNCTION
/begin FUNCTION OVR_AndExport4 "Group /ByModelHeirarchy/LaforgeTestApp_CCU/Core0-TestApp/V2G/OE_CCS/Arbitration/Arbit_V2gSharedSignals /OVR_AndExport4" /begin LOC_MEASUREMENT V2gRxSigIsolStatus_flg /end LOC_MEASUREMENT /begin REF_CHARACTERISTIC V2gRxSigIsolStatus_flgOf_C V2gRxSigIsolStatus_flgOv_C /end REF_CHARACTERISTIC /end FUNCTION
/begin FUNCTION OVR_AndExport5 "Group /ByModelHeirarchy/LaforgeTestApp_CCU/Core0-TestApp/V2G/OE_CCS/Arbitration/Arbit_V2gSharedSignals /OVR_AndExport5" /begin LOC_MEASUREMENT V2gRxSigIsolStatus /end LOC_MEASUREMENT /begin REF_CHARACTERISTIC V2gRxSigIsolStatusOf_C V2gRxSigIsolStatusOv_C /end REF_CHARACTERISTIC /end FUNCTION
/begin FUNCTION OVR_AndExport61 "Group /ByModelHeirarchy/LaforgeTestApp_CCU/Core0-TestApp/V2G/OE_CCS/Arbitration/Arbit_V2gSharedSignals /OVR_AndExport6" /begin LOC_MEASUREMENT V2gRxSigEvseStatus_flg /end LOC_MEASUREMENT /begin REF_CHARACTERISTIC V2gRxSigEvseStatus_flgOf_C V2gRxSigEvseStatus_flgOv_C /end REF_CHARACTERISTIC /end FUNCTION
/begin FUNCTION OVR_AndExport7 "Group /ByModelHeirarchy/LaforgeTestApp_CCU/Core0-TestApp/V2G/OE_CCS/Arbitration/Arbit_V2gSharedSignals /OVR_AndExport7" /begin LOC_MEASUREMENT V2gRxSigMaxVolt_flg /end LOC_MEASUREMENT /begin REF_CHARACTERISTIC V2gRxSigMaxVolt_flgOf_C V2gRxSigMaxVolt_flgOv_C /end REF_CHARACTERISTIC /end FUNCTION
/begin FUNCTION OVR_AndExport8 "Group /ByModelHeirarchy/LaforgeTestApp_CCU/Core0-TestApp/V2G/OE_CCS/Arbitration/Arbit_V2gSharedSignals /OVR_AndExport8" /begin LOC_MEASUREMENT V2gRxSigEvseStatus /end LOC_MEASUREMENT /begin REF_CHARACTERISTIC V2gRxSigEvseStatusOf_C V2gRxSigEvseStatusOv_C /end REF_CHARACTERISTIC /end FUNCTION
/begin FUNCTION OVR_AndExport9 "Group /ByModelHeirarchy/LaforgeTestApp_CCU/Core0-TestApp/V2G/OE_CCS/Arbitration/Arbit_V2gSharedSignals /OVR_AndExport9" /begin LOC_MEASUREMENT V2gRxSigMaxVolt /end LOC_MEASUREMENT /begin REF_CHARACTERISTIC V2gRxSigMaxVoltOf_C V2gRxSigMaxVoltOv_C /end REF_CHARACTERISTIC /end FUNCTION
/begin FUNCTION Arbit_V2gSharedSignals_ "Group /ByModelHeirarchy/LaforgeTestApp_CCU/Core0-TestApp/V2G/OE_CCS/Arbitration/Arbit_V2gSharedSignals "
 /begin SUB_FUNCTION OVR_AndExport11 OVR_AndExport10 OVR_AndExport11 OVR_AndExport12 OVR_AndExport131 OVR_AndExport14 OVR_AndExport15 OVR_AndExport16 OVR_AndExport17 OVR_AndExport18 OVR_AndExport19 OVR_AndExport2 OVR_AndExport20 OVR_AndExport21 OVR_AndExport22 OVR_AndExport23 OVR_AndExport24 OVR_AndExport25 OVR_AndExport26 OVR_AndExport27 OVR_AndExport28 OVR_AndExport29 OVR_AndExport3 OVR_AndExport30 OVR_AndExport31 OVR_AndExport32 OVR_AndExport33 OVR_AndExport34 OVR_AndExport35 OVR_AndExport4 OVR_AndExport5 OVR_AndExport61 OVR_AndExport7 OVR_AndExport8 OVR_AndExport9 /end SUB_FUNCTION
/end FUNCTION
/begin FUNCTION Arbitration "Group /ByModelHeirarchy/LaforgeTestApp_CCU/Core0-TestApp/V2G/OE_CCS/Arbitration"
 /begin SUB_FUNCTION Arbit_V2gRxMsg_Authentication Arbit_V2gRxMsg_PaymentSelection Arbit_V2gRxMsg_ServiceDetail Arbit_V2gRxMsg_ServiceDetailPa0 Arbit_V2gRxMsg_ServiceDiscovery Arbit_V2gRxMsg_SessionSetup Arbit_V2gRxMsg_SessionStop Arbit_V2gRxMsg_V2gRxMsgBptCtrl Arbit_V2gRxMsg_V2gRxMsgCblChk Arbit_V2gRxMsg_V2gRxMsgChgParD0 Arbit_V2gRxMsg_V2gRxMsgCrntDmd Arbit_V2gRxMsg_V2gRxMsgPreChg Arbit_V2gRxMsg_V2gRxMsgPwrDeliv Arbit_V2gRxMsg_V2gRxMsgWeldDet Arbit_V2gSharedSignals_ /end SUB_FUNCTION
/end FUNCTION
/begin FUNCTION CcsCtlEcu "Group /ByModelHeirarchy/LaforgeTestApp_CCU/Core0-TestApp/V2G/OE_CCS/CTL/CcsCtlEcu" /begin LOC_MEASUREMENT CcsCtlEcuHoldEcuPwrReq CcsCtlEcuHoldQcaPwrReq /end LOC_MEASUREMENT /begin REF_CHARACTERISTIC CcsCtlEcuHoldQcaPwrReqTime_C CcsCtlEcuHoldQcaPwrReq_C /end REF_CHARACTERISTIC /end FUNCTION
/begin FUNCTION OVR_AndExport "Group /ByModelHeirarchy/LaforgeTestApp_CCU/Core0-TestApp/V2G/OE_CCS/CTL/CcsOprCtrl/OVR_AndExport" /begin LOC_MEASUREMENT V2gTxParameterSetId /end LOC_MEASUREMENT /begin REF_CHARACTERISTIC V2gTxParameterSetIdOf_C V2gTxParameterSetIdOv_C /end REF_CHARACTERISTIC /end FUNCTION
/begin FUNCTION OVR_AndExport12 "Group /ByModelHeirarchy/LaforgeTestApp_CCU/Core0-TestApp/V2G/OE_CCS/CTL/CcsOprCtrl/OVR_AndExport1" /begin LOC_MEASUREMENT V2gTxEvCrntMinLim /end LOC_MEASUREMENT /begin REF_CHARACTERISTIC V2gTxEvCrntMinLimOf_C V2gTxEvCrntMinLimOv_C /end REF_CHARACTERISTIC /end FUNCTION
/begin FUNCTION OVR_AndExport101 "Group /ByModelHeirarchy/LaforgeTestApp_CCU/Core0-TestApp/V2G/OE_CCS/CTL/CcsOprCtrl/OVR_AndExport10" /begin LOC_MEASUREMENT V2gTxEvDisChgPwrMinLim /end LOC_MEASUREMENT /begin REF_CHARACTERISTIC V2gTxEvDisChgPwrMinLimOf_C V2gTxEvDisChgPwrMinLimOv_C /end REF_CHARACTERISTIC /end FUNCTION
/begin FUNCTION OVR_AndExport111 "Group /ByModelHeirarchy/LaforgeTestApp_CCU/Core0-TestApp/V2G/OE_CCS/CTL/CcsOprCtrl/OVR_AndExport11" /begin LOC_MEASUREMENT V2gTxDcChgParamEnable /end LOC_MEASUREMENT /begin REF_CHARACTERISTIC V2gTxDcChgParamEnableOf_C V2gTxDcChgParamEnableOv_C /end REF_CHARACTERISTIC /end FUNCTION
/begin FUNCTION OVR_AndExport121 "Group /ByModelHeirarchy/LaforgeTestApp_CCU/Core0-TestApp/V2G/OE_CCS/CTL/CcsOprCtrl/OVR_AndExport12" /begin LOC_MEASUREMENT V2gTxChargeProgress /end LOC_MEASUREMENT /begin REF_CHARACTERISTIC V2gTxChargeProgressOf_C V2gTxChargeProgressOv_C /end REF_CHARACTERISTIC /end FUNCTION
/begin FUNCTION OVR_AndExport132 "Group /ByModelHeirarchy/LaforgeTestApp_CCU/Core0-TestApp/V2G/OE_CCS/CTL/CcsOprCtrl/OVR_AndExport13" /begin LOC_MEASUREMENT V2gTxEvOperation /end LOC_MEASUREMENT /begin REF_CHARACTERISTIC V2gTxEvOperationOf_C V2gTxEvOperationOv_C /end REF_CHARACTERISTIC /end FUNCTION
/begin FUNCTION OVR_AndExport141 "Group /ByModelHeirarchy/LaforgeTestApp_CCU/Core0-TestApp/V2G/OE_CCS/CTL/CcsOprCtrl/OVR_AndExport14" /begin LOC_MEASUREMENT V2gTxEvOperationEn /end LOC_MEASUREMENT /begin REF_CHARACTERISTIC V2gTxEvOperationEnOf_C V2gTxEvOperationEnOv_C /end REF_CHARACTERISTIC /end FUNCTION
/begin FUNCTION OVR_AndExport171 "Group /ByModelHeirarchy/LaforgeTestApp_CCU/Core0-TestApp/V2G/OE_CCS/CTL/CcsOprCtrl/OVR_AndExport17" /begin LOC_MEASUREMENT V2gTxEvVoltMaxLim /end LOC_MEASUREMENT /begin REF_CHARACTERISTIC V2gTxEvVoltMaxLimOf_C V2gTxEvVoltMaxLimOv_C /end REF_CHARACTERISTIC /end FUNCTION
/begin FUNCTION OVR_AndExport181 "Group /ByModelHeirarchy/LaforgeTestApp_CCU/Core0-TestApp/V2G/OE_CCS/CTL/CcsOprCtrl/OVR_AndExport18" /begin LOC_MEASUREMENT V2gTxEvCrntMaxLim /end LOC_MEASUREMENT /begin REF_CHARACTERISTIC V2gTxEvCrntMaxLimOf_C V2gTxEvCrntMaxLimOv_C /end REF_CHARACTERISTIC /end FUNCTION
/begin FUNCTION OVR_AndExport191 "Group /ByModelHeirarchy/LaforgeTestApp_CCU/Core0-TestApp/V2G/OE_CCS/CTL/CcsOprCtrl/OVR_AndExport19" /begin LOC_MEASUREMENT V2gTxEvPwrMaxLim /end LOC_MEASUREMENT /begin REF_CHARACTERISTIC V2gTxEvPwrMaxLimOf_C V2gTxEvPwrMaxLimOv_C /end REF_CHARACTERISTIC /end FUNCTION
/begin FUNCTION OVR_AndExport21 "Group /ByModelHeirarchy/LaforgeTestApp_CCU/Core0-TestApp/V2G/OE_CCS/CTL/CcsOprCtrl/OVR_AndExport2" /begin LOC_MEASUREMENT V2gTxEvPwrMinLim /end LOC_MEASUREMENT /begin REF_CHARACTERISTIC V2gTxEvPwrMinLimOf_C V2gTxEvPwrMinLimOv_C /end REF_CHARACTERISTIC /end FUNCTION
/begin FUNCTION OVR_AndExport201 "Group /ByModelHeirarchy/LaforgeTestApp_CCU/Core0-TestApp/V2G/OE_CCS/CTL/CcsOprCtrl/OVR_AndExport20" /begin LOC_MEASUREMENT V2gTxEvTargetCrnt /end LOC_MEASUREMENT /begin REF_CHARACTERISTIC V2gTxEvTargetCrntOf_C V2gTxEvTargetCrntOv_C /end REF_CHARACTERISTIC /end FUNCTION
/begin FUNCTION OVR_AndExport211 "Group /ByModelHeirarchy/LaforgeTestApp_CCU/Core0-TestApp/V2G/OE_CCS/CTL/CcsOprCtrl/OVR_AndExport21" /begin LOC_MEASUREMENT V2gTxEvTargetVolt /end LOC_MEASUREMENT /begin REF_CHARACTERISTIC V2gTxEvTargetVoltOf_C V2gTxEvTargetVoltOv_C /end REF_CHARACTERISTIC /end FUNCTION
/begin FUNCTION OVR_AndExport221 "Group /ByModelHeirarchy/LaforgeTestApp_CCU/Core0-TestApp/V2G/OE_CCS/CTL/CcsOprCtrl/OVR_AndExport22" /begin LOC_MEASUREMENT V2gTxProfileEntryCnt /end LOC_MEASUREMENT /begin REF_CHARACTERISTIC V2gTxProfileEntryCntOf_C V2gTxProfileEntryCntOv_C /end REF_CHARACTERISTIC /end FUNCTION
/begin FUNCTION OVR_AndExport251 "Group /ByModelHeirarchy/LaforgeTestApp_CCU/Core0-TestApp/V2G/OE_CCS/CTL/CcsOprCtrl/OVR_AndExport25" /begin LOC_MEASUREMENT V2gTxSaSchdlTupleId /end LOC_MEASUREMENT /begin REF_CHARACTERISTIC V2gTxSaSchdlTupleIdOf_C V2gTxSaSchdlTupleIdOv_C /end REF_CHARACTERISTIC /end FUNCTION
/begin FUNCTION OVR_AndExport261 "Group /ByModelHeirarchy/LaforgeTestApp_CCU/Core0-TestApp/V2G/OE_CCS/CTL/CcsOprCtrl/OVR_AndExport26" /begin LOC_MEASUREMENT V2gTxServiceId /end LOC_MEASUREMENT /begin REF_CHARACTERISTIC V2gTxServiceIdOf_C V2gTxServiceIdOv_C /end REF_CHARACTERISTIC /end FUNCTION
/begin FUNCTION OVR_AndExport31 "Group /ByModelHeirarchy/LaforgeTestApp_CCU/Core0-TestApp/V2G/OE_CCS/CTL/CcsOprCtrl/OVR_AndExport3" /begin LOC_MEASUREMENT V2gTxEvVoltMinLim /end LOC_MEASUREMENT /begin REF_CHARACTERISTIC V2gTxEvVoltMinLimOf_C V2gTxEvVoltMinLimOv_C /end REF_CHARACTERISTIC /end FUNCTION
/begin FUNCTION OVR_AndExport321 "Group /ByModelHeirarchy/LaforgeTestApp_CCU/Core0-TestApp/V2G/OE_CCS/CTL/CcsOprCtrl/OVR_AndExport32" /begin LOC_MEASUREMENT CcsOprV2gTxReadyToCharge /end LOC_MEASUREMENT /begin REF_CHARACTERISTIC CcsOprV2gTxReadyToChargeOf_C CcsOprV2gTxReadyToChargeOv_C /end REF_CHARACTERISTIC /end FUNCTION
/begin FUNCTION OVR_AndExport41 "Group /ByModelHeirarchy/LaforgeTestApp_CCU/Core0-TestApp/V2G/OE_CCS/CTL/CcsOprCtrl/OVR_AndExport4"
 /begin LOC_MEASUREMENT V2gTxSupSvcIds[0] V2gTxSupSvcIds[1] V2gTxSupSvcIds[2] V2gTxSupSvcIds[3] V2gTxSupSvcIds[4] V2gTxSupSvcIds[5] V2gTxSupSvcIds[6] V2gTxSupSvcIds[7] V2gTxSupSvcIds[8] V2gTxSupSvcIds[9] /end LOC_MEASUREMENT
 /begin REF_CHARACTERISTIC V2gTxSupSvcIdsOf_C V2gTxSupSvcIdsOv_C /end REF_CHARACTERISTIC
/end FUNCTION
/begin FUNCTION OVR_AndExport51 "Group /ByModelHeirarchy/LaforgeTestApp_CCU/Core0-TestApp/V2G/OE_CCS/CTL/CcsOprCtrl/OVR_AndExport5" /begin LOC_MEASUREMENT V2gTxSupSvcIdsLen /end LOC_MEASUREMENT /begin REF_CHARACTERISTIC V2gTxSupSvcIdsLenOf_C V2gTxSupSvcIdsLenOv_C /end REF_CHARACTERISTIC /end FUNCTION
/begin FUNCTION OVR_AndExport62 "Group /ByModelHeirarchy/LaforgeTestApp_CCU/Core0-TestApp/V2G/OE_CCS/CTL/CcsOprCtrl/OVR_AndExport6" /begin LOC_MEASUREMENT V2gTxBptParamEnable /end LOC_MEASUREMENT /begin REF_CHARACTERISTIC V2gTxBptParamEnableOf_C V2gTxBptParamEnableOv_C /end REF_CHARACTERISTIC /end FUNCTION
/begin FUNCTION OVR_AndExport71 "Group /ByModelHeirarchy/LaforgeTestApp_CCU/Core0-TestApp/V2G/OE_CCS/CTL/CcsOprCtrl/OVR_AndExport7" /begin LOC_MEASUREMENT V2gTxEvDisChgCrntMaxLim /end LOC_MEASUREMENT /begin REF_CHARACTERISTIC V2gTxEvDisChgCrntMaxLimOf_C V2gTxEvDisChgCrntMaxLimOv_C /end REF_CHARACTERISTIC /end FUNCTION
/begin FUNCTION OVR_AndExport81 "Group /ByModelHeirarchy/LaforgeTestApp_CCU/Core0-TestApp/V2G/OE_CCS/CTL/CcsOprCtrl/OVR_AndExport8" /begin LOC_MEASUREMENT V2gTxEvDisChgCrntMinLim /end LOC_MEASUREMENT /begin REF_CHARACTERISTIC V2gTxEvDisChgCrntMinLimOf_C V2gTxEvDisChgCrntMinLimOv_C /end REF_CHARACTERISTIC /end FUNCTION
/begin FUNCTION OVR_AndExport91 "Group /ByModelHeirarchy/LaforgeTestApp_CCU/Core0-TestApp/V2G/OE_CCS/CTL/CcsOprCtrl/OVR_AndExport9" /begin LOC_MEASUREMENT V2gTxEvDisChgPwrMaxLim /end LOC_MEASUREMENT /begin REF_CHARACTERISTIC V2gTxEvDisChgPwrMaxLimOf_C V2gTxEvDisChgPwrMaxLimOv_C /end REF_CHARACTERISTIC /end FUNCTION
/begin FUNCTION CcsOprCtrl "Group /ByModelHeirarchy/LaforgeTestApp_CCU/Core0-TestApp/V2G/OE_CCS/CTL/CcsOprCtrl"
 /begin SUB_FUNCTION OVR_AndExport OVR_AndExport12 OVR_AndExport101 OVR_AndExport111 OVR_AndExport121 OVR_AndExport132 OVR_AndExport141 OVR_AndExport171 OVR_AndExport181 OVR_AndExport191 OVR_AndExport21 OVR_AndExport201 OVR_AndExport211 OVR_AndExport221 OVR_AndExport251 OVR_AndExport261 OVR_AndExport31 OVR_AndExport321 OVR_AndExport41 OVR_AndExport51 OVR_AndExport62 OVR_AndExport71 OVR_AndExport81 OVR_AndExport91 /end SUB_FUNCTION
 /begin LOC_MEASUREMENT CcsOprHvEvTargetCrnt CcsOprHvEvTargetVolt CcsOprTargetCrntChgLimByPwr CcsOprTargetCrntDchgLimByPwr V2gTxEvReqEgyTransferType V2gTxSaSchdlTupleIdEn /end LOC_MEASUREMENT
 /begin REF_CHARACTERISTIC CcsOprChgProfileEntryDuration_0 CcsOprChgProfileEntryMaxPwr_CA CcsOprChgProfileEntryStrt_CA CcsOprPrechgTargetCrnt_C /end REF_CHARACTERISTIC
/end FUNCTION
/begin FUNCTION OVR_AndExport13 "Group /ByModelHeirarchy/LaforgeTestApp_CCU/Core0-TestApp/V2G/OE_CCS/CTL/CcsOprDisp/OVR_AndExport1" /begin LOC_MEASUREMENT V2gTxEvMinEgyReq /end LOC_MEASUREMENT /begin REF_CHARACTERISTIC V2gTxEvMinEgyReqOf_C V2gTxEvMinEgyReqOv_C /end REF_CHARACTERISTIC /end FUNCTION
/begin FUNCTION OVR_AndExport102 "Group /ByModelHeirarchy/LaforgeTestApp_CCU/Core0-TestApp/V2G/OE_CCS/CTL/CcsOprDisp/OVR_AndExport10" /begin LOC_MEASUREMENT V2gTxEvEgyReqAmount /end LOC_MEASUREMENT /begin REF_CHARACTERISTIC V2gTxEvEgyReqAmountOf_C V2gTxEvEgyReqAmountOv_C /end REF_CHARACTERISTIC /end FUNCTION
/begin FUNCTION OVR_AndExport122 "Group /ByModelHeirarchy/LaforgeTestApp_CCU/Core0-TestApp/V2G/OE_CCS/CTL/CcsOprDisp/OVR_AndExport12" /begin LOC_MEASUREMENT V2gTxBulkChargingComplete /end LOC_MEASUREMENT
 /begin REF_CHARACTERISTIC V2gTxBulkChargingCompleteOf_C V2gTxBulkChargingCompleteOv_C /end REF_CHARACTERISTIC
/end FUNCTION
/begin FUNCTION OVR_AndExport133 "Group /ByModelHeirarchy/LaforgeTestApp_CCU/Core0-TestApp/V2G/OE_CCS/CTL/CcsOprDisp/OVR_AndExport13" /begin LOC_MEASUREMENT V2gTxChargingComplete /end LOC_MEASUREMENT /begin REF_CHARACTERISTIC V2gTxChargingCompleteOf_C V2gTxChargingCompleteOv_C /end REF_CHARACTERISTIC /end FUNCTION
/begin FUNCTION OVR_AndExport151 "Group /ByModelHeirarchy/LaforgeTestApp_CCU/Core0-TestApp/V2G/OE_CCS/CTL/CcsOprDisp/OVR_AndExport15" /begin LOC_MEASUREMENT CcsOprV2gTxEvCabinCondition /end LOC_MEASUREMENT
 /begin REF_CHARACTERISTIC CcsOprV2gTxEvCabinConditionOf_C CcsOprV2gTxEvCabinConditionOv_C /end REF_CHARACTERISTIC
/end FUNCTION
/begin FUNCTION OVR_AndExport161 "Group /ByModelHeirarchy/LaforgeTestApp_CCU/Core0-TestApp/V2G/OE_CCS/CTL/CcsOprDisp/OVR_AndExport16" /begin LOC_MEASUREMENT V2gTxEvRessCondition /end LOC_MEASUREMENT /begin REF_CHARACTERISTIC V2gTxEvRessConditionOf_C V2gTxEvRessConditionOv_C /end REF_CHARACTERISTIC /end FUNCTION
/begin FUNCTION OVR_AndExport22 "Group /ByModelHeirarchy/LaforgeTestApp_CCU/Core0-TestApp/V2G/OE_CCS/CTL/CcsOprDisp/OVR_AndExport2" /begin LOC_MEASUREMENT V2gTxEvMaxEgyReq /end LOC_MEASUREMENT /begin REF_CHARACTERISTIC V2gTxEvMaxEgyReqOf_C V2gTxEvMaxEgyReqOv_C /end REF_CHARACTERISTIC /end FUNCTION
/begin FUNCTION OVR_AndExport231 "Group /ByModelHeirarchy/LaforgeTestApp_CCU/Core0-TestApp/V2G/OE_CCS/CTL/CcsOprDisp/OVR_AndExport23" /begin LOC_MEASUREMENT V2gTxRemainTimetoBulkSoc /end LOC_MEASUREMENT /begin REF_CHARACTERISTIC V2gTxRemainTimetoBulkSocOf_C V2gTxRemainTimetoBulkSocOv_C /end REF_CHARACTERISTIC /end FUNCTION
/begin FUNCTION OVR_AndExport241 "Group /ByModelHeirarchy/LaforgeTestApp_CCU/Core0-TestApp/V2G/OE_CCS/CTL/CcsOprDisp/OVR_AndExport24" /begin LOC_MEASUREMENT V2gTxRemainTimeToFullSoc /end LOC_MEASUREMENT /begin REF_CHARACTERISTIC V2gTxRemainTimeToFullSocOf_C V2gTxRemainTimeToFullSocOv_C /end REF_CHARACTERISTIC /end FUNCTION
/begin FUNCTION OVR_AndExport271 "Group /ByModelHeirarchy/LaforgeTestApp_CCU/Core0-TestApp/V2G/OE_CCS/CTL/CcsOprDisp/OVR_AndExport27" /begin LOC_MEASUREMENT V2gTxBulkSoc /end LOC_MEASUREMENT /begin REF_CHARACTERISTIC V2gTxBulkSocOf_C V2gTxBulkSocOv_C /end REF_CHARACTERISTIC /end FUNCTION
/begin FUNCTION OVR_AndExport281 "Group /ByModelHeirarchy/LaforgeTestApp_CCU/Core0-TestApp/V2G/OE_CCS/CTL/CcsOprDisp/OVR_AndExport28" /begin LOC_MEASUREMENT V2gTxFullSoc /end LOC_MEASUREMENT /begin REF_CHARACTERISTIC V2gTxFullSocOf_C V2gTxFullSocOv_C /end REF_CHARACTERISTIC /end FUNCTION
/begin FUNCTION OVR_AndExport291 "Group /ByModelHeirarchy/LaforgeTestApp_CCU/Core0-TestApp/V2G/OE_CCS/CTL/CcsOprDisp/OVR_AndExport29" /begin LOC_MEASUREMENT V2gTxEvRessSoc /end LOC_MEASUREMENT /begin REF_CHARACTERISTIC V2gTxEvRessSocOf_C V2gTxEvRessSocOv_C /end REF_CHARACTERISTIC /end FUNCTION
/begin FUNCTION OVR_AndExport32 "Group /ByModelHeirarchy/LaforgeTestApp_CCU/Core0-TestApp/V2G/OE_CCS/CTL/CcsOprDisp/OVR_AndExport3" /begin LOC_MEASUREMENT V2gTxTargetSoc /end LOC_MEASUREMENT /begin REF_CHARACTERISTIC V2gTxTargetSocOf_C V2gTxTargetSocOv_C /end REF_CHARACTERISTIC /end FUNCTION
/begin FUNCTION OVR_AndExport301 "Group /ByModelHeirarchy/LaforgeTestApp_CCU/Core0-TestApp/V2G/OE_CCS/CTL/CcsOprDisp/OVR_AndExport30" /begin LOC_MEASUREMENT V2gTxEvErrorCode /end LOC_MEASUREMENT /begin REF_CHARACTERISTIC V2gTxEvErrorCodeOf_C V2gTxEvErrorCodeOv_C /end REF_CHARACTERISTIC /end FUNCTION
/begin FUNCTION OVR_AndExport311 "Group /ByModelHeirarchy/LaforgeTestApp_CCU/Core0-TestApp/V2G/OE_CCS/CTL/CcsOprDisp/OVR_AndExport31" /begin LOC_MEASUREMENT V2gTxEvReady /end LOC_MEASUREMENT /begin REF_CHARACTERISTIC V2gTxEvReadyOf_C V2gTxEvReadyOv_C /end REF_CHARACTERISTIC /end FUNCTION
/begin FUNCTION OVR_AndExport92 "Group /ByModelHeirarchy/LaforgeTestApp_CCU/Core0-TestApp/V2G/OE_CCS/CTL/CcsOprDisp/OVR_AndExport9" /begin LOC_MEASUREMENT V2gTxEvEgyCapacity /end LOC_MEASUREMENT /begin REF_CHARACTERISTIC V2gTxEvEgyCapacityOf_C V2gTxEvEgyCapacityOv_C /end REF_CHARACTERISTIC /end FUNCTION
/begin FUNCTION CcsOprDisp "Group /ByModelHeirarchy/LaforgeTestApp_CCU/Core0-TestApp/V2G/OE_CCS/CTL/CcsOprDisp"
 /begin SUB_FUNCTION OVR_AndExport13 OVR_AndExport102 OVR_AndExport122 OVR_AndExport133 OVR_AndExport151 OVR_AndExport161 OVR_AndExport22 OVR_AndExport231 OVR_AndExport241 OVR_AndExport271 OVR_AndExport281 OVR_AndExport291 OVR_AndExport32 OVR_AndExport301 OVR_AndExport311 OVR_AndExport92 /end SUB_FUNCTION
 /begin REF_CHARACTERISTIC CcsOprSessionCompleteSocThrsh_C /end REF_CHARACTERISTIC
/end FUNCTION
/begin FUNCTION OVR_AndExport14 "Group /ByModelHeirarchy/LaforgeTestApp_CCU/Core0-TestApp/V2G/OE_CCS/CTL/OVR_AndExport1" /begin LOC_MEASUREMENT CcsStmV2gConnectInit /end LOC_MEASUREMENT /begin REF_CHARACTERISTIC CcsStmV2gConnectInitOf_C CcsStmV2gConnectInitOv_C /end REF_CHARACTERISTIC /end FUNCTION
/begin FUNCTION OVR_AndExport23 "Group /ByModelHeirarchy/LaforgeTestApp_CCU/Core0-TestApp/V2G/OE_CCS/CTL/OVR_AndExport2" /begin LOC_MEASUREMENT CcsStmState /end LOC_MEASUREMENT /begin REF_CHARACTERISTIC CcsStmStateOf_C CcsStmStateOv_C /end REF_CHARACTERISTIC /end FUNCTION
/begin FUNCTION OVR_AndExport33 "Group /ByModelHeirarchy/LaforgeTestApp_CCU/Core0-TestApp/V2G/OE_CCS/CTL/OVR_AndExport3" /begin LOC_MEASUREMENT CcsStmV2gConnectTerminate /end LOC_MEASUREMENT
 /begin REF_CHARACTERISTIC CcsStmV2gConnectTerminateOf_C CcsStmV2gConnectTerminateOv_C /end REF_CHARACTERISTIC
/end FUNCTION
/begin FUNCTION OVR_AndExport42 "Group /ByModelHeirarchy/LaforgeTestApp_CCU/Core0-TestApp/V2G/OE_CCS/CTL/OVR_AndExport4" /begin REF_CHARACTERISTIC CcsStmChgRelayEnOf_C CcsStmChgRelayEnOv_C /end REF_CHARACTERISTIC /end FUNCTION
/begin FUNCTION OVR_AndExport52 "Group /ByModelHeirarchy/LaforgeTestApp_CCU/Core0-TestApp/V2G/OE_CCS/CTL/OVR_AndExport5" /begin REF_CHARACTERISTIC CcsStmChgInletLockEnOf_C CcsStmChgInletLockEnOv_C /end REF_CHARACTERISTIC /end FUNCTION
/begin FUNCTION OVR_AndExport63 "Group /ByModelHeirarchy/LaforgeTestApp_CCU/Core0-TestApp/V2G/OE_CCS/CTL/OVR_AndExport6" /begin LOC_MEASUREMENT CcsStmV2gPilotPulldownEn /end LOC_MEASUREMENT /begin REF_CHARACTERISTIC CcsStmV2gPilotPulldownEnOf_C CcsStmV2gPilotPulldownEnOv_C /end REF_CHARACTERISTIC /end FUNCTION
/begin FUNCTION OVR_AndExport72 "Group /ByModelHeirarchy/LaforgeTestApp_CCU/Core0-TestApp/V2G/OE_CCS/CTL/OVR_AndExport7" /begin REF_CHARACTERISTIC CcsStmEvIsolCheckInhibitOf_C CcsStmEvIsolCheckInhibitOv_C /end REF_CHARACTERISTIC /end FUNCTION
/begin FUNCTION OVR_AndExport82 "Group /ByModelHeirarchy/LaforgeTestApp_CCU/Core0-TestApp/V2G/OE_CCS/CTL/OVR_AndExport8"
 /begin REF_CHARACTERISTIC CcsStmChgRelayWeldCheckEnOf_C CcsStmChgRelayWeldCheckEnOv_C /end REF_CHARACTERISTIC
/end FUNCTION
/begin FUNCTION OVR_AndExport93 "Group /ByModelHeirarchy/LaforgeTestApp_CCU/Core0-TestApp/V2G/OE_CCS/CTL/OVR_AndExport9" /begin LOC_MEASUREMENT CcsStmV2gStMsgTx /end LOC_MEASUREMENT /begin REF_CHARACTERISTIC CcsStmV2gStMsgTxOf_C CcsStmV2gStMsgTxOv_C /end REF_CHARACTERISTIC /end FUNCTION
/begin FUNCTION StateMachine "Group /ByModelHeirarchy/LaforgeTestApp_CCU/Core0-TestApp/V2G/OE_CCS/CTL/StateMachine"
 /begin LOC_MEASUREMENT CcsStmState CcsStmV2gConnectInit CcsStmV2gConnectTerminate CcsStmV2gPilotPulldownEn CcsStmV2gQcaEn CcsStmV2gStMsgTx /end LOC_MEASUREMENT
/end FUNCTION
/begin FUNCTION CTL "Group /ByModelHeirarchy/LaforgeTestApp_CCU/Core0-TestApp/V2G/OE_CCS/CTL"
 /begin SUB_FUNCTION CcsCtlEcu CcsOprCtrl CcsOprDisp OVR_AndExport14 OVR_AndExport23 OVR_AndExport33 OVR_AndExport42 OVR_AndExport52 OVR_AndExport63 OVR_AndExport72 OVR_AndExport82 OVR_AndExport93 StateMachine /end SUB_FUNCTION
 /begin LOC_MEASUREMENT CcsStmV2gQcaEn /end LOC_MEASUREMENT
 /begin REF_CHARACTERISTIC CcsCtlSvcDetailMsgEnable_C /end REF_CHARACTERISTIC
/end FUNCTION
/begin FUNCTION CcsVersion "Group /ByModelHeirarchy/LaforgeTestApp_CCU/Core0-TestApp/V2G/OE_CCS/CcsVersion" /begin LOC_MEASUREMENT CcsVersionMajor CcsVersionMinor CcsVersionSubMinor /end LOC_MEASUREMENT /end FUNCTION
/begin FUNCTION GenericBitMask "Group /ByModelHeirarchy/LaforgeTestApp_CCU/Core0-TestApp/V2G/OE_CCS/FLT/CcsFltStopFaultResponse/GenericBitMask" /begin LOC_MEASUREMENT CcsCtlStopCpEStop /end LOC_MEASUREMENT /begin REF_CHARACTERISTIC CcsCtlStopCpEStopMask_C /end REF_CHARACTERISTIC /end FUNCTION
/begin FUNCTION GenericBitMask1 "Group /ByModelHeirarchy/LaforgeTestApp_CCU/Core0-TestApp/V2G/OE_CCS/FLT/CcsFltStopFaultResponse/GenericBitMask1" /begin LOC_MEASUREMENT CcsCtlStopPpEStop /end LOC_MEASUREMENT /begin REF_CHARACTERISTIC CcsCtlStopPpEStopMask_C /end REF_CHARACTERISTIC /end FUNCTION
/begin FUNCTION GenericBitMask10 "Group /ByModelHeirarchy/LaforgeTestApp_CCU/Core0-TestApp/V2G/OE_CCS/FLT/CcsFltStopFaultResponse/GenericBitMask10" /begin LOC_MEASUREMENT CcsCtlStopCpNStop /end LOC_MEASUREMENT /begin REF_CHARACTERISTIC CcsCtlStopCpNStopMask_C /end REF_CHARACTERISTIC /end FUNCTION
/begin FUNCTION GenericBitMask11 "Group /ByModelHeirarchy/LaforgeTestApp_CCU/Core0-TestApp/V2G/OE_CCS/FLT/CcsFltStopFaultResponse/GenericBitMask11" /begin LOC_MEASUREMENT CcsCtlStopRxEvsePwrRStop /end LOC_MEASUREMENT /begin REF_CHARACTERISTIC CcsCtlStopRxEvsePwrRStopMask_C /end REF_CHARACTERISTIC /end FUNCTION
/begin FUNCTION GenericBitMask12 "Group /ByModelHeirarchy/LaforgeTestApp_CCU/Core0-TestApp/V2G/OE_CCS/FLT/CcsFltStopFaultResponse/GenericBitMask12" /begin LOC_MEASUREMENT CcsCtlStopCpRStop /end LOC_MEASUREMENT /begin REF_CHARACTERISTIC CcsCtlStopCpRStopMask_C /end REF_CHARACTERISTIC /end FUNCTION
/begin FUNCTION GenericBitMask13 "Group /ByModelHeirarchy/LaforgeTestApp_CCU/Core0-TestApp/V2G/OE_CCS/FLT/CcsFltStopFaultResponse/GenericBitMask13" /begin LOC_MEASUREMENT CcsCtlStopPpRStop /end LOC_MEASUREMENT /begin REF_CHARACTERISTIC CcsCtlStopPpRStopMask_C /end REF_CHARACTERISTIC /end FUNCTION
/begin FUNCTION GenericBitMask14 "Group /ByModelHeirarchy/LaforgeTestApp_CCU/Core0-TestApp/V2G/OE_CCS/FLT/CcsFltStopFaultResponse/GenericBitMask14" /begin LOC_MEASUREMENT CcsCtlStopPpNStop /end LOC_MEASUREMENT /begin REF_CHARACTERISTIC CcsCtlStopPpNStopMask_C /end REF_CHARACTERISTIC /end FUNCTION
/begin FUNCTION GenericBitMask15 "Group /ByModelHeirarchy/LaforgeTestApp_CCU/Core0-TestApp/V2G/OE_CCS/FLT/CcsFltStopFaultResponse/GenericBitMask15" /begin LOC_MEASUREMENT CcsCtlStopIntFltRStop /end LOC_MEASUREMENT /begin REF_CHARACTERISTIC CcsCtlStopIntFltRStopMask_C /end REF_CHARACTERISTIC /end FUNCTION
/begin FUNCTION GenericBitMask16 "Group /ByModelHeirarchy/LaforgeTestApp_CCU/Core0-TestApp/V2G/OE_CCS/FLT/CcsFltStopFaultResponse/GenericBitMask16" /begin LOC_MEASUREMENT CcsCtlStopSeqRStop /end LOC_MEASUREMENT /begin REF_CHARACTERISTIC CcsCtlStopSeqRStopMask_C /end REF_CHARACTERISTIC /end FUNCTION
/begin FUNCTION GenericBitMask17 "Group /ByModelHeirarchy/LaforgeTestApp_CCU/Core0-TestApp/V2G/OE_CCS/FLT/CcsFltStopFaultResponse/GenericBitMask17" /begin LOC_MEASUREMENT CcsCtlStopV2gMsgRStop /end LOC_MEASUREMENT /begin REF_CHARACTERISTIC CcsCtlStopV2gMsgRStopMask_C /end REF_CHARACTERISTIC /end FUNCTION
/begin FUNCTION GenericBitMask18 "Group /ByModelHeirarchy/LaforgeTestApp_CCU/Core0-TestApp/V2G/OE_CCS/FLT/CcsFltStopFaultResponse/GenericBitMask18" /begin LOC_MEASUREMENT CcsCtlStopRxEvseProcRStop /end LOC_MEASUREMENT /begin REF_CHARACTERISTIC CcsCtlStopRxEvseProcRStopMask_C /end REF_CHARACTERISTIC /end FUNCTION
/begin FUNCTION GenericBitMask19 "Group /ByModelHeirarchy/LaforgeTestApp_CCU/Core0-TestApp/V2G/OE_CCS/FLT/CcsFltStopFaultResponse/GenericBitMask19" /begin LOC_MEASUREMENT CcsCtlStopRxEvseIsolRStop /end LOC_MEASUREMENT /begin REF_CHARACTERISTIC CcsCtlStopRxEvseIsolRStopMask_C /end REF_CHARACTERISTIC /end FUNCTION
/begin FUNCTION GenericBitMask2 "Group /ByModelHeirarchy/LaforgeTestApp_CCU/Core0-TestApp/V2G/OE_CCS/FLT/CcsFltStopFaultResponse/GenericBitMask2" /begin LOC_MEASUREMENT CcsCtlStopSeqEStop /end LOC_MEASUREMENT /begin REF_CHARACTERISTIC CcsCtlStopSeqEStopMask_C /end REF_CHARACTERISTIC /end FUNCTION
/begin FUNCTION GenericBitMask20 "Group /ByModelHeirarchy/LaforgeTestApp_CCU/Core0-TestApp/V2G/OE_CCS/FLT/CcsFltStopFaultResponse/GenericBitMask20" /begin LOC_MEASUREMENT CcsCtlStopRxEvseStRStop /end LOC_MEASUREMENT /begin REF_CHARACTERISTIC CcsCtlStopRxEvseStRStopMask_C /end REF_CHARACTERISTIC /end FUNCTION
/begin FUNCTION GenericBitMask21 "Group /ByModelHeirarchy/LaforgeTestApp_CCU/Core0-TestApp/V2G/OE_CCS/FLT/CcsFltStopFaultResponse/GenericBitMask21" /begin LOC_MEASUREMENT CcsCtlStopRxEgyTypeRStop /end LOC_MEASUREMENT /begin REF_CHARACTERISTIC CcsCtlStopRxEgyTypeRStopMask_C /end REF_CHARACTERISTIC /end FUNCTION
/begin FUNCTION GenericBitMask22 "Group /ByModelHeirarchy/LaforgeTestApp_CCU/Core0-TestApp/V2G/OE_CCS/FLT/CcsFltStopFaultResponse/GenericBitMask22" /begin LOC_MEASUREMENT CcsCtlStopRxEvseVoltRStop /end LOC_MEASUREMENT /begin REF_CHARACTERISTIC CcsCtlStopRxEvseVoltRStopMask_C /end REF_CHARACTERISTIC /end FUNCTION
/begin FUNCTION GenericBitMask23 "Group /ByModelHeirarchy/LaforgeTestApp_CCU/Core0-TestApp/V2G/OE_CCS/FLT/CcsFltStopFaultResponse/GenericBitMask23" /begin LOC_MEASUREMENT CcsCtlStopRxEvseCrntRStop /end LOC_MEASUREMENT /begin REF_CHARACTERISTIC CcsCtlStopRxEvseCrntRStopMask_C /end REF_CHARACTERISTIC /end FUNCTION
/begin FUNCTION GenericBitMask24 "Group /ByModelHeirarchy/LaforgeTestApp_CCU/Core0-TestApp/V2G/OE_CCS/FLT/CcsFltStopFaultResponse/GenericBitMask24" /begin LOC_MEASUREMENT CcsCtlStopRxEvsePwrNStop /end LOC_MEASUREMENT /begin REF_CHARACTERISTIC CcsCtlStopRxEvsePwrNStopMask_C /end REF_CHARACTERISTIC /end FUNCTION
/begin FUNCTION GenericBitMask25 "Group /ByModelHeirarchy/LaforgeTestApp_CCU/Core0-TestApp/V2G/OE_CCS/FLT/CcsFltStopFaultResponse/GenericBitMask25" /begin LOC_MEASUREMENT CcsCtlStopSeqNStop /end LOC_MEASUREMENT /begin REF_CHARACTERISTIC CcsCtlStopSeqNStopMask_C /end REF_CHARACTERISTIC /end FUNCTION
/begin FUNCTION GenericBitMask26 "Group /ByModelHeirarchy/LaforgeTestApp_CCU/Core0-TestApp/V2G/OE_CCS/FLT/CcsFltStopFaultResponse/GenericBitMask26" /begin LOC_MEASUREMENT CcsCtlStopV2gMsgNStop /end LOC_MEASUREMENT /begin REF_CHARACTERISTIC CcsCtlStopV2gMsgNStopMask_C /end REF_CHARACTERISTIC /end FUNCTION
/begin FUNCTION GenericBitMask27 "Group /ByModelHeirarchy/LaforgeTestApp_CCU/Core0-TestApp/V2G/OE_CCS/FLT/CcsFltStopFaultResponse/GenericBitMask27" /begin LOC_MEASUREMENT CcsCtlStopRxEvseProcNStop /end LOC_MEASUREMENT /begin REF_CHARACTERISTIC CcsCtlStopRxEvseProcNStopMask_C /end REF_CHARACTERISTIC /end FUNCTION
/begin FUNCTION GenericBitMask28 "Group /ByModelHeirarchy/LaforgeTestApp_CCU/Core0-TestApp/V2G/OE_CCS/FLT/CcsFltStopFaultResponse/GenericBitMask28" /begin LOC_MEASUREMENT CcsCtlStopRxEvseIsolNStop /end LOC_MEASUREMENT /begin REF_CHARACTERISTIC CcsCtlStopRxEvseIsolNStopMask_C /end REF_CHARACTERISTIC /end FUNCTION
/begin FUNCTION GenericBitMask29 "Group /ByModelHeirarchy/LaforgeTestApp_CCU/Core0-TestApp/V2G/OE_CCS/FLT/CcsFltStopFaultResponse/GenericBitMask29" /begin LOC_MEASUREMENT CcsCtlStopRxEvseStNStop /end LOC_MEASUREMENT /begin REF_CHARACTERISTIC CcsCtlStopRxEvseStNStopMask_C /end REF_CHARACTERISTIC /end FUNCTION
/begin FUNCTION GenericBitMask3 "Group /ByModelHeirarchy/LaforgeTestApp_CCU/Core0-TestApp/V2G/OE_CCS/FLT/CcsFltStopFaultResponse/GenericBitMask3" /begin LOC_MEASUREMENT CcsCtlStopV2gMsgEStop /end LOC_MEASUREMENT /begin REF_CHARACTERISTIC CcsCtlStopV2gMsgEStopMask_C /end REF_CHARACTERISTIC /end FUNCTION
/begin FUNCTION GenericBitMask30 "Group /ByModelHeirarchy/LaforgeTestApp_CCU/Core0-TestApp/V2G/OE_CCS/FLT/CcsFltStopFaultResponse/GenericBitMask30" /begin LOC_MEASUREMENT CcsCtlStopRxEgyTypeNStop /end LOC_MEASUREMENT /begin REF_CHARACTERISTIC CcsCtlStopRxEgyTypeNStopMask_C /end REF_CHARACTERISTIC /end FUNCTION
/begin FUNCTION GenericBitMask31 "Group /ByModelHeirarchy/LaforgeTestApp_CCU/Core0-TestApp/V2G/OE_CCS/FLT/CcsFltStopFaultResponse/GenericBitMask31" /begin LOC_MEASUREMENT CcsCtlStopRxEvseVoltNStop /end LOC_MEASUREMENT /begin REF_CHARACTERISTIC CcsCtlStopRxEvseVoltNStopMask_C /end REF_CHARACTERISTIC /end FUNCTION
/begin FUNCTION GenericBitMask32 "Group /ByModelHeirarchy/LaforgeTestApp_CCU/Core0-TestApp/V2G/OE_CCS/FLT/CcsFltStopFaultResponse/GenericBitMask32" /begin LOC_MEASUREMENT CcsCtlStopRxEvseCrntNStop /end LOC_MEASUREMENT /begin REF_CHARACTERISTIC CcsCtlStopRxEvseCrntNStopMask_C /end REF_CHARACTERISTIC /end FUNCTION
/begin FUNCTION GenericBitMask33 "Group /ByModelHeirarchy/LaforgeTestApp_CCU/Core0-TestApp/V2G/OE_CCS/FLT/CcsFltStopFaultResponse/GenericBitMask33" /begin LOC_MEASUREMENT CcsCtlStopRxEvsePwrEStop /end LOC_MEASUREMENT /begin REF_CHARACTERISTIC CcsCtlStopRxEvsePwrEStopMask_C /end REF_CHARACTERISTIC /end FUNCTION
/begin FUNCTION GenericBitMask34 "Group /ByModelHeirarchy/LaforgeTestApp_CCU/Core0-TestApp/V2G/OE_CCS/FLT/CcsFltStopFaultResponse/GenericBitMask34" /begin LOC_MEASUREMENT CcsCtlStopRxEvVoltRStop /end LOC_MEASUREMENT /begin REF_CHARACTERISTIC CcsCtlStopRxEvVoltRStopMask_C /end REF_CHARACTERISTIC /end FUNCTION
/begin FUNCTION GenericBitMask35 "Group /ByModelHeirarchy/LaforgeTestApp_CCU/Core0-TestApp/V2G/OE_CCS/FLT/CcsFltStopFaultResponse/GenericBitMask35" /begin LOC_MEASUREMENT CcsCtlStopIntFltNStop /end LOC_MEASUREMENT /begin REF_CHARACTERISTIC CcsCtlStopIntFltNStopMask_C /end REF_CHARACTERISTIC /end FUNCTION
/begin FUNCTION GenericBitMask36 "Group /ByModelHeirarchy/LaforgeTestApp_CCU/Core0-TestApp/V2G/OE_CCS/FLT/CcsFltStopFaultResponse/GenericBitMask36" /begin LOC_MEASUREMENT CcsCtlStopSupPrtclNStop /end LOC_MEASUREMENT /begin REF_CHARACTERISTIC CcsCtlStopSupPrtclNStopMask_C /end REF_CHARACTERISTIC /end FUNCTION
/begin FUNCTION GenericBitMask37 "Group /ByModelHeirarchy/LaforgeTestApp_CCU/Core0-TestApp/V2G/OE_CCS/FLT/CcsFltStopFaultResponse/GenericBitMask37" /begin LOC_MEASUREMENT CcsCtlStopSupPrtclRStop /end LOC_MEASUREMENT /begin REF_CHARACTERISTIC CcsCtlStopSupPrtclRStopMask_C /end REF_CHARACTERISTIC /end FUNCTION
/begin FUNCTION GenericBitMask38 "Group /ByModelHeirarchy/LaforgeTestApp_CCU/Core0-TestApp/V2G/OE_CCS/FLT/CcsFltStopFaultResponse/GenericBitMask38" /begin LOC_MEASUREMENT CcsCtlStopSupPrtclEStop /end LOC_MEASUREMENT /begin REF_CHARACTERISTIC CcsCtlStopSupPrtclEStopMask_C /end REF_CHARACTERISTIC /end FUNCTION
/begin FUNCTION GenericBitMask39 "Group /ByModelHeirarchy/LaforgeTestApp_CCU/Core0-TestApp/V2G/OE_CCS/FLT/CcsFltStopFaultResponse/GenericBitMask39" /begin LOC_MEASUREMENT CcsCtlStopRxEvVoltNStop /end LOC_MEASUREMENT /begin REF_CHARACTERISTIC CcsCtlStopRxEvVoltNStopMask_C /end REF_CHARACTERISTIC /end FUNCTION
/begin FUNCTION GenericBitMask4 "Group /ByModelHeirarchy/LaforgeTestApp_CCU/Core0-TestApp/V2G/OE_CCS/FLT/CcsFltStopFaultResponse/GenericBitMask4" /begin LOC_MEASUREMENT CcsCtlStopRxEvseProcEStop /end LOC_MEASUREMENT /begin REF_CHARACTERISTIC CcsCtlStopRxEvseProcEStopMask_C /end REF_CHARACTERISTIC /end FUNCTION
/begin FUNCTION GenericBitMask40 "Group /ByModelHeirarchy/LaforgeTestApp_CCU/Core0-TestApp/V2G/OE_CCS/FLT/CcsFltStopFaultResponse/GenericBitMask40" /begin LOC_MEASUREMENT CcsCtlStopIntFltEStop /end LOC_MEASUREMENT /begin REF_CHARACTERISTIC CcsCtlStopIntFltEStopMask_C /end REF_CHARACTERISTIC /end FUNCTION
/begin FUNCTION GenericBitMask41 "Group /ByModelHeirarchy/LaforgeTestApp_CCU/Core0-TestApp/V2G/OE_CCS/FLT/CcsFltStopFaultResponse/GenericBitMask41" /begin LOC_MEASUREMENT CcsCtlStopRxEvVoltEStop /end LOC_MEASUREMENT /begin REF_CHARACTERISTIC CcsCtlStopRxEvVoltEStopMask_C /end REF_CHARACTERISTIC /end FUNCTION
/begin FUNCTION GenericBitMask5 "Group /ByModelHeirarchy/LaforgeTestApp_CCU/Core0-TestApp/V2G/OE_CCS/FLT/CcsFltStopFaultResponse/GenericBitMask5" /begin LOC_MEASUREMENT CcsCtlStopRxEvseIsolEStop /end LOC_MEASUREMENT /begin REF_CHARACTERISTIC CcsCtlStopRxEvseIsolEStopMask_C /end REF_CHARACTERISTIC /end FUNCTION
/begin FUNCTION GenericBitMask6 "Group /ByModelHeirarchy/LaforgeTestApp_CCU/Core0-TestApp/V2G/OE_CCS/FLT/CcsFltStopFaultResponse/GenericBitMask6" /begin LOC_MEASUREMENT CcsCtlStopRxEvseStEStop /end LOC_MEASUREMENT /begin REF_CHARACTERISTIC CcsCtlStopRxEvseStEStopMask_C /end REF_CHARACTERISTIC /end FUNCTION
/begin FUNCTION GenericBitMask7 "Group /ByModelHeirarchy/LaforgeTestApp_CCU/Core0-TestApp/V2G/OE_CCS/FLT/CcsFltStopFaultResponse/GenericBitMask7" /begin LOC_MEASUREMENT CcsCtlStopRxEgyTypeEStop /end LOC_MEASUREMENT /begin REF_CHARACTERISTIC CcsCtlStopRxEgyTypeEStopMask_C /end REF_CHARACTERISTIC /end FUNCTION
/begin FUNCTION GenericBitMask8 "Group /ByModelHeirarchy/LaforgeTestApp_CCU/Core0-TestApp/V2G/OE_CCS/FLT/CcsFltStopFaultResponse/GenericBitMask8" /begin LOC_MEASUREMENT CcsCtlStopRxEvseVoltEStop /end LOC_MEASUREMENT /begin REF_CHARACTERISTIC CcsCtlStopRxEvseVoltEStopMask_C /end REF_CHARACTERISTIC /end FUNCTION
/begin FUNCTION GenericBitMask9 "Group /ByModelHeirarchy/LaforgeTestApp_CCU/Core0-TestApp/V2G/OE_CCS/FLT/CcsFltStopFaultResponse/GenericBitMask9" /begin LOC_MEASUREMENT CcsCtlStopRxEvseCrntEStop /end LOC_MEASUREMENT /begin REF_CHARACTERISTIC CcsCtlStopRxEvseCrntEStopMask_C /end REF_CHARACTERISTIC /end FUNCTION
/begin FUNCTION OVR_AndExport39 "Group /ByModelHeirarchy/LaforgeTestApp_CCU/Core0-TestApp/V2G/OE_CCS/FLT/CcsFltStopFaultResponse/OVR_AndExport39" /begin LOC_MEASUREMENT CcsFltStopFltResponse /end LOC_MEASUREMENT /begin REF_CHARACTERISTIC CcsFltStopFltResponseOf_C CcsFltStopFltResponseOv_C /end REF_CHARACTERISTIC /end FUNCTION
/begin FUNCTION CcsFltStopFaultResponse "Group /ByModelHeirarchy/LaforgeTestApp_CCU/Core0-TestApp/V2G/OE_CCS/FLT/CcsFltStopFaultResponse"
 /begin SUB_FUNCTION GenericBitMask GenericBitMask1 GenericBitMask10 GenericBitMask11 GenericBitMask12 GenericBitMask13 GenericBitMask14 GenericBitMask15 GenericBitMask16 GenericBitMask17 GenericBitMask18 GenericBitMask19 GenericBitMask2 GenericBitMask20 GenericBitMask21 GenericBitMask22 GenericBitMask23 GenericBitMask24 GenericBitMask25 GenericBitMask26 GenericBitMask27 GenericBitMask28 GenericBitMask29 GenericBitMask3 GenericBitMask30 GenericBitMask31 GenericBitMask32 GenericBitMask33 GenericBitMask34 GenericBitMask35 GenericBitMask36 GenericBitMask37 GenericBitMask38 GenericBitMask39 GenericBitMask4 GenericBitMask40 GenericBitMask41 GenericBitMask5 GenericBitMask6 GenericBitMask7 GenericBitMask8 GenericBitMask9 OVR_AndExport39 /end SUB_FUNCTION
/end FUNCTION
/end MODULE
/end PROJECT
