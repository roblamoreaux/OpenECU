ASAP2_VERSION 1 31
/begin PROJECT LaForge_CCU_TestApp "Test Application for LaForge TC367"
/begin HEADER "Dana" VERSION "0_3_1" /end HEADER
/begin MODULE OpenECU_TC367_001 ""
/* Scalar measurable for DDE 'A2_vproxim_MaxFlt'. */
/begin MEASUREMENT A2_vproxim_MaxFlt "Proximity above max threshold latched after debounce (CCU pin A2)" UBYTE CU_A2_VPROXIM_MAXFLT 1 100 0.0 1.0 ECU_ADDRESS 0x70019f28 BYTE_ORDER MSB_LAST /end MEASUREMENT
/begin COMPU_METHOD CU_A2_VPROXIM_MAXFLT "Conversion method for A2_vproxim_MaxFlt" RAT_FUNC "%10.0" "(not defined)" COEFFS 0.000000 1.000000 -0.000000 0.000000 0.000000 1.000000 /end COMPU_METHOD
/* Scalar measurable for DDE 'A2_vproxim_MaxFltActv'. */
/begin MEASUREMENT A2_vproxim_MaxFltActv "Active fault high A2 (Max fault no latch or debounce)" UBYTE CU_A2_VPROXIM_MAXFLTACTV 1 100 0.0 1.0 ECU_ADDRESS 0x70019eb2 BYTE_ORDER MSB_LAST /end MEASUREMENT
/begin COMPU_METHOD CU_A2_VPROXIM_MAXFLTACTV "Conversion method for A2_vproxim_MaxFltActv" RAT_FUNC "%10.0" "(not defined)" COEFFS 0.000000 1.000000 -0.000000 0.000000 0.000000 1.000000 /end COMPU_METHOD
/* Scalar measurable for DDE 'A2_vproxim_MinFlt'. */
/begin MEASUREMENT A2_vproxim_MinFlt "Proximity below min threshold latched after debounce (CCU pin A2)" UBYTE CU_A2_VPROXIM_MINFLT 1 100 0.0 1.0 ECU_ADDRESS 0x7001a131 BYTE_ORDER MSB_LAST /end MEASUREMENT
/begin COMPU_METHOD CU_A2_VPROXIM_MINFLT "Conversion method for A2_vproxim_MinFlt" RAT_FUNC "%10.0" "(not defined)" COEFFS 0.000000 1.000000 -0.000000 0.000000 0.000000 1.000000 /end COMPU_METHOD
/* Scalar measurable for DDE 'A2_vproxim_MinFltActv'. */
/begin MEASUREMENT A2_vproxim_MinFltActv "Active fault low A2 (Min fault no latch or debounce)" UBYTE CU_A2_VPROXIM_MINFLTACTV 1 100 0.0 1.0 ECU_ADDRESS 0x7001a0a1 BYTE_ORDER MSB_LAST /end MEASUREMENT
/begin COMPU_METHOD CU_A2_VPROXIM_MINFLTACTV "Conversion method for A2_vproxim_MinFltActv" RAT_FUNC "%10.0" "(not defined)" COEFFS 0.000000 1.000000 -0.000000 0.000000 0.000000 1.000000 /end COMPU_METHOD
/* Scalar measurable for DDE 'A3_vpilot_MaxFlt'. */
/begin MEASUREMENT A3_vpilot_MaxFlt "Pilot above max threshold latched after debounce (CCU pin A3)" UBYTE CU_A3_VPILOT_MAXFLT 1 100 0.0 1.0 ECU_ADDRESS 0x7001a02c BYTE_ORDER MSB_LAST /end MEASUREMENT
/begin COMPU_METHOD CU_A3_VPILOT_MAXFLT "Conversion method for A3_vpilot_MaxFlt" RAT_FUNC "%10.0" "(not defined)" COEFFS 0.000000 1.000000 -0.000000 0.000000 0.000000 1.000000 /end COMPU_METHOD
/* Scalar measurable for DDE 'A3_vpilot_MaxFltActv'. */
/begin MEASUREMENT A3_vpilot_MaxFltActv "Active fault high A3 (Max fault no latch or debounce)" UBYTE CU_A3_VPILOT_MAXFLTACTV 1 100 0.0 1.0 ECU_ADDRESS 0x70019fa0 BYTE_ORDER MSB_LAST /end MEASUREMENT
/begin COMPU_METHOD CU_A3_VPILOT_MAXFLTACTV "Conversion method for A3_vpilot_MaxFltActv" RAT_FUNC "%10.0" "(not defined)" COEFFS 0.000000 1.000000 -0.000000 0.000000 0.000000 1.000000 /end COMPU_METHOD
/* Scalar measurable for DDE 'A3_vpilot_MinFlt'. */
/begin MEASUREMENT A3_vpilot_MinFlt "Pilot below min threshold latched after debounce (CCU pin A3)" UBYTE CU_A3_VPILOT_MINFLT 1 100 0.0 1.0 ECU_ADDRESS 0x70019f1c BYTE_ORDER MSB_LAST /end MEASUREMENT
/begin COMPU_METHOD CU_A3_VPILOT_MINFLT "Conversion method for A3_vpilot_MinFlt" RAT_FUNC "%10.0" "(not defined)" COEFFS 0.000000 1.000000 -0.000000 0.000000 0.000000 1.000000 /end COMPU_METHOD
/* Scalar measurable for DDE 'A3_vpilot_MinFltActv'. */
/begin MEASUREMENT A3_vpilot_MinFltActv "Active fault low A3 (Min fault no latch or debounce)" UBYTE CU_A3_VPILOT_MINFLTACTV 1 100 0.0 1.0 ECU_ADDRESS 0x70019eac BYTE_ORDER MSB_LAST /end MEASUREMENT
/begin COMPU_METHOD CU_A3_VPILOT_MINFLTACTV "Conversion method for A3_vpilot_MinFltActv" RAT_FUNC "%10.0" "(not defined)" COEFFS 0.000000 1.000000 -0.000000 0.000000 0.000000 1.000000 /end COMPU_METHOD
/* Scalar measurable for DDE 'A3_vpilpeak_MaxFlt'. */
/begin MEASUREMENT A3_vpilpeak_MaxFlt "Pilot Peak above max threshold latched after debounce (CCU pin A3)" UBYTE CU_A3_VPILPEAK_MAXFLT 1 100 0.0 1.0 ECU_ADDRESS 0x7001a111 BYTE_ORDER MSB_LAST /end MEASUREMENT
/begin COMPU_METHOD CU_A3_VPILPEAK_MAXFLT "Conversion method for A3_vpilpeak_MaxFlt" RAT_FUNC "%10.0" "(not defined)" COEFFS 0.000000 1.000000 -0.000000 0.000000 0.000000 1.000000 /end COMPU_METHOD
/* Scalar measurable for DDE 'A3_vpilpeak_MaxFltActv'. */
/begin MEASUREMENT A3_vpilpeak_MaxFltActv "Active fault high A3 (Max fault no latch or debounce)" UBYTE CU_A3_VPILPEAK_MAXFLTACTV 1 100 0.0 1.0 ECU_ADDRESS 0x7001a098 BYTE_ORDER MSB_LAST /end MEASUREMENT
/begin COMPU_METHOD CU_A3_VPILPEAK_MAXFLTACTV "Conversion method for A3_vpilpeak_MaxFltActv" RAT_FUNC "%10.0" "(not defined)" COEFFS 0.000000 1.000000 -0.000000 0.000000 0.000000 1.000000 /end COMPU_METHOD
/* Scalar measurable for DDE 'A3_vpilpeak_MinFlt'. */
/begin MEASUREMENT A3_vpilpeak_MinFlt "Pilot Peak below min threshold latched after debounce (CCU pin A3)" UBYTE CU_A3_VPILPEAK_MINFLT 1 100 0.0 1.0 ECU_ADDRESS 0x7001a01c BYTE_ORDER MSB_LAST /end MEASUREMENT
/begin COMPU_METHOD CU_A3_VPILPEAK_MINFLT "Conversion method for A3_vpilpeak_MinFlt" RAT_FUNC "%10.0" "(not defined)" COEFFS 0.000000 1.000000 -0.000000 0.000000 0.000000 1.000000 /end COMPU_METHOD
/* Scalar measurable for DDE 'A3_vpilpeak_MinFltActv'. */
/begin MEASUREMENT A3_vpilpeak_MinFltActv "Active fault low A3 (Min fault no latch or debounce)" UBYTE CU_A3_VPILPEAK_MINFLTACTV 1 100 0.0 1.0 ECU_ADDRESS 0x70019f92 BYTE_ORDER MSB_LAST /end MEASUREMENT
/begin COMPU_METHOD CU_A3_VPILPEAK_MINFLTACTV "Conversion method for A3_vpilpeak_MinFltActv" RAT_FUNC "%10.0" "(not defined)" COEFFS 0.000000 1.000000 -0.000000 0.000000 0.000000 1.000000 /end COMPU_METHOD
/* Scalar measurable for DDE 'AnyECUWakeSignal'. */
/begin MEASUREMENT AnyECUWakeSignal "OR of Ignition>Threshold, CANWAKE, PilotWake, or internal PowerHold" UBYTE CU_ANYECUWAKESIGNAL 1 100 0.0 1.0 ECU_ADDRESS 0x70019f0e BYTE_ORDER MSB_LAST /end MEASUREMENT
/begin COMPU_METHOD CU_ANYECUWAKESIGNAL "Conversion method for AnyECUWakeSignal" RAT_FUNC "%10.0" "(not defined)" COEFFS 0.000000 1.000000 -0.000000 0.000000 0.000000 1.000000 /end COMPU_METHOD
/* Scalar measurable for DDE 'B2_vtempa_MaxFlt'. */
/begin MEASUREMENT B2_vtempa_MaxFlt "Thermistor sensor A above max threshold latched after debounce (CCU pin B2)" UBYTE CU_B2_VTEMPA_MAXFLT 1 100 0.0 1.0 ECU_ADDRESS 0x70019e9e BYTE_ORDER MSB_LAST /end MEASUREMENT
/begin COMPU_METHOD CU_B2_VTEMPA_MAXFLT "Conversion method for B2_vtempa_MaxFlt" RAT_FUNC "%10.0" "(not defined)" COEFFS 0.000000 1.000000 -0.000000 0.000000 0.000000 1.000000 /end COMPU_METHOD
/* Scalar measurable for DDE 'B2_vtempa_MaxFltActv'. */
/begin MEASUREMENT B2_vtempa_MaxFltActv "Active fault high B2 (Max fault no latch or debounce)" UBYTE CU_B2_VTEMPA_MAXFLTACTV 1 100 0.0 1.0 ECU_ADDRESS 0x7001a109 BYTE_ORDER MSB_LAST /end MEASUREMENT
/begin COMPU_METHOD CU_B2_VTEMPA_MAXFLTACTV "Conversion method for B2_vtempa_MaxFltActv" RAT_FUNC "%10.0" "(not defined)" COEFFS 0.000000 1.000000 -0.000000 0.000000 0.000000 1.000000 /end COMPU_METHOD
/* Scalar measurable for DDE 'B2_vtempa_MinFlt'. */
/begin MEASUREMENT B2_vtempa_MinFlt "Thermistor sensor A below min threshold latched after debounce (CCU pin B2)" UBYTE CU_B2_VTEMPA_MINFLT 1 100 0.0 1.0 ECU_ADDRESS 0x7001a08d BYTE_ORDER MSB_LAST /end MEASUREMENT
/begin COMPU_METHOD CU_B2_VTEMPA_MINFLT "Conversion method for B2_vtempa_MinFlt" RAT_FUNC "%10.0" "(not defined)" COEFFS 0.000000 1.000000 -0.000000 0.000000 0.000000 1.000000 /end COMPU_METHOD
/* Scalar measurable for DDE 'B2_vtempa_MinFltActv'. */
/begin MEASUREMENT B2_vtempa_MinFltActv "Active fault low B2 (Min fault no latch or debounce)" UBYTE CU_B2_VTEMPA_MINFLTACTV 1 100 0.0 1.0 ECU_ADDRESS 0x7001a018 BYTE_ORDER MSB_LAST /end MEASUREMENT
/begin COMPU_METHOD CU_B2_VTEMPA_MINFLTACTV "Conversion method for B2_vtempa_MinFltActv" RAT_FUNC "%10.0" "(not defined)" COEFFS 0.000000 1.000000 -0.000000 0.000000 0.000000 1.000000 /end COMPU_METHOD
/* Scalar measurable for DDE 'B3_vtempb_MaxFlt'. */
/begin MEASUREMENT B3_vtempb_MaxFlt "Thermistor sensor B above max threshold latched after debounce (CCU pin B3)" UBYTE CU_B3_VTEMPB_MAXFLT 1 100 0.0 1.0 ECU_ADDRESS 0x70019f88 BYTE_ORDER MSB_LAST /end MEASUREMENT
/begin COMPU_METHOD CU_B3_VTEMPB_MAXFLT "Conversion method for B3_vtempb_MaxFlt" RAT_FUNC "%10.0" "(not defined)" COEFFS 0.000000 1.000000 -0.000000 0.000000 0.000000 1.000000 /end COMPU_METHOD
/* Scalar measurable for DDE 'B3_vtempb_MaxFltActv'. */
/begin MEASUREMENT B3_vtempb_MaxFltActv "Active fault high B3 (Max fault no latch or debounce)" UBYTE CU_B3_VTEMPB_MAXFLTACTV 1 100 0.0 1.0 ECU_ADDRESS 0x70019f05 BYTE_ORDER MSB_LAST /end MEASUREMENT
/begin COMPU_METHOD CU_B3_VTEMPB_MAXFLTACTV "Conversion method for B3_vtempb_MaxFltActv" RAT_FUNC "%10.0" "(not defined)" COEFFS 0.000000 1.000000 -0.000000 0.000000 0.000000 1.000000 /end COMPU_METHOD
/* Scalar measurable for DDE 'B3_vtempb_MinFlt'. */
/begin MEASUREMENT B3_vtempb_MinFlt "Thermistor sensor B below min threshold latched after debounce (CCU pin B3)" UBYTE CU_B3_VTEMPB_MINFLT 1 100 0.0 1.0 ECU_ADDRESS 0x7001a1a4 BYTE_ORDER MSB_LAST /end MEASUREMENT
/begin COMPU_METHOD CU_B3_VTEMPB_MINFLT "Conversion method for B3_vtempb_MinFlt" RAT_FUNC "%10.0" "(not defined)" COEFFS 0.000000 1.000000 -0.000000 0.000000 0.000000 1.000000 /end COMPU_METHOD
/* Scalar measurable for DDE 'B3_vtempb_MinFltActv'. */
/begin MEASUREMENT B3_vtempb_MinFltActv "Active fault low B3 (Min fault no latch or debounce)" UBYTE CU_B3_VTEMPB_MINFLTACTV 1 100 0.0 1.0 ECU_ADDRESS 0x7001a0ff BYTE_ORDER MSB_LAST /end MEASUREMENT
/begin COMPU_METHOD CU_B3_VTEMPB_MINFLTACTV "Conversion method for B3_vtempb_MinFltActv" RAT_FUNC "%10.0" "(not defined)" COEFFS 0.000000 1.000000 -0.000000 0.000000 0.000000 1.000000 /end COMPU_METHOD
/* Scalar measurable for DDE 'B4_vtempc_MaxFlt'. */
/begin MEASUREMENT B4_vtempc_MaxFlt "Thermistor sensor C above max threshold latched after debounce (CCU pin B4)" UBYTE CU_B4_VTEMPC_MAXFLT 1 100 0.0 1.0 ECU_ADDRESS 0x7001a082 BYTE_ORDER MSB_LAST /end MEASUREMENT
/begin COMPU_METHOD CU_B4_VTEMPC_MAXFLT "Conversion method for B4_vtempc_MaxFlt" RAT_FUNC "%10.0" "(not defined)" COEFFS 0.000000 1.000000 -0.000000 0.000000 0.000000 1.000000 /end COMPU_METHOD
/* Scalar measurable for DDE 'B4_vtempc_MaxFltActv'. */
/begin MEASUREMENT B4_vtempc_MaxFltActv "Active fault high B4 (Max fault no latch or debounce)" UBYTE CU_B4_VTEMPC_MAXFLTACTV 1 100 0.0 1.0 ECU_ADDRESS 0x7001a008 BYTE_ORDER MSB_LAST /end MEASUREMENT
/begin COMPU_METHOD CU_B4_VTEMPC_MAXFLTACTV "Conversion method for B4_vtempc_MaxFltActv" RAT_FUNC "%10.0" "(not defined)" COEFFS 0.000000 1.000000 -0.000000 0.000000 0.000000 1.000000 /end COMPU_METHOD
/* Scalar measurable for DDE 'B4_vtempc_MinFlt'. */
/begin MEASUREMENT B4_vtempc_MinFlt "Thermistor sensor C below min threshold latched after debounce (CCU pin B4)" UBYTE CU_B4_VTEMPC_MINFLT 1 100 0.0 1.0 ECU_ADDRESS 0x70019f7c BYTE_ORDER MSB_LAST /end MEASUREMENT
/begin COMPU_METHOD CU_B4_VTEMPC_MINFLT "Conversion method for B4_vtempc_MinFlt" RAT_FUNC "%10.0" "(not defined)" COEFFS 0.000000 1.000000 -0.000000 0.000000 0.000000 1.000000 /end COMPU_METHOD
/* Scalar measurable for DDE 'B4_vtempc_MinFltActv'. */
/begin MEASUREMENT B4_vtempc_MinFltActv "Active fault low B4 (Min fault no latch or debounce)" UBYTE CU_B4_VTEMPC_MINFLTACTV 1 100 0.0 1.0 ECU_ADDRESS 0x70019efd BYTE_ORDER MSB_LAST /end MEASUREMENT
/begin COMPU_METHOD CU_B4_VTEMPC_MINFLTACTV "Conversion method for B4_vtempc_MinFltActv" RAT_FUNC "%10.0" "(not defined)" COEFFS 0.000000 1.000000 -0.000000 0.000000 0.000000 1.000000 /end COMPU_METHOD
/* Scalar measurable for DDE 'C2_vtempd_MaxFlt'. */
/begin MEASUREMENT C2_vtempd_MaxFlt "Thermistor sensor D above max threshold latched after debounce (CCU pin C2)" UBYTE CU_C2_VTEMPD_MAXFLT 1 100 0.0 1.0 ECU_ADDRESS 0x7001a185 BYTE_ORDER MSB_LAST /end MEASUREMENT
/begin COMPU_METHOD CU_C2_VTEMPD_MAXFLT "Conversion method for C2_vtempd_MaxFlt" RAT_FUNC "%10.0" "(not defined)" COEFFS 0.000000 1.000000 -0.000000 0.000000 0.000000 1.000000 /end COMPU_METHOD
/* Scalar measurable for DDE 'C2_vtempd_MaxFltActv'. */
/begin MEASUREMENT C2_vtempd_MaxFltActv "Active fault high C2 (Max fault no latch or debounce)" UBYTE CU_C2_VTEMPD_MAXFLTACTV 1 100 0.0 1.0 ECU_ADDRESS 0x7001a0f4 BYTE_ORDER MSB_LAST /end MEASUREMENT
/begin COMPU_METHOD CU_C2_VTEMPD_MAXFLTACTV "Conversion method for C2_vtempd_MaxFltActv" RAT_FUNC "%10.0" "(not defined)" COEFFS 0.000000 1.000000 -0.000000 0.000000 0.000000 1.000000 /end COMPU_METHOD
/* Scalar measurable for DDE 'C2_vtempd_MinFlt'. */
/begin MEASUREMENT C2_vtempd_MinFlt "Thermistor sensor D below min threshold latched after debounce (CCU pin C2)" UBYTE CU_C2_VTEMPD_MINFLT 1 100 0.0 1.0 ECU_ADDRESS 0x7001a078 BYTE_ORDER MSB_LAST /end MEASUREMENT
/begin COMPU_METHOD CU_C2_VTEMPD_MINFLT "Conversion method for C2_vtempd_MinFlt" RAT_FUNC "%10.0" "(not defined)" COEFFS 0.000000 1.000000 -0.000000 0.000000 0.000000 1.000000 /end COMPU_METHOD
/* Scalar measurable for DDE 'C2_vtempd_MinFltActv'. */
/begin MEASUREMENT C2_vtempd_MinFltActv "Active fault low C2 (Min fault no latch or debounce)" UBYTE CU_C2_VTEMPD_MINFLTACTV 1 100 0.0 1.0 ECU_ADDRESS 0x7001a000 BYTE_ORDER MSB_LAST /end MEASUREMENT
/begin COMPU_METHOD CU_C2_VTEMPD_MINFLTACTV "Conversion method for C2_vtempd_MinFltActv" RAT_FUNC "%10.0" "(not defined)" COEFFS 0.000000 1.000000 -0.000000 0.000000 0.000000 1.000000 /end COMPU_METHOD
/* Scalar measurable for DDE 'CANBusStatus'. */
/begin MEASUREMENT CANBusStatus "(not defined)" FLOAT32_IEEE CU_CANBUSSTATUS 1 100 0.0 1.0 ECU_ADDRESS 0x70019f6c BYTE_ORDER MSB_LAST /end MEASUREMENT
/begin COMPU_METHOD CU_CANBUSSTATUS "Conversion method for CANBusStatus" RAT_FUNC "%10.0" "(not defined)" COEFFS 0.000000 1.000000 -0.000000 0.000000 0.000000 1.000000 /end COMPU_METHOD
/* Scalar measurable for DDE 'CANFDCounter'. */
/begin MEASUREMENT CANFDCounter "(not defined)" ULONG CU_CANFDCOUNTER 1 100 0.0 4294967295.0 ECU_ADDRESS 0x70019ef0 BYTE_ORDER MSB_LAST /end MEASUREMENT
/begin COMPU_METHOD CU_CANFDCOUNTER "Conversion method for CANFDCounter" RAT_FUNC "%10.0" "(not defined)" COEFFS 0.000000 1.000000 -0.000000 0.000000 0.000000 1.000000 /end COMPU_METHOD
/* Scalar measurable for DDE 'CANFDRxErr'. */
/begin MEASUREMENT CANFDRxErr "(not defined)" UBYTE CU_CANFDRXERR 1 100 0.0 255.0 ECU_ADDRESS 0x7001a0e8 BYTE_ORDER MSB_LAST /end MEASUREMENT
/begin COMPU_METHOD CU_CANFDRXERR "Conversion method for CANFDRxErr" RAT_FUNC "%10.0" "(not defined)" COEFFS 0.000000 1.000000 -0.000000 0.000000 0.000000 1.000000 /end COMPU_METHOD
/* Scalar measurable for DDE 'CANFDRxOverrun'. */
/begin MEASUREMENT CANFDRxOverrun "(not defined)" UBYTE CU_CANFDRXOVERRUN 1 100 0.0 255.0 ECU_ADDRESS 0x7001a070 BYTE_ORDER MSB_LAST /end MEASUREMENT
/begin COMPU_METHOD CU_CANFDRXOVERRUN "Conversion method for CANFDRxOverrun" RAT_FUNC "%10.0" "(not defined)" COEFFS 0.000000 1.000000 -0.000000 0.000000 0.000000 1.000000 /end COMPU_METHOD
/* Scalar measurable for DDE 'CANFDRxTrig'. */
/begin MEASUREMENT CANFDRxTrig "(not defined)" FLOAT32_IEEE CU_CANFDRXTRIG 1 100 -3.40282346639e+38 3.40282346639e+38 ECU_ADDRESS 0x70019ff4 BYTE_ORDER MSB_LAST /end MEASUREMENT
/begin COMPU_METHOD CU_CANFDRXTRIG "Conversion method for CANFDRxTrig" RAT_FUNC "%10.0" "(not defined)" COEFFS 0.000000 1.000000 -0.000000 0.000000 0.000000 1.000000 /end COMPU_METHOD
/* Scalar measurable for DDE 'CANFDRxTxCompare[0]'. */
/begin MEASUREMENT CANFDRxTxCompare[0] "(not defined)" UBYTE CU_CANFDRXTXCOMPARE[0] 1 100 0.0 255.0 ECU_ADDRESS 0x70019f5d BYTE_ORDER MSB_LAST /end MEASUREMENT
/begin COMPU_METHOD CU_CANFDRXTXCOMPARE[0] "Conversion method for CANFDRxTxCompare[0]" RAT_FUNC "%10.0" "(not defined)" COEFFS 0.000000 1.000000 -0.000000 0.000000 0.000000 1.000000 /end COMPU_METHOD
/* Scalar measurable for DDE 'CANFDRxTxCompare[1]'. */
/begin MEASUREMENT CANFDRxTxCompare[1] "(not defined)" UBYTE CU_CANFDRXTXCOMPARE[1] 1 100 0.0 255.0 ECU_ADDRESS 0x70019f5e BYTE_ORDER MSB_LAST /end MEASUREMENT
/begin COMPU_METHOD CU_CANFDRXTXCOMPARE[1] "Conversion method for CANFDRxTxCompare[1]" RAT_FUNC "%10.0" "(not defined)" COEFFS 0.000000 1.000000 -0.000000 0.000000 0.000000 1.000000 /end COMPU_METHOD
/* Scalar measurable for DDE 'CANFDRxTxCompare[2]'. */
/begin MEASUREMENT CANFDRxTxCompare[2] "(not defined)" UBYTE CU_CANFDRXTXCOMPARE[2] 1 100 0.0 255.0 ECU_ADDRESS 0x70019f5f BYTE_ORDER MSB_LAST /end MEASUREMENT
/begin COMPU_METHOD CU_CANFDRXTXCOMPARE[2] "Conversion method for CANFDRxTxCompare[2]" RAT_FUNC "%10.0" "(not defined)" COEFFS 0.000000 1.000000 -0.000000 0.000000 0.000000 1.000000 /end COMPU_METHOD
/* Scalar measurable for DDE 'CANFDRxTxCompare[3]'. */
/begin MEASUREMENT CANFDRxTxCompare[3] "(not defined)" UBYTE CU_CANFDRXTXCOMPARE[3] 1 100 0.0 255.0 ECU_ADDRESS 0x70019f60 BYTE_ORDER MSB_LAST /end MEASUREMENT
/begin COMPU_METHOD CU_CANFDRXTXCOMPARE[3] "Conversion method for CANFDRxTxCompare[3]" RAT_FUNC "%10.0" "(not defined)" COEFFS 0.000000 1.000000 -0.000000 0.000000 0.000000 1.000000 /end COMPU_METHOD
/* Scalar measurable for DDE 'CANFDRxTxCompare[4]'. */
/begin MEASUREMENT CANFDRxTxCompare[4] "(not defined)" UBYTE CU_CANFDRXTXCOMPARE[4] 1 100 0.0 255.0 ECU_ADDRESS 0x70019f61 BYTE_ORDER MSB_LAST /end MEASUREMENT
/begin COMPU_METHOD CU_CANFDRXTXCOMPARE[4] "Conversion method for CANFDRxTxCompare[4]" RAT_FUNC "%10.0" "(not defined)" COEFFS 0.000000 1.000000 -0.000000 0.000000 0.000000 1.000000 /end COMPU_METHOD
/* Scalar measurable for DDE 'CANFDRxTxCompare[5]'. */
/begin MEASUREMENT CANFDRxTxCompare[5] "(not defined)" UBYTE CU_CANFDRXTXCOMPARE[5] 1 100 0.0 255.0 ECU_ADDRESS 0x70019f62 BYTE_ORDER MSB_LAST /end MEASUREMENT
/begin COMPU_METHOD CU_CANFDRXTXCOMPARE[5] "Conversion method for CANFDRxTxCompare[5]" RAT_FUNC "%10.0" "(not defined)" COEFFS 0.000000 1.000000 -0.000000 0.000000 0.000000 1.000000 /end COMPU_METHOD
/* Scalar measurable for DDE 'CANFDRxTxCompare[6]'. */
/begin MEASUREMENT CANFDRxTxCompare[6] "(not defined)" UBYTE CU_CANFDRXTXCOMPARE[6] 1 100 0.0 255.0 ECU_ADDRESS 0x70019f63 BYTE_ORDER MSB_LAST /end MEASUREMENT
/begin COMPU_METHOD CU_CANFDRXTXCOMPARE[6] "Conversion method for CANFDRxTxCompare[6]" RAT_FUNC "%10.0" "(not defined)" COEFFS 0.000000 1.000000 -0.000000 0.000000 0.000000 1.000000 /end COMPU_METHOD
/* Scalar measurable for DDE 'CANFDRxTxCompare[7]'. */
/begin MEASUREMENT CANFDRxTxCompare[7] "(not defined)" UBYTE CU_CANFDRXTXCOMPARE[7] 1 100 0.0 255.0 ECU_ADDRESS 0x70019f64 BYTE_ORDER MSB_LAST /end MEASUREMENT
/begin COMPU_METHOD CU_CANFDRXTXCOMPARE[7] "Conversion method for CANFDRxTxCompare[7]" RAT_FUNC "%10.0" "(not defined)" COEFFS 0.000000 1.000000 -0.000000 0.000000 0.000000 1.000000 /end COMPU_METHOD
/* Scalar measurable for DDE 'CANFDRxTxFault'. */
/begin MEASUREMENT CANFDRxTxFault "(not defined)" UBYTE CU_CANFDRXTXFAULT 1 100 0.0 255.0 ECU_ADDRESS 0x70019ee4 BYTE_ORDER MSB_LAST /end MEASUREMENT
/begin COMPU_METHOD CU_CANFDRXTXFAULT "Conversion method for CANFDRxTxFault" RAT_FUNC "%10.0" "(not defined)" COEFFS 0.000000 1.000000 -0.000000 0.000000 0.000000 1.000000 /end COMPU_METHOD
/* Scalar measurable for DDE 'CANFDRx[0]'. */
/begin MEASUREMENT CANFDRx[0] "(not defined)" UBYTE CU_CANFDRX[0] 1 100 0.0 255.0 ECU_ADDRESS 0x7001a171 BYTE_ORDER MSB_LAST /end MEASUREMENT
/begin COMPU_METHOD CU_CANFDRX[0] "Conversion method for CANFDRx[0]" RAT_FUNC "%10.0" "(not defined)" COEFFS 0.000000 1.000000 -0.000000 0.000000 0.000000 1.000000 /end COMPU_METHOD
/* Scalar measurable for DDE 'CANFDRx[1]'. */
/begin MEASUREMENT CANFDRx[1] "(not defined)" UBYTE CU_CANFDRX[1] 1 100 0.0 255.0 ECU_ADDRESS 0x7001a172 BYTE_ORDER MSB_LAST /end MEASUREMENT
/begin COMPU_METHOD CU_CANFDRX[1] "Conversion method for CANFDRx[1]" RAT_FUNC "%10.0" "(not defined)" COEFFS 0.000000 1.000000 -0.000000 0.000000 0.000000 1.000000 /end COMPU_METHOD
/* Scalar measurable for DDE 'CANFDRx[2]'. */
/begin MEASUREMENT CANFDRx[2] "(not defined)" UBYTE CU_CANFDRX[2] 1 100 0.0 255.0 ECU_ADDRESS 0x7001a173 BYTE_ORDER MSB_LAST /end MEASUREMENT
/begin COMPU_METHOD CU_CANFDRX[2] "Conversion method for CANFDRx[2]" RAT_FUNC "%10.0" "(not defined)" COEFFS 0.000000 1.000000 -0.000000 0.000000 0.000000 1.000000 /end COMPU_METHOD
/* Scalar measurable for DDE 'CANFDRx[3]'. */
/begin MEASUREMENT CANFDRx[3] "(not defined)" UBYTE CU_CANFDRX[3] 1 100 0.0 255.0 ECU_ADDRESS 0x7001a174 BYTE_ORDER MSB_LAST /end MEASUREMENT
/begin COMPU_METHOD CU_CANFDRX[3] "Conversion method for CANFDRx[3]" RAT_FUNC "%10.0" "(not defined)" COEFFS 0.000000 1.000000 -0.000000 0.000000 0.000000 1.000000 /end COMPU_METHOD
/* Scalar measurable for DDE 'CANFDRx[4]'. */
/begin MEASUREMENT CANFDRx[4] "(not defined)" UBYTE CU_CANFDRX[4] 1 100 0.0 255.0 ECU_ADDRESS 0x7001a175 BYTE_ORDER MSB_LAST /end MEASUREMENT
/begin COMPU_METHOD CU_CANFDRX[4] "Conversion method for CANFDRx[4]" RAT_FUNC "%10.0" "(not defined)" COEFFS 0.000000 1.000000 -0.000000 0.000000 0.000000 1.000000 /end COMPU_METHOD
/* Scalar measurable for DDE 'CANFDRx[5]'. */
/begin MEASUREMENT CANFDRx[5] "(not defined)" UBYTE CU_CANFDRX[5] 1 100 0.0 255.0 ECU_ADDRESS 0x7001a176 BYTE_ORDER MSB_LAST /end MEASUREMENT
/begin COMPU_METHOD CU_CANFDRX[5] "Conversion method for CANFDRx[5]" RAT_FUNC "%10.0" "(not defined)" COEFFS 0.000000 1.000000 -0.000000 0.000000 0.000000 1.000000 /end COMPU_METHOD
/* Scalar measurable for DDE 'CANFDRx[6]'. */
/begin MEASUREMENT CANFDRx[6] "(not defined)" UBYTE CU_CANFDRX[6] 1 100 0.0 255.0 ECU_ADDRESS 0x7001a177 BYTE_ORDER MSB_LAST /end MEASUREMENT
/begin COMPU_METHOD CU_CANFDRX[6] "Conversion method for CANFDRx[6]" RAT_FUNC "%10.0" "(not defined)" COEFFS 0.000000 1.000000 -0.000000 0.000000 0.000000 1.000000 /end COMPU_METHOD
/* Scalar measurable for DDE 'CANFDRx[7]'. */
/begin MEASUREMENT CANFDRx[7] "(not defined)" UBYTE CU_CANFDRX[7] 1 100 0.0 255.0 ECU_ADDRESS 0x7001a178 BYTE_ORDER MSB_LAST /end MEASUREMENT
/begin COMPU_METHOD CU_CANFDRX[7] "Conversion method for CANFDRx[7]" RAT_FUNC "%10.0" "(not defined)" COEFFS 0.000000 1.000000 -0.000000 0.000000 0.000000 1.000000 /end COMPU_METHOD
/* Scalar measurable for DDE 'CANFDTrig'. */
/begin MEASUREMENT CANFDTrig "(not defined)" FLOAT32_IEEE CU_CANFDTRIG 1 100 -3.40282346639e+38 3.40282346639e+38 ECU_ADDRESS 0x7001a164 BYTE_ORDER MSB_LAST /end MEASUREMENT
/begin COMPU_METHOD CU_CANFDTRIG "Conversion method for CANFDTrig" RAT_FUNC "%10.0" "(not defined)" COEFFS 0.000000 1.000000 -0.000000 0.000000 0.000000 1.000000 /end COMPU_METHOD
/* Scalar measurable for DDE 'CANFDTxAckCnt'. */
/begin MEASUREMENT CANFDTxAckCnt "(not defined)" ULONG CU_CANFDTXACKCNT 1 100 0.0 4294967295.0 ECU_ADDRESS 0x7001a0dc BYTE_ORDER MSB_LAST /end MEASUREMENT
/begin COMPU_METHOD CU_CANFDTXACKCNT "Conversion method for CANFDTxAckCnt" RAT_FUNC "%10.0" "cnt" COEFFS 0.000000 1.000000 -0.000000 0.000000 0.000000 1.000000 /end COMPU_METHOD
/* Scalar measurable for DDE 'CANFDTxData[0]'. */
/begin MEASUREMENT CANFDTxData[0] "(not defined)" UBYTE CU_CANFDTXDATA[0] 1 100 0.0 255.0 ECU_ADDRESS 0x7001a05c BYTE_ORDER MSB_LAST /end MEASUREMENT
/begin COMPU_METHOD CU_CANFDTXDATA[0] "Conversion method for CANFDTxData[0]" RAT_FUNC "%10.0" "(not defined)" COEFFS 0.000000 1.000000 -0.000000 0.000000 0.000000 1.000000 /end COMPU_METHOD
/* Scalar measurable for DDE 'CANFDTxData[1]'. */
/begin MEASUREMENT CANFDTxData[1] "(not defined)" UBYTE CU_CANFDTXDATA[1] 1 100 0.0 255.0 ECU_ADDRESS 0x7001a05d BYTE_ORDER MSB_LAST /end MEASUREMENT
/begin COMPU_METHOD CU_CANFDTXDATA[1] "Conversion method for CANFDTxData[1]" RAT_FUNC "%10.0" "(not defined)" COEFFS 0.000000 1.000000 -0.000000 0.000000 0.000000 1.000000 /end COMPU_METHOD
/* Scalar measurable for DDE 'CANFDTxData[2]'. */
/begin MEASUREMENT CANFDTxData[2] "(not defined)" UBYTE CU_CANFDTXDATA[2] 1 100 0.0 255.0 ECU_ADDRESS 0x7001a05e BYTE_ORDER MSB_LAST /end MEASUREMENT
/begin COMPU_METHOD CU_CANFDTXDATA[2] "Conversion method for CANFDTxData[2]" RAT_FUNC "%10.0" "(not defined)" COEFFS 0.000000 1.000000 -0.000000 0.000000 0.000000 1.000000 /end COMPU_METHOD
/* Scalar measurable for DDE 'CANFDTxData[3]'. */
/begin MEASUREMENT CANFDTxData[3] "(not defined)" UBYTE CU_CANFDTXDATA[3] 1 100 0.0 255.0 ECU_ADDRESS 0x7001a05f BYTE_ORDER MSB_LAST /end MEASUREMENT
/begin COMPU_METHOD CU_CANFDTXDATA[3] "Conversion method for CANFDTxData[3]" RAT_FUNC "%10.0" "(not defined)" COEFFS 0.000000 1.000000 -0.000000 0.000000 0.000000 1.000000 /end COMPU_METHOD
/* Scalar measurable for DDE 'CANFDTxData[4]'. */
/begin MEASUREMENT CANFDTxData[4] "(not defined)" UBYTE CU_CANFDTXDATA[4] 1 100 0.0 255.0 ECU_ADDRESS 0x7001a060 BYTE_ORDER MSB_LAST /end MEASUREMENT
/begin COMPU_METHOD CU_CANFDTXDATA[4] "Conversion method for CANFDTxData[4]" RAT_FUNC "%10.0" "(not defined)" COEFFS 0.000000 1.000000 -0.000000 0.000000 0.000000 1.000000 /end COMPU_METHOD
/* Scalar measurable for DDE 'CANFDTxData[5]'. */
/begin MEASUREMENT CANFDTxData[5] "(not defined)" UBYTE CU_CANFDTXDATA[5] 1 100 0.0 255.0 ECU_ADDRESS 0x7001a061 BYTE_ORDER MSB_LAST /end MEASUREMENT
/begin COMPU_METHOD CU_CANFDTXDATA[5] "Conversion method for CANFDTxData[5]" RAT_FUNC "%10.0" "(not defined)" COEFFS 0.000000 1.000000 -0.000000 0.000000 0.000000 1.000000 /end COMPU_METHOD
/* Scalar measurable for DDE 'CANFDTxData[6]'. */
/begin MEASUREMENT CANFDTxData[6] "(not defined)" UBYTE CU_CANFDTXDATA[6] 1 100 0.0 255.0 ECU_ADDRESS 0x7001a062 BYTE_ORDER MSB_LAST /end MEASUREMENT
/begin COMPU_METHOD CU_CANFDTXDATA[6] "Conversion method for CANFDTxData[6]" RAT_FUNC "%10.0" "(not defined)" COEFFS 0.000000 1.000000 -0.000000 0.000000 0.000000 1.000000 /end COMPU_METHOD
/* Scalar measurable for DDE 'CANFDTxData[7]'. */
/begin MEASUREMENT CANFDTxData[7] "(not defined)" UBYTE CU_CANFDTXDATA[7] 1 100 0.0 255.0 ECU_ADDRESS 0x7001a063 BYTE_ORDER MSB_LAST /end MEASUREMENT
/begin COMPU_METHOD CU_CANFDTXDATA[7] "Conversion method for CANFDTxData[7]" RAT_FUNC "%10.0" "(not defined)" COEFFS 0.000000 1.000000 -0.000000 0.000000 0.000000 1.000000 /end COMPU_METHOD
/* Scalar measurable for DDE 'CANFDTxErrFlg'. */
/begin MEASUREMENT CANFDTxErrFlg "(not defined)" UBYTE CU_CANFDTXERRFLG 1 100 0.0 255.0 ECU_ADDRESS 0x70019fe5 BYTE_ORDER MSB_LAST /end MEASUREMENT
/begin COMPU_METHOD CU_CANFDTXERRFLG "Conversion method for CANFDTxErrFlg" RAT_FUNC "%10.0" "(not defined)" COEFFS 0.000000 1.000000 -0.000000 0.000000 0.000000 1.000000 /end COMPU_METHOD
/* Scalar measurable for DDE 'CANFDTxTimeout'. */
/begin MEASUREMENT CANFDTxTimeout "(not defined)" UBYTE CU_CANFDTXTIMEOUT 1 100 0.0 255.0 ECU_ADDRESS 0x70019f54 BYTE_ORDER MSB_LAST /end MEASUREMENT
/begin COMPU_METHOD CU_CANFDTXTIMEOUT "Conversion method for CANFDTxTimeout" RAT_FUNC "%10.0" "b" COEFFS 0.000000 1.000000 -0.000000 0.000000 0.000000 1.000000 /end COMPU_METHOD
/* Scalar measurable for DDE 'CcsCtlEcuHoldEcuPwrReq'. */
/begin MEASUREMENT CcsCtlEcuHoldEcuPwrReq "TRUE is a Request from PiCCS to Host software to Hold ECU power (when TRUE) due to Wake-by-Pilot" UBYTE CU_CCSCTLECUHOLDECUPWRREQ 1 100 0.0 1.0 ECU_ADDRESS 0x70017e36 BYTE_ORDER MSB_LAST /end MEASUREMENT
/begin COMPU_METHOD CU_CCSCTLECUHOLDECUPWRREQ "Conversion method for CcsCtlEcuHoldEcuPwrReq" RAT_FUNC "%10.0" "b" COEFFS 0.000000 1.000000 -0.000000 0.000000 0.000000 1.000000 /end COMPU_METHOD
/* Scalar measurable for DDE 'CcsCtlEcuHoldQcaPwrReq'. */
/begin MEASUREMENT CcsCtlEcuHoldQcaPwrReq "TRUE is a Request from PiCCS to Host software to Hold QCA chip (PowerLine Communication modem) power" UBYTE CU_CCSCTLECUHOLDQCAPWRREQ 1 100 0.0 1.0 ECU_ADDRESS 0x70017e68 BYTE_ORDER MSB_LAST /end MEASUREMENT
/begin COMPU_METHOD CU_CCSCTLECUHOLDQCAPWRREQ "Conversion method for CcsCtlEcuHoldQcaPwrReq" RAT_FUNC "%10.0" "b" COEFFS 0.000000 1.000000 -0.000000 0.000000 0.000000 1.000000 /end COMPU_METHOD
/* Scalar measurable for DDE 'CcsCtlStopCpEStop'. */
/begin MEASUREMENT CcsCtlStopCpEStop "Flag that indicates an emergency shutdown triggered by CcsFltCpWrd faults" UBYTE CU_CCSCTLSTOPCPESTOP 1 100 0.0 1.0 ECU_ADDRESS 0x700182b2 BYTE_ORDER MSB_LAST /end MEASUREMENT
/begin COMPU_METHOD CU_CCSCTLSTOPCPESTOP "Conversion method for CcsCtlStopCpEStop" RAT_FUNC "%10.0" "b" COEFFS 0.000000 1.000000 -0.000000 0.000000 0.000000 1.000000 /end COMPU_METHOD
/* Scalar measurable for DDE 'CcsCtlStopCpNStop'. */
/begin MEASUREMENT CcsCtlStopCpNStop "Flag that indicates a normal shutdown triggered by CcsFltCpWrd faults" UBYTE CU_CCSCTLSTOPCPNSTOP 1 100 0.0 1.0 ECU_ADDRESS 0x70017db9 BYTE_ORDER MSB_LAST /end MEASUREMENT
/begin COMPU_METHOD CU_CCSCTLSTOPCPNSTOP "Conversion method for CcsCtlStopCpNStop" RAT_FUNC "%10.0" "b" COEFFS 0.000000 1.000000 -0.000000 0.000000 0.000000 1.000000 /end COMPU_METHOD
/* Scalar measurable for DDE 'CcsCtlStopCpRStop'. */
/begin MEASUREMENT CcsCtlStopCpRStop "Flag that indicates a rapid shutdown triggered by CcsFltCpWrd faults" UBYTE CU_CCSCTLSTOPCPRSTOP 1 100 0.0 1.0 ECU_ADDRESS 0x700181fe BYTE_ORDER MSB_LAST /end MEASUREMENT
/begin COMPU_METHOD CU_CCSCTLSTOPCPRSTOP "Conversion method for CcsCtlStopCpRStop" RAT_FUNC "%10.0" "b" COEFFS 0.000000 1.000000 -0.000000 0.000000 0.000000 1.000000 /end COMPU_METHOD
/* Scalar measurable for DDE 'CcsCtlStopIntFltEStop'. */
/begin MEASUREMENT CcsCtlStopIntFltEStop "Flag that indicates an emergency shutdown triggered by CcsFltInternalFaultsWrd faults" UBYTE CU_CCSCTLSTOPINTFLTESTOP 1 100 0.0 1.0 ECU_ADDRESS 0x70017d1a BYTE_ORDER MSB_LAST /end MEASUREMENT
/begin COMPU_METHOD CU_CCSCTLSTOPINTFLTESTOP "Conversion method for CcsCtlStopIntFltEStop" RAT_FUNC "%10.0" "b" COEFFS 0.000000 1.000000 -0.000000 0.000000 0.000000 1.000000 /end COMPU_METHOD
/* Scalar measurable for DDE 'CcsCtlStopIntFltNStop'. */
/begin MEASUREMENT CcsCtlStopIntFltNStop "Flag that indicates a normal shutdown triggered by CcsFltInternalFaultsWrd faults" UBYTE CU_CCSCTLSTOPINTFLTNSTOP 1 100 0.0 1.0 ECU_ADDRESS 0x70018170 BYTE_ORDER MSB_LAST /end MEASUREMENT
/begin COMPU_METHOD CU_CCSCTLSTOPINTFLTNSTOP "Conversion method for CcsCtlStopIntFltNStop" RAT_FUNC "%10.0" "b" COEFFS 0.000000 1.000000 -0.000000 0.000000 0.000000 1.000000 /end COMPU_METHOD
/* Scalar measurable for DDE 'CcsCtlStopIntFltRStop'. */
/begin MEASUREMENT CcsCtlStopIntFltRStop "Flag that indicates a rapid shutdown triggered by CcsFltInternalFaultsWrd faults" UBYTE CU_CCSCTLSTOPINTFLTRSTOP 1 100 0.0 1.0 ECU_ADDRESS 0x70017c45 BYTE_ORDER MSB_LAST /end MEASUREMENT
/begin COMPU_METHOD CU_CCSCTLSTOPINTFLTRSTOP "Conversion method for CcsCtlStopIntFltRStop" RAT_FUNC "%10.0" "b" COEFFS 0.000000 1.000000 -0.000000 0.000000 0.000000 1.000000 /end COMPU_METHOD
/* Scalar measurable for DDE 'CcsCtlStopPpEStop'. */
/begin MEASUREMENT CcsCtlStopPpEStop "Flag that indicates an emergency shutdown triggered by CcsFltPpWrd faults" UBYTE CU_CCSCTLSTOPPPESTOP 1 100 0.0 1.0 ECU_ADDRESS 0x70018009 BYTE_ORDER MSB_LAST /end MEASUREMENT
/begin COMPU_METHOD CU_CCSCTLSTOPPPESTOP "Conversion method for CcsCtlStopPpEStop" RAT_FUNC "%10.0" "b" COEFFS 0.000000 1.000000 -0.000000 0.000000 0.000000 1.000000 /end COMPU_METHOD
/* Scalar measurable for DDE 'CcsCtlStopPpNStop'. */
/begin MEASUREMENT CcsCtlStopPpNStop "Flag that indicates a normal shutdown triggered by CcsFltPpWrd faults" UBYTE CU_CCSCTLSTOPPPNSTOP 1 100 0.0 1.0 ECU_ADDRESS 0x70018470 BYTE_ORDER MSB_LAST /end MEASUREMENT
/begin COMPU_METHOD CU_CCSCTLSTOPPPNSTOP "Conversion method for CcsCtlStopPpNStop" RAT_FUNC "%10.0" "b" COEFFS 0.000000 1.000000 -0.000000 0.000000 0.000000 1.000000 /end COMPU_METHOD
/* Scalar measurable for DDE 'CcsCtlStopPpRStop'. */
/begin MEASUREMENT CcsCtlStopPpRStop "Flag that indicates a rapid shutdown triggered by CcsFltPpWrd faults" UBYTE CU_CCSCTLSTOPPPRSTOP 1 100 0.0 1.0 ECU_ADDRESS 0x70017f65 BYTE_ORDER MSB_LAST /end MEASUREMENT
/begin COMPU_METHOD CU_CCSCTLSTOPPPRSTOP "Conversion method for CcsCtlStopPpRStop" RAT_FUNC "%10.0" "b" COEFFS 0.000000 1.000000 -0.000000 0.000000 0.000000 1.000000 /end COMPU_METHOD
/* Scalar measurable for DDE 'CcsCtlStopRxEgyTypeEStop'. */
/begin MEASUREMENT CcsCtlStopRxEgyTypeEStop "Flag that indicates an emergency shutdown triggered by CcsFltRxEgyTrnsTypeWrd faults" UBYTE CU_CCSCTLSTOPRXEGYTYPEESTOP 1 100 0.0 1.0 ECU_ADDRESS 0x700183aa BYTE_ORDER MSB_LAST /end MEASUREMENT
/begin COMPU_METHOD CU_CCSCTLSTOPRXEGYTYPEESTOP "Conversion method for CcsCtlStopRxEgyTypeEStop" RAT_FUNC "%10.0" "b" COEFFS 0.000000 1.000000 -0.000000 0.000000 0.000000 1.000000 /end COMPU_METHOD
/* Scalar measurable for DDE 'CcsCtlStopRxEgyTypeNStop'. */
/begin MEASUREMENT CcsCtlStopRxEgyTypeNStop "Flag that indicates a normal shutdown triggered by CcsFltRxEgyTrnsTypeWrd faults" UBYTE CU_CCSCTLSTOPRXEGYTYPENSTOP 1 100 0.0 1.0 ECU_ADDRESS 0x70017eb5 BYTE_ORDER MSB_LAST /end MEASUREMENT
/begin COMPU_METHOD CU_CCSCTLSTOPRXEGYTYPENSTOP "Conversion method for CcsCtlStopRxEgyTypeNStop" RAT_FUNC "%10.0" "b" COEFFS 0.000000 1.000000 -0.000000 0.000000 0.000000 1.000000 /end COMPU_METHOD
/* Scalar measurable for DDE 'CcsCtlStopRxEgyTypeRStop'. */
/begin MEASUREMENT CcsCtlStopRxEgyTypeRStop "Flag that indicates a rapid shutdown triggered by CcsFltRxEgyTrnsTypeWrd faults" UBYTE CU_CCSCTLSTOPRXEGYTYPERSTOP 1 100 0.0 1.0 ECU_ADDRESS 0x70018316 BYTE_ORDER MSB_LAST /end MEASUREMENT
/begin COMPU_METHOD CU_CCSCTLSTOPRXEGYTYPERSTOP "Conversion method for CcsCtlStopRxEgyTypeRStop" RAT_FUNC "%10.0" "b" COEFFS 0.000000 1.000000 -0.000000 0.000000 0.000000 1.000000 /end COMPU_METHOD
/* Scalar measurable for DDE 'CcsCtlStopRxEvVoltEStop'. */
/begin MEASUREMENT CcsCtlStopRxEvVoltEStop "Flag that indicates an emergency shutdown triggered by CcsFltRxEvVoltWrd faults" UBYTE CU_CCSCTLSTOPRXEVVOLTESTOP 1 100 0.0 1.0 ECU_ADDRESS 0x70017e1a BYTE_ORDER MSB_LAST /end MEASUREMENT
/begin COMPU_METHOD CU_CCSCTLSTOPRXEVVOLTESTOP "Conversion method for CcsCtlStopRxEvVoltEStop" RAT_FUNC "%10.0" "b" COEFFS 0.000000 1.000000 -0.000000 0.000000 0.000000 1.000000 /end COMPU_METHOD
/* Scalar measurable for DDE 'CcsCtlStopRxEvVoltNStop'. */
/begin MEASUREMENT CcsCtlStopRxEvVoltNStop "Flag that indicates a normal shutdown triggered by CcsFltRxEvVoltWrd faults" UBYTE CU_CCSCTLSTOPRXEVVOLTNSTOP 1 100 0.0 1.0 ECU_ADDRESS 0x7001826e BYTE_ORDER MSB_LAST /end MEASUREMENT
/begin COMPU_METHOD CU_CCSCTLSTOPRXEVVOLTNSTOP "Conversion method for CcsCtlStopRxEvVoltNStop" RAT_FUNC "%10.0" "b" COEFFS 0.000000 1.000000 -0.000000 0.000000 0.000000 1.000000 /end COMPU_METHOD
/* Scalar measurable for DDE 'CcsCtlStopRxEvVoltRStop'. */
/begin MEASUREMENT CcsCtlStopRxEvVoltRStop "Flag that indicates a rapid shutdown triggered by CcsFltRxEvVoltWrd faults" UBYTE CU_CCSCTLSTOPRXEVVOLTRSTOP 1 100 0.0 1.0 ECU_ADDRESS 0x70017d7c BYTE_ORDER MSB_LAST /end MEASUREMENT
/begin COMPU_METHOD CU_CCSCTLSTOPRXEVVOLTRSTOP "Conversion method for CcsCtlStopRxEvVoltRStop" RAT_FUNC "%10.0" "b" COEFFS 0.000000 1.000000 -0.000000 0.000000 0.000000 1.000000 /end COMPU_METHOD
/* Scalar measurable for DDE 'CcsCtlStopRxEvseCrntEStop'. */
/begin MEASUREMENT CcsCtlStopRxEvseCrntEStop "Flag that indicates an emergency shutdown triggered by CcsFltRxEvseCrntWrd faults" UBYTE CU_CCSCTLSTOPRXEVSECRNTESTOP 1 100 0.0 1.0 ECU_ADDRESS 0x700181ad BYTE_ORDER MSB_LAST /end MEASUREMENT
/begin COMPU_METHOD CU_CCSCTLSTOPRXEVSECRNTESTOP "Conversion method for CcsCtlStopRxEvseCrntEStop" RAT_FUNC "%10.0" "b" COEFFS 0.000000 1.000000 -0.000000 0.000000 0.000000 1.000000 /end COMPU_METHOD
/* Scalar measurable for DDE 'CcsCtlStopRxEvseCrntNStop'. */
/begin MEASUREMENT CcsCtlStopRxEvseCrntNStop "Flag that indicates a normal shutdown triggered by CcsFltRxEvseCrntWrd faults" UBYTE CU_CCSCTLSTOPRXEVSECRNTNSTOP 1 100 0.0 1.0 ECU_ADDRESS 0x70017c8c BYTE_ORDER MSB_LAST /end MEASUREMENT
/begin COMPU_METHOD CU_CCSCTLSTOPRXEVSECRNTNSTOP "Conversion method for CcsCtlStopRxEvseCrntNStop" RAT_FUNC "%10.0" "b" COEFFS 0.000000 1.000000 -0.000000 0.000000 0.000000 1.000000 /end COMPU_METHOD
/* Scalar measurable for DDE 'CcsCtlStopRxEvseCrntRStop'. */
/begin MEASUREMENT CcsCtlStopRxEvseCrntRStop "Flag that indicates a rapid shutdown triggered by CcsFltRxEvseCrntWrd faults" UBYTE CU_CCSCTLSTOPRXEVSECRNTRSTOP 1 100 0.0 1.0 ECU_ADDRESS 0x700180e1 BYTE_ORDER MSB_LAST /end MEASUREMENT
/begin COMPU_METHOD CU_CCSCTLSTOPRXEVSECRNTRSTOP "Conversion method for CcsCtlStopRxEvseCrntRStop" RAT_FUNC "%10.0" "b" COEFFS 0.000000 1.000000 -0.000000 0.000000 0.000000 1.000000 /end COMPU_METHOD
/* Scalar measurable for DDE 'CcsCtlStopRxEvseIsolEStop'. */
/begin MEASUREMENT CcsCtlStopRxEvseIsolEStop "Flag that indicates an emergency shutdown triggered by CcsFltRxEvseIsolWrd faults" UBYTE CU_CCSCTLSTOPRXEVSEISOLESTOP 1 100 0.0 1.0 ECU_ADDRESS 0x700184bc BYTE_ORDER MSB_LAST /end MEASUREMENT
/begin COMPU_METHOD CU_CCSCTLSTOPRXEVSEISOLESTOP "Conversion method for CcsCtlStopRxEvseIsolEStop" RAT_FUNC "%10.0" "b" COEFFS 0.000000 1.000000 -0.000000 0.000000 0.000000 1.000000 /end COMPU_METHOD
/* Scalar measurable for DDE 'CcsCtlStopRxEvseIsolNStop'. */
/begin MEASUREMENT CcsCtlStopRxEvseIsolNStop "Flag that indicates a normal shutdown triggered by CcsFltRxEvseIsolWrd faults" UBYTE CU_CCSCTLSTOPRXEVSEISOLNSTOP 1 100 0.0 1.0 ECU_ADDRESS 0x70017fa8 BYTE_ORDER MSB_LAST /end MEASUREMENT
/begin COMPU_METHOD CU_CCSCTLSTOPRXEVSEISOLNSTOP "Conversion method for CcsCtlStopRxEvseIsolNStop" RAT_FUNC "%10.0" "b" COEFFS 0.000000 1.000000 -0.000000 0.000000 0.000000 1.000000 /end COMPU_METHOD
/* Scalar measurable for DDE 'CcsCtlStopRxEvseIsolRStop'. */
/begin MEASUREMENT CcsCtlStopRxEvseIsolRStop "Flag that indicates a rapid shutdown triggered by CcsFltRxEvseIsolWrd faults" UBYTE CU_CCSCTLSTOPRXEVSEISOLRSTOP 1 100 0.0 1.0 ECU_ADDRESS 0x70018427 BYTE_ORDER MSB_LAST /end MEASUREMENT
/begin COMPU_METHOD CU_CCSCTLSTOPRXEVSEISOLRSTOP "Conversion method for CcsCtlStopRxEvseIsolRStop" RAT_FUNC "%10.0" "b" COEFFS 0.000000 1.000000 -0.000000 0.000000 0.000000 1.000000 /end COMPU_METHOD
/* Scalar measurable for DDE 'CcsCtlStopRxEvseProcEStop'. */
/begin MEASUREMENT CcsCtlStopRxEvseProcEStop "Flag that indicates an emergency shutdown triggered by CcsFltRxEvseProcStWrd faults" UBYTE CU_CCSCTLSTOPRXEVSEPROCESTOP 1 100 0.0 1.0 ECU_ADDRESS 0x70017ef4 BYTE_ORDER MSB_LAST /end MEASUREMENT
/begin COMPU_METHOD CU_CCSCTLSTOPRXEVSEPROCESTOP "Conversion method for CcsCtlStopRxEvseProcEStop" RAT_FUNC "%10.0" "b" COEFFS 0.000000 1.000000 -0.000000 0.000000 0.000000 1.000000 /end COMPU_METHOD
/* Scalar measurable for DDE 'CcsCtlStopRxEvseProcNStop'. */
/begin MEASUREMENT CcsCtlStopRxEvseProcNStop "Flag that indicates a normal shutdown triggered by CcsFltRxEvseProcStWrd faults" UBYTE CU_CCSCTLSTOPRXEVSEPROCNSTOP 1 100 0.0 1.0 ECU_ADDRESS 0x7001836c BYTE_ORDER MSB_LAST /end MEASUREMENT
/begin COMPU_METHOD CU_CCSCTLSTOPRXEVSEPROCNSTOP "Conversion method for CcsCtlStopRxEvseProcNStop" RAT_FUNC "%10.0" "b" COEFFS 0.000000 1.000000 -0.000000 0.000000 0.000000 1.000000 /end COMPU_METHOD
/* Scalar measurable for DDE 'CcsCtlStopRxEvseProcRStop'. */
/begin MEASUREMENT CcsCtlStopRxEvseProcRStop "Flag that indicates a rapid shutdown triggered by CcsFltRxEvseProcStWrd faults" UBYTE CU_CCSCTLSTOPRXEVSEPROCRSTOP 1 100 0.0 1.0 ECU_ADDRESS 0x70017e69 BYTE_ORDER MSB_LAST /end MEASUREMENT
/begin COMPU_METHOD CU_CCSCTLSTOPRXEVSEPROCRSTOP "Conversion method for CcsCtlStopRxEvseProcRStop" RAT_FUNC "%10.0" "b" COEFFS 0.000000 1.000000 -0.000000 0.000000 0.000000 1.000000 /end COMPU_METHOD
/* Scalar measurable for DDE 'CcsCtlStopRxEvsePwrEStop'. */
/begin MEASUREMENT CcsCtlStopRxEvsePwrEStop "Flag that indicates an emergency shutdown triggered by CcsFltRxEvsePwrWrd faults" UBYTE CU_CCSCTLSTOPRXEVSEPWRESTOP 1 100 0.0 1.0 ECU_ADDRESS 0x700182b3 BYTE_ORDER MSB_LAST /end MEASUREMENT
/begin COMPU_METHOD CU_CCSCTLSTOPRXEVSEPWRESTOP "Conversion method for CcsCtlStopRxEvsePwrEStop" RAT_FUNC "%10.0" "b" COEFFS 0.000000 1.000000 -0.000000 0.000000 0.000000 1.000000 /end COMPU_METHOD
/* Scalar measurable for DDE 'CcsCtlStopRxEvsePwrNStop'. */
/begin MEASUREMENT CcsCtlStopRxEvsePwrNStop "Flag that indicates a normal shutdown triggered by CcsFltRxEvsePwrWrd faults" UBYTE CU_CCSCTLSTOPRXEVSEPWRNSTOP 1 100 0.0 1.0 ECU_ADDRESS 0x70017dba BYTE_ORDER MSB_LAST /end MEASUREMENT
/begin COMPU_METHOD CU_CCSCTLSTOPRXEVSEPWRNSTOP "Conversion method for CcsCtlStopRxEvsePwrNStop" RAT_FUNC "%10.0" "b" COEFFS 0.000000 1.000000 -0.000000 0.000000 0.000000 1.000000 /end COMPU_METHOD
/* Scalar measurable for DDE 'CcsCtlStopRxEvsePwrRStop'. */
/begin MEASUREMENT CcsCtlStopRxEvsePwrRStop "Flag that indicates a rapid shutdown triggered by CcsFltRxEvsePwrWrd faults" UBYTE CU_CCSCTLSTOPRXEVSEPWRRSTOP 1 100 0.0 1.0 ECU_ADDRESS 0x700181ff BYTE_ORDER MSB_LAST /end MEASUREMENT
/begin COMPU_METHOD CU_CCSCTLSTOPRXEVSEPWRRSTOP "Conversion method for CcsCtlStopRxEvsePwrRStop" RAT_FUNC "%10.0" "b" COEFFS 0.000000 1.000000 -0.000000 0.000000 0.000000 1.000000 /end COMPU_METHOD
/* Scalar measurable for DDE 'CcsCtlStopRxEvseStEStop'. */
/begin MEASUREMENT CcsCtlStopRxEvseStEStop "Flag that indicates an emergency shutdown triggered by CcsFltRxEvseStCodeWrd faults" UBYTE CU_CCSCTLSTOPRXEVSESTESTOP 1 100 0.0 1.0 ECU_ADDRESS 0x70017d1b BYTE_ORDER MSB_LAST /end MEASUREMENT
/begin COMPU_METHOD CU_CCSCTLSTOPRXEVSESTESTOP "Conversion method for CcsCtlStopRxEvseStEStop" RAT_FUNC "%10.0" "b" COEFFS 0.000000 1.000000 -0.000000 0.000000 0.000000 1.000000 /end COMPU_METHOD
/* Scalar measurable for DDE 'CcsCtlStopRxEvseStNStop'. */
/begin MEASUREMENT CcsCtlStopRxEvseStNStop "Flag that indicates a normal shutdown triggered by CcsFltRxEvseStCodeWrd faults" UBYTE CU_CCSCTLSTOPRXEVSESTNSTOP 1 100 0.0 1.0 ECU_ADDRESS 0x70018171 BYTE_ORDER MSB_LAST /end MEASUREMENT
/begin COMPU_METHOD CU_CCSCTLSTOPRXEVSESTNSTOP "Conversion method for CcsCtlStopRxEvseStNStop" RAT_FUNC "%10.0" "b" COEFFS 0.000000 1.000000 -0.000000 0.000000 0.000000 1.000000 /end COMPU_METHOD
/* Scalar measurable for DDE 'CcsCtlStopRxEvseStRStop'. */
/begin MEASUREMENT CcsCtlStopRxEvseStRStop "Flag that indicates a rapid shutdown triggered by CcsFltRxEvseStCodeWrd faults" UBYTE CU_CCSCTLSTOPRXEVSESTRSTOP 1 100 0.0 1.0 ECU_ADDRESS 0x70017c46 BYTE_ORDER MSB_LAST /end MEASUREMENT
/begin COMPU_METHOD CU_CCSCTLSTOPRXEVSESTRSTOP "Conversion method for CcsCtlStopRxEvseStRStop" RAT_FUNC "%10.0" "b" COEFFS 0.000000 1.000000 -0.000000 0.000000 0.000000 1.000000 /end COMPU_METHOD
/* Scalar measurable for DDE 'CcsCtlStopRxEvseVoltEStop'. */
/begin MEASUREMENT CcsCtlStopRxEvseVoltEStop "Flag that indicates an emergency shutdown triggered by CcsFltRxEvseVoltWrd faults" UBYTE CU_CCSCTLSTOPRXEVSEVOLTESTOP 1 100 0.0 1.0 ECU_ADDRESS 0x7001800a BYTE_ORDER MSB_LAST /end MEASUREMENT
/begin COMPU_METHOD CU_CCSCTLSTOPRXEVSEVOLTESTOP "Conversion method for CcsCtlStopRxEvseVoltEStop" RAT_FUNC "%10.0" "b" COEFFS 0.000000 1.000000 -0.000000 0.000000 0.000000 1.000000 /end COMPU_METHOD
/* Scalar measurable for DDE 'CcsCtlStopRxEvseVoltNStop'. */
/begin MEASUREMENT CcsCtlStopRxEvseVoltNStop "Flag that indicates a normal shutdown triggered by CcsFltRxEvseVoltWrd faults" UBYTE CU_CCSCTLSTOPRXEVSEVOLTNSTOP 1 100 0.0 1.0 ECU_ADDRESS 0x70018471 BYTE_ORDER MSB_LAST /end MEASUREMENT
/begin COMPU_METHOD CU_CCSCTLSTOPRXEVSEVOLTNSTOP "Conversion method for CcsCtlStopRxEvseVoltNStop" RAT_FUNC "%10.0" "b" COEFFS 0.000000 1.000000 -0.000000 0.000000 0.000000 1.000000 /end COMPU_METHOD
/* Scalar measurable for DDE 'CcsCtlStopRxEvseVoltRStop'. */
/begin MEASUREMENT CcsCtlStopRxEvseVoltRStop "Flag that indicates a rapid shutdown triggered by CcsFltRxEvseVoltWrd faults" UBYTE CU_CCSCTLSTOPRXEVSEVOLTRSTOP 1 100 0.0 1.0 ECU_ADDRESS 0x70017f66 BYTE_ORDER MSB_LAST /end MEASUREMENT
/begin COMPU_METHOD CU_CCSCTLSTOPRXEVSEVOLTRSTOP "Conversion method for CcsCtlStopRxEvseVoltRStop" RAT_FUNC "%10.0" "b" COEFFS 0.000000 1.000000 -0.000000 0.000000 0.000000 1.000000 /end COMPU_METHOD
/* Scalar measurable for DDE 'CcsCtlStopSeqEStop'. */
/begin MEASUREMENT CcsCtlStopSeqEStop "Flag that indicates an emergency shutdown triggered by CcsFltSeqWrd faults" UBYTE CU_CCSCTLSTOPSEQESTOP 1 100 0.0 1.0 ECU_ADDRESS 0x700183ab BYTE_ORDER MSB_LAST /end MEASUREMENT
/begin COMPU_METHOD CU_CCSCTLSTOPSEQESTOP "Conversion method for CcsCtlStopSeqEStop" RAT_FUNC "%10.0" "b" COEFFS 0.000000 1.000000 -0.000000 0.000000 0.000000 1.000000 /end COMPU_METHOD
/* Scalar measurable for DDE 'CcsCtlStopSeqNStop'. */
/begin MEASUREMENT CcsCtlStopSeqNStop "Flag that indicates a normal shutdown triggered by CcsFltSeqWrd faults" UBYTE CU_CCSCTLSTOPSEQNSTOP 1 100 0.0 1.0 ECU_ADDRESS 0x70017eb6 BYTE_ORDER MSB_LAST /end MEASUREMENT
/begin COMPU_METHOD CU_CCSCTLSTOPSEQNSTOP "Conversion method for CcsCtlStopSeqNStop" RAT_FUNC "%10.0" "b" COEFFS 0.000000 1.000000 -0.000000 0.000000 0.000000 1.000000 /end COMPU_METHOD
/* Scalar measurable for DDE 'CcsCtlStopSeqRStop'. */
/begin MEASUREMENT CcsCtlStopSeqRStop "Flag that indicates a rapid shutdown triggered by CcsFltSeqWrd faults" UBYTE CU_CCSCTLSTOPSEQRSTOP 1 100 0.0 1.0 ECU_ADDRESS 0x70018317 BYTE_ORDER MSB_LAST /end MEASUREMENT
/begin COMPU_METHOD CU_CCSCTLSTOPSEQRSTOP "Conversion method for CcsCtlStopSeqRStop" RAT_FUNC "%10.0" "b" COEFFS 0.000000 1.000000 -0.000000 0.000000 0.000000 1.000000 /end COMPU_METHOD
/* Scalar measurable for DDE 'CcsCtlStopSupPrtclEStop'. */
/begin MEASUREMENT CcsCtlStopSupPrtclEStop "Flag that indicates a emergency shutdown triggered by CcsFltEvseSupPrtclWrd faults" UBYTE CU_CCSCTLSTOPSUPPRTCLESTOP 1 100 0.0 1.0 ECU_ADDRESS 0x70017e1b BYTE_ORDER MSB_LAST /end MEASUREMENT
/begin COMPU_METHOD CU_CCSCTLSTOPSUPPRTCLESTOP "Conversion method for CcsCtlStopSupPrtclEStop" RAT_FUNC "%10.0" "b" COEFFS 0.000000 1.000000 -0.000000 0.000000 0.000000 1.000000 /end COMPU_METHOD
/* Scalar measurable for DDE 'CcsCtlStopSupPrtclNStop'. */
/begin MEASUREMENT CcsCtlStopSupPrtclNStop "Flag that indicates a normal shutdown triggered by CcsFltEvseSupPrtclWrd faults" UBYTE CU_CCSCTLSTOPSUPPRTCLNSTOP 1 100 0.0 1.0 ECU_ADDRESS 0x7001826f BYTE_ORDER MSB_LAST /end MEASUREMENT
/begin COMPU_METHOD CU_CCSCTLSTOPSUPPRTCLNSTOP "Conversion method for CcsCtlStopSupPrtclNStop" RAT_FUNC "%10.0" "b" COEFFS 0.000000 1.000000 -0.000000 0.000000 0.000000 1.000000 /end COMPU_METHOD
/* Scalar measurable for DDE 'CcsCtlStopSupPrtclRStop'. */
/begin MEASUREMENT CcsCtlStopSupPrtclRStop "Flag that indicates a rapid shutdown triggered by CcsFltSupPrtclWrd faults" UBYTE CU_CCSCTLSTOPSUPPRTCLRSTOP 1 100 0.0 1.0 ECU_ADDRESS 0x70017d7d BYTE_ORDER MSB_LAST /end MEASUREMENT
/begin COMPU_METHOD CU_CCSCTLSTOPSUPPRTCLRSTOP "Conversion method for CcsCtlStopSupPrtclRStop" RAT_FUNC "%10.0" "b" COEFFS 0.000000 1.000000 -0.000000 0.000000 0.000000 1.000000 /end COMPU_METHOD
/* Scalar measurable for DDE 'CcsCtlStopV2gMsgEStop'. */
/begin MEASUREMENT CcsCtlStopV2gMsgEStop "Flag that indicates an emergency shutdown triggered by CcsFltV2gMsgWrd faults" UBYTE CU_CCSCTLSTOPV2GMSGESTOP 1 100 0.0 1.0 ECU_ADDRESS 0x700181ae BYTE_ORDER MSB_LAST /end MEASUREMENT
/begin COMPU_METHOD CU_CCSCTLSTOPV2GMSGESTOP "Conversion method for CcsCtlStopV2gMsgEStop" RAT_FUNC "%10.0" "b" COEFFS 0.000000 1.000000 -0.000000 0.000000 0.000000 1.000000 /end COMPU_METHOD
/* Scalar measurable for DDE 'CcsCtlStopV2gMsgNStop'. */
/begin MEASUREMENT CcsCtlStopV2gMsgNStop "Flag that indicates a normal shutdown triggered by CcsFltV2gMsgWrd faults" UBYTE CU_CCSCTLSTOPV2GMSGNSTOP 1 100 0.0 1.0 ECU_ADDRESS 0x70017c8d BYTE_ORDER MSB_LAST /end MEASUREMENT
/begin COMPU_METHOD CU_CCSCTLSTOPV2GMSGNSTOP "Conversion method for CcsCtlStopV2gMsgNStop" RAT_FUNC "%10.0" "b" COEFFS 0.000000 1.000000 -0.000000 0.000000 0.000000 1.000000 /end COMPU_METHOD
/* Scalar measurable for DDE 'CcsCtlStopV2gMsgRStop'. */
/begin MEASUREMENT CcsCtlStopV2gMsgRStop "Flag that indicates a rapid shutdown triggered by CcsFltV2gMsgWrd faults" UBYTE CU_CCSCTLSTOPV2GMSGRSTOP 1 100 0.0 1.0 ECU_ADDRESS 0x700180e2 BYTE_ORDER MSB_LAST /end MEASUREMENT
/begin COMPU_METHOD CU_CCSCTLSTOPV2GMSGRSTOP "Conversion method for CcsCtlStopV2gMsgRStop" RAT_FUNC "%10.0" "b" COEFFS 0.000000 1.000000 -0.000000 0.000000 0.000000 1.000000 /end COMPU_METHOD
/* Scalar measurable for DDE 'CcsFltCpWrd'. */
/begin MEASUREMENT CcsFltCpWrd "Fault word that contains all confirmed fault flags defined for Control PilotDutycycle" UBYTE CU_CCSFLTCPWRD 1 100 0.0 255.0 ECU_ADDRESS 0x700184bd BYTE_ORDER MSB_LAST /end MEASUREMENT
/begin COMPU_METHOD CU_CCSFLTCPWRD "Conversion method for CcsFltCpWrd" RAT_FUNC "%10.0" "1" COEFFS 0.000000 1.000000 -0.000000 0.000000 0.000000 1.000000 /end COMPU_METHOD
/* Scalar measurable for DDE 'CcsFltEvseSupPrtclWrd'. */
/begin MEASUREMENT CcsFltEvseSupPrtclWrd "Fault word that contains all confirmed fault flags defined for V2G received signal EVSE Supported Protocol" UBYTE CU_CCSFLTEVSESUPPRTCLWRD 1 100 0.0 255.0 ECU_ADDRESS 0x70017fa9 BYTE_ORDER MSB_LAST /end MEASUREMENT
/begin COMPU_METHOD CU_CCSFLTEVSESUPPRTCLWRD "Conversion method for CcsFltEvseSupPrtclWrd" RAT_FUNC "%10.0" "1" COEFFS 0.000000 1.000000 -0.000000 0.000000 0.000000 1.000000 /end COMPU_METHOD
/* Scalar measurable for DDE 'CcsFltInternalFaultsWrd'. */
/begin MEASUREMENT CcsFltInternalFaultsWrd "Fault word that contains all confirmed fault flags defined for Internal faults" UBYTE CU_CCSFLTINTERNALFAULTSWRD 1 100 0.0 255.0 ECU_ADDRESS 0x70018428 BYTE_ORDER MSB_LAST /end MEASUREMENT
/begin COMPU_METHOD CU_CCSFLTINTERNALFAULTSWRD "Conversion method for CcsFltInternalFaultsWrd" RAT_FUNC "%10.0" "1" COEFFS 0.000000 1.000000 -0.000000 0.000000 0.000000 1.000000 /end COMPU_METHOD
/* Scalar measurable for DDE 'CcsFltLinkWrd'. */
/begin MEASUREMENT CcsFltLinkWrd "Fault word that contains all confirmed fault flags defined for V2G Communication Link" UBYTE CU_CCSFLTLINKWRD 1 100 0.0 255.0 ECU_ADDRESS 0x70017ef5 BYTE_ORDER MSB_LAST /end MEASUREMENT
/begin COMPU_METHOD CU_CCSFLTLINKWRD "Conversion method for CcsFltLinkWrd" RAT_FUNC "%10.0" "1" COEFFS 0.000000 1.000000 -0.000000 0.000000 0.000000 1.000000 /end COMPU_METHOD
/* Scalar measurable for DDE 'CcsFltPpWrd'. */
/begin MEASUREMENT CcsFltPpWrd "Fault word that contains all confirmed fault flags defined for Proximity Pilot Voltage" UBYTE CU_CCSFLTPPWRD 1 100 0.0 255.0 ECU_ADDRESS 0x7001836d BYTE_ORDER MSB_LAST /end MEASUREMENT
/begin COMPU_METHOD CU_CCSFLTPPWRD "Conversion method for CcsFltPpWrd" RAT_FUNC "%10.0" "1" COEFFS 0.000000 1.000000 -0.000000 0.000000 0.000000 1.000000 /end COMPU_METHOD
/* Scalar measurable for DDE 'CcsFltRxEgyTrnsTypeWrd'. */
/begin MEASUREMENT CcsFltRxEgyTrnsTypeWrd "Fault word that contains all confirmed fault flags defined for V2G received signal Energy Transfer Type" UBYTE CU_CCSFLTRXEGYTRNSTYPEWRD 1 100 0.0 255.0 ECU_ADDRESS 0x70017e6a BYTE_ORDER MSB_LAST /end MEASUREMENT
/begin COMPU_METHOD CU_CCSFLTRXEGYTRNSTYPEWRD "Conversion method for CcsFltRxEgyTrnsTypeWrd" RAT_FUNC "%10.0" "1" COEFFS 0.000000 1.000000 -0.000000 0.000000 0.000000 1.000000 /end COMPU_METHOD
/* Scalar measurable for DDE 'CcsFltRxEvVoltWrd'. */
/begin MEASUREMENT CcsFltRxEvVoltWrd "Fault word that contains all confirmed fault flags defined for Host EV Voltage" UBYTE CU_CCSFLTRXEVVOLTWRD 1 100 0.0 255.0 ECU_ADDRESS 0x700182b4 BYTE_ORDER MSB_LAST /end MEASUREMENT
/begin COMPU_METHOD CU_CCSFLTRXEVVOLTWRD "Conversion method for CcsFltRxEvVoltWrd" RAT_FUNC "%10.0" "1" COEFFS 0.000000 1.000000 -0.000000 0.000000 0.000000 1.000000 /end COMPU_METHOD
/* Scalar measurable for DDE 'CcsFltRxEvseCrntWrd'. */
/begin MEASUREMENT CcsFltRxEvseCrntWrd "Fault word that contains all confirmed fault flags defined for V2G EVSE Current" UBYTE CU_CCSFLTRXEVSECRNTWRD 1 100 0.0 255.0 ECU_ADDRESS 0x70017dbb BYTE_ORDER MSB_LAST /end MEASUREMENT
/begin COMPU_METHOD CU_CCSFLTRXEVSECRNTWRD "Conversion method for CcsFltRxEvseCrntWrd" RAT_FUNC "%10.0" "1" COEFFS 0.000000 1.000000 -0.000000 0.000000 0.000000 1.000000 /end COMPU_METHOD
/* Scalar measurable for DDE 'CcsFltRxEvseIsolStWrd'. */
/begin MEASUREMENT CcsFltRxEvseIsolStWrd "Fault word that contains all confirmed fault flags defined for V2G received signal EVSE Isolation Status" UBYTE CU_CCSFLTRXEVSEISOLSTWRD 1 100 0.0 255.0 ECU_ADDRESS 0x70018200 BYTE_ORDER MSB_LAST /end MEASUREMENT
/begin COMPU_METHOD CU_CCSFLTRXEVSEISOLSTWRD "Conversion method for CcsFltRxEvseIsolStWrd" RAT_FUNC "%10.0" "1" COEFFS 0.000000 1.000000 -0.000000 0.000000 0.000000 1.000000 /end COMPU_METHOD
/* Scalar measurable for DDE 'CcsFltRxEvseProcStWrd'. */
/begin MEASUREMENT CcsFltRxEvseProcStWrd "Fault word that contains all confirmed fault flags defined for V2G received signal EVSE Processing Status" UBYTE CU_CCSFLTRXEVSEPROCSTWRD 1 100 0.0 255.0 ECU_ADDRESS 0x70017d1c BYTE_ORDER MSB_LAST /end MEASUREMENT
/begin COMPU_METHOD CU_CCSFLTRXEVSEPROCSTWRD "Conversion method for CcsFltRxEvseProcStWrd" RAT_FUNC "%10.0" "1" COEFFS 0.000000 1.000000 -0.000000 0.000000 0.000000 1.000000 /end COMPU_METHOD
/* Scalar measurable for DDE 'CcsFltRxEvsePwrWrd'. */
/begin MEASUREMENT CcsFltRxEvsePwrWrd "Fault word that contains all confirmed fault flags related to EVSE Power" UBYTE CU_CCSFLTRXEVSEPWRWRD 1 100 0.0 255.0 ECU_ADDRESS 0x70018172 BYTE_ORDER MSB_LAST /end MEASUREMENT
/begin COMPU_METHOD CU_CCSFLTRXEVSEPWRWRD "Conversion method for CcsFltRxEvsePwrWrd" RAT_FUNC "%10.0" "1" COEFFS 0.000000 1.000000 -0.000000 0.000000 0.000000 1.000000 /end COMPU_METHOD
/* Scalar measurable for DDE 'CcsFltRxEvseStCodeWrd'. */
/begin MEASUREMENT CcsFltRxEvseStCodeWrd "Fault word that contains all confirmed fault flags defined for V2G received signal EVSE Status Code" UBYTE CU_CCSFLTRXEVSESTCODEWRD 1 100 0.0 255.0 ECU_ADDRESS 0x70017c47 BYTE_ORDER MSB_LAST /end MEASUREMENT
/begin COMPU_METHOD CU_CCSFLTRXEVSESTCODEWRD "Conversion method for CcsFltRxEvseStCodeWrd" RAT_FUNC "%10.0" "1" COEFFS 0.000000 1.000000 -0.000000 0.000000 0.000000 1.000000 /end COMPU_METHOD
/* Scalar measurable for DDE 'CcsFltRxEvseVoltWrd'. */
/begin MEASUREMENT CcsFltRxEvseVoltWrd "Fault word that contains all confirmed fault flags defined for V2G EVSE Voltage" UBYTE CU_CCSFLTRXEVSEVOLTWRD 1 100 0.0 255.0 ECU_ADDRESS 0x7001800b BYTE_ORDER MSB_LAST /end MEASUREMENT
/begin COMPU_METHOD CU_CCSFLTRXEVSEVOLTWRD "Conversion method for CcsFltRxEvseVoltWrd" RAT_FUNC "%10.0" "1" COEFFS 0.000000 1.000000 -0.000000 0.000000 0.000000 1.000000 /end COMPU_METHOD
/* Scalar measurable for DDE 'CcsFltSeqWrd'. */
/begin MEASUREMENT CcsFltSeqWrd "Fault word that contains all confirmed fault flags defined for V2G Performance (Sequence) Timeout Precharge" UBYTE CU_CCSFLTSEQWRD 1 100 0.0 255.0 ECU_ADDRESS 0x70018472 BYTE_ORDER MSB_LAST /end MEASUREMENT
/begin COMPU_METHOD CU_CCSFLTSEQWRD "Conversion method for CcsFltSeqWrd" RAT_FUNC "%10.0" "1" COEFFS 0.000000 1.000000 -0.000000 0.000000 0.000000 1.000000 /end COMPU_METHOD
/* Scalar measurable for DDE 'CcsFltStopFltResponse'. */
/begin MEASUREMENT CcsFltStopFltResponse "Identifies the the state machine fault reaction" SLONG CU_CCSFLTSTOPFLTRESPONSE 1 100 -2147483648.0 2147483647.0 ECU_ADDRESS 0x70017f68 BYTE_ORDER MSB_LAST /end MEASUREMENT
/begin COMPU_METHOD CU_CCSFLTSTOPFLTRESPONSE "Conversion method for CcsFltStopFltResponse" TAB_VERB "%12.0" "enum" COMPU_TAB_REF CT_CCSFLTSTOPFLTRESPONSE /end COMPU_METHOD
/begin COMPU_VTAB CT_CCSFLTSTOPFLTRESPONSE "Conversion method for CcsFltStopFltResponse" TAB_VERB 4 0 "NO_FAULT_CONTINUE" 1 "NO_FAULT_NORMAL_STOP" 2 "FAULT_NONCRITICAL_STOP" 3 "FAULT_EMERGENCY_STOP" /end COMPU_VTAB
/* Scalar measurable for DDE 'CcsFltV2gMsgWrd'. */
/begin MEASUREMENT CcsFltV2gMsgWrd "Fault word that contains all confirmed fault flags defined for V2G Response message Timeout" UBYTE CU_CCSFLTV2GMSGWRD 1 100 0.0 255.0 ECU_ADDRESS 0x700183ac BYTE_ORDER MSB_LAST /end MEASUREMENT
/begin COMPU_METHOD CU_CCSFLTV2GMSGWRD "Conversion method for CcsFltV2gMsgWrd" RAT_FUNC "%10.0" "1" COEFFS 0.000000 1.000000 -0.000000 0.000000 0.000000 1.000000 /end COMPU_METHOD
/* Scalar measurable for DDE 'CcsIprAcdAvlbMaxAcChgCrnt'. */
/begin MEASUREMENT CcsIprAcdAvlbMaxAcChgCrnt "The final calculated maximum available AC current from PWM dutycycle of EVSE Pilot signal (based on SAE J1772) and Charging state-machine and proximity signal state" FLOAT32_IEEE CU_CCSIPRACDAVLBMAXACCHGCRNT 1 100 0.0 200.0 ECU_ADDRESS 0x70017eb8 BYTE_ORDER MSB_LAST /end MEASUREMENT
/begin COMPU_METHOD CU_CCSIPRACDAVLBMAXACCHGCRNT "Conversion method for CcsIprAcdAvlbMaxAcChgCrnt" RAT_FUNC "%10.0" "A" COEFFS 0.000000 1.000000 -0.000000 0.000000 0.000000 1.000000 /end COMPU_METHOD
/* Scalar measurable for DDE 'CcsIprAcdAvlbMaxAcChgCrntPwm'. */
/begin MEASUREMENT CcsIprAcdAvlbMaxAcChgCrntPwm "The calculated maximum available AC current from PWM dutycycle of EVSE Pilot signal (based on SAE J1772)" FLOAT32_IEEE CU_CCSIPRACDAVLBMAXACCHGCRNTPWM 1 100 0.0 200.0 ECU_ADDRESS 0x70018318 BYTE_ORDER MSB_LAST /end MEASUREMENT
/begin COMPU_METHOD CU_CCSIPRACDAVLBMAXACCHGCRNTPWM "Conversion method for CcsIprAcdAvlbMaxAcChgCrntPwm" RAT_FUNC "%10.0" "A" COEFFS 0.000000 1.000000 -0.000000 0.000000 0.000000 1.000000 /end COMPU_METHOD
/* Scalar measurable for DDE 'CcsIprChgPortCrntDc'. */
/begin MEASUREMENT CcsIprChgPortCrntDc "Interpreted value of charging DC current at the charge inlet port" FLOAT32_IEEE CU_CCSIPRCHGPORTCRNTDC 1 100 0.0 196605.0 ECU_ADDRESS 0x70017e1c BYTE_ORDER MSB_LAST /end MEASUREMENT
/begin COMPU_METHOD CU_CCSIPRCHGPORTCRNTDC "Conversion method for CcsIprChgPortCrntDc" RAT_FUNC "%10.0" "A" COEFFS 0.000000 1.000000 -0.000000 0.000000 0.000000 1.000000 /end COMPU_METHOD
/* Scalar measurable for DDE 'CcsIprChgPortVoltDc'. */
/begin MEASUREMENT CcsIprChgPortVoltDc "Interpreted value of charging DC voltage at the charge inlet port" FLOAT32_IEEE CU_CCSIPRCHGPORTVOLTDC 1 100 0.0 196605.0 ECU_ADDRESS 0x70018270 BYTE_ORDER MSB_LAST /end MEASUREMENT
/begin COMPU_METHOD CU_CCSIPRCHGPORTVOLTDC "Conversion method for CcsIprChgPortVoltDc" RAT_FUNC "%10.0" "V" COEFFS 0.000000 1.000000 -0.000000 0.000000 0.000000 1.000000 /end COMPU_METHOD
/* Scalar measurable for DDE 'CcsIprCpChargingMode'. */
/begin MEASUREMENT CcsIprCpChargingMode "The determined enumerated charging mode based on dutycycle of pilot signal" SLONG CU_CCSIPRCPCHARGINGMODE 1 100 -2147483648.0 2147483647.0 ECU_ADDRESS 0x70017d80 BYTE_ORDER MSB_LAST /end MEASUREMENT
/begin COMPU_METHOD CU_CCSIPRCPCHARGINGMODE "Conversion method for CcsIprCpChargingMode" TAB_VERB "%12.0" "enum" COMPU_TAB_REF CT_CCSIPRCPCHARGINGMODE /end COMPU_METHOD
/begin COMPU_VTAB CT_CCSIPRCPCHARGINGMODE "Conversion method for CcsIprCpChargingMode" TAB_VERB 4 0 "CHARGINGMODE_UNKNOWN" 1 "CHARGINGMODE_DC" 2 "CHARGINGMODE_AC" 3 "CHARGINGMODE_ERROR" /end COMPU_VTAB
/* Scalar measurable for DDE 'CcsIprCpDutcycAc'. */
/begin MEASUREMENT CcsIprCpDutcycAc "Indicator that the EVSE Pilot signal has a dutycycle in valid range for AC charging" UBYTE CU_CCSIPRCPDUTCYCAC 1 100 0.0 1.0 ECU_ADDRESS 0x700181af BYTE_ORDER MSB_LAST /end MEASUREMENT
/begin COMPU_METHOD CU_CCSIPRCPDUTCYCAC "Conversion method for CcsIprCpDutcycAc" RAT_FUNC "%10.0" "b" COEFFS 0.000000 1.000000 -0.000000 0.000000 0.000000 1.000000 /end COMPU_METHOD
/* Scalar measurable for DDE 'CcsIprCpDutcycPct5'. */
/begin MEASUREMENT CcsIprCpDutcycPct5 "Indicator that the EVSE Pilot signal has dutycycle of 5% which is for digital communication over PLC" UBYTE CU_CCSIPRCPDUTCYCPCT5 1 100 0.0 1.0 ECU_ADDRESS 0x70017c8e BYTE_ORDER MSB_LAST /end MEASUREMENT
/begin COMPU_METHOD CU_CCSIPRCPDUTCYCPCT5 "Conversion method for CcsIprCpDutcycPct5" RAT_FUNC "%10.0" "b" COEFFS 0.000000 1.000000 -0.000000 0.000000 0.000000 1.000000 /end COMPU_METHOD
/* Scalar measurable for DDE 'CcsIprCpDutcycRangeAc'. */
/begin MEASUREMENT CcsIprCpDutcycRangeAc "Indicator that the EVSE Pilot signal has dutycycle of the range for AC charging" UBYTE CU_CCSIPRCPDUTCYCRANGEAC 1 100 0.0 1.0 ECU_ADDRESS 0x700180e3 BYTE_ORDER MSB_LAST /end MEASUREMENT
/begin COMPU_METHOD CU_CCSIPRCPDUTCYCRANGEAC "Conversion method for CcsIprCpDutcycRangeAc" RAT_FUNC "%10.0" "b" COEFFS 0.000000 1.000000 -0.000000 0.000000 0.000000 1.000000 /end COMPU_METHOD
/* Scalar measurable for DDE 'CcsIprCpDutyPct5InRange'. */
/begin MEASUREMENT CcsIprCpDutyPct5InRange "Indicator that the EVSE Pilot signal has dutycycle of 5% which is for digital communication over PLC" UBYTE CU_CCSIPRCPDUTYPCT5INRANGE 1 100 0.0 1.0 ECU_ADDRESS 0x700184be BYTE_ORDER MSB_LAST /end MEASUREMENT
/begin COMPU_METHOD CU_CCSIPRCPDUTYPCT5INRANGE "Conversion method for CcsIprCpDutyPct5InRange" RAT_FUNC "%10.0" "b" COEFFS 0.000000 1.000000 -0.000000 0.000000 0.000000 1.000000 /end COMPU_METHOD
/* Scalar measurable for DDE 'CcsIprCpOscillatorOff'. */
/begin MEASUREMENT CcsIprCpOscillatorOff "Indicator that the Oscillator is off on the pilot signal" UBYTE CU_CCSIPRCPOSCILLATOROFF 1 100 0.0 1.0 ECU_ADDRESS 0x70017faa BYTE_ORDER MSB_LAST /end MEASUREMENT
/begin COMPU_METHOD CU_CCSIPRCPOSCILLATOROFF "Conversion method for CcsIprCpOscillatorOff" RAT_FUNC "%10.0" "b" COEFFS 0.000000 1.000000 -0.000000 0.000000 0.000000 1.000000 /end COMPU_METHOD
/* Scalar measurable for DDE 'CcsIprCpSt'. */
/begin MEASUREMENT CcsIprCpSt "Enumerated state of Control Piliot signal from charging interface" SLONG CU_CCSIPRCPST 1 100 -2147483648.0 2147483647.0 ECU_ADDRESS 0x7001842c BYTE_ORDER MSB_LAST /end MEASUREMENT
/begin COMPU_METHOD CU_CCSIPRCPST "Conversion method for CcsIprCpSt" TAB_VERB "%12.0" "enum" COMPU_TAB_REF CT_CCSIPRCPST /end COMPU_METHOD
/begin COMPU_VTAB CT_CCSIPRCPST "Conversion method for CcsIprCpSt" TAB_VERB 10 0 "PILOT_ST_UNKNOWN" 1 "PILOT_ST_A_0V_DISCONNECTED" 2 "PILOT_ST_B1_9V_OSCILTR_OFF" 3 "PILOT_ST_B2_9V_OSCILTR_ON" 4 "PILOT_ST_C2_6V_OSCILTR_ON" 5 "PILOT_ST_D2_3V_OSCILTR_ON" 6 "PILOT_ST_C1_6V_OSCILTR_OFF" 7 "PILOT_ST_D1_3V_OSCILTR_OFF" 8 "PILOT_ST_E_0V" 9 "PILOT_ST_F_m12V_OSCILTR_OFF" /end COMPU_VTAB
/* Scalar measurable for DDE 'CcsIprDcChgCrntNearZero'. */
/begin MEASUREMENT CcsIprDcChgCrntNearZero "True indicates that the charge current is close to zero (used for Relay weld checking after Charging)" UBYTE CU_CCSIPRDCCHGCRNTNEARZERO 1 100 0.0 1.0 ECU_ADDRESS 0x70017ef6 BYTE_ORDER MSB_LAST /end MEASUREMENT
/begin COMPU_METHOD CU_CCSIPRDCCHGCRNTNEARZERO "Conversion method for CcsIprDcChgCrntNearZero" RAT_FUNC "%10.0" "b" COEFFS 0.000000 1.000000 -0.000000 0.000000 0.000000 1.000000 /end COMPU_METHOD
/* Scalar measurable for DDE 'CcsIprDcChgInletCrntSafe'. */
/begin MEASUREMENT CcsIprDcChgInletCrntSafe "Indicator that the current at charge inlet is low and is in a safe level" UBYTE CU_CCSIPRDCCHGINLETCRNTSAFE 1 100 0.0 1.0 ECU_ADDRESS 0x7001836e BYTE_ORDER MSB_LAST /end MEASUREMENT
/begin COMPU_METHOD CU_CCSIPRDCCHGINLETCRNTSAFE "Conversion method for CcsIprDcChgInletCrntSafe" RAT_FUNC "%10.0" "b" COEFFS 0.000000 1.000000 -0.000000 0.000000 0.000000 1.000000 /end COMPU_METHOD
/* Scalar measurable for DDE 'CcsIprDcChgInletVoltSafe'. */
/begin MEASUREMENT CcsIprDcChgInletVoltSafe "Indicator that the volt at charge inlet is low and is in a safe level" UBYTE CU_CCSIPRDCCHGINLETVOLTSAFE 1 100 0.0 1.0 ECU_ADDRESS 0x70017e6b BYTE_ORDER MSB_LAST /end MEASUREMENT
/begin COMPU_METHOD CU_CCSIPRDCCHGINLETVOLTSAFE "Conversion method for CcsIprDcChgInletVoltSafe" RAT_FUNC "%10.0" "b" COEFFS 0.000000 1.000000 -0.000000 0.000000 0.000000 1.000000 /end COMPU_METHOD
/* Scalar measurable for DDE 'CcsIprDcPrechgComplete'. */
/begin MEASUREMENT CcsIprDcPrechgComplete "True indicates the precharge is done and RESS voltage is almost equal to Charge Inlet volt" UBYTE CU_CCSIPRDCPRECHGCOMPLETE 1 100 0.0 1.0 ECU_ADDRESS 0x700182b5 BYTE_ORDER MSB_LAST /end MEASUREMENT
/begin COMPU_METHOD CU_CCSIPRDCPRECHGCOMPLETE "Conversion method for CcsIprDcPrechgComplete" RAT_FUNC "%10.0" "b" COEFFS 0.000000 1.000000 -0.000000 0.000000 0.000000 1.000000 /end COMPU_METHOD
/* Scalar measurable for DDE 'CcsIprDisSchIdx'. */
/begin MEASUREMENT CcsIprDisSchIdx "Index value of the curently active discharging schedule segment" SBYTE CU_CCSIPRDISSCHIDX 1 100 -1.0 127.0 ECU_ADDRESS 0x70017dbc BYTE_ORDER MSB_LAST /end MEASUREMENT
/begin COMPU_METHOD CU_CCSIPRDISSCHIDX "Conversion method for CcsIprDisSchIdx" RAT_FUNC "%10.0" "NA" COEFFS 0.000000 1.000000 -0.000000 0.000000 0.000000 1.000000 /end COMPU_METHOD
/* Scalar measurable for DDE 'CcsIprDisSchMaxIdx'. */
/begin MEASUREMENT CcsIprDisSchMaxIdx "Maximum valid index of the current discharging schedule. -1 indicates the charging schedule is not valid." SBYTE CU_CCSIPRDISSCHMAXIDX 1 100 -1.0 127.0 ECU_ADDRESS 0x70018201 BYTE_ORDER MSB_LAST /end MEASUREMENT
/begin COMPU_METHOD CU_CCSIPRDISSCHMAXIDX "Conversion method for CcsIprDisSchMaxIdx" RAT_FUNC "%10.0" "NA" COEFFS 0.000000 1.000000 -0.000000 0.000000 0.000000 1.000000 /end COMPU_METHOD
/* Scalar measurable for DDE 'CcsIprDisSchPmaxClipped'. */
/begin MEASUREMENT CcsIprDisSchPmaxClipped "Indicates that the discharge schedule is presently imposing a Pmax clip on the system" UBYTE CU_CCSIPRDISSCHPMAXCLIPPED 1 100 0.0 1.0 ECU_ADDRESS 0x70017d1d BYTE_ORDER MSB_LAST /end MEASUREMENT
/begin COMPU_METHOD CU_CCSIPRDISSCHPMAXCLIPPED "Conversion method for CcsIprDisSchPmaxClipped" RAT_FUNC "%10.0" "b" COEFFS 0.000000 1.000000 -0.000000 0.000000 0.000000 1.000000 /end COMPU_METHOD
/* Scalar measurable for DDE 'CcsIprDisSchTimer'. */
/begin MEASUREMENT CcsIprDisSchTimer "Discharge schedule timer value" ULONG CU_CCSIPRDISSCHTIMER 1 100 0.0 4294967295.0 ECU_ADDRESS 0x70018174 BYTE_ORDER MSB_LAST /end MEASUREMENT
/begin COMPU_METHOD CU_CCSIPRDISSCHTIMER "Conversion method for CcsIprDisSchTimer" RAT_FUNC "%10.0" "NA" COEFFS 0.000000 1.000000 -0.000000 0.000000 0.000000 1.000000 /end COMPU_METHOD
/* Scalar measurable for DDE 'CcsIprPpPos'. */
/begin MEASUREMENT CcsIprPpPos "Displayable for monitoring  processed EVSE PP signal position" UBYTE CU_CCSIPRPPPOS 1 100 0.0 2.0 ECU_ADDRESS 0x70017c48 BYTE_ORDER MSB_LAST /end MEASUREMENT
/begin COMPU_METHOD CU_CCSIPRPPPOS "Conversion method for CcsIprPpPos" RAT_FUNC "%10.0" "1" COEFFS 0.000000 1.000000 -0.000000 0.000000 0.000000 1.000000 /end COMPU_METHOD
/* Scalar measurable for DDE 'CcsIprPpSt'. */
/begin MEASUREMENT CcsIprPpSt "Enumerated State of Proximity Signal according to SAE J1772" SLONG CU_CCSIPRPPST 1 100 -2147483648.0 2147483647.0 ECU_ADDRESS 0x7001800c BYTE_ORDER MSB_LAST /end MEASUREMENT
/begin COMPU_METHOD CU_CCSIPRPPST "Conversion method for CcsIprPpSt" TAB_VERB "%12.0" "enum" COMPU_TAB_REF CT_CCSIPRPPST /end COMPU_METHOD
/begin COMPU_VTAB CT_CCSIPRPPST "Conversion method for CcsIprPpSt" TAB_VERB 4 0 "PROX_DISCONNECTED" 1 "PROX_CONNECTED_S3_OPEN" 2 "PROX_CONNECTED_S3_CLOSE" 3 "PROX_INVALID" /end COMPU_VTAB
/* Scalar measurable for DDE 'CcsIprPrtEvseCouplerPluggedIn'. */
/begin MEASUREMENT CcsIprPrtEvseCouplerPluggedIn "True indicates the EVSE charge coupler is plugged in to the vehcile charge inlet" UBYTE CU_CCSIPRPRTEVSECOUPLERPLUGGED0 1 100 0.0 1.0 ECU_ADDRESS 0x70018473 BYTE_ORDER MSB_LAST /end MEASUREMENT
/begin COMPU_METHOD CU_CCSIPRPRTEVSECOUPLERPLUGGED0 "Conversion method for CcsIprPrtEvseCouplerPluggedIn" RAT_FUNC "%10.0" "b" COEFFS 0.000000 1.000000 -0.000000 0.000000 0.000000 1.000000 /end COMPU_METHOD
/* Scalar measurable for DDE 'CcsIprPrtHvPresent'. */
/begin MEASUREMENT CcsIprPrtHvPresent "True indicates a voltage is present at the charge inlet either on the core pins (AC or DC) or on extended pins (DC only)" UBYTE CU_CCSIPRPRTHVPRESENT 1 100 0.0 1.0 ECU_ADDRESS 0x70017f6c BYTE_ORDER MSB_LAST /end MEASUREMENT
/begin COMPU_METHOD CU_CCSIPRPRTHVPRESENT "Conversion method for CcsIprPrtHvPresent" RAT_FUNC "%10.0" "b" COEFFS 0.000000 1.000000 -0.000000 0.000000 0.000000 1.000000 /end COMPU_METHOD
/* Scalar measurable for DDE 'CcsIprPrtVehChargingPortSt'. */
/begin MEASUREMENT CcsIprPrtVehChargingPortSt "Enumerated state of Charging Inlet to be transmitted as a CAN signal to the vehicle controllers" SLONG CU_CCSIPRPRTVEHCHARGINGPORTST 1 100 -2147483648.0 2147483647.0 ECU_ADDRESS 0x700183b0 BYTE_ORDER MSB_LAST /end MEASUREMENT
/begin COMPU_METHOD CU_CCSIPRPRTVEHCHARGINGPORTST "Conversion method for CcsIprPrtVehChargingPortSt" TAB_VERB "%12.0" "enum" COMPU_TAB_REF CT_CCSIPRPRTVEHCHARGINGPORTST /end COMPU_METHOD
/begin COMPU_VTAB CT_CCSIPRPRTVEHCHARGINGPORTST "Conversion method for CcsIprPrtVehChargingPortSt" TAB_VERB 4 0 "CHARGER_UNPLUGGED" 1 "CHARGER_PLUGGED_HV_ABSENT" 2 "CHARGER_PLUGGED_HV_PRESENT" 3 "CHARGER_PORT_UNKNOWN" /end COMPU_VTAB
/* Scalar measurable for DDE 'CcsIprPrxDischargePmax'. */
/begin MEASUREMENT CcsIprPrxDischargePmax "Pmax value from the currently active discharge schedule" FLOAT32_IEEE CU_CCSIPRPRXDISCHARGEPMAX 1 100 0.0 10000000.0 ECU_ADDRESS 0x70017ebc BYTE_ORDER MSB_LAST /end MEASUREMENT
/begin COMPU_METHOD CU_CCSIPRPRXDISCHARGEPMAX "Conversion method for CcsIprPrxDischargePmax" RAT_FUNC "%10.0" "W" COEFFS 0.000000 1.000000 -0.000000 0.000000 0.000000 1.000000 /end COMPU_METHOD
/* Scalar measurable for DDE 'CcsIprPrxEvseCrntMax'. */
/begin MEASUREMENT CcsIprPrxEvseCrntMax "Maximum current the EVSE can deliver" FLOAT32_IEEE CU_CCSIPRPRXEVSECRNTMAX 1 100 0.0 196605.0 ECU_ADDRESS 0x7001831c BYTE_ORDER MSB_LAST /end MEASUREMENT
/begin COMPU_METHOD CU_CCSIPRPRXEVSECRNTMAX "Conversion method for CcsIprPrxEvseCrntMax" RAT_FUNC "%10.0" "A" COEFFS 0.000000 1.000000 -0.000000 0.000000 0.000000 1.000000 /end COMPU_METHOD
/* Scalar measurable for DDE 'CcsIprPrxEvseCrntMin'. */
/begin MEASUREMENT CcsIprPrxEvseCrntMin "Minimum current the EVSE can deliver" FLOAT32_IEEE CU_CCSIPRPRXEVSECRNTMIN 1 100 0.0 196605.0 ECU_ADDRESS 0x70017e20 BYTE_ORDER MSB_LAST /end MEASUREMENT
/begin COMPU_METHOD CU_CCSIPRPRXEVSECRNTMIN "Conversion method for CcsIprPrxEvseCrntMin" RAT_FUNC "%10.0" "A" COEFFS 0.000000 1.000000 -0.000000 0.000000 0.000000 1.000000 /end COMPU_METHOD
/* Scalar measurable for DDE 'CcsIprPrxEvseCrntValid'. */
/begin MEASUREMENT CcsIprPrxEvseCrntValid "TRUE indicates the most recent DC current measurement by EVSE at the charge inlet is considered valid. This value is recevied by the last V2G message" UBYTE CU_CCSIPRPRXEVSECRNTVALID 1 100 0.0 1.0 ECU_ADDRESS 0x70018274 BYTE_ORDER MSB_LAST /end MEASUREMENT
/begin COMPU_METHOD CU_CCSIPRPRXEVSECRNTVALID "Conversion method for CcsIprPrxEvseCrntValid" RAT_FUNC "%10.0" "NA" COEFFS 0.000000 1.000000 -0.000000 0.000000 0.000000 1.000000 /end COMPU_METHOD
/* Scalar measurable for DDE 'CcsIprPrxEvseDchgCrntMax'. */
/begin MEASUREMENT CcsIprPrxEvseDchgCrntMax "Maximum discharge current the EVSE can deliver" FLOAT32_IEEE CU_CCSIPRPRXEVSEDCHGCRNTMAX 1 100 0.0 196605.0 ECU_ADDRESS 0x70017d84 BYTE_ORDER MSB_LAST /end MEASUREMENT
/begin COMPU_METHOD CU_CCSIPRPRXEVSEDCHGCRNTMAX "Conversion method for CcsIprPrxEvseDchgCrntMax" RAT_FUNC "%10.0" "A" COEFFS 0.000000 1.000000 -0.000000 0.000000 0.000000 1.000000 /end COMPU_METHOD
/* Scalar measurable for DDE 'CcsIprPrxEvseDchgCrntMin'. */
/begin MEASUREMENT CcsIprPrxEvseDchgCrntMin "Maximum discharge current the EVSE can deliver" FLOAT32_IEEE CU_CCSIPRPRXEVSEDCHGCRNTMIN 1 100 0.0 196605.0 ECU_ADDRESS 0x700181b0 BYTE_ORDER MSB_LAST /end MEASUREMENT
/begin COMPU_METHOD CU_CCSIPRPRXEVSEDCHGCRNTMIN "Conversion method for CcsIprPrxEvseDchgCrntMin" RAT_FUNC "%10.0" "A" COEFFS 0.000000 1.000000 -0.000000 0.000000 0.000000 1.000000 /end COMPU_METHOD
/* Scalar measurable for DDE 'CcsIprPrxEvseDchgPwrMax'. */
/begin MEASUREMENT CcsIprPrxEvseDchgPwrMax "Maximum discharge power the EVSE can deliver" FLOAT32_IEEE CU_CCSIPRPRXEVSEDCHGPWRMAX 1 100 0.0 196605.0 ECU_ADDRESS 0x70017c90 BYTE_ORDER MSB_LAST /end MEASUREMENT
/begin COMPU_METHOD CU_CCSIPRPRXEVSEDCHGPWRMAX "Conversion method for CcsIprPrxEvseDchgPwrMax" RAT_FUNC "%10.0" "A" COEFFS 0.000000 1.000000 -0.000000 0.000000 0.000000 1.000000 /end COMPU_METHOD
/* Scalar measurable for DDE 'CcsIprPrxEvsePwrMax'. */
/begin MEASUREMENT CcsIprPrxEvsePwrMax "Maximum power that EVSE can deliver" FLOAT32_IEEE CU_CCSIPRPRXEVSEPWRMAX 1 100 0.0 196605.0 ECU_ADDRESS 0x700180e4 BYTE_ORDER MSB_LAST /end MEASUREMENT
/begin COMPU_METHOD CU_CCSIPRPRXEVSEPWRMAX "Conversion method for CcsIprPrxEvsePwrMax" RAT_FUNC "%10.0" "W" COEFFS 0.000000 1.000000 -0.000000 0.000000 0.000000 1.000000 /end COMPU_METHOD
/* Scalar measurable for DDE 'CcsIprPrxEvseVoltMax'. */
/begin MEASUREMENT CcsIprPrxEvseVoltMax "Maximum voltage the EVSE can deliver" FLOAT32_IEEE CU_CCSIPRPRXEVSEVOLTMAX 1 100 0.0 196605.0 ECU_ADDRESS 0x70017c08 BYTE_ORDER MSB_LAST /end MEASUREMENT
/begin COMPU_METHOD CU_CCSIPRPRXEVSEVOLTMAX "Conversion method for CcsIprPrxEvseVoltMax" RAT_FUNC "%10.0" "V" COEFFS 0.000000 1.000000 -0.000000 0.000000 0.000000 1.000000 /end COMPU_METHOD
/* Scalar measurable for DDE 'CcsIprPrxEvseVoltMin'. */
/begin MEASUREMENT CcsIprPrxEvseVoltMin "Minimum voltage the EVSE can deliver" FLOAT32_IEEE CU_CCSIPRPRXEVSEVOLTMIN 1 100 0.0 196605.0 ECU_ADDRESS 0x70017fac BYTE_ORDER MSB_LAST /end MEASUREMENT
/begin COMPU_METHOD CU_CCSIPRPRXEVSEVOLTMIN "Conversion method for CcsIprPrxEvseVoltMin" RAT_FUNC "%10.0" "V" COEFFS 0.000000 1.000000 -0.000000 0.000000 0.000000 1.000000 /end COMPU_METHOD
/* Scalar measurable for DDE 'CcsIprPrxEvseVoltValid'. */
/begin MEASUREMENT CcsIprPrxEvseVoltValid "TRUE indicates the most recent DC voltage measurement by EVSE at the charge inlet is considered valid. This value is recevied by the last V2G message" UBYTE CU_CCSIPRPRXEVSEVOLTVALID 1 100 0.0 1.0 ECU_ADDRESS 0x70018430 BYTE_ORDER MSB_LAST /end MEASUREMENT
/begin COMPU_METHOD CU_CCSIPRPRXEVSEVOLTVALID "Conversion method for CcsIprPrxEvseVoltValid" RAT_FUNC "%10.0" "NA" COEFFS 0.000000 1.000000 -0.000000 0.000000 0.000000 1.000000 /end COMPU_METHOD
/* Scalar measurable for DDE 'CcsIprPrxSchedulePmax'. */
/begin MEASUREMENT CcsIprPrxSchedulePmax "Pmax value from the currently active charge schedule" FLOAT32_IEEE CU_CCSIPRPRXSCHEDULEPMAX 1 100 0.0 10000000.0 ECU_ADDRESS 0x70017ef8 BYTE_ORDER MSB_LAST /end MEASUREMENT
/begin COMPU_METHOD CU_CCSIPRPRXSCHEDULEPMAX "Conversion method for CcsIprPrxSchedulePmax" RAT_FUNC "%10.0" "W" COEFFS 0.000000 1.000000 -0.000000 0.000000 0.000000 1.000000 /end COMPU_METHOD
/* Scalar measurable for DDE 'CcsIprSchIdx'. */
/begin MEASUREMENT CcsIprSchIdx "Index value of the curently active charging schedule segment" SBYTE CU_CCSIPRSCHIDX 1 100 -1.0 127.0 ECU_ADDRESS 0x7001836f BYTE_ORDER MSB_LAST /end MEASUREMENT
/begin COMPU_METHOD CU_CCSIPRSCHIDX "Conversion method for CcsIprSchIdx" RAT_FUNC "%10.0" "NA" COEFFS 0.000000 1.000000 -0.000000 0.000000 0.000000 1.000000 /end COMPU_METHOD
/* Scalar measurable for DDE 'CcsIprSchMaxIdx'. */
/begin MEASUREMENT CcsIprSchMaxIdx "Maximum valid index of the current charging schedule. -1 indicates the charging schedule is not valid." SBYTE CU_CCSIPRSCHMAXIDX 1 100 -1.0 127.0 ECU_ADDRESS 0x70017e6c BYTE_ORDER MSB_LAST /end MEASUREMENT
/begin COMPU_METHOD CU_CCSIPRSCHMAXIDX "Conversion method for CcsIprSchMaxIdx" RAT_FUNC "%10.0" "NA" COEFFS 0.000000 1.000000 -0.000000 0.000000 0.000000 1.000000 /end COMPU_METHOD
/* Scalar measurable for DDE 'CcsIprSchPmaxClipped'. */
/begin MEASUREMENT CcsIprSchPmaxClipped "Indicates that the charge schedule is presently imposing a Pmax clip on the system" UBYTE CU_CCSIPRSCHPMAXCLIPPED 1 100 0.0 1.0 ECU_ADDRESS 0x700182b6 BYTE_ORDER MSB_LAST /end MEASUREMENT
/begin COMPU_METHOD CU_CCSIPRSCHPMAXCLIPPED "Conversion method for CcsIprSchPmaxClipped" RAT_FUNC "%10.0" "b" COEFFS 0.000000 1.000000 -0.000000 0.000000 0.000000 1.000000 /end COMPU_METHOD
/* Scalar measurable for DDE 'CcsIprSchTimer'. */
/begin MEASUREMENT CcsIprSchTimer "Charge schedule timer value" ULONG CU_CCSIPRSCHTIMER 1 100 0.0 4294967295.0 ECU_ADDRESS 0x70017dc0 BYTE_ORDER MSB_LAST /end MEASUREMENT
/begin COMPU_METHOD CU_CCSIPRSCHTIMER "Conversion method for CcsIprSchTimer" RAT_FUNC "%10.0" "NA" COEFFS 0.000000 1.000000 -0.000000 0.000000 0.000000 1.000000 /end COMPU_METHOD
/* Scalar measurable for DDE 'CcsOprHvEvTargetCrnt'. */
/begin MEASUREMENT CcsOprHvEvTargetCrnt "Final Target Current requested from EVSE" FLOAT32_IEEE CU_CCSOPRHVEVTARGETCRNT 1 100 -1000.0 1000.0 ECU_ADDRESS 0x70018204 BYTE_ORDER MSB_LAST /end MEASUREMENT
/begin COMPU_METHOD CU_CCSOPRHVEVTARGETCRNT "Conversion method for CcsOprHvEvTargetCrnt" RAT_FUNC "%10.0" "A" COEFFS 0.000000 1.000000 -0.000000 0.000000 0.000000 1.000000 /end COMPU_METHOD
/* Scalar measurable for DDE 'CcsOprHvEvTargetVolt'. */
/begin MEASUREMENT CcsOprHvEvTargetVolt "Final Target Voltage requested from EVSE" FLOAT32_IEEE CU_CCSOPRHVEVTARGETVOLT 1 100 0.0 1000.0 ECU_ADDRESS 0x70017d20 BYTE_ORDER MSB_LAST /end MEASUREMENT
/begin COMPU_METHOD CU_CCSOPRHVEVTARGETVOLT "Conversion method for CcsOprHvEvTargetVolt" RAT_FUNC "%10.0" "V" COEFFS 0.000000 1.000000 -0.000000 0.000000 0.000000 1.000000 /end COMPU_METHOD
/* Scalar measurable for DDE 'CcsOprTargetCrntChgLimByPwr'. */
/begin MEASUREMENT CcsOprTargetCrntChgLimByPwr "Target Current requested from EVSE that is limited by EV and EVSE maximum charge power" FLOAT32_IEEE CU_CCSOPRTARGETCRNTCHGLIMBYPWR 1 100 -1000.0 1000.0 ECU_ADDRESS 0x70018178 BYTE_ORDER MSB_LAST /end MEASUREMENT
/begin COMPU_METHOD CU_CCSOPRTARGETCRNTCHGLIMBYPWR "Conversion method for CcsOprTargetCrntChgLimByPwr" RAT_FUNC "%10.0" "A" COEFFS 0.000000 1.000000 -0.000000 0.000000 0.000000 1.000000 /end COMPU_METHOD
/* Scalar measurable for DDE 'CcsOprTargetCrntDchgLimByPwr'. */
/begin MEASUREMENT CcsOprTargetCrntDchgLimByPwr "Target Current requested from EVSE that is limited by EV and EVSE maximum charge power" FLOAT32_IEEE CU_CCSOPRTARGETCRNTDCHGLIMBYPWR 1 100 -1000.0 1000.0 ECU_ADDRESS 0x70017c4c BYTE_ORDER MSB_LAST /end MEASUREMENT
/begin COMPU_METHOD CU_CCSOPRTARGETCRNTDCHGLIMBYPWR "Conversion method for CcsOprTargetCrntDchgLimByPwr" RAT_FUNC "%10.0" "A" COEFFS 0.000000 1.000000 -0.000000 0.000000 0.000000 1.000000 /end COMPU_METHOD
/* Scalar measurable for DDE 'CcsOprV2gTxEvCabinCondition'. */
/begin MEASUREMENT CcsOprV2gTxEvCabinCondition "Vehicle Cabin Conditioning, The vehicle is using energy from the DC supply to heat or cool the passenger compartment" UBYTE CU_CCSOPRV2GTXEVCABINCONDITION1 1 100 0.0 1.0 ECU_ADDRESS 0x70018010 BYTE_ORDER MSB_LAST /end MEASUREMENT
/begin COMPU_METHOD CU_CCSOPRV2GTXEVCABINCONDITION1 "Conversion method for CcsOprV2gTxEvCabinCondition" RAT_FUNC "%10.0" "b" COEFFS 0.000000 1.000000 -0.000000 0.000000 0.000000 1.000000 /end COMPU_METHOD
/* Scalar measurable for DDE 'CcsOprV2gTxReadyToCharge'. */
/begin MEASUREMENT CcsOprV2gTxReadyToCharge "If set to TRUE, signals that the vehicle is ready for full energy transfer." UBYTE CU_CCSOPRV2GTXREADYTOCHARGE 1 100 0.0 1.0 ECU_ADDRESS 0x70018474 BYTE_ORDER MSB_LAST /end MEASUREMENT
/begin COMPU_METHOD CU_CCSOPRV2GTXREADYTOCHARGE "Conversion method for CcsOprV2gTxReadyToCharge" RAT_FUNC "%10.0" "b" COEFFS 0.000000 1.000000 -0.000000 0.000000 0.000000 1.000000 /end COMPU_METHOD
/* Scalar measurable for DDE 'CcsOutPtxDinAuthTxFlg'. */
/begin MEASUREMENT CcsOutPtxDinAuthTxFlg "a rising edge on this signal triggers the transmission of the V2G AuthorizationReq message to the EVSE" UBYTE CU_CCSOUTPTXDINAUTHTXFLG 1 100 0.0 1.0 ECU_ADDRESS 0x70017f6d BYTE_ORDER MSB_LAST /end MEASUREMENT
/begin COMPU_METHOD CU_CCSOUTPTXDINAUTHTXFLG "Conversion method for CcsOutPtxDinAuthTxFlg" RAT_FUNC "%10.0" "b" COEFFS 0.000000 1.000000 -0.000000 0.000000 0.000000 1.000000 /end COMPU_METHOD
/* Scalar measurable for DDE 'CcsOutPtxDinCblChkTxFlg'. */
/begin MEASUREMENT CcsOutPtxDinCblChkTxFlg "a rising edge on this signal triggers the transmission of the V2G CableCheckReq message to the EVSE" UBYTE CU_CCSOUTPTXDINCBLCHKTXFLG 1 100 0.0 1.0 ECU_ADDRESS 0x700183b4 BYTE_ORDER MSB_LAST /end MEASUREMENT
/begin COMPU_METHOD CU_CCSOUTPTXDINCBLCHKTXFLG "Conversion method for CcsOutPtxDinCblChkTxFlg" RAT_FUNC "%10.0" "b" COEFFS 0.000000 1.000000 -0.000000 0.000000 0.000000 1.000000 /end COMPU_METHOD
/* Scalar measurable for DDE 'CcsOutPtxDinChgParDiscTxFlg'. */
/begin MEASUREMENT CcsOutPtxDinChgParDiscTxFlg "a rising edge on this signal triggers the transmission of the second V2G ChargeParameterDiscoveryReq message to the EVSE" UBYTE CU_CCSOUTPTXDINCHGPARDISCTXFLG 1 100 0.0 1.0 ECU_ADDRESS 0x70017ec0 BYTE_ORDER MSB_LAST /end MEASUREMENT
/begin COMPU_METHOD CU_CCSOUTPTXDINCHGPARDISCTXFLG "Conversion method for CcsOutPtxDinChgParDiscTxFlg" RAT_FUNC "%10.0" "b" COEFFS 0.000000 1.000000 -0.000000 0.000000 0.000000 1.000000 /end COMPU_METHOD
/* Scalar measurable for DDE 'CcsOutPtxDinCrntDmdTxFlg'. */
/begin MEASUREMENT CcsOutPtxDinCrntDmdTxFlg "a rising edge on this signal triggers the transmission of the V2G CurrentDemandReq message to the EVSE" UBYTE CU_CCSOUTPTXDINCRNTDMDTXFLG 1 100 0.0 1.0 ECU_ADDRESS 0x70018320 BYTE_ORDER MSB_LAST /end MEASUREMENT
/begin COMPU_METHOD CU_CCSOUTPTXDINCRNTDMDTXFLG "Conversion method for CcsOutPtxDinCrntDmdTxFlg" RAT_FUNC "%10.0" "b" COEFFS 0.000000 1.000000 -0.000000 0.000000 0.000000 1.000000 /end COMPU_METHOD
/* Scalar measurable for DDE 'CcsOutPtxDinPmtSelTxFlg'. */
/begin MEASUREMENT CcsOutPtxDinPmtSelTxFlg "a rising edge on this signal triggers the transmission of the V2G ServicePaymentSelectionReq message to the EVSE" UBYTE CU_CCSOUTPTXDINPMTSELTXFLG 1 100 0.0 1.0 ECU_ADDRESS 0x70017e24 BYTE_ORDER MSB_LAST /end MEASUREMENT
/begin COMPU_METHOD CU_CCSOUTPTXDINPMTSELTXFLG "Conversion method for CcsOutPtxDinPmtSelTxFlg" RAT_FUNC "%10.0" "b" COEFFS 0.000000 1.000000 -0.000000 0.000000 0.000000 1.000000 /end COMPU_METHOD
/* Scalar measurable for DDE 'CcsOutPtxDinPreChgTxFlg'. */
/begin MEASUREMENT CcsOutPtxDinPreChgTxFlg "a rising edge on this signal triggers the transmission of the V2G PrechargeReq message to the EVSE" UBYTE CU_CCSOUTPTXDINPRECHGTXFLG 1 100 0.0 1.0 ECU_ADDRESS 0x70018275 BYTE_ORDER MSB_LAST /end MEASUREMENT
/begin COMPU_METHOD CU_CCSOUTPTXDINPRECHGTXFLG "Conversion method for CcsOutPtxDinPreChgTxFlg" RAT_FUNC "%10.0" "b" COEFFS 0.000000 1.000000 -0.000000 0.000000 0.000000 1.000000 /end COMPU_METHOD
/* Scalar measurable for DDE 'CcsOutPtxDinPwrDelShtDnTxFlg'. */
/begin MEASUREMENT CcsOutPtxDinPwrDelShtDnTxFlg "a rising edge on this signal triggers the transmission of the V2G PowerDeliveryReq shutdown message to the EVSE" UBYTE CU_CCSOUTPTXDINPWRDELSHTDNTXFLG 1 100 0.0 1.0 ECU_ADDRESS 0x70017d88 BYTE_ORDER MSB_LAST /end MEASUREMENT
/begin COMPU_METHOD CU_CCSOUTPTXDINPWRDELSHTDNTXFLG "Conversion method for CcsOutPtxDinPwrDelShtDnTxFlg" RAT_FUNC "%10.0" "b" COEFFS 0.000000 1.000000 -0.000000 0.000000 0.000000 1.000000 /end COMPU_METHOD
/* Scalar measurable for DDE 'CcsOutPtxDinPwrDelivTxFlg'. */
/begin MEASUREMENT CcsOutPtxDinPwrDelivTxFlg "a rising edge on this signal triggers the transmission of the V2G PowerDeliveryReq message to the EVSE" UBYTE CU_CCSOUTPTXDINPWRDELIVTXFLG 1 100 0.0 1.0 ECU_ADDRESS 0x700181b4 BYTE_ORDER MSB_LAST /end MEASUREMENT
/begin COMPU_METHOD CU_CCSOUTPTXDINPWRDELIVTXFLG "Conversion method for CcsOutPtxDinPwrDelivTxFlg" RAT_FUNC "%10.0" "b" COEFFS 0.000000 1.000000 -0.000000 0.000000 0.000000 1.000000 /end COMPU_METHOD
/* Scalar measurable for DDE 'CcsOutPtxDinSesSetupTxFlg'. */
/begin MEASUREMENT CcsOutPtxDinSesSetupTxFlg "a rising edge on this signal triggers the transmission of the V2G SessionSetupReq message to the EVSE" UBYTE CU_CCSOUTPTXDINSESSETUPTXFLG 1 100 0.0 1.0 ECU_ADDRESS 0x70017c94 BYTE_ORDER MSB_LAST /end MEASUREMENT
/begin COMPU_METHOD CU_CCSOUTPTXDINSESSETUPTXFLG "Conversion method for CcsOutPtxDinSesSetupTxFlg" RAT_FUNC "%10.0" "b" COEFFS 0.000000 1.000000 -0.000000 0.000000 0.000000 1.000000 /end COMPU_METHOD
/* Scalar measurable for DDE 'CcsOutPtxDinSesStopTxFlg'. */
/begin MEASUREMENT CcsOutPtxDinSesStopTxFlg "a rising edge on this signal triggers the transmission of the V2G SessionStopReq message to the EVSE" UBYTE CU_CCSOUTPTXDINSESSTOPTXFLG 1 100 0.0 1.0 ECU_ADDRESS 0x700180e8 BYTE_ORDER MSB_LAST /end MEASUREMENT
/begin COMPU_METHOD CU_CCSOUTPTXDINSESSTOPTXFLG "Conversion method for CcsOutPtxDinSesStopTxFlg" RAT_FUNC "%10.0" "b" COEFFS 0.000000 1.000000 -0.000000 0.000000 0.000000 1.000000 /end COMPU_METHOD
/* Scalar measurable for DDE 'CcsOutPtxDinSvcDiscTxFlg'. */
/begin MEASUREMENT CcsOutPtxDinSvcDiscTxFlg "a rising edge on this signal triggers the transmission of the V2G ServiceDiscoveryReq message to the EVSE" UBYTE CU_CCSOUTPTXDINSVCDISCTXFLG 1 100 0.0 1.0 ECU_ADDRESS 0x70017c0c BYTE_ORDER MSB_LAST /end MEASUREMENT
/begin COMPU_METHOD CU_CCSOUTPTXDINSVCDISCTXFLG "Conversion method for CcsOutPtxDinSvcDiscTxFlg" RAT_FUNC "%10.0" "b" COEFFS 0.000000 1.000000 -0.000000 0.000000 0.000000 1.000000 /end COMPU_METHOD
/* Scalar measurable for DDE 'CcsOutPtxDinWeldDetTxFlg'. */
/begin MEASUREMENT CcsOutPtxDinWeldDetTxFlg "a rising edge on this signal triggers the transmission of the V2G WeldingDetectionReq message to the EVSE" UBYTE CU_CCSOUTPTXDINWELDDETTXFLG 1 100 0.0 1.0 ECU_ADDRESS 0x70017fb0 BYTE_ORDER MSB_LAST /end MEASUREMENT
/begin COMPU_METHOD CU_CCSOUTPTXDINWELDDETTXFLG "Conversion method for CcsOutPtxDinWeldDetTxFlg" RAT_FUNC "%10.0" "b" COEFFS 0.000000 1.000000 -0.000000 0.000000 0.000000 1.000000 /end COMPU_METHOD
/* Scalar measurable for DDE 'CcsOutPtxIso1AuthTxFlg'. */
/begin MEASUREMENT CcsOutPtxIso1AuthTxFlg "a rising edge on this signal triggers the transmission of the V2G AuthorizationReq message to the EVSE" UBYTE CU_CCSOUTPTXISO1AUTHTXFLG 1 100 0.0 1.0 ECU_ADDRESS 0x70018431 BYTE_ORDER MSB_LAST /end MEASUREMENT
/begin COMPU_METHOD CU_CCSOUTPTXISO1AUTHTXFLG "Conversion method for CcsOutPtxIso1AuthTxFlg" RAT_FUNC "%10.0" "b" COEFFS 0.000000 1.000000 -0.000000 0.000000 0.000000 1.000000 /end COMPU_METHOD
/* Scalar measurable for DDE 'CcsOutPtxIso1CblChkTxFlg'. */
/begin MEASUREMENT CcsOutPtxIso1CblChkTxFlg "a rising edge on this signal triggers the transmission of the V2G CableCheckReq message to the EVSE" UBYTE CU_CCSOUTPTXISO1CBLCHKTXFLG 1 100 0.0 1.0 ECU_ADDRESS 0x70017efc BYTE_ORDER MSB_LAST /end MEASUREMENT
/begin COMPU_METHOD CU_CCSOUTPTXISO1CBLCHKTXFLG "Conversion method for CcsOutPtxIso1CblChkTxFlg" RAT_FUNC "%10.0" "b" COEFFS 0.000000 1.000000 -0.000000 0.000000 0.000000 1.000000 /end COMPU_METHOD
/* Scalar measurable for DDE 'CcsOutPtxIso1ChgParDiscTxFlg'. */
/begin MEASUREMENT CcsOutPtxIso1ChgParDiscTxFlg "a rising edge on this signal triggers the transmission of the second V2G ChargeParameterDiscoveryReq message to the EVSE" UBYTE CU_CCSOUTPTXISO1CHGPARDISCTXFLG 1 100 0.0 1.0 ECU_ADDRESS 0x70018370 BYTE_ORDER MSB_LAST /end MEASUREMENT
/begin COMPU_METHOD CU_CCSOUTPTXISO1CHGPARDISCTXFLG "Conversion method for CcsOutPtxIso1ChgParDiscTxFlg" RAT_FUNC "%10.0" "b" COEFFS 0.000000 1.000000 -0.000000 0.000000 0.000000 1.000000 /end COMPU_METHOD
/* Scalar measurable for DDE 'CcsOutPtxIso1CrntDmdTxFlg'. */
/begin MEASUREMENT CcsOutPtxIso1CrntDmdTxFlg "a rising edge on this signal triggers the transmission of the V2G CurrentDemandReq message to the EVSE" UBYTE CU_CCSOUTPTXISO1CRNTDMDTXFLG 1 100 0.0 1.0 ECU_ADDRESS 0x70017e6d BYTE_ORDER MSB_LAST /end MEASUREMENT
/begin COMPU_METHOD CU_CCSOUTPTXISO1CRNTDMDTXFLG "Conversion method for CcsOutPtxIso1CrntDmdTxFlg" RAT_FUNC "%10.0" "b" COEFFS 0.000000 1.000000 -0.000000 0.000000 0.000000 1.000000 /end COMPU_METHOD
/* Scalar measurable for DDE 'CcsOutPtxIso1PmtSelTxFlg'. */
/begin MEASUREMENT CcsOutPtxIso1PmtSelTxFlg "a rising edge on this signal triggers the transmission of the V2G ServicePaymentSelectionReq message to the EVSE" UBYTE CU_CCSOUTPTXISO1PMTSELTXFLG 1 100 0.0 1.0 ECU_ADDRESS 0x700182b7 BYTE_ORDER MSB_LAST /end MEASUREMENT
/begin COMPU_METHOD CU_CCSOUTPTXISO1PMTSELTXFLG "Conversion method for CcsOutPtxIso1PmtSelTxFlg" RAT_FUNC "%10.0" "b" COEFFS 0.000000 1.000000 -0.000000 0.000000 0.000000 1.000000 /end COMPU_METHOD
/* Scalar measurable for DDE 'CcsOutPtxIso1PreChgTxFlg'. */
/begin MEASUREMENT CcsOutPtxIso1PreChgTxFlg "a rising edge on this signal triggers the transmission of the V2G PrechargeReq message to the EVSE" UBYTE CU_CCSOUTPTXISO1PRECHGTXFLG 1 100 0.0 1.0 ECU_ADDRESS 0x70017dc4 BYTE_ORDER MSB_LAST /end MEASUREMENT
/begin COMPU_METHOD CU_CCSOUTPTXISO1PRECHGTXFLG "Conversion method for CcsOutPtxIso1PreChgTxFlg" RAT_FUNC "%10.0" "b" COEFFS 0.000000 1.000000 -0.000000 0.000000 0.000000 1.000000 /end COMPU_METHOD
/* Scalar measurable for DDE 'CcsOutPtxIso1PwrDelShtDnTxFlg'. */
/begin MEASUREMENT CcsOutPtxIso1PwrDelShtDnTxFlg "a rising edge on this signal triggers the transmission of the V2G PowerDeliveryReq shutdown message to the EVSE" UBYTE CU_CCSOUTPTXISO1PWRDELSHTDNTXF0 1 100 0.0 1.0 ECU_ADDRESS 0x70018208 BYTE_ORDER MSB_LAST /end MEASUREMENT
/begin COMPU_METHOD CU_CCSOUTPTXISO1PWRDELSHTDNTXF0 "Conversion method for CcsOutPtxIso1PwrDelShtDnTxFlg" RAT_FUNC "%10.0" "b" COEFFS 0.000000 1.000000 -0.000000 0.000000 0.000000 1.000000 /end COMPU_METHOD
/* Scalar measurable for DDE 'CcsOutPtxIso1PwrDelivTxFlg'. */
/begin MEASUREMENT CcsOutPtxIso1PwrDelivTxFlg "a rising edge on this signal triggers the transmission of the V2G PowerDeliveryReq message to the EVSE" UBYTE CU_CCSOUTPTXISO1PWRDELIVTXFLG 1 100 0.0 1.0 ECU_ADDRESS 0x70017d24 BYTE_ORDER MSB_LAST /end MEASUREMENT
/begin COMPU_METHOD CU_CCSOUTPTXISO1PWRDELIVTXFLG "Conversion method for CcsOutPtxIso1PwrDelivTxFlg" RAT_FUNC "%10.0" "b" COEFFS 0.000000 1.000000 -0.000000 0.000000 0.000000 1.000000 /end COMPU_METHOD
/* Scalar measurable for DDE 'CcsOutPtxIso1SesSetupTxFlg'. */
/begin MEASUREMENT CcsOutPtxIso1SesSetupTxFlg "a rising edge on this signal triggers the transmission of the V2G SessionSetupReq message to the EVSE" UBYTE CU_CCSOUTPTXISO1SESSETUPTXFLG 1 100 0.0 1.0 ECU_ADDRESS 0x7001817c BYTE_ORDER MSB_LAST /end MEASUREMENT
/begin COMPU_METHOD CU_CCSOUTPTXISO1SESSETUPTXFLG "Conversion method for CcsOutPtxIso1SesSetupTxFlg" RAT_FUNC "%10.0" "b" COEFFS 0.000000 1.000000 -0.000000 0.000000 0.000000 1.000000 /end COMPU_METHOD
/* Scalar measurable for DDE 'CcsOutPtxIso1SesStopTxFlg'. */
/begin MEASUREMENT CcsOutPtxIso1SesStopTxFlg "a rising edge on this signal triggers the transmission of the V2G SessionStopReq message to the EVSE" UBYTE CU_CCSOUTPTXISO1SESSTOPTXFLG 1 100 0.0 1.0 ECU_ADDRESS 0x70017c50 BYTE_ORDER MSB_LAST /end MEASUREMENT
/begin COMPU_METHOD CU_CCSOUTPTXISO1SESSTOPTXFLG "Conversion method for CcsOutPtxIso1SesStopTxFlg" RAT_FUNC "%10.0" "b" COEFFS 0.000000 1.000000 -0.000000 0.000000 0.000000 1.000000 /end COMPU_METHOD
/* Scalar measurable for DDE 'CcsOutPtxIso1SvcDetailTxFlg'. */
/begin MEASUREMENT CcsOutPtxIso1SvcDetailTxFlg "a rising edge on this signal triggers the transmission of the V2G ServiceDetailReq message to the EVSE" UBYTE CU_CCSOUTPTXISO1SVCDETAILTXFLG 1 100 0.0 1.0 ECU_ADDRESS 0x70018011 BYTE_ORDER MSB_LAST /end MEASUREMENT
/begin COMPU_METHOD CU_CCSOUTPTXISO1SVCDETAILTXFLG "Conversion method for CcsOutPtxIso1SvcDetailTxFlg" RAT_FUNC "%10.0" "b" COEFFS 0.000000 1.000000 -0.000000 0.000000 0.000000 1.000000 /end COMPU_METHOD
/* Scalar measurable for DDE 'CcsOutPtxIso1SvcDiscTxFlg'. */
/begin MEASUREMENT CcsOutPtxIso1SvcDiscTxFlg "a rising edge on this signal triggers the transmission of the V2G ServiceDiscoveryReq message to the EVSE" UBYTE CU_CCSOUTPTXISO1SVCDISCTXFLG 1 100 0.0 1.0 ECU_ADDRESS 0x70018475 BYTE_ORDER MSB_LAST /end MEASUREMENT
/begin COMPU_METHOD CU_CCSOUTPTXISO1SVCDISCTXFLG "Conversion method for CcsOutPtxIso1SvcDiscTxFlg" RAT_FUNC "%10.0" "b" COEFFS 0.000000 1.000000 -0.000000 0.000000 0.000000 1.000000 /end COMPU_METHOD
/* Scalar measurable for DDE 'CcsOutPtxIso1WeldDetTxFlg'. */
/begin MEASUREMENT CcsOutPtxIso1WeldDetTxFlg "a rising edge on this signal triggers the transmission of the V2G WeldingDetectionReq message to the EVSE" UBYTE CU_CCSOUTPTXISO1WELDDETTXFLG 1 100 0.0 1.0 ECU_ADDRESS 0x70017f6e BYTE_ORDER MSB_LAST /end MEASUREMENT
/begin COMPU_METHOD CU_CCSOUTPTXISO1WELDDETTXFLG "Conversion method for CcsOutPtxIso1WeldDetTxFlg" RAT_FUNC "%10.0" "b" COEFFS 0.000000 1.000000 -0.000000 0.000000 0.000000 1.000000 /end COMPU_METHOD
/* Scalar measurable for DDE 'CcsOutPtxIso2AuthTxFlg'. */
/begin MEASUREMENT CcsOutPtxIso2AuthTxFlg "a rising edge on this signal triggers the transmission of the V2G  AuthorizationReq message to the EVSE" UBYTE CU_CCSOUTPTXISO2AUTHTXFLG 1 100 0.0 1.0 ECU_ADDRESS 0x700183b5 BYTE_ORDER MSB_LAST /end MEASUREMENT
/begin COMPU_METHOD CU_CCSOUTPTXISO2AUTHTXFLG "Conversion method for CcsOutPtxIso2AuthTxFlg" RAT_FUNC "%10.0" "b" COEFFS 0.000000 1.000000 -0.000000 0.000000 0.000000 1.000000 /end COMPU_METHOD
/* Scalar measurable for DDE 'CcsOutPtxIso2BptCtrlTxFlg'. */
/begin MEASUREMENT CcsOutPtxIso2BptCtrlTxFlg "a rising edge on this signal triggers the transmission of the V2G DC_BidirectionalControlReq message to the EVSE" UBYTE CU_CCSOUTPTXISO2BPTCTRLTXFLG 1 100 0.0 1.0 ECU_ADDRESS 0x70017ec1 BYTE_ORDER MSB_LAST /end MEASUREMENT
/begin COMPU_METHOD CU_CCSOUTPTXISO2BPTCTRLTXFLG "Conversion method for CcsOutPtxIso2BptCtrlTxFlg" RAT_FUNC "%10.0" "b" COEFFS 0.000000 1.000000 -0.000000 0.000000 0.000000 1.000000 /end COMPU_METHOD
/* Scalar measurable for DDE 'CcsOutPtxIso2CblChkTxFlg'. */
/begin MEASUREMENT CcsOutPtxIso2CblChkTxFlg "a rising edge on this signal triggers the transmission of the V2G CableCheckReq message to the EVSE" UBYTE CU_CCSOUTPTXISO2CBLCHKTXFLG 1 100 0.0 1.0 ECU_ADDRESS 0x70018321 BYTE_ORDER MSB_LAST /end MEASUREMENT
/begin COMPU_METHOD CU_CCSOUTPTXISO2CBLCHKTXFLG "Conversion method for CcsOutPtxIso2CblChkTxFlg" RAT_FUNC "%10.0" "b" COEFFS 0.000000 1.000000 -0.000000 0.000000 0.000000 1.000000 /end COMPU_METHOD
/* Scalar measurable for DDE 'CcsOutPtxIso2ChgParDiscTxFlg'. */
/begin MEASUREMENT CcsOutPtxIso2ChgParDiscTxFlg "a rising edge on this signal triggers the transmission of the V2G ChargeParameterDiscoveryReq message to the EVSE" UBYTE CU_CCSOUTPTXISO2CHGPARDISCTXFLG 1 100 0.0 1.0 ECU_ADDRESS 0x70017e25 BYTE_ORDER MSB_LAST /end MEASUREMENT
/begin COMPU_METHOD CU_CCSOUTPTXISO2CHGPARDISCTXFLG "Conversion method for CcsOutPtxIso2ChgParDiscTxFlg" RAT_FUNC "%10.0" "b" COEFFS 0.000000 1.000000 -0.000000 0.000000 0.000000 1.000000 /end COMPU_METHOD
/* Scalar measurable for DDE 'CcsOutPtxIso2CrntDmdTxFlg'. */
/begin MEASUREMENT CcsOutPtxIso2CrntDmdTxFlg "a rising edge on this signal triggers the transmission of the V2G CurrentDemandReq message to the EVSE" UBYTE CU_CCSOUTPTXISO2CRNTDMDTXFLG 1 100 0.0 1.0 ECU_ADDRESS 0x70018276 BYTE_ORDER MSB_LAST /end MEASUREMENT
/begin COMPU_METHOD CU_CCSOUTPTXISO2CRNTDMDTXFLG "Conversion method for CcsOutPtxIso2CrntDmdTxFlg" RAT_FUNC "%10.0" "b" COEFFS 0.000000 1.000000 -0.000000 0.000000 0.000000 1.000000 /end COMPU_METHOD
/* Scalar measurable for DDE 'CcsOutPtxIso2PmtSelTxFlg'. */
/begin MEASUREMENT CcsOutPtxIso2PmtSelTxFlg "a rising edge on this signal triggers the transmission of the V2G PaymentServiceSelectionReq message to the EVSE" UBYTE CU_CCSOUTPTXISO2PMTSELTXFLG 1 100 0.0 1.0 ECU_ADDRESS 0x70017d89 BYTE_ORDER MSB_LAST /end MEASUREMENT
/begin COMPU_METHOD CU_CCSOUTPTXISO2PMTSELTXFLG "Conversion method for CcsOutPtxIso2PmtSelTxFlg" RAT_FUNC "%10.0" "b" COEFFS 0.000000 1.000000 -0.000000 0.000000 0.000000 1.000000 /end COMPU_METHOD
/* Scalar measurable for DDE 'CcsOutPtxIso2PreChgTxFlg'. */
/begin MEASUREMENT CcsOutPtxIso2PreChgTxFlg "a rising edge on this signal triggers the transmission of the V2G PreChargeReq message to the EVSE" UBYTE CU_CCSOUTPTXISO2PRECHGTXFLG 1 100 0.0 1.0 ECU_ADDRESS 0x700181b5 BYTE_ORDER MSB_LAST /end MEASUREMENT
/begin COMPU_METHOD CU_CCSOUTPTXISO2PRECHGTXFLG "Conversion method for CcsOutPtxIso2PreChgTxFlg" RAT_FUNC "%10.0" "b" COEFFS 0.000000 1.000000 -0.000000 0.000000 0.000000 1.000000 /end COMPU_METHOD
/* Scalar measurable for DDE 'CcsOutPtxIso2PwrDelShtdnTxFlg'. */
/begin MEASUREMENT CcsOutPtxIso2PwrDelShtdnTxFlg "a rising edge on this signal triggers the transmission of the second V2G PowerDeliveryReq message to the EVSE" UBYTE CU_CCSOUTPTXISO2PWRDELSHTDNTXF0 1 100 0.0 1.0 ECU_ADDRESS 0x70017c95 BYTE_ORDER MSB_LAST /end MEASUREMENT
/begin COMPU_METHOD CU_CCSOUTPTXISO2PWRDELSHTDNTXF0 "Conversion method for CcsOutPtxIso2PwrDelShtdnTxFlg" RAT_FUNC "%10.0" "b" COEFFS 0.000000 1.000000 -0.000000 0.000000 0.000000 1.000000 /end COMPU_METHOD
/* Scalar measurable for DDE 'CcsOutPtxIso2PwrDelivTxFlg'. */
/begin MEASUREMENT CcsOutPtxIso2PwrDelivTxFlg "a rising edge on this signal triggers the transmission of the V2G PowerDeliveryReq message to the EVSE" UBYTE CU_CCSOUTPTXISO2PWRDELIVTXFLG 1 100 0.0 1.0 ECU_ADDRESS 0x700180e9 BYTE_ORDER MSB_LAST /end MEASUREMENT
/begin COMPU_METHOD CU_CCSOUTPTXISO2PWRDELIVTXFLG "Conversion method for CcsOutPtxIso2PwrDelivTxFlg" RAT_FUNC "%10.0" "b" COEFFS 0.000000 1.000000 -0.000000 0.000000 0.000000 1.000000 /end COMPU_METHOD
/* Scalar measurable for DDE 'CcsOutPtxIso2SesSetupTxFlg'. */
/begin MEASUREMENT CcsOutPtxIso2SesSetupTxFlg "a rising edge on this signal triggers the transmission of the V2G SessionSetupReq message to the EVSE" UBYTE CU_CCSOUTPTXISO2SESSETUPTXFLG 1 100 0.0 1.0 ECU_ADDRESS 0x70017c0d BYTE_ORDER MSB_LAST /end MEASUREMENT
/begin COMPU_METHOD CU_CCSOUTPTXISO2SESSETUPTXFLG "Conversion method for CcsOutPtxIso2SesSetupTxFlg" RAT_FUNC "%10.0" "b" COEFFS 0.000000 1.000000 -0.000000 0.000000 0.000000 1.000000 /end COMPU_METHOD
/* Scalar measurable for DDE 'CcsOutPtxIso2SesStopTxFlg'. */
/begin MEASUREMENT CcsOutPtxIso2SesStopTxFlg "a rising edge on this signal triggers the transmission of the V2G SessionStopReq message to the EVSE" UBYTE CU_CCSOUTPTXISO2SESSTOPTXFLG 1 100 0.0 1.0 ECU_ADDRESS 0x70017fb1 BYTE_ORDER MSB_LAST /end MEASUREMENT
/begin COMPU_METHOD CU_CCSOUTPTXISO2SESSTOPTXFLG "Conversion method for CcsOutPtxIso2SesStopTxFlg" RAT_FUNC "%10.0" "b" COEFFS 0.000000 1.000000 -0.000000 0.000000 0.000000 1.000000 /end COMPU_METHOD
/* Scalar measurable for DDE 'CcsOutPtxIso2SvcDetailTxFlg'. */
/begin MEASUREMENT CcsOutPtxIso2SvcDetailTxFlg "a rising edge on this signal triggers the transmission of the V2G ServiceDetailReq message to the EVSE" UBYTE CU_CCSOUTPTXISO2SVCDETAILTXFLG 1 100 0.0 1.0 ECU_ADDRESS 0x70018432 BYTE_ORDER MSB_LAST /end MEASUREMENT
/begin COMPU_METHOD CU_CCSOUTPTXISO2SVCDETAILTXFLG "Conversion method for CcsOutPtxIso2SvcDetailTxFlg" RAT_FUNC "%10.0" "b" COEFFS 0.000000 1.000000 -0.000000 0.000000 0.000000 1.000000 /end COMPU_METHOD
/* Scalar measurable for DDE 'CcsOutPtxIso2SvcDiscTxFlg'. */
/begin MEASUREMENT CcsOutPtxIso2SvcDiscTxFlg "a rising edge on this signal triggers the transmission of the V2G ServiceDiscoveryReq message to the EVSE" UBYTE CU_CCSOUTPTXISO2SVCDISCTXFLG 1 100 0.0 1.0 ECU_ADDRESS 0x70017efd BYTE_ORDER MSB_LAST /end MEASUREMENT
/begin COMPU_METHOD CU_CCSOUTPTXISO2SVCDISCTXFLG "Conversion method for CcsOutPtxIso2SvcDiscTxFlg" RAT_FUNC "%10.0" "b" COEFFS 0.000000 1.000000 -0.000000 0.000000 0.000000 1.000000 /end COMPU_METHOD
/* Scalar measurable for DDE 'CcsOutPtxIso2WeldDetTxFlg'. */
/begin MEASUREMENT CcsOutPtxIso2WeldDetTxFlg "a rising edge on this signal triggers the transmission of the V2G WeldingDetectionReq message to the EVSE" UBYTE CU_CCSOUTPTXISO2WELDDETTXFLG 1 100 0.0 1.0 ECU_ADDRESS 0x70018371 BYTE_ORDER MSB_LAST /end MEASUREMENT
/begin COMPU_METHOD CU_CCSOUTPTXISO2WELDDETTXFLG "Conversion method for CcsOutPtxIso2WeldDetTxFlg" RAT_FUNC "%10.0" "b" COEFFS 0.000000 1.000000 -0.000000 0.000000 0.000000 1.000000 /end COMPU_METHOD
/* Scalar measurable for DDE 'CcsOutPtxMsgTransmitError'. */
/begin MEASUREMENT CcsOutPtxMsgTransmitError "is set to 1 if an error occurs while transmitting any of the V2G messages from PiCCs. This error is set by OE when it fails to process the input signals of a V2G TX message." UBYTE CU_CCSOUTPTXMSGTRANSMITERROR 1 100 0.0 1.0 ECU_ADDRESS 0x70017e6e BYTE_ORDER MSB_LAST /end MEASUREMENT
/begin COMPU_METHOD CU_CCSOUTPTXMSGTRANSMITERROR "Conversion method for CcsOutPtxMsgTransmitError" RAT_FUNC "%10.0" "b" COEFFS 0.000000 1.000000 -0.000000 0.000000 0.000000 1.000000 /end COMPU_METHOD
/* Scalar measurable for DDE 'CcsOutPtxSuppAppProtoTxFlg'. */
/begin MEASUREMENT CcsOutPtxSuppAppProtoTxFlg "a rising edge on this signal triggers the transmission of the V2G SupportedAppProtocolReq message to the EVSE" UBYTE CU_CCSOUTPTXSUPPAPPPROTOTXFLG 1 100 0.0 1.0 ECU_ADDRESS 0x700182b8 BYTE_ORDER MSB_LAST /end MEASUREMENT
/begin COMPU_METHOD CU_CCSOUTPTXSUPPAPPPROTOTXFLG "Conversion method for CcsOutPtxSuppAppProtoTxFlg" RAT_FUNC "%10.0" "b" COEFFS 0.000000 1.000000 -0.000000 0.000000 0.000000 1.000000 /end COMPU_METHOD
/* Scalar measurable for DDE 'CcsPilotClear'. */
/begin MEASUREMENT CcsPilotClear "Pilot Peak Reset signal from the Reset Timer block" UBYTE CU_CCSPILOTCLEAR 1 100 0.0 255.0 ECU_ADDRESS 0x70019edc BYTE_ORDER MSB_LAST /end MEASUREMENT
/begin COMPU_METHOD CU_CCSPILOTCLEAR "Conversion method for CcsPilotClear" RAT_FUNC "%10.0" "(not defined)" COEFFS 0.000000 1.000000 -0.000000 0.000000 0.000000 1.000000 /end COMPU_METHOD
/* Scalar measurable for DDE 'CcsStmState'. */
/begin MEASUREMENT CcsStmState "enumerated state of state-machine that controls the sequence of charge seesion" SLONG CU_CCSSTMSTATE 1 100 -2147483648.0 2147483647.0 ECU_ADDRESS 0x70017dc8 BYTE_ORDER MSB_LAST /end MEASUREMENT
/begin COMPU_METHOD CU_CCSSTMSTATE "Conversion method for CcsStmState" TAB_VERB "%12.0" "enum" COMPU_TAB_REF CT_CCSSTMSTATE /end COMPU_METHOD
/begin COMPU_VTAB CT_CCSSTMSTATE "Conversion method for CcsStmState" TAB_VERB 45 0 "V2G_CHARGER_DISCON" 31 "V2G_WAITFOR_IDENTIFYING_CHG_MODE" 1 "V2G_ENABLE_QCA" 2 "V2G_INIT_SLAC_ASSOC" 3 "V2G_INIT_APP_PROTOCOL" 4 "V2G_INIT_SESSION_SETUP" 5 "V2G_INIT_SERVICE_DISCOV" 40 "V2G_INIT_SERVICE_DETAIL" 6 "V2G_INIT_PAYMENT_SEL" 7 "V2G_INIT_CONTRACT_AUTHEN" 8 "V2G_INIT_CHG_PARAM_DISCOV" 9 "V2G_INIT_CHG_INLET_LOCK_ENABLE" 10 "V2G_ISOL_EV_STOP_ISOL_MONITOR" 11 "V2G_ISOL_CABLE_CHECK" 12 "V2G_PRECHG_PRECHARGING" 13 "V2G_PRECHG_CLOSE_CHARGE_RELAYS" 14 "V2G_PRECHG_POWERDELIVERY" 15 "V2G_ENGYTRNSF_CRNT_DEMAND" 16 "V2G_NORMSHUTDN_POWERDELIVERY" 17 "V2G_NORMSHUTDN_WAIT_ZEROCURRENT" 18 "V2G_NORMSHUTDN_PILOT_B2" 19 "V2G_NORMSHUTDN_WELD_DETECT" 20 "V2G_NORMSHUTDN_OPEN_CHARGE_RELAYS" 21 "V2G_NORMSHUTDN_SESSION_STOP" 22 "V2G_NORMSHUTDN_TERMINATE_TCP_LINK" 23 "V2G_NORMSHUTDN_INLET_VOLT_SAFELEVEL" 24 "V2G_NORMSHUTDN_CHG_SESSION_COMPLETE" 25 "V2G_VEHSHUTDN_SESSION_STOP" 26 "V2G_VEHSHUTDN_TERMINATE_TCP_LINK" 27 "V2G_VEHSHUTDN_OPEN_CHARGE_RELAYS" 28 "V2G_VEHSHUTDN_COMPLETE" 29 "V2G_EVSESHUTDN_TERMINATE_TCP_LINK" 30 "V2G_EVSESHUTDN_OPEN_CHARGE_RELAYS" 32 "V2G_EVSESHUTDN_COMPLETE" 33 "V2G_AC_VERIFY_PROX_S3_CLOSED" 34 "V2G_AC_CLOSE_PILOT_S2_READY" 35 "V2G_AC_WAIT_EVSE_COTACTOR_CLOSE" 36 "V2G_AC_DRAW_ENERGY" 37 "V2G_AC_SHUTDN_WAIT_CRNT_ZERO" 38 "V2G_AC_SHUTDN_COMPLETE_WAIT_UNPLUG" 39 "V2G_AC_SHUTDN_UNEXPECTED_ERR" 41 "V2G_ENGYTRNSF_BPT" 42 "V2G_POWERDELIVERY_RENEG" 43 "V2G_CHG_PARAM_DISC_RENEG" 44 "V2G_ENGYTRNSF_ZEROCURRENT" /end COMPU_VTAB
/* Scalar measurable for DDE 'CcsStmV2gConnectInit'. */
/begin MEASUREMENT CcsStmV2gConnectInit "command for establishing the communication link with EVSE (EV-EVSE assosiation)." UBYTE CU_CCSSTMV2GCONNECTINIT 1 100 0.0 1.0 ECU_ADDRESS 0x70018209 BYTE_ORDER MSB_LAST /end MEASUREMENT
/begin COMPU_METHOD CU_CCSSTMV2GCONNECTINIT "Conversion method for CcsStmV2gConnectInit" RAT_FUNC "%10.0" "b" COEFFS 0.000000 1.000000 -0.000000 0.000000 0.000000 1.000000 /end COMPU_METHOD
/* Scalar measurable for DDE 'CcsStmV2gConnectTerminate'. */
/begin MEASUREMENT CcsStmV2gConnectTerminate "command for terminating the communication link with EVSE." UBYTE CU_CCSSTMV2GCONNECTTERMINATE 1 100 0.0 1.0 ECU_ADDRESS 0x70017d25 BYTE_ORDER MSB_LAST /end MEASUREMENT
/begin COMPU_METHOD CU_CCSSTMV2GCONNECTTERMINATE "Conversion method for CcsStmV2gConnectTerminate" RAT_FUNC "%10.0" "b" COEFFS 0.000000 1.000000 -0.000000 0.000000 0.000000 1.000000 /end COMPU_METHOD
/* Scalar measurable for DDE 'CcsStmV2gPilotPulldownEn'. */
/begin MEASUREMENT CcsStmV2gPilotPulldownEn "command for enabling the internal digital output for Pilot pulldown (According to SAE J1772 F.1.8 this means entering C or D mode for Piliot signal)" UBYTE CU_CCSSTMV2GPILOTPULLDOWNEN 1 100 0.0 1.0 ECU_ADDRESS 0x7001817d BYTE_ORDER MSB_LAST /end MEASUREMENT
/begin COMPU_METHOD CU_CCSSTMV2GPILOTPULLDOWNEN "Conversion method for CcsStmV2gPilotPulldownEn" RAT_FUNC "%10.0" "b" COEFFS 0.000000 1.000000 -0.000000 0.000000 0.000000 1.000000 /end COMPU_METHOD
/* Scalar measurable for DDE 'CcsStmV2gQcaEn'. */
/begin MEASUREMENT CcsStmV2gQcaEn "command for enabling the V2G QCA chip on the PCB board" UBYTE CU_CCSSTMV2GQCAEN 1 100 0.0 1.0 ECU_ADDRESS 0x70017c51 BYTE_ORDER MSB_LAST /end MEASUREMENT
/begin COMPU_METHOD CU_CCSSTMV2GQCAEN "Conversion method for CcsStmV2gQcaEn" RAT_FUNC "%10.0" "b" COEFFS 0.000000 1.000000 -0.000000 0.000000 0.000000 1.000000 /end COMPU_METHOD
/* Scalar measurable for DDE 'CcsStmV2gStMsgTx'. */
/begin MEASUREMENT CcsStmV2gStMsgTx "enumerated state of state-machine that controls the transmission of PLC messages to the EVSE" SLONG CU_CCSSTMV2GSTMSGTX 1 100 -2147483648.0 2147483647.0 ECU_ADDRESS 0x70018014 BYTE_ORDER MSB_LAST /end MEASUREMENT
/begin COMPU_METHOD CU_CCSSTMV2GSTMSGTX "Conversion method for CcsStmV2gStMsgTx" TAB_VERB "%12.0" "enum" COMPU_TAB_REF CT_CCSSTMV2GSTMSGTX /end COMPU_METHOD
/begin COMPU_VTAB CT_CCSSTMV2GSTMSGTX "Conversion method for CcsStmV2gStMsgTx" TAB_VERB 16 0 "V2G_MSGTX_RESEND" 1 "V2G_MSGTX_SEND_SESSETUP" 2 "V2G_MSGTX_SEND_SVCDISCV" 15 "V2G_MSGTX_SEND_SVCDETAIL" 3 "V2G_MSGTX_SEND_PMTSEL" 4 "V2G_MSGTX_SEND_AUTH" 5 "V2G_MSGTX_SEND_CHGPARDISC" 6 "V2G_MSGTX_SEND_CBLCHK" 7 "V2G_MSGTX_SEND_PRECHG" 8 "V2G_MSGTX_SEND_PWRDELIV" 9 "V2G_MSGTX_SEND_CRNTDMD" 10 "V2G_MSGTX_SEND_PWRDELIV_SHUTDN" 11 "V2G_MSGTX_SEND_WELDDET" 12 "V2G_MSGTX_SEND_SESSTOP" 13 "V2G_SEND_SUPPORTEDPROTO" 14 "V2G_SEND_ISO2_BPTCTRL" /end COMPU_VTAB
/* Scalar measurable for DDE 'CcsVersionMajor'. */
/begin MEASUREMENT CcsVersionMajor "Pi-CCS Major Version Number" UBYTE CU_CCSVERSIONMAJOR 1 100 0.0 255.0 ECU_ADDRESS 0x70018476 BYTE_ORDER MSB_LAST /end MEASUREMENT
/begin COMPU_METHOD CU_CCSVERSIONMAJOR "Conversion method for CcsVersionMajor" RAT_FUNC "%10.0" "1" COEFFS 0.000000 1.000000 -0.000000 0.000000 0.000000 1.000000 /end COMPU_METHOD
/* Scalar measurable for DDE 'CcsVersionMinor'. */
/begin MEASUREMENT CcsVersionMinor "Pi-CCS Minor Version Number" UBYTE CU_CCSVERSIONMINOR 1 100 0.0 255.0 ECU_ADDRESS 0x70017f6f BYTE_ORDER MSB_LAST /end MEASUREMENT
/begin COMPU_METHOD CU_CCSVERSIONMINOR "Conversion method for CcsVersionMinor" RAT_FUNC "%10.0" "1" COEFFS 0.000000 1.000000 -0.000000 0.000000 0.000000 1.000000 /end COMPU_METHOD
/* Scalar measurable for DDE 'CcsVersionSubMinor'. */
/begin MEASUREMENT CcsVersionSubMinor "Pi-CCS Sub minor Version Number" UBYTE CU_CCSVERSIONSUBMINOR 1 100 0.0 255.0 ECU_ADDRESS 0x700183b6 BYTE_ORDER MSB_LAST /end MEASUREMENT
/begin COMPU_METHOD CU_CCSVERSIONSUBMINOR "Conversion method for CcsVersionSubMinor" RAT_FUNC "%10.0" "1" COEFFS 0.000000 1.000000 -0.000000 0.000000 0.000000 1.000000 /end COMPU_METHOD
/* Scalar measurable for DDE 'CmdCANAWAKE'. */
/begin MEASUREMENT CmdCANAWAKE "EcuRunning OR NotShutdownFromLowBatt" UBYTE CU_CMDCANAWAKE 1 100 0.0 255.0 ECU_ADDRESS 0x7001a15c BYTE_ORDER MSB_LAST /end MEASUREMENT
/begin COMPU_METHOD CU_CMDCANAWAKE "Conversion method for CmdCANAWAKE" RAT_FUNC "%10.0" "(not defined)" COEFFS 0.000000 1.000000 -0.000000 0.000000 0.000000 1.000000 /end COMPU_METHOD
/* Scalar measurable for DDE 'CtlEcuPsuPowerHold'. */
/begin MEASUREMENT CtlEcuPsuPowerHold "True value indicates the ECU power is currently being held by one of its own digital outputs, note that one of ECU extenal wakeup sources might still be active and holding ECU power" UBYTE CU_CTLECUPSUPOWERHOLD 1 100 0.0 1.0 ECU_ADDRESS 0x70017ec2 BYTE_ORDER MSB_LAST /end MEASUREMENT
/begin COMPU_METHOD CU_CTLECUPSUPOWERHOLD "Conversion method for CtlEcuPsuPowerHold" RAT_FUNC "%10.0" "b" COEFFS 0.000000 1.000000 -0.000000 0.000000 0.000000 1.000000 /end COMPU_METHOD
/* Scalar measurable for DDE 'D3_AinE_MaxFlt'. */
/begin MEASUREMENT D3_AinE_MaxFlt "AinE/ChgLock above max threshold latched after debounce (CCU pin D3)" UBYTE CU_D3_AINE_MAXFLT 1 100 0.0 1.0 ECU_ADDRESS 0x7001a0d8 BYTE_ORDER MSB_LAST /end MEASUREMENT
/begin COMPU_METHOD CU_D3_AINE_MAXFLT "Conversion method for D3_AinE_MaxFlt" RAT_FUNC "%10.0" "(not defined)" COEFFS 0.000000 1.000000 -0.000000 0.000000 0.000000 1.000000 /end COMPU_METHOD
/* Scalar measurable for DDE 'D3_AinE_MaxFltActv'. */
/begin MEASUREMENT D3_AinE_MaxFltActv "Active fault high D3 (Max fault no latch or debounce)" UBYTE CU_D3_AINE_MAXFLTACTV 1 100 0.0 1.0 ECU_ADDRESS 0x7001a050 BYTE_ORDER MSB_LAST /end MEASUREMENT
/begin COMPU_METHOD CU_D3_AINE_MAXFLTACTV "Conversion method for D3_AinE_MaxFltActv" RAT_FUNC "%10.0" "(not defined)" COEFFS 0.000000 1.000000 -0.000000 0.000000 0.000000 1.000000 /end COMPU_METHOD
/* Scalar measurable for DDE 'D3_AinE_MinFlt'. */
/begin MEASUREMENT D3_AinE_MinFlt "AinE/ChgLock below min threshold latched after debounce (CCU pin D3)" UBYTE CU_D3_AINE_MINFLT 1 100 0.0 1.0 ECU_ADDRESS 0x70019fd8 BYTE_ORDER MSB_LAST /end MEASUREMENT
/begin COMPU_METHOD CU_D3_AINE_MINFLT "Conversion method for D3_AinE_MinFlt" RAT_FUNC "%10.0" "(not defined)" COEFFS 0.000000 1.000000 -0.000000 0.000000 0.000000 1.000000 /end COMPU_METHOD
/* Scalar measurable for DDE 'D3_AinE_MinFltActv'. */
/begin MEASUREMENT D3_AinE_MinFltActv "Active fault low D3 (Min fault no latch or debounce)" UBYTE CU_D3_AINE_MINFLTACTV 1 100 0.0 1.0 ECU_ADDRESS 0x70019f49 BYTE_ORDER MSB_LAST /end MEASUREMENT
/begin COMPU_METHOD CU_D3_AINE_MINFLTACTV "Conversion method for D3_AinE_MinFltActv" RAT_FUNC "%10.0" "(not defined)" COEFFS 0.000000 1.000000 -0.000000 0.000000 0.000000 1.000000 /end COMPU_METHOD
/* Scalar measurable for DDE 'DinAuthEvseProcessingSt'. */
/begin MEASUREMENT DinAuthEvseProcessingSt "Message YB: Parameter indicating that the EVSE has finished the processing that was initiated after the ContractAuthenticationReq or that the EVSE is still processing at the time the response message was sent." UBYTE CU_DINAUTHEVSEPROCESSINGST 1 100 0.0 255.0 ECU_ADDRESS 0x70018322 BYTE_ORDER MSB_LAST /end MEASUREMENT
/begin COMPU_METHOD CU_DINAUTHEVSEPROCESSINGST "Conversion method for DinAuthEvseProcessingSt" RAT_FUNC "%10.0" "enum" COEFFS 0.000000 1.000000 -0.000000 0.000000 0.000000 1.000000 /end COMPU_METHOD
/* Scalar measurable for DDE 'DinCblChkEvseIsolStatusFlg'. */
/begin MEASUREMENT DinCblChkEvseIsolStatusFlg "Identifies the presence of the EVSEIsolationStatus parameter." UBYTE CU_DINCBLCHKEVSEISOLSTATUSFLG 1 100 0.0 1.0 ECU_ADDRESS 0x70017e26 BYTE_ORDER MSB_LAST /end MEASUREMENT
/begin COMPU_METHOD CU_DINCBLCHKEVSEISOLSTATUSFLG "Conversion method for DinCblChkEvseIsolStatusFlg" RAT_FUNC "%10.0" "b" COEFFS 0.000000 1.000000 -0.000000 0.000000 0.000000 1.000000 /end COMPU_METHOD
/* Scalar measurable for DDE 'DinChgParDiscRxTrg'. */
/begin MEASUREMENT DinChgParDiscRxTrg "Trigger falg that on a rising edge indicates the event for receiving the PLC (V2G) message response 3b from EVSE" UBYTE CU_DINCHGPARDISCRXTRG 1 100 0.0 1.0 ECU_ADDRESS 0x70018277 BYTE_ORDER MSB_LAST /end MEASUREMENT
/begin COMPU_METHOD CU_DINCHGPARDISCRXTRG "Conversion method for DinChgParDiscRxTrg" RAT_FUNC "%10.0" "b" COEFFS 0.000000 1.000000 -0.000000 0.000000 0.000000 1.000000 /end COMPU_METHOD
/* Scalar measurable for DDE 'DinCrntDmdEvseCrntMaxLimFlg'. */
/begin MEASUREMENT DinCrntDmdEvseCrntMaxLimFlg "Indicates that the EVSEMaximumCurrentLimit parameter is available." UBYTE CU_DINCRNTDMDEVSECRNTMAXLIMFLG 1 100 0.0 1.0 ECU_ADDRESS 0x70017d8a BYTE_ORDER MSB_LAST /end MEASUREMENT
/begin COMPU_METHOD CU_DINCRNTDMDEVSECRNTMAXLIMFLG "Conversion method for DinCrntDmdEvseCrntMaxLimFlg" RAT_FUNC "%10.0" "b" COEFFS 0.000000 1.000000 -0.000000 0.000000 0.000000 1.000000 /end COMPU_METHOD
/* Scalar measurable for DDE 'DinCrntDmdEvseIsolStatusFlg'. */
/begin MEASUREMENT DinCrntDmdEvseIsolStatusFlg "Identifies the presence of the EVSEIsolationStatus parameter." UBYTE CU_DINCRNTDMDEVSEISOLSTATUSFLG 1 100 0.0 1.0 ECU_ADDRESS 0x700181b6 BYTE_ORDER MSB_LAST /end MEASUREMENT
/begin COMPU_METHOD CU_DINCRNTDMDEVSEISOLSTATUSFLG "Conversion method for DinCrntDmdEvseIsolStatusFlg" RAT_FUNC "%10.0" "b" COEFFS 0.000000 1.000000 -0.000000 0.000000 0.000000 1.000000 /end COMPU_METHOD
/* Scalar measurable for DDE 'DinCrntDmdEvsePwrLimReached'. */
/begin MEASUREMENT DinCrntDmdEvsePwrLimReached "If set to TRUE, the EVSE has reached its power limit." UBYTE CU_DINCRNTDMDEVSEPWRLIMREACHED 1 100 0.0 1.0 ECU_ADDRESS 0x70017c96 BYTE_ORDER MSB_LAST /end MEASUREMENT
/begin COMPU_METHOD CU_DINCRNTDMDEVSEPWRLIMREACHED "Conversion method for DinCrntDmdEvsePwrLimReached" RAT_FUNC "%10.0" "b" COEFFS 0.000000 1.000000 -0.000000 0.000000 0.000000 1.000000 /end COMPU_METHOD
/* Scalar measurable for DDE 'DinCrntDmdEvseStatusCode'. */
/begin MEASUREMENT DinCrntDmdEvseStatusCode "Indicates the internal state of the EVSE." UBYTE CU_DINCRNTDMDEVSESTATUSCODE 1 100 0.0 255.0 ECU_ADDRESS 0x700180ea BYTE_ORDER MSB_LAST /end MEASUREMENT
/begin COMPU_METHOD CU_DINCRNTDMDEVSESTATUSCODE "Conversion method for DinCrntDmdEvseStatusCode" RAT_FUNC "%10.0" "enum" COEFFS 0.000000 1.000000 -0.000000 0.000000 0.000000 1.000000 /end COMPU_METHOD
/* Scalar measurable for DDE 'DinCrntDmdEvseVolt'. */
/begin MEASUREMENT DinCrntDmdEvseVolt "Present voltage of EVSE" FLOAT32_IEEE CU_DINCRNTDMDEVSEVOLT 1 100 0.0 196605.0 ECU_ADDRESS 0x70017c10 BYTE_ORDER MSB_LAST /end MEASUREMENT
/begin COMPU_METHOD CU_DINCRNTDMDEVSEVOLT "Conversion method for DinCrntDmdEvseVolt" RAT_FUNC "%10.0" "V" COEFFS 0.000000 1.000000 -0.000000 0.000000 0.000000 1.000000 /end COMPU_METHOD
/* Scalar measurable for DDE 'DinCrntDmdEvseVoltMaxLim'. */
/begin MEASUREMENT DinCrntDmdEvseVoltMaxLim "Maximum voltage the EVSE can deliver" FLOAT32_IEEE CU_DINCRNTDMDEVSEVOLTMAXLIM 1 100 0.0 196605.0 ECU_ADDRESS 0x70017fb4 BYTE_ORDER MSB_LAST /end MEASUREMENT
/begin COMPU_METHOD CU_DINCRNTDMDEVSEVOLTMAXLIM "Conversion method for DinCrntDmdEvseVoltMaxLim" RAT_FUNC "%10.0" "V" COEFFS 0.000000 1.000000 -0.000000 0.000000 0.000000 1.000000 /end COMPU_METHOD
/* Scalar measurable for DDE 'DinCrntDmdEvseVoltMaxLimFlg'. */
/begin MEASUREMENT DinCrntDmdEvseVoltMaxLimFlg "Indicates that the EVSEMaximumVoltageLimit parameter is available." UBYTE CU_DINCRNTDMDEVSEVOLTMAXLIMFLG 1 100 0.0 1.0 ECU_ADDRESS 0x70018433 BYTE_ORDER MSB_LAST /end MEASUREMENT
/begin COMPU_METHOD CU_DINCRNTDMDEVSEVOLTMAXLIMFLG "Conversion method for DinCrntDmdEvseVoltMaxLimFlg" RAT_FUNC "%10.0" "b" COEFFS 0.000000 1.000000 -0.000000 0.000000 0.000000 1.000000 /end COMPU_METHOD
/* Scalar measurable for DDE 'DinDcChgParDiscEvseEgyDeliverableFlg'. */
/begin MEASUREMENT DinDcChgParDiscEvseEgyDelivera0 "Indicated the presente of the amount of energy signal to be delivered by the EVSE." UBYTE CU_DINDCCHGPARDISCEVSEEGYDELIV0 1 100 0.0 1.0 ECU_ADDRESS 0x70017efe BYTE_ORDER MSB_LAST /end MEASUREMENT
/begin COMPU_METHOD CU_DINDCCHGPARDISCEVSEEGYDELIV0 "Conversion method for DinDcChgParDiscEvseEgyDeliverableFlg" RAT_FUNC "%10.0" "b" COEFFS 0.000000 1.000000 -0.000000 0.000000 0.000000 1.000000 /end COMPU_METHOD
/* Scalar measurable for DDE 'DinDcChgParDiscEvsePwrMaxLimFlg'. */
/begin MEASUREMENT DinDcChgParDiscEvsePwrMaxLimFlg "Identifies the presence of the EVSEMaximumPower parameter." UBYTE CU_DINDCCHGPARDISCEVSEPWRMAXLI0 1 100 0.0 1.0 ECU_ADDRESS 0x70018372 BYTE_ORDER MSB_LAST /end MEASUREMENT
/begin COMPU_METHOD CU_DINDCCHGPARDISCEVSEPWRMAXLI0 "Conversion method for DinDcChgParDiscEvsePwrMaxLimFlg" RAT_FUNC "%10.0" "b" COEFFS 0.000000 1.000000 -0.000000 0.000000 0.000000 1.000000 /end COMPU_METHOD
/* Scalar measurable for DDE 'DinDcChgParDiscEvseVoltMaxLim'. */
/begin MEASUREMENT DinDcChgParDiscEvseVoltMaxLim "Maximum voltage the EVSE can deliver" FLOAT32_IEEE CU_DINDCCHGPARDISCEVSEVOLTMAXL0 1 100 0.0 196605.0 ECU_ADDRESS 0x70017e70 BYTE_ORDER MSB_LAST /end MEASUREMENT
/begin COMPU_METHOD CU_DINDCCHGPARDISCEVSEVOLTMAXL0 "Conversion method for DinDcChgParDiscEvseVoltMaxLim" RAT_FUNC "%10.0" "V" COEFFS 0.000000 1.000000 -0.000000 0.000000 0.000000 1.000000 /end COMPU_METHOD
/* Scalar measurable for DDE 'DinPmtSelRxTrg'. */
/begin MEASUREMENT DinPmtSelRxTrg "Trigger falg that on a rising edge indicates the event for receiving the PLC (V2G) message response Xb from EVSE" UBYTE CU_DINPMTSELRXTRG 1 100 0.0 1.0 ECU_ADDRESS 0x700182b9 BYTE_ORDER MSB_LAST /end MEASUREMENT
/begin COMPU_METHOD CU_DINPMTSELRXTRG "Conversion method for DinPmtSelRxTrg" RAT_FUNC "%10.0" "b" COEFFS 0.000000 1.000000 -0.000000 0.000000 0.000000 1.000000 /end COMPU_METHOD
/* Scalar measurable for DDE 'DinPreChgResponseCode'. */
/begin MEASUREMENT DinPreChgResponseCode "for message 5b: indicates the acknowledgment status of  this V2G messages received by the SECC." UBYTE CU_DINPRECHGRESPONSECODE 1 100 0.0 255.0 ECU_ADDRESS 0x70017dcc BYTE_ORDER MSB_LAST /end MEASUREMENT
/begin COMPU_METHOD CU_DINPRECHGRESPONSECODE "Conversion method for DinPreChgResponseCode" RAT_FUNC "%10.0" "1" COEFFS 0.000000 1.000000 -0.000000 0.000000 0.000000 1.000000 /end COMPU_METHOD
/* Scalar measurable for DDE 'DinPwrDelivDcEvseStatusFlg'. */
/begin MEASUREMENT DinPwrDelivDcEvseStatusFlg "Identifies the presence of the EVSEStatusCode parameter." UBYTE CU_DINPWRDELIVDCEVSESTATUSFLG 1 100 0.0 1.0 ECU_ADDRESS 0x7001820a BYTE_ORDER MSB_LAST /end MEASUREMENT
/begin COMPU_METHOD CU_DINPWRDELIVDCEVSESTATUSFLG "Conversion method for DinPwrDelivDcEvseStatusFlg" RAT_FUNC "%10.0" "b" COEFFS 0.000000 1.000000 -0.000000 0.000000 0.000000 1.000000 /end COMPU_METHOD
/* Scalar measurable for DDE 'DinPwrDelivEvseIsolSt'. */
/begin MEASUREMENT DinPwrDelivEvseIsolSt "Indicates the isolation condition" UBYTE CU_DINPWRDELIVEVSEISOLST 1 100 0.0 255.0 ECU_ADDRESS 0x70017d26 BYTE_ORDER MSB_LAST /end MEASUREMENT
/begin COMPU_METHOD CU_DINPWRDELIVEVSEISOLST "Conversion method for DinPwrDelivEvseIsolSt" RAT_FUNC "%10.0" "enum" COEFFS 0.000000 1.000000 -0.000000 0.000000 0.000000 1.000000 /end COMPU_METHOD
/* Scalar measurable for DDE 'DinPwrDelivEvseStatusCode'. */
/begin MEASUREMENT DinPwrDelivEvseStatusCode "Indicates the internal state of the EVSE." UBYTE CU_DINPWRDELIVEVSESTATUSCODE 1 100 0.0 255.0 ECU_ADDRESS 0x7001817e BYTE_ORDER MSB_LAST /end MEASUREMENT
/begin COMPU_METHOD CU_DINPWRDELIVEVSESTATUSCODE "Conversion method for DinPwrDelivEvseStatusCode" RAT_FUNC "%10.0" "enum" COEFFS 0.000000 1.000000 -0.000000 0.000000 0.000000 1.000000 /end COMPU_METHOD
/* Scalar measurable for DDE 'DinPwrDelivResponseCode'. */
/begin MEASUREMENT DinPwrDelivResponseCode "for message 6b: indicates the acknowledgment status of  this V2G messages received by the SECC." UBYTE CU_DINPWRDELIVRESPONSECODE 1 100 0.0 255.0 ECU_ADDRESS 0x70017c52 BYTE_ORDER MSB_LAST /end MEASUREMENT
/begin COMPU_METHOD CU_DINPWRDELIVRESPONSECODE "Conversion method for DinPwrDelivResponseCode" RAT_FUNC "%10.0" "1" COEFFS 0.000000 1.000000 -0.000000 0.000000 0.000000 1.000000 /end COMPU_METHOD
/* Scalar measurable for DDE 'DinPwrDelivRxTrg'. */
/begin MEASUREMENT DinPwrDelivRxTrg "Trigger falg that on a rising edge indicates the event for receiving the PLC (V2G) message response 6b from EVSE" UBYTE CU_DINPWRDELIVRXTRG 1 100 0.0 1.0 ECU_ADDRESS 0x70018018 BYTE_ORDER MSB_LAST /end MEASUREMENT
/begin COMPU_METHOD CU_DINPWRDELIVRXTRG "Conversion method for DinPwrDelivRxTrg" RAT_FUNC "%10.0" "b" COEFFS 0.000000 1.000000 -0.000000 0.000000 0.000000 1.000000 /end COMPU_METHOD
/* Scalar measurable for DDE 'DinSesSetupEvseIdLen'. */
/begin MEASUREMENT DinSesSetupEvseIdLen "Number of bytes in EVSE ID" UBYTE CU_DINSESSETUPEVSEIDLEN 1 100 0.0 37.0 ECU_ADDRESS 0x70018477 BYTE_ORDER MSB_LAST /end MEASUREMENT
/begin COMPU_METHOD CU_DINSESSETUPEVSEIDLEN "Conversion method for DinSesSetupEvseIdLen" RAT_FUNC "%10.0" "1" COEFFS 0.000000 1.000000 -0.000000 0.000000 0.000000 1.000000 /end COMPU_METHOD
/* Scalar measurable for DDE 'DinSesStopResponseCode'. */
/begin MEASUREMENT DinSesStopResponseCode "for message 10b: indicates the acknowledgment status of  this V2G messages received by the SECC." UBYTE CU_DINSESSTOPRESPONSECODE 1 100 0.0 255.0 ECU_ADDRESS 0x70017f70 BYTE_ORDER MSB_LAST /end MEASUREMENT
/begin COMPU_METHOD CU_DINSESSTOPRESPONSECODE "Conversion method for DinSesStopResponseCode" RAT_FUNC "%10.0" "1" COEFFS 0.000000 1.000000 -0.000000 0.000000 0.000000 1.000000 /end COMPU_METHOD
/* Scalar measurable for DDE 'mpl_pkn_pxros_performance.stack.isr.status'. */
/begin MEASUREMENT mpl_pkn_pxros_performance.stac3 "Current status of stack performance measurement for task: pkn_pxros_performance" SLONG CU_MPL_PKN_PXROS_PERFORMANCE.S3 1 100 0.0 255.0 ECU_ADDRESS 0x700173b0 BYTE_ORDER MSB_LAST /end MEASUREMENT
/begin COMPU_METHOD CU_MPL_PKN_PXROS_PERFORMANCE.S3 "Conversion method for mpl_pkn_pxros_performance.stack.isr.status" TAB_VERB "%12.0" "(not defined)" COMPU_TAB_REF CT_MPL_PKN_PXROS_PERFORMANCE.S3 /end COMPU_METHOD
/begin COMPU_VTAB CT_MPL_PKN_PXROS_PERFORMANCE.S3 "Conversion method for mpl_pkn_pxros_performance.stack.isr.status" TAB_VERB 5 0 "PKN_TASK_STK_STAT_NR_IN_PROG" 1 "PKN_TASK_STACK_DATA_STATUS_VALID" 2 "PKN_TASK_STK_STAT_NR_GROW_SPEC" 3 "PKN_TASK_STK_STAT_NR_ALLOC_SPEC" 4 "PKN_TASK_STK_STAT_NR_INV_SPEC" /end COMPU_VTAB
/* Scalar measurable for DDE 'mpl_pkn_pxros_performance.stack.isr.used'. */
/begin MEASUREMENT mpl_pkn_pxros_performance.stac1 "Used bytes of interrupt stack for task named: pkn_pxros_performance" ULONG CU_MPL_PKN_PXROS_PERFORMANCE.S1 1 100 0.0 4294967295.0 ECU_ADDRESS 0x700173ac BYTE_ORDER MSB_LAST /end MEASUREMENT
/begin COMPU_METHOD CU_MPL_PKN_PXROS_PERFORMANCE.S1 "Conversion method for mpl_pkn_pxros_performance.stack.isr.used" RAT_FUNC "%10.0" "bytes" COEFFS 0.000000 1.000000 -0.000000 0.000000 0.000000 1.000000 /end COMPU_METHOD
/* Scalar measurable for DDE 'mpl_pkn_pxros_performance.stack.task.status'. */
/begin MEASUREMENT mpl_pkn_pxros_performance.stac0 "Current status of stack performance measurement for task: pkn_pxros_performance" SLONG CU_MPL_PKN_PXROS_PERFORMANCE.S0 1 100 0.0 255.0 ECU_ADDRESS 0x700173c0 BYTE_ORDER MSB_LAST /end MEASUREMENT
/begin COMPU_METHOD CU_MPL_PKN_PXROS_PERFORMANCE.S0 "Conversion method for mpl_pkn_pxros_performance.stack.task.status" TAB_VERB "%12.0" "(not defined)" COMPU_TAB_REF CT_MPL_PKN_PXROS_PERFORMANCE.S0 /end COMPU_METHOD
/begin COMPU_VTAB CT_MPL_PKN_PXROS_PERFORMANCE.S0 "Conversion method for mpl_pkn_pxros_performance.stack.task.status" TAB_VERB 5 0 "PKN_TASK_STK_STAT_NR_IN_PROG" 1 "PKN_TASK_STACK_DATA_STATUS_VALID" 2 "PKN_TASK_STK_STAT_NR_GROW_SPEC" 3 "PKN_TASK_STK_STAT_NR_ALLOC_SPEC" 4 "PKN_TASK_STK_STAT_NR_INV_SPEC" /end COMPU_VTAB
/* Scalar measurable for DDE 'mpl_pkn_pxros_performance.stack.task.used'. */
/begin MEASUREMENT mpl_pkn_pxros_performance.stac2 "Used bytes of task stack for task named: pkn_pxros_performance" ULONG CU_MPL_PKN_PXROS_PERFORMANCE.S2 1 100 0.0 4294967295.0 ECU_ADDRESS 0x700173bc BYTE_ORDER MSB_LAST /end MEASUREMENT
/begin COMPU_METHOD CU_MPL_PKN_PXROS_PERFORMANCE.S2 "Conversion method for mpl_pkn_pxros_performance.stack.task.used" RAT_FUNC "%10.0" "bytes" COEFFS 0.000000 1.000000 -0.000000 0.000000 0.000000 1.000000 /end COMPU_METHOD
/* Scalar measurable for DDE 'mpl_pkn_pxros_performance.timing.max_task_time'. */
/begin MEASUREMENT mpl_pkn_pxros_performance.timi1 "Maximum duration of task since reset: pkn_pxros_performance" ULONG CU_MPL_PKN_PXROS_PERFORMANCE.T1 1 100 0.0 42949672.0 ECU_ADDRESS 0x7001ca98 BYTE_ORDER MSB_LAST /end MEASUREMENT
/begin COMPU_METHOD CU_MPL_PKN_PXROS_PERFORMANCE.T1 "Conversion method for mpl_pkn_pxros_performance.timing.max_task_time" RAT_FUNC "%10.0" "microseconds" COEFFS 0.000000 100.000000 -0.000000 0.000000 0.000000 1.000000 /end COMPU_METHOD
/* Scalar measurable for DDE 'mpl_pkn_pxros_performance.timing.overruns'. */
/begin MEASUREMENT mpl_pkn_pxros_performance.timi3 ": pkn_pxros_performance" UBYTE CU_MPL_PKN_PXROS_PERFORMANCE.T3 1 100 0.0 255.0 ECU_ADDRESS 0x700173a0 BYTE_ORDER MSB_LAST /end MEASUREMENT
/begin COMPU_METHOD CU_MPL_PKN_PXROS_PERFORMANCE.T3 "Conversion method for mpl_pkn_pxros_performance.timing.overruns" RAT_FUNC "%10.0" "count" COEFFS 0.000000 1.000000 -0.000000 0.000000 0.000000 1.000000 /end COMPU_METHOD
/* Scalar measurable for DDE 'mpl_pkn_pxros_performance.timing.runs'. */
/begin MEASUREMENT mpl_pkn_pxros_performance.timi2 ": pkn_pxros_performance" ULONG CU_MPL_PKN_PXROS_PERFORMANCE.T2 1 100 0.0 4294967295.0 ECU_ADDRESS 0x7001739c BYTE_ORDER MSB_LAST /end MEASUREMENT
/begin COMPU_METHOD CU_MPL_PKN_PXROS_PERFORMANCE.T2 "Conversion method for mpl_pkn_pxros_performance.timing.runs" RAT_FUNC "%10.0" "count" COEFFS 0.000000 1.000000 -0.000000 0.000000 0.000000 1.000000 /end COMPU_METHOD
/* Scalar measurable for DDE 'mpl_pkn_pxros_performance.timing.task_time'. */
/begin MEASUREMENT mpl_pkn_pxros_performance.timi0 "Duration of task: pkn_pxros_performance" ULONG CU_MPL_PKN_PXROS_PERFORMANCE.T0 1 100 0.0 42949672.0 ECU_ADDRESS 0x7001ca3c BYTE_ORDER MSB_LAST /end MEASUREMENT
/begin COMPU_METHOD CU_MPL_PKN_PXROS_PERFORMANCE.T0 "Conversion method for mpl_pkn_pxros_performance.timing.task_time" RAT_FUNC "%10.0" "microseconds" COEFFS 0.000000 100.000000 -0.000000 0.000000 0.000000 1.000000 /end COMPU_METHOD
/* Scalar measurable for DDE 'mpl_pkn_pxros_pm_entry_invalid_core_count'. */
/begin MEASUREMENT mpl_pkn_pxros_pm_entry_invalid0 "Count of invalid core identifiers to the performance measurement task" ULONG CU_MPL_PKN_PXROS_PM_ENTRY_INVA0 1 100 0.0 4294967295.0 ECU_ADDRESS 0x7001db68 BYTE_ORDER MSB_LAST /end MEASUREMENT
/begin COMPU_METHOD CU_MPL_PKN_PXROS_PM_ENTRY_INVA0 "Conversion method for mpl_pkn_pxros_pm_entry_invalid_core_count" RAT_FUNC "%10.0" "count" COEFFS 0.000000 1.000000 -0.000000 0.000000 0.000000 1.000000 /end COMPU_METHOD
/* Scalar measurable for DDE 'mpl_pkn_pxros_pm_entry_invalid_task_idx_count'. */
/begin MEASUREMENT mpl_pkn_pxros_pm_entry_invalid1 "Count of invalid task indexes to the performance measurement task" ULONG CU_MPL_PKN_PXROS_PM_ENTRY_INVA1 1 100 0.0 4294967295.0 ECU_ADDRESS 0x7001db8c BYTE_ORDER MSB_LAST /end MEASUREMENT
/begin COMPU_METHOD CU_MPL_PKN_PXROS_PM_ENTRY_INVA1 "Conversion method for mpl_pkn_pxros_pm_entry_invalid_task_idx_count" RAT_FUNC "%10.0" "count" COEFFS 0.000000 1.000000 -0.000000 0.000000 0.000000 1.000000 /end COMPU_METHOD
/* Scalar measurable for DDE 'mpl_pkn_pxros_pm_exit_invalid_core_count'. */
/begin MEASUREMENT mpl_pkn_pxros_pm_exit_invalid_1 "Count of invalid core identifiers to the performance measurement task" ULONG CU_MPL_PKN_PXROS_PM_EXIT_INVAL1 1 100 0.0 4294967295.0 ECU_ADDRESS 0x7001db68 BYTE_ORDER MSB_LAST /end MEASUREMENT
/begin COMPU_METHOD CU_MPL_PKN_PXROS_PM_EXIT_INVAL1 "Conversion method for mpl_pkn_pxros_pm_exit_invalid_core_count" RAT_FUNC "%10.0" "count" COEFFS 0.000000 1.000000 -0.000000 0.000000 0.000000 1.000000 /end COMPU_METHOD
/* Scalar measurable for DDE 'mpl_pkn_pxros_pm_exit_invalid_task_idx_count'. */
/begin MEASUREMENT mpl_pkn_pxros_pm_exit_invalid_0 "Count of invalid task indexes to the performance measurement task" ULONG CU_MPL_PKN_PXROS_PM_EXIT_INVAL0 1 100 0.0 4294967295.0 ECU_ADDRESS 0x7001db70 BYTE_ORDER MSB_LAST /end MEASUREMENT
/begin COMPU_METHOD CU_MPL_PKN_PXROS_PM_EXIT_INVAL0 "Conversion method for mpl_pkn_pxros_pm_exit_invalid_task_idx_count" RAT_FUNC "%10.0" "count" COEFFS 0.000000 1.000000 -0.000000 0.000000 0.000000 1.000000 /end COMPU_METHOD
/* Scalar measurable for DDE 'mpl_pkn_pxros_pm_invalid_event_count'. */
/begin MEASUREMENT mpl_pkn_pxros_pm_invalid_event0 "Count of invalid message events to the performance measurement task" ULONG CU_MPL_PKN_PXROS_PM_INVALID_EV0 1 100 0.0 4294967295.0 ECU_ADDRESS 0x7001db80 BYTE_ORDER MSB_LAST /end MEASUREMENT
/begin COMPU_METHOD CU_MPL_PKN_PXROS_PM_INVALID_EV0 "Conversion method for mpl_pkn_pxros_pm_invalid_event_count" RAT_FUNC "%10.0" "count" COEFFS 0.000000 1.000000 -0.000000 0.000000 0.000000 1.000000 /end COMPU_METHOD
/* Scalar measurable for DDE 'mpl_pkn_pxros_pm_invalid_msg_count'. */
/begin MEASUREMENT mpl_pkn_pxros_pm_invalid_msg_c0 "Count of invalid messages to the performance measurement task" ULONG CU_MPL_PKN_PXROS_PM_INVALID_MS0 1 100 0.0 4294967295.0 ECU_ADDRESS 0x7001db84 BYTE_ORDER MSB_LAST /end MEASUREMENT
/begin COMPU_METHOD CU_MPL_PKN_PXROS_PM_INVALID_MS0 "Conversion method for mpl_pkn_pxros_pm_invalid_msg_count" RAT_FUNC "%10.0" "count" COEFFS 0.000000 1.000000 -0.000000 0.000000 0.000000 1.000000 /end COMPU_METHOD
/* Scalar measurable for DDE 'mpl_plat_build_day'. */
/begin MEASUREMENT mpl_plat_build_day "Platform build day" UWORD CU_MPL_PLAT_BUILD_DAY 1 100 0.0 65535.0 ECU_ADDRESS 0x7001d7e8 BYTE_ORDER MSB_LAST /end MEASUREMENT
/begin COMPU_METHOD CU_MPL_PLAT_BUILD_DAY "Conversion method for mpl_plat_build_day" RAT_FUNC "%10.0" "(not defined)" COEFFS 0.000000 1.000000 -0.000000 0.000000 0.000000 1.000000 /end COMPU_METHOD
/* Scalar measurable for DDE 'mpl_plat_build_month'. */
/begin MEASUREMENT mpl_plat_build_month "Platform build month" UWORD CU_MPL_PLAT_BUILD_MONTH 1 100 0.0 65535.0 ECU_ADDRESS 0x7001d7ea BYTE_ORDER MSB_LAST /end MEASUREMENT
/begin COMPU_METHOD CU_MPL_PLAT_BUILD_MONTH "Conversion method for mpl_plat_build_month" RAT_FUNC "%10.0" "(not defined)" COEFFS 0.000000 1.000000 -0.000000 0.000000 0.000000 1.000000 /end COMPU_METHOD
/* Scalar measurable for DDE 'mpl_plat_build_year'. */
/begin MEASUREMENT mpl_plat_build_year "Platform build year" UWORD CU_MPL_PLAT_BUILD_YEAR 1 100 0.0 65535.0 ECU_ADDRESS 0x7001d7ec BYTE_ORDER MSB_LAST /end MEASUREMENT
/begin COMPU_METHOD CU_MPL_PLAT_BUILD_YEAR "Conversion method for mpl_plat_build_year" RAT_FUNC "%10.0" "(not defined)" COEFFS 0.000000 1.000000 -0.000000 0.000000 0.000000 1.000000 /end COMPU_METHOD
/* Scalar measurable for DDE 'mpl_plat_part_num_group'. */
/begin MEASUREMENT mpl_plat_part_num_group "Platform Group ID number of the part number" UBYTE CU_MPL_PLAT_PART_NUM_GROUP 1 100 0.0 255.0 ECU_ADDRESS 0x7001d7ee BYTE_ORDER MSB_LAST /end MEASUREMENT
/begin COMPU_METHOD CU_MPL_PLAT_PART_NUM_GROUP "Conversion method for mpl_plat_part_num_group" RAT_FUNC "%10.0" "(not defined)" COEFFS 0.000000 1.000000 -0.000000 0.000000 0.000000 1.000000 /end COMPU_METHOD
/* Scalar measurable for DDE 'mpl_plat_part_num_id'. */
/begin MEASUREMENT mpl_plat_part_num_id "Platform Part ID of the part number" ULONG CU_MPL_PLAT_PART_NUM_ID 1 100 0.0 4294967295.0 ECU_ADDRESS 0x7001d7e0 BYTE_ORDER MSB_LAST /end MEASUREMENT
/begin COMPU_METHOD CU_MPL_PLAT_PART_NUM_ID "Conversion method for mpl_plat_part_num_id" RAT_FUNC "%10.0" "(not defined)" COEFFS 0.000000 1.000000 -0.000000 0.000000 0.000000 1.000000 /end COMPU_METHOD
/* Scalar measurable for DDE 'mpl_plat_part_num_issue'. */
/begin MEASUREMENT mpl_plat_part_num_issue "Platform Issue number of the part number" UWORD CU_MPL_PLAT_PART_NUM_ISSUE 1 100 0.0 65535.0 ECU_ADDRESS 0x7001d7e6 BYTE_ORDER MSB_LAST /end MEASUREMENT
/begin COMPU_METHOD CU_MPL_PLAT_PART_NUM_ISSUE "Conversion method for mpl_plat_part_num_issue" RAT_FUNC "%10.0" "(not defined)" COEFFS 0.000000 1.000000 -0.000000 0.000000 0.000000 1.000000 /end COMPU_METHOD
/* Scalar measurable for DDE 'mpl_plat_part_num_letter'. */
/begin MEASUREMENT mpl_plat_part_num_letter "Platform Group Letter of the part number" UBYTE CU_MPL_PLAT_PART_NUM_LETTER 1 100 0.0 255.0 ECU_ADDRESS 0x7001d7f2 BYTE_ORDER MSB_LAST /end MEASUREMENT
/begin COMPU_METHOD CU_MPL_PLAT_PART_NUM_LETTER "Conversion method for mpl_plat_part_num_letter" RAT_FUNC "%10.0" "(not defined)" COEFFS 0.000000 1.000000 -0.000000 0.000000 0.000000 1.000000 /end COMPU_METHOD
/* Scalar measurable for DDE 'mpl_plat_ver_major'. */
/begin MEASUREMENT mpl_plat_ver_major "Platform major version number" UWORD CU_MPL_PLAT_VER_MAJOR 1 100 0.0 65535.0 ECU_ADDRESS 0x7001d7f0 BYTE_ORDER MSB_LAST /end MEASUREMENT
/begin COMPU_METHOD CU_MPL_PLAT_VER_MAJOR "Conversion method for mpl_plat_ver_major" RAT_FUNC "%10.0" "(not defined)" COEFFS 0.000000 1.000000 -0.000000 0.000000 0.000000 1.000000 /end COMPU_METHOD
/* Scalar measurable for DDE 'mpl_plat_ver_minor'. */
/begin MEASUREMENT mpl_plat_ver_minor "Platform minor version number" UWORD CU_MPL_PLAT_VER_MINOR 1 100 0.0 65535.0 ECU_ADDRESS 0x7001d7f4 BYTE_ORDER MSB_LAST /end MEASUREMENT
/begin COMPU_METHOD CU_MPL_PLAT_VER_MINOR "Conversion method for mpl_plat_ver_minor" RAT_FUNC "%10.0" "(not defined)" COEFFS 0.000000 1.000000 -0.000000 0.000000 0.000000 1.000000 /end COMPU_METHOD
/* Scalar measurable for DDE 'mpl_plat_ver_sub'. */
/begin MEASUREMENT mpl_plat_ver_sub "Platform sub minor version number" UWORD CU_MPL_PLAT_VER_SUB 1 100 0.0 65535.0 ECU_ADDRESS 0x7001d7e4 BYTE_ORDER MSB_LAST /end MEASUREMENT
/begin COMPU_METHOD CU_MPL_PLAT_VER_SUB "Conversion method for mpl_plat_ver_sub" RAT_FUNC "%10.0" "(not defined)" COEFFS 0.000000 1.000000 -0.000000 0.000000 0.000000 1.000000 /end COMPU_METHOD
/* Scalar measurable for DDE 'mpl_pqca_client.stack.isr.status'. */
/begin MEASUREMENT mpl_pqca_client.stack.isr.stat0 "Current status of stack performance measurement for task: pqca_client" SLONG CU_MPL_PQCA_CLIENT.STACK.ISR.S0 1 100 0.0 255.0 ECU_ADDRESS 0x70017320 BYTE_ORDER MSB_LAST /end MEASUREMENT
/begin COMPU_METHOD CU_MPL_PQCA_CLIENT.STACK.ISR.S0 "Conversion method for mpl_pqca_client.stack.isr.status" TAB_VERB "%12.0" "(not defined)" COMPU_TAB_REF CT_MPL_PQCA_CLIENT.STACK.ISR.S0 /end COMPU_METHOD
/begin COMPU_VTAB CT_MPL_PQCA_CLIENT.STACK.ISR.S0 "Conversion method for mpl_pqca_client.stack.isr.status" TAB_VERB 5 0 "PKN_TASK_STK_STAT_NR_IN_PROG" 1 "PKN_TASK_STACK_DATA_STATUS_VALID" 2 "PKN_TASK_STK_STAT_NR_GROW_SPEC" 3 "PKN_TASK_STK_STAT_NR_ALLOC_SPEC" 4 "PKN_TASK_STK_STAT_NR_INV_SPEC" /end COMPU_VTAB
/* Scalar measurable for DDE 'mpl_pqca_client.stack.isr.used'. */
/begin MEASUREMENT mpl_pqca_client.stack.isr.used "Used bytes of interrupt stack for task named: pqca_client" ULONG CU_MPL_PQCA_CLIENT.STACK.ISR.U0 1 100 0.0 4294967295.0 ECU_ADDRESS 0x7001731c BYTE_ORDER MSB_LAST /end MEASUREMENT
/begin COMPU_METHOD CU_MPL_PQCA_CLIENT.STACK.ISR.U0 "Conversion method for mpl_pqca_client.stack.isr.used" RAT_FUNC "%10.0" "bytes" COEFFS 0.000000 1.000000 -0.000000 0.000000 0.000000 1.000000 /end COMPU_METHOD
/* Scalar measurable for DDE 'mpl_pqca_client.stack.task.status'. */
/begin MEASUREMENT mpl_pqca_client.stack.task.sta0 "Current status of stack performance measurement for task: pqca_client" SLONG CU_MPL_PQCA_CLIENT.STACK.TASK.0 1 100 0.0 255.0 ECU_ADDRESS 0x70017330 BYTE_ORDER MSB_LAST /end MEASUREMENT
/begin COMPU_METHOD CU_MPL_PQCA_CLIENT.STACK.TASK.0 "Conversion method for mpl_pqca_client.stack.task.status" TAB_VERB "%12.0" "(not defined)" COMPU_TAB_REF CT_MPL_PQCA_CLIENT.STACK.TASK.0 /end COMPU_METHOD
/begin COMPU_VTAB CT_MPL_PQCA_CLIENT.STACK.TASK.0 "Conversion method for mpl_pqca_client.stack.task.status" TAB_VERB 5 0 "PKN_TASK_STK_STAT_NR_IN_PROG" 1 "PKN_TASK_STACK_DATA_STATUS_VALID" 2 "PKN_TASK_STK_STAT_NR_GROW_SPEC" 3 "PKN_TASK_STK_STAT_NR_ALLOC_SPEC" 4 "PKN_TASK_STK_STAT_NR_INV_SPEC" /end COMPU_VTAB
/* Scalar measurable for DDE 'mpl_pqca_client.stack.task.used'. */
/begin MEASUREMENT mpl_pqca_client.stack.task.used "Used bytes of task stack for task named: pqca_client" ULONG CU_MPL_PQCA_CLIENT.STACK.TASK.1 1 100 0.0 4294967295.0 ECU_ADDRESS 0x7001732c BYTE_ORDER MSB_LAST /end MEASUREMENT
/begin COMPU_METHOD CU_MPL_PQCA_CLIENT.STACK.TASK.1 "Conversion method for mpl_pqca_client.stack.task.used" RAT_FUNC "%10.0" "bytes" COEFFS 0.000000 1.000000 -0.000000 0.000000 0.000000 1.000000 /end COMPU_METHOD
/* Scalar measurable for DDE 'mpl_pqca_client.timing.max_task_time'. */
/begin MEASUREMENT mpl_pqca_client.timing.max_tas0 "Maximum duration of task since reset: pqca_client" ULONG CU_MPL_PQCA_CLIENT.TIMING.MAX_0 1 100 0.0 42949672.0 ECU_ADDRESS 0x7001caa0 BYTE_ORDER MSB_LAST /end MEASUREMENT
/begin COMPU_METHOD CU_MPL_PQCA_CLIENT.TIMING.MAX_0 "Conversion method for mpl_pqca_client.timing.max_task_time" RAT_FUNC "%10.0" "microseconds" COEFFS 0.000000 100.000000 -0.000000 0.000000 0.000000 1.000000 /end COMPU_METHOD
/* Scalar measurable for DDE 'mpl_pqca_client.timing.overruns'. */
/begin MEASUREMENT mpl_pqca_client.timing.overruns ": pqca_client" UBYTE CU_MPL_PQCA_CLIENT.TIMING.OVER0 1 100 0.0 255.0 ECU_ADDRESS 0x70017310 BYTE_ORDER MSB_LAST /end MEASUREMENT
/begin COMPU_METHOD CU_MPL_PQCA_CLIENT.TIMING.OVER0 "Conversion method for mpl_pqca_client.timing.overruns" RAT_FUNC "%10.0" "count" COEFFS 0.000000 1.000000 -0.000000 0.000000 0.000000 1.000000 /end COMPU_METHOD
/* Scalar measurable for DDE 'mpl_pqca_client.timing.runs'. */
/begin MEASUREMENT mpl_pqca_client.timing.runs ": pqca_client" ULONG CU_MPL_PQCA_CLIENT.TIMING.RUNS 1 100 0.0 4294967295.0 ECU_ADDRESS 0x7001730c BYTE_ORDER MSB_LAST /end MEASUREMENT
/begin COMPU_METHOD CU_MPL_PQCA_CLIENT.TIMING.RUNS "Conversion method for mpl_pqca_client.timing.runs" RAT_FUNC "%10.0" "count" COEFFS 0.000000 1.000000 -0.000000 0.000000 0.000000 1.000000 /end COMPU_METHOD
/* Scalar measurable for DDE 'mpl_pqca_client.timing.task_time'. */
/begin MEASUREMENT mpl_pqca_client.timing.task_ti0 "Duration of task: pqca_client" ULONG CU_MPL_PQCA_CLIENT.TIMING.TASK0 1 100 0.0 42949672.0 ECU_ADDRESS 0x7001ca44 BYTE_ORDER MSB_LAST /end MEASUREMENT
/begin COMPU_METHOD CU_MPL_PQCA_CLIENT.TIMING.TASK0 "Conversion method for mpl_pqca_client.timing.task_time" RAT_FUNC "%10.0" "microseconds" COEFFS 0.000000 100.000000 -0.000000 0.000000 0.000000 1.000000 /end COMPU_METHOD
/* Scalar measurable for DDE 'mpl_prg_build_day'. */
/begin MEASUREMENT mpl_prg_build_day "PRG build day" UWORD CU_MPL_PRG_BUILD_DAY 1 100 0.0 65535.0 ECU_ADDRESS 0x70013d0a BYTE_ORDER MSB_LAST /end MEASUREMENT
/begin COMPU_METHOD CU_MPL_PRG_BUILD_DAY "Conversion method for mpl_prg_build_day" RAT_FUNC "%10.0" "(not defined)" COEFFS 0.000000 1.000000 -0.000000 0.000000 0.000000 1.000000 /end COMPU_METHOD
/* Scalar measurable for DDE 'mpl_prg_build_month'. */
/begin MEASUREMENT mpl_prg_build_month "PRG build month" UWORD CU_MPL_PRG_BUILD_MONTH 1 100 0.0 65535.0 ECU_ADDRESS 0x70013d08 BYTE_ORDER MSB_LAST /end MEASUREMENT
/begin COMPU_METHOD CU_MPL_PRG_BUILD_MONTH "Conversion method for mpl_prg_build_month" RAT_FUNC "%10.0" "(not defined)" COEFFS 0.000000 1.000000 -0.000000 0.000000 0.000000 1.000000 /end COMPU_METHOD
/* Scalar measurable for DDE 'mpl_prg_build_year'. */
/begin MEASUREMENT mpl_prg_build_year "PRG build year" UWORD CU_MPL_PRG_BUILD_YEAR 1 100 0.0 65535.0 ECU_ADDRESS 0x70013d06 BYTE_ORDER MSB_LAST /end MEASUREMENT
/begin COMPU_METHOD CU_MPL_PRG_BUILD_YEAR "Conversion method for mpl_prg_build_year" RAT_FUNC "%10.0" "(not defined)" COEFFS 0.000000 1.000000 -0.000000 0.000000 0.000000 1.000000 /end COMPU_METHOD
/* Scalar measurable for DDE 'mpl_prg_part_num_group'. */
/begin MEASUREMENT mpl_prg_part_num_group "PRG Group ID number in the part number" UBYTE CU_MPL_PRG_PART_NUM_GROUP 1 100 0.0 255.0 ECU_ADDRESS 0x70013d05 BYTE_ORDER MSB_LAST /end MEASUREMENT
/begin COMPU_METHOD CU_MPL_PRG_PART_NUM_GROUP "Conversion method for mpl_prg_part_num_group" RAT_FUNC "%10.0" "(not defined)" COEFFS 0.000000 1.000000 -0.000000 0.000000 0.000000 1.000000 /end COMPU_METHOD
/* Scalar measurable for DDE 'mpl_prg_part_num_id'. */
/begin MEASUREMENT mpl_prg_part_num_id "PRG Part ID in the part number" ULONG CU_MPL_PRG_PART_NUM_ID 1 100 0.0 4294967295.0 ECU_ADDRESS 0x70013d00 BYTE_ORDER MSB_LAST /end MEASUREMENT
/begin COMPU_METHOD CU_MPL_PRG_PART_NUM_ID "Conversion method for mpl_prg_part_num_id" RAT_FUNC "%10.0" "(not defined)" COEFFS 0.000000 1.000000 -0.000000 0.000000 0.000000 1.000000 /end COMPU_METHOD
/* Scalar measurable for DDE 'mpl_prg_part_num_issue'. */
/begin MEASUREMENT mpl_prg_part_num_issue "PRG Issue number in the part number" UWORD CU_MPL_PRG_PART_NUM_ISSUE 1 100 0.0 65535.0 ECU_ADDRESS 0x70013cfc BYTE_ORDER MSB_LAST /end MEASUREMENT
/begin COMPU_METHOD CU_MPL_PRG_PART_NUM_ISSUE "Conversion method for mpl_prg_part_num_issue" RAT_FUNC "%10.0" "(not defined)" COEFFS 0.000000 1.000000 -0.000000 0.000000 0.000000 1.000000 /end COMPU_METHOD
/* Scalar measurable for DDE 'mpl_prg_part_num_letter'. */
/begin MEASUREMENT mpl_prg_part_num_letter "PRG Group Letter in the part number" UBYTE CU_MPL_PRG_PART_NUM_LETTER 1 100 0.0 255.0 ECU_ADDRESS 0x70013d04 BYTE_ORDER MSB_LAST /end MEASUREMENT
/begin COMPU_METHOD CU_MPL_PRG_PART_NUM_LETTER "Conversion method for mpl_prg_part_num_letter" RAT_FUNC "%10.0" "(not defined)" COEFFS 0.000000 1.000000 -0.000000 0.000000 0.000000 1.000000 /end COMPU_METHOD
/* Scalar measurable for DDE 'mpl_prg_ver_major'. */
/begin MEASUREMENT mpl_prg_ver_major "PRG major version number" UWORD CU_MPL_PRG_VER_MAJOR 1 100 0.0 65535.0 ECU_ADDRESS 0x70013d10 BYTE_ORDER MSB_LAST /end MEASUREMENT
/begin COMPU_METHOD CU_MPL_PRG_VER_MAJOR "Conversion method for mpl_prg_ver_major" RAT_FUNC "%10.0" "(not defined)" COEFFS 0.000000 1.000000 -0.000000 0.000000 0.000000 1.000000 /end COMPU_METHOD
/* Scalar measurable for DDE 'mpl_prg_ver_minor'. */
/begin MEASUREMENT mpl_prg_ver_minor "PRG minor version number" UWORD CU_MPL_PRG_VER_MINOR 1 100 0.0 65535.0 ECU_ADDRESS 0x70013d0e BYTE_ORDER MSB_LAST /end MEASUREMENT
/begin COMPU_METHOD CU_MPL_PRG_VER_MINOR "Conversion method for mpl_prg_ver_minor" RAT_FUNC "%10.0" "(not defined)" COEFFS 0.000000 1.000000 -0.000000 0.000000 0.000000 1.000000 /end COMPU_METHOD
/* Scalar measurable for DDE 'mpl_prg_ver_sub'. */
/begin MEASUREMENT mpl_prg_ver_sub "PRG sub minor version number" UWORD CU_MPL_PRG_VER_SUB 1 100 0.0 65535.0 ECU_ADDRESS 0x70013d0c BYTE_ORDER MSB_LAST /end MEASUREMENT
/begin COMPU_METHOD CU_MPL_PRG_VER_SUB "Conversion method for mpl_prg_ver_sub" RAT_FUNC "%10.0" "(not defined)" COEFFS 0.000000 1.000000 -0.000000 0.000000 0.000000 1.000000 /end COMPU_METHOD
/* Scalar measurable for DDE 'mpl_psaf_pfm_task.stack.isr.status'. */
/begin MEASUREMENT mpl_psaf_pfm_task.stack.isr.st0 "Current status of stack performance measurement for task: psaf_pfm_task" SLONG CU_MPL_PSAF_PFM_TASK.STACK.ISR0 1 100 0.0 255.0 ECU_ADDRESS 0x70016f30 BYTE_ORDER MSB_LAST /end MEASUREMENT
/begin COMPU_METHOD CU_MPL_PSAF_PFM_TASK.STACK.ISR0 "Conversion method for mpl_psaf_pfm_task.stack.isr.status" TAB_VERB "%12.0" "(not defined)" COMPU_TAB_REF CT_MPL_PSAF_PFM_TASK.STACK.ISR0 /end COMPU_METHOD
/begin COMPU_VTAB CT_MPL_PSAF_PFM_TASK.STACK.ISR0 "Conversion method for mpl_psaf_pfm_task.stack.isr.status" TAB_VERB 5 0 "PKN_TASK_STK_STAT_NR_IN_PROG" 1 "PKN_TASK_STACK_DATA_STATUS_VALID" 2 "PKN_TASK_STK_STAT_NR_GROW_SPEC" 3 "PKN_TASK_STK_STAT_NR_ALLOC_SPEC" 4 "PKN_TASK_STK_STAT_NR_INV_SPEC" /end COMPU_VTAB
/* Scalar measurable for DDE 'mpl_psaf_pfm_task.stack.isr.used'. */
/begin MEASUREMENT mpl_psaf_pfm_task.stack.isr.us0 "Used bytes of interrupt stack for task named: psaf_pfm_task" ULONG CU_MPL_PSAF_PFM_TASK.STACK.ISR1 1 100 0.0 4294967295.0 ECU_ADDRESS 0x70016f2c BYTE_ORDER MSB_LAST /end MEASUREMENT
/begin COMPU_METHOD CU_MPL_PSAF_PFM_TASK.STACK.ISR1 "Conversion method for mpl_psaf_pfm_task.stack.isr.used" RAT_FUNC "%10.0" "bytes" COEFFS 0.000000 1.000000 -0.000000 0.000000 0.000000 1.000000 /end COMPU_METHOD
/* Scalar measurable for DDE 'mpl_psaf_pfm_task.stack.task.status'. */
/begin MEASUREMENT mpl_psaf_pfm_task.stack.task.s0 "Current status of stack performance measurement for task: psaf_pfm_task" SLONG CU_MPL_PSAF_PFM_TASK.STACK.TAS0 1 100 0.0 255.0 ECU_ADDRESS 0x70016f40 BYTE_ORDER MSB_LAST /end MEASUREMENT
/begin COMPU_METHOD CU_MPL_PSAF_PFM_TASK.STACK.TAS0 "Conversion method for mpl_psaf_pfm_task.stack.task.status" TAB_VERB "%12.0" "(not defined)" COMPU_TAB_REF CT_MPL_PSAF_PFM_TASK.STACK.TAS0 /end COMPU_METHOD
/begin COMPU_VTAB CT_MPL_PSAF_PFM_TASK.STACK.TAS0 "Conversion method for mpl_psaf_pfm_task.stack.task.status" TAB_VERB 5 0 "PKN_TASK_STK_STAT_NR_IN_PROG" 1 "PKN_TASK_STACK_DATA_STATUS_VALID" 2 "PKN_TASK_STK_STAT_NR_GROW_SPEC" 3 "PKN_TASK_STK_STAT_NR_ALLOC_SPEC" 4 "PKN_TASK_STK_STAT_NR_INV_SPEC" /end COMPU_VTAB
/* Scalar measurable for DDE 'mpl_psaf_pfm_task.stack.task.used'. */
/begin MEASUREMENT mpl_psaf_pfm_task.stack.task.u0 "Used bytes of task stack for task named: psaf_pfm_task" ULONG CU_MPL_PSAF_PFM_TASK.STACK.TAS1 1 100 0.0 4294967295.0 ECU_ADDRESS 0x70016f3c BYTE_ORDER MSB_LAST /end MEASUREMENT
/begin COMPU_METHOD CU_MPL_PSAF_PFM_TASK.STACK.TAS1 "Conversion method for mpl_psaf_pfm_task.stack.task.used" RAT_FUNC "%10.0" "bytes" COEFFS 0.000000 1.000000 -0.000000 0.000000 0.000000 1.000000 /end COMPU_METHOD
/* Scalar measurable for DDE 'mpl_psaf_pfm_task.timing.max_task_time'. */
/begin MEASUREMENT mpl_psaf_pfm_task.timing.max_t0 "Maximum duration of task since reset: psaf_pfm_task" ULONG CU_MPL_PSAF_PFM_TASK.TIMING.MA0 1 100 0.0 42949672.0 ECU_ADDRESS 0x7001cad8 BYTE_ORDER MSB_LAST /end MEASUREMENT
/begin COMPU_METHOD CU_MPL_PSAF_PFM_TASK.TIMING.MA0 "Conversion method for mpl_psaf_pfm_task.timing.max_task_time" RAT_FUNC "%10.0" "microseconds" COEFFS 0.000000 100.000000 -0.000000 0.000000 0.000000 1.000000 /end COMPU_METHOD
/* Scalar measurable for DDE 'mpl_psaf_pfm_task.timing.overruns'. */
/begin MEASUREMENT mpl_psaf_pfm_task.timing.overr0 ": psaf_pfm_task" UBYTE CU_MPL_PSAF_PFM_TASK.TIMING.OV0 1 100 0.0 255.0 ECU_ADDRESS 0x70016f20 BYTE_ORDER MSB_LAST /end MEASUREMENT
/begin COMPU_METHOD CU_MPL_PSAF_PFM_TASK.TIMING.OV0 "Conversion method for mpl_psaf_pfm_task.timing.overruns" RAT_FUNC "%10.0" "count" COEFFS 0.000000 1.000000 -0.000000 0.000000 0.000000 1.000000 /end COMPU_METHOD
/* Scalar measurable for DDE 'mpl_psaf_pfm_task.timing.runs'. */
/begin MEASUREMENT mpl_psaf_pfm_task.timing.runs ": psaf_pfm_task" ULONG CU_MPL_PSAF_PFM_TASK.TIMING.RU0 1 100 0.0 4294967295.0 ECU_ADDRESS 0x70016f1c BYTE_ORDER MSB_LAST /end MEASUREMENT
/begin COMPU_METHOD CU_MPL_PSAF_PFM_TASK.TIMING.RU0 "Conversion method for mpl_psaf_pfm_task.timing.runs" RAT_FUNC "%10.0" "count" COEFFS 0.000000 1.000000 -0.000000 0.000000 0.000000 1.000000 /end COMPU_METHOD
/* Scalar measurable for DDE 'mpl_psaf_pfm_task.timing.task_time'. */
/begin MEASUREMENT mpl_psaf_pfm_task.timing.task_0 "Duration of task: psaf_pfm_task" ULONG CU_MPL_PSAF_PFM_TASK.TIMING.TA0 1 100 0.0 42949672.0 ECU_ADDRESS 0x7001ca7c BYTE_ORDER MSB_LAST /end MEASUREMENT
/begin COMPU_METHOD CU_MPL_PSAF_PFM_TASK.TIMING.TA0 "Conversion method for mpl_psaf_pfm_task.timing.task_time" RAT_FUNC "%10.0" "microseconds" COEFFS 0.000000 100.000000 -0.000000 0.000000 0.000000 1.000000 /end COMPU_METHOD
/* Scalar measurable for DDE 'mpl_psaf_task.stack.isr.status'. */
/begin MEASUREMENT mpl_psaf_task.stack.isr.status "Current status of stack performance measurement for task: psaf_task" SLONG CU_MPL_PSAF_TASK.STACK.ISR.STA0 1 100 0.0 255.0 ECU_ADDRESS 0x70016ea0 BYTE_ORDER MSB_LAST /end MEASUREMENT
/begin COMPU_METHOD CU_MPL_PSAF_TASK.STACK.ISR.STA0 "Conversion method for mpl_psaf_task.stack.isr.status" TAB_VERB "%12.0" "(not defined)" COMPU_TAB_REF CT_MPL_PSAF_TASK.STACK.ISR.STA0 /end COMPU_METHOD
/begin COMPU_VTAB CT_MPL_PSAF_TASK.STACK.ISR.STA0 "Conversion method for mpl_psaf_task.stack.isr.status" TAB_VERB 5 0 "PKN_TASK_STK_STAT_NR_IN_PROG" 1 "PKN_TASK_STACK_DATA_STATUS_VALID" 2 "PKN_TASK_STK_STAT_NR_GROW_SPEC" 3 "PKN_TASK_STK_STAT_NR_ALLOC_SPEC" 4 "PKN_TASK_STK_STAT_NR_INV_SPEC" /end COMPU_VTAB
/* Scalar measurable for DDE 'mpl_psaf_task.stack.isr.used'. */
/begin MEASUREMENT mpl_psaf_task.stack.isr.used "Used bytes of interrupt stack for task named: psaf_task" ULONG CU_MPL_PSAF_TASK.STACK.ISR.USED 1 100 0.0 4294967295.0 ECU_ADDRESS 0x70016e9c BYTE_ORDER MSB_LAST /end MEASUREMENT
/begin COMPU_METHOD CU_MPL_PSAF_TASK.STACK.ISR.USED "Conversion method for mpl_psaf_task.stack.isr.used" RAT_FUNC "%10.0" "bytes" COEFFS 0.000000 1.000000 -0.000000 0.000000 0.000000 1.000000 /end COMPU_METHOD
/* Scalar measurable for DDE 'mpl_psaf_task.stack.task.status'. */
/begin MEASUREMENT mpl_psaf_task.stack.task.status "Current status of stack performance measurement for task: psaf_task" SLONG CU_MPL_PSAF_TASK.STACK.TASK.ST0 1 100 0.0 255.0 ECU_ADDRESS 0x70016eb0 BYTE_ORDER MSB_LAST /end MEASUREMENT
/begin COMPU_METHOD CU_MPL_PSAF_TASK.STACK.TASK.ST0 "Conversion method for mpl_psaf_task.stack.task.status" TAB_VERB "%12.0" "(not defined)" COMPU_TAB_REF CT_MPL_PSAF_TASK.STACK.TASK.ST0 /end COMPU_METHOD
/begin COMPU_VTAB CT_MPL_PSAF_TASK.STACK.TASK.ST0 "Conversion method for mpl_psaf_task.stack.task.status" TAB_VERB 5 0 "PKN_TASK_STK_STAT_NR_IN_PROG" 1 "PKN_TASK_STACK_DATA_STATUS_VALID" 2 "PKN_TASK_STK_STAT_NR_GROW_SPEC" 3 "PKN_TASK_STK_STAT_NR_ALLOC_SPEC" 4 "PKN_TASK_STK_STAT_NR_INV_SPEC" /end COMPU_VTAB
/* Scalar measurable for DDE 'mpl_psaf_task.stack.task.used'. */
/begin MEASUREMENT mpl_psaf_task.stack.task.used "Used bytes of task stack for task named: psaf_task" ULONG CU_MPL_PSAF_TASK.STACK.TASK.US0 1 100 0.0 4294967295.0 ECU_ADDRESS 0x70016eac BYTE_ORDER MSB_LAST /end MEASUREMENT
/begin COMPU_METHOD CU_MPL_PSAF_TASK.STACK.TASK.US0 "Conversion method for mpl_psaf_task.stack.task.used" RAT_FUNC "%10.0" "bytes" COEFFS 0.000000 1.000000 -0.000000 0.000000 0.000000 1.000000 /end COMPU_METHOD
/* Scalar measurable for DDE 'mpl_psaf_task.timing.max_task_time'. */
/begin MEASUREMENT mpl_psaf_task.timing.max_task_0 "Maximum duration of task since reset: psaf_task" ULONG CU_MPL_PSAF_TASK.TIMING.MAX_TA0 1 100 0.0 42949672.0 ECU_ADDRESS 0x7001cae0 BYTE_ORDER MSB_LAST /end MEASUREMENT
/begin COMPU_METHOD CU_MPL_PSAF_TASK.TIMING.MAX_TA0 "Conversion method for mpl_psaf_task.timing.max_task_time" RAT_FUNC "%10.0" "microseconds" COEFFS 0.000000 100.000000 -0.000000 0.000000 0.000000 1.000000 /end COMPU_METHOD
/* Scalar measurable for DDE 'mpl_psaf_task.timing.overruns'. */
/begin MEASUREMENT mpl_psaf_task.timing.overruns ": psaf_task" UBYTE CU_MPL_PSAF_TASK.TIMING.OVERRU0 1 100 0.0 255.0 ECU_ADDRESS 0x70016e90 BYTE_ORDER MSB_LAST /end MEASUREMENT
/begin COMPU_METHOD CU_MPL_PSAF_TASK.TIMING.OVERRU0 "Conversion method for mpl_psaf_task.timing.overruns" RAT_FUNC "%10.0" "count" COEFFS 0.000000 1.000000 -0.000000 0.000000 0.000000 1.000000 /end COMPU_METHOD
/* Scalar measurable for DDE 'mpl_psaf_task.timing.runs'. */
/begin MEASUREMENT mpl_psaf_task.timing.runs ": psaf_task" ULONG CU_MPL_PSAF_TASK.TIMING.RUNS 1 100 0.0 4294967295.0 ECU_ADDRESS 0x70016e8c BYTE_ORDER MSB_LAST /end MEASUREMENT
/begin COMPU_METHOD CU_MPL_PSAF_TASK.TIMING.RUNS "Conversion method for mpl_psaf_task.timing.runs" RAT_FUNC "%10.0" "count" COEFFS 0.000000 1.000000 -0.000000 0.000000 0.000000 1.000000 /end COMPU_METHOD
/* Scalar measurable for DDE 'mpl_psaf_task.timing.task_time'. */
/begin MEASUREMENT mpl_psaf_task.timing.task_time "Duration of task: psaf_task" ULONG CU_MPL_PSAF_TASK.TIMING.TASK_T0 1 100 0.0 42949672.0 ECU_ADDRESS 0x7001ca84 BYTE_ORDER MSB_LAST /end MEASUREMENT
/begin COMPU_METHOD CU_MPL_PSAF_TASK.TIMING.TASK_T0 "Conversion method for mpl_psaf_task.timing.task_time" RAT_FUNC "%10.0" "microseconds" COEFFS 0.000000 100.000000 -0.000000 0.000000 0.000000 1.000000 /end COMPU_METHOD
/* Scalar measurable for DDE 'mpl_psaf_tst_task.stack.isr.status'. */
/begin MEASUREMENT mpl_psaf_tst_task.stack.isr.st0 "Current status of stack performance measurement for task: psaf_tst_task" SLONG CU_MPL_PSAF_TST_TASK.STACK.ISR1 1 100 0.0 255.0 ECU_ADDRESS 0x70016ee8 BYTE_ORDER MSB_LAST /end MEASUREMENT
/begin COMPU_METHOD CU_MPL_PSAF_TST_TASK.STACK.ISR1 "Conversion method for mpl_psaf_tst_task.stack.isr.status" TAB_VERB "%12.0" "(not defined)" COMPU_TAB_REF CT_MPL_PSAF_TST_TASK.STACK.ISR1 /end COMPU_METHOD
/begin COMPU_VTAB CT_MPL_PSAF_TST_TASK.STACK.ISR1 "Conversion method for mpl_psaf_tst_task.stack.isr.status" TAB_VERB 5 0 "PKN_TASK_STK_STAT_NR_IN_PROG" 1 "PKN_TASK_STACK_DATA_STATUS_VALID" 2 "PKN_TASK_STK_STAT_NR_GROW_SPEC" 3 "PKN_TASK_STK_STAT_NR_ALLOC_SPEC" 4 "PKN_TASK_STK_STAT_NR_INV_SPEC" /end COMPU_VTAB
/* Scalar measurable for DDE 'mpl_psaf_tst_task.stack.isr.used'. */
/begin MEASUREMENT mpl_psaf_tst_task.stack.isr.us0 "Used bytes of interrupt stack for task named: psaf_tst_task" ULONG CU_MPL_PSAF_TST_TASK.STACK.ISR0 1 100 0.0 4294967295.0 ECU_ADDRESS 0x70016ee4 BYTE_ORDER MSB_LAST /end MEASUREMENT
/begin COMPU_METHOD CU_MPL_PSAF_TST_TASK.STACK.ISR0 "Conversion method for mpl_psaf_tst_task.stack.isr.used" RAT_FUNC "%10.0" "bytes" COEFFS 0.000000 1.000000 -0.000000 0.000000 0.000000 1.000000 /end COMPU_METHOD
/* Scalar measurable for DDE 'mpl_psaf_tst_task.stack.task.status'. */
/begin MEASUREMENT mpl_psaf_tst_task.stack.task.s0 "Current status of stack performance measurement for task: psaf_tst_task" SLONG CU_MPL_PSAF_TST_TASK.STACK.TAS1 1 100 0.0 255.0 ECU_ADDRESS 0x70016ef8 BYTE_ORDER MSB_LAST /end MEASUREMENT
/begin COMPU_METHOD CU_MPL_PSAF_TST_TASK.STACK.TAS1 "Conversion method for mpl_psaf_tst_task.stack.task.status" TAB_VERB "%12.0" "(not defined)" COMPU_TAB_REF CT_MPL_PSAF_TST_TASK.STACK.TAS1 /end COMPU_METHOD
/begin COMPU_VTAB CT_MPL_PSAF_TST_TASK.STACK.TAS1 "Conversion method for mpl_psaf_tst_task.stack.task.status" TAB_VERB 5 0 "PKN_TASK_STK_STAT_NR_IN_PROG" 1 "PKN_TASK_STACK_DATA_STATUS_VALID" 2 "PKN_TASK_STK_STAT_NR_GROW_SPEC" 3 "PKN_TASK_STK_STAT_NR_ALLOC_SPEC" 4 "PKN_TASK_STK_STAT_NR_INV_SPEC" /end COMPU_VTAB
/* Scalar measurable for DDE 'mpl_psaf_tst_task.stack.task.used'. */
/begin MEASUREMENT mpl_psaf_tst_task.stack.task.u0 "Used bytes of task stack for task named: psaf_tst_task" ULONG CU_MPL_PSAF_TST_TASK.STACK.TAS0 1 100 0.0 4294967295.0 ECU_ADDRESS 0x70016ef4 BYTE_ORDER MSB_LAST /end MEASUREMENT
/begin COMPU_METHOD CU_MPL_PSAF_TST_TASK.STACK.TAS0 "Conversion method for mpl_psaf_tst_task.stack.task.used" RAT_FUNC "%10.0" "bytes" COEFFS 0.000000 1.000000 -0.000000 0.000000 0.000000 1.000000 /end COMPU_METHOD
/* Scalar measurable for DDE 'mpl_psaf_tst_task.timing.max_task_time'. */
/begin MEASUREMENT mpl_psaf_tst_task.timing.max_t0 "Maximum duration of task since reset: psaf_tst_task" ULONG CU_MPL_PSAF_TST_TASK.TIMING.MA0 1 100 0.0 42949672.0 ECU_ADDRESS 0x7001cadc BYTE_ORDER MSB_LAST /end MEASUREMENT
/begin COMPU_METHOD CU_MPL_PSAF_TST_TASK.TIMING.MA0 "Conversion method for mpl_psaf_tst_task.timing.max_task_time" RAT_FUNC "%10.0" "microseconds" COEFFS 0.000000 100.000000 -0.000000 0.000000 0.000000 1.000000 /end COMPU_METHOD
/* Scalar measurable for DDE 'mpl_psaf_tst_task.timing.overruns'. */
/begin MEASUREMENT mpl_psaf_tst_task.timing.overr0 ": psaf_tst_task" UBYTE CU_MPL_PSAF_TST_TASK.TIMING.OV0 1 100 0.0 255.0 ECU_ADDRESS 0x70016ed8 BYTE_ORDER MSB_LAST /end MEASUREMENT
/begin COMPU_METHOD CU_MPL_PSAF_TST_TASK.TIMING.OV0 "Conversion method for mpl_psaf_tst_task.timing.overruns" RAT_FUNC "%10.0" "count" COEFFS 0.000000 1.000000 -0.000000 0.000000 0.000000 1.000000 /end COMPU_METHOD
/* Scalar measurable for DDE 'mpl_psaf_tst_task.timing.runs'. */
/begin MEASUREMENT mpl_psaf_tst_task.timing.runs ": psaf_tst_task" ULONG CU_MPL_PSAF_TST_TASK.TIMING.RU0 1 100 0.0 4294967295.0 ECU_ADDRESS 0x70016ed4 BYTE_ORDER MSB_LAST /end MEASUREMENT
/begin COMPU_METHOD CU_MPL_PSAF_TST_TASK.TIMING.RU0 "Conversion method for mpl_psaf_tst_task.timing.runs" RAT_FUNC "%10.0" "count" COEFFS 0.000000 1.000000 -0.000000 0.000000 0.000000 1.000000 /end COMPU_METHOD
/* Scalar measurable for DDE 'mpl_psaf_tst_task.timing.task_time'. */
/begin MEASUREMENT mpl_psaf_tst_task.timing.task_0 "Duration of task: psaf_tst_task" ULONG CU_MPL_PSAF_TST_TASK.TIMING.TA0 1 100 0.0 42949672.0 ECU_ADDRESS 0x7001ca80 BYTE_ORDER MSB_LAST /end MEASUREMENT
/begin COMPU_METHOD CU_MPL_PSAF_TST_TASK.TIMING.TA0 "Conversion method for mpl_psaf_tst_task.timing.task_time" RAT_FUNC "%10.0" "microseconds" COEFFS 0.000000 100.000000 -0.000000 0.000000 0.000000 1.000000 /end COMPU_METHOD
/* Scalar measurable for DDE 'mpl_psec_task.stack.isr.status'. */
/begin MEASUREMENT mpl_psec_task.stack.isr.status "Current status of stack performance measurement for task: psec_task" SLONG CU_MPL_PSEC_TASK.STACK.ISR.STA0 1 100 0.0 255.0 ECU_ADDRESS 0x70016e10 BYTE_ORDER MSB_LAST /end MEASUREMENT
/begin COMPU_METHOD CU_MPL_PSEC_TASK.STACK.ISR.STA0 "Conversion method for mpl_psec_task.stack.isr.status" TAB_VERB "%12.0" "(not defined)" COMPU_TAB_REF CT_MPL_PSEC_TASK.STACK.ISR.STA0 /end COMPU_METHOD
/begin COMPU_VTAB CT_MPL_PSEC_TASK.STACK.ISR.STA0 "Conversion method for mpl_psec_task.stack.isr.status" TAB_VERB 5 0 "PKN_TASK_STK_STAT_NR_IN_PROG" 1 "PKN_TASK_STACK_DATA_STATUS_VALID" 2 "PKN_TASK_STK_STAT_NR_GROW_SPEC" 3 "PKN_TASK_STK_STAT_NR_ALLOC_SPEC" 4 "PKN_TASK_STK_STAT_NR_INV_SPEC" /end COMPU_VTAB
/* Scalar measurable for DDE 'mpl_psec_task.stack.isr.used'. */
/begin MEASUREMENT mpl_psec_task.stack.isr.used "Used bytes of interrupt stack for task named: psec_task" ULONG CU_MPL_PSEC_TASK.STACK.ISR.USED 1 100 0.0 4294967295.0 ECU_ADDRESS 0x70016e0c BYTE_ORDER MSB_LAST /end MEASUREMENT
/begin COMPU_METHOD CU_MPL_PSEC_TASK.STACK.ISR.USED "Conversion method for mpl_psec_task.stack.isr.used" RAT_FUNC "%10.0" "bytes" COEFFS 0.000000 1.000000 -0.000000 0.000000 0.000000 1.000000 /end COMPU_METHOD
/* Scalar measurable for DDE 'mpl_psec_task.stack.task.status'. */
/begin MEASUREMENT mpl_psec_task.stack.task.status "Current status of stack performance measurement for task: psec_task" SLONG CU_MPL_PSEC_TASK.STACK.TASK.ST0 1 100 0.0 255.0 ECU_ADDRESS 0x70016e20 BYTE_ORDER MSB_LAST /end MEASUREMENT
/begin COMPU_METHOD CU_MPL_PSEC_TASK.STACK.TASK.ST0 "Conversion method for mpl_psec_task.stack.task.status" TAB_VERB "%12.0" "(not defined)" COMPU_TAB_REF CT_MPL_PSEC_TASK.STACK.TASK.ST0 /end COMPU_METHOD
/begin COMPU_VTAB CT_MPL_PSEC_TASK.STACK.TASK.ST0 "Conversion method for mpl_psec_task.stack.task.status" TAB_VERB 5 0 "PKN_TASK_STK_STAT_NR_IN_PROG" 1 "PKN_TASK_STACK_DATA_STATUS_VALID" 2 "PKN_TASK_STK_STAT_NR_GROW_SPEC" 3 "PKN_TASK_STK_STAT_NR_ALLOC_SPEC" 4 "PKN_TASK_STK_STAT_NR_INV_SPEC" /end COMPU_VTAB
/* Scalar measurable for DDE 'mpl_psec_task.stack.task.used'. */
/begin MEASUREMENT mpl_psec_task.stack.task.used "Used bytes of task stack for task named: psec_task" ULONG CU_MPL_PSEC_TASK.STACK.TASK.US0 1 100 0.0 4294967295.0 ECU_ADDRESS 0x70016e1c BYTE_ORDER MSB_LAST /end MEASUREMENT
/begin COMPU_METHOD CU_MPL_PSEC_TASK.STACK.TASK.US0 "Conversion method for mpl_psec_task.stack.task.used" RAT_FUNC "%10.0" "bytes" COEFFS 0.000000 1.000000 -0.000000 0.000000 0.000000 1.000000 /end COMPU_METHOD
/* Scalar measurable for DDE 'mpl_psec_task.timing.max_task_time'. */
/begin MEASUREMENT mpl_psec_task.timing.max_task_0 "Maximum duration of task since reset: psec_task" ULONG CU_MPL_PSEC_TASK.TIMING.MAX_TA0 1 100 0.0 42949672.0 ECU_ADDRESS 0x7001cae8 BYTE_ORDER MSB_LAST /end MEASUREMENT
/begin COMPU_METHOD CU_MPL_PSEC_TASK.TIMING.MAX_TA0 "Conversion method for mpl_psec_task.timing.max_task_time" RAT_FUNC "%10.0" "microseconds" COEFFS 0.000000 100.000000 -0.000000 0.000000 0.000000 1.000000 /end COMPU_METHOD
/* Scalar measurable for DDE 'mpl_psec_task.timing.overruns'. */
/begin MEASUREMENT mpl_psec_task.timing.overruns ": psec_task" UBYTE CU_MPL_PSEC_TASK.TIMING.OVERRU0 1 100 0.0 255.0 ECU_ADDRESS 0x70016e00 BYTE_ORDER MSB_LAST /end MEASUREMENT
/begin COMPU_METHOD CU_MPL_PSEC_TASK.TIMING.OVERRU0 "Conversion method for mpl_psec_task.timing.overruns" RAT_FUNC "%10.0" "count" COEFFS 0.000000 1.000000 -0.000000 0.000000 0.000000 1.000000 /end COMPU_METHOD
/* Scalar measurable for DDE 'mpl_psec_task.timing.runs'. */
/begin MEASUREMENT mpl_psec_task.timing.runs ": psec_task" ULONG CU_MPL_PSEC_TASK.TIMING.RUNS 1 100 0.0 4294967295.0 ECU_ADDRESS 0x70016dfc BYTE_ORDER MSB_LAST /end MEASUREMENT
/begin COMPU_METHOD CU_MPL_PSEC_TASK.TIMING.RUNS "Conversion method for mpl_psec_task.timing.runs" RAT_FUNC "%10.0" "count" COEFFS 0.000000 1.000000 -0.000000 0.000000 0.000000 1.000000 /end COMPU_METHOD
/* Scalar measurable for DDE 'mpl_psec_task.timing.task_time'. */
/begin MEASUREMENT mpl_psec_task.timing.task_time "Duration of task: psec_task" ULONG CU_MPL_PSEC_TASK.TIMING.TASK_T0 1 100 0.0 42949672.0 ECU_ADDRESS 0x7001ca8c BYTE_ORDER MSB_LAST /end MEASUREMENT
/begin COMPU_METHOD CU_MPL_PSEC_TASK.TIMING.TASK_T0 "Conversion method for mpl_psec_task.timing.task_time" RAT_FUNC "%10.0" "microseconds" COEFFS 0.000000 100.000000 -0.000000 0.000000 0.000000 1.000000 /end COMPU_METHOD
/* Scalar measurable for DDE 'mpl_pv2g_client.stack.isr.status'. */
/begin MEASUREMENT mpl_pv2g_client.stack.isr.stat0 "Current status of stack performance measurement for task: pv2g_client" SLONG CU_MPL_PV2G_CLIENT.STACK.ISR.S0 1 100 0.0 255.0 ECU_ADDRESS 0x700172d8 BYTE_ORDER MSB_LAST /end MEASUREMENT
/begin COMPU_METHOD CU_MPL_PV2G_CLIENT.STACK.ISR.S0 "Conversion method for mpl_pv2g_client.stack.isr.status" TAB_VERB "%12.0" "(not defined)" COMPU_TAB_REF CT_MPL_PV2G_CLIENT.STACK.ISR.S0 /end COMPU_METHOD
/begin COMPU_VTAB CT_MPL_PV2G_CLIENT.STACK.ISR.S0 "Conversion method for mpl_pv2g_client.stack.isr.status" TAB_VERB 5 0 "PKN_TASK_STK_STAT_NR_IN_PROG" 1 "PKN_TASK_STACK_DATA_STATUS_VALID" 2 "PKN_TASK_STK_STAT_NR_GROW_SPEC" 3 "PKN_TASK_STK_STAT_NR_ALLOC_SPEC" 4 "PKN_TASK_STK_STAT_NR_INV_SPEC" /end COMPU_VTAB
/* Scalar measurable for DDE 'mpl_pv2g_client.stack.isr.used'. */
/begin MEASUREMENT mpl_pv2g_client.stack.isr.used "Used bytes of interrupt stack for task named: pv2g_client" ULONG CU_MPL_PV2G_CLIENT.STACK.ISR.U0 1 100 0.0 4294967295.0 ECU_ADDRESS 0x700172d4 BYTE_ORDER MSB_LAST /end MEASUREMENT
/begin COMPU_METHOD CU_MPL_PV2G_CLIENT.STACK.ISR.U0 "Conversion method for mpl_pv2g_client.stack.isr.used" RAT_FUNC "%10.0" "bytes" COEFFS 0.000000 1.000000 -0.000000 0.000000 0.000000 1.000000 /end COMPU_METHOD
/* Scalar measurable for DDE 'mpl_pv2g_client.stack.task.status'. */
/begin MEASUREMENT mpl_pv2g_client.stack.task.sta0 "Current status of stack performance measurement for task: pv2g_client" SLONG CU_MPL_PV2G_CLIENT.STACK.TASK.0 1 100 0.0 255.0 ECU_ADDRESS 0x700172e8 BYTE_ORDER MSB_LAST /end MEASUREMENT
/begin COMPU_METHOD CU_MPL_PV2G_CLIENT.STACK.TASK.0 "Conversion method for mpl_pv2g_client.stack.task.status" TAB_VERB "%12.0" "(not defined)" COMPU_TAB_REF CT_MPL_PV2G_CLIENT.STACK.TASK.0 /end COMPU_METHOD
/begin COMPU_VTAB CT_MPL_PV2G_CLIENT.STACK.TASK.0 "Conversion method for mpl_pv2g_client.stack.task.status" TAB_VERB 5 0 "PKN_TASK_STK_STAT_NR_IN_PROG" 1 "PKN_TASK_STACK_DATA_STATUS_VALID" 2 "PKN_TASK_STK_STAT_NR_GROW_SPEC" 3 "PKN_TASK_STK_STAT_NR_ALLOC_SPEC" 4 "PKN_TASK_STK_STAT_NR_INV_SPEC" /end COMPU_VTAB
/* Scalar measurable for DDE 'mpl_pv2g_client.stack.task.used'. */
/begin MEASUREMENT mpl_pv2g_client.stack.task.used "Used bytes of task stack for task named: pv2g_client" ULONG CU_MPL_PV2G_CLIENT.STACK.TASK.1 1 100 0.0 4294967295.0 ECU_ADDRESS 0x700172e4 BYTE_ORDER MSB_LAST /end MEASUREMENT
/begin COMPU_METHOD CU_MPL_PV2G_CLIENT.STACK.TASK.1 "Conversion method for mpl_pv2g_client.stack.task.used" RAT_FUNC "%10.0" "bytes" COEFFS 0.000000 1.000000 -0.000000 0.000000 0.000000 1.000000 /end COMPU_METHOD
/* Scalar measurable for DDE 'mpl_pv2g_client.timing.max_task_time'. */
/begin MEASUREMENT mpl_pv2g_client.timing.max_tas0 "Maximum duration of task since reset: pv2g_client" ULONG CU_MPL_PV2G_CLIENT.TIMING.MAX_0 1 100 0.0 42949672.0 ECU_ADDRESS 0x7001caa4 BYTE_ORDER MSB_LAST /end MEASUREMENT
/begin COMPU_METHOD CU_MPL_PV2G_CLIENT.TIMING.MAX_0 "Conversion method for mpl_pv2g_client.timing.max_task_time" RAT_FUNC "%10.0" "microseconds" COEFFS 0.000000 100.000000 -0.000000 0.000000 0.000000 1.000000 /end COMPU_METHOD
/* Scalar measurable for DDE 'mpl_pv2g_client.timing.overruns'. */
/begin MEASUREMENT mpl_pv2g_client.timing.overruns ": pv2g_client" UBYTE CU_MPL_PV2G_CLIENT.TIMING.OVER0 1 100 0.0 255.0 ECU_ADDRESS 0x700172c8 BYTE_ORDER MSB_LAST /end MEASUREMENT
/begin COMPU_METHOD CU_MPL_PV2G_CLIENT.TIMING.OVER0 "Conversion method for mpl_pv2g_client.timing.overruns" RAT_FUNC "%10.0" "count" COEFFS 0.000000 1.000000 -0.000000 0.000000 0.000000 1.000000 /end COMPU_METHOD
/* Scalar measurable for DDE 'mpl_pv2g_client.timing.runs'. */
/begin MEASUREMENT mpl_pv2g_client.timing.runs ": pv2g_client" ULONG CU_MPL_PV2G_CLIENT.TIMING.RUNS 1 100 0.0 4294967295.0 ECU_ADDRESS 0x700172c4 BYTE_ORDER MSB_LAST /end MEASUREMENT
/begin COMPU_METHOD CU_MPL_PV2G_CLIENT.TIMING.RUNS "Conversion method for mpl_pv2g_client.timing.runs" RAT_FUNC "%10.0" "count" COEFFS 0.000000 1.000000 -0.000000 0.000000 0.000000 1.000000 /end COMPU_METHOD
/* Scalar measurable for DDE 'mpl_pv2g_client.timing.task_time'. */
/begin MEASUREMENT mpl_pv2g_client.timing.task_ti0 "Duration of task: pv2g_client" ULONG CU_MPL_PV2G_CLIENT.TIMING.TASK0 1 100 0.0 42949672.0 ECU_ADDRESS 0x7001ca48 BYTE_ORDER MSB_LAST /end MEASUREMENT
/begin COMPU_METHOD CU_MPL_PV2G_CLIENT.TIMING.TASK0 "Conversion method for mpl_pv2g_client.timing.task_time" RAT_FUNC "%10.0" "microseconds" COEFFS 0.000000 100.000000 -0.000000 0.000000 0.000000 1.000000 /end COMPU_METHOD
/* Scalar measurable for DDE 'mpl_reset_count'. */
/begin MEASUREMENT mpl_reset_count "Number of resets since power-up." ULONG CU_MPL_RESET_COUNT 1 100 0.0 4294967295.0 ECU_ADDRESS 0x7001d784 BYTE_ORDER MSB_LAST /end MEASUREMENT
/begin COMPU_METHOD CU_MPL_RESET_COUNT "Conversion method for mpl_reset_count" RAT_FUNC "%10.0" "events" COEFFS 0.000000 1.000000 -0.000000 0.000000 0.000000 1.000000 /end COMPU_METHOD
/* Scalar measurable for DDE 'mpl_run_time'. */
/begin MEASUREMENT mpl_run_time "Time since startup" ULONG CU_MPL_RUN_TIME 1 100 0.0 4294967295.0 ECU_ADDRESS 0xf0240004 BYTE_ORDER MSB_LAST /end MEASUREMENT
/begin COMPU_METHOD CU_MPL_RUN_TIME "Conversion method for mpl_run_time" RAT_FUNC "%10.0" "seconds" COEFFS 0.000000 1.000000 -0.000000 0.000000 0.000000 1.000000 /end COMPU_METHOD
/* Scalar measurable for DDE 'mpl_task_10ms.stack.isr.status'. */
/begin MEASUREMENT mpl_task_10ms.stack.isr.status "Current status of stack performance measurement for task: task_10ms" SLONG CU_MPL_TASK_10MS.STACK.ISR.STA0 1 100 0.0 255.0 ECU_ADDRESS 0x70016dc8 BYTE_ORDER MSB_LAST /end MEASUREMENT
/begin COMPU_METHOD CU_MPL_TASK_10MS.STACK.ISR.STA0 "Conversion method for mpl_task_10ms.stack.isr.status" TAB_VERB "%12.0" "(not defined)" COMPU_TAB_REF CT_MPL_TASK_10MS.STACK.ISR.STA0 /end COMPU_METHOD
/begin COMPU_VTAB CT_MPL_TASK_10MS.STACK.ISR.STA0 "Conversion method for mpl_task_10ms.stack.isr.status" TAB_VERB 5 0 "PKN_TASK_STK_STAT_NR_IN_PROG" 1 "PKN_TASK_STACK_DATA_STATUS_VALID" 2 "PKN_TASK_STK_STAT_NR_GROW_SPEC" 3 "PKN_TASK_STK_STAT_NR_ALLOC_SPEC" 4 "PKN_TASK_STK_STAT_NR_INV_SPEC" /end COMPU_VTAB
/* Scalar measurable for DDE 'mpl_task_10ms.stack.isr.used'. */
/begin MEASUREMENT mpl_task_10ms.stack.isr.used "Used bytes of interrupt stack for task named: task_10ms" ULONG CU_MPL_TASK_10MS.STACK.ISR.USED 1 100 0.0 4294967295.0 ECU_ADDRESS 0x70016dc4 BYTE_ORDER MSB_LAST /end MEASUREMENT
/begin COMPU_METHOD CU_MPL_TASK_10MS.STACK.ISR.USED "Conversion method for mpl_task_10ms.stack.isr.used" RAT_FUNC "%10.0" "bytes" COEFFS 0.000000 1.000000 -0.000000 0.000000 0.000000 1.000000 /end COMPU_METHOD
/* Scalar measurable for DDE 'mpl_task_10ms.stack.task.status'. */
/begin MEASUREMENT mpl_task_10ms.stack.task.status "Current status of stack performance measurement for task: task_10ms" SLONG CU_MPL_TASK_10MS.STACK.TASK.ST0 1 100 0.0 255.0 ECU_ADDRESS 0x70016dd8 BYTE_ORDER MSB_LAST /end MEASUREMENT
/begin COMPU_METHOD CU_MPL_TASK_10MS.STACK.TASK.ST0 "Conversion method for mpl_task_10ms.stack.task.status" TAB_VERB "%12.0" "(not defined)" COMPU_TAB_REF CT_MPL_TASK_10MS.STACK.TASK.ST0 /end COMPU_METHOD
/begin COMPU_VTAB CT_MPL_TASK_10MS.STACK.TASK.ST0 "Conversion method for mpl_task_10ms.stack.task.status" TAB_VERB 5 0 "PKN_TASK_STK_STAT_NR_IN_PROG" 1 "PKN_TASK_STACK_DATA_STATUS_VALID" 2 "PKN_TASK_STK_STAT_NR_GROW_SPEC" 3 "PKN_TASK_STK_STAT_NR_ALLOC_SPEC" 4 "PKN_TASK_STK_STAT_NR_INV_SPEC" /end COMPU_VTAB
/* Scalar measurable for DDE 'mpl_task_10ms.stack.task.used'. */
/begin MEASUREMENT mpl_task_10ms.stack.task.used "Used bytes of task stack for task named: task_10ms" ULONG CU_MPL_TASK_10MS.STACK.TASK.US0 1 100 0.0 4294967295.0 ECU_ADDRESS 0x70016dd4 BYTE_ORDER MSB_LAST /end MEASUREMENT
/begin COMPU_METHOD CU_MPL_TASK_10MS.STACK.TASK.US0 "Conversion method for mpl_task_10ms.stack.task.used" RAT_FUNC "%10.0" "bytes" COEFFS 0.000000 1.000000 -0.000000 0.000000 0.000000 1.000000 /end COMPU_METHOD
/* Scalar measurable for DDE 'mpl_task_10ms.timing.max_task_time'. */
/begin MEASUREMENT mpl_task_10ms.timing.max_task_0 "Maximum duration of task since reset: task_10ms" ULONG CU_MPL_TASK_10MS.TIMING.MAX_TA0 1 100 0.0 42949672.0 ECU_ADDRESS 0x7001ca94 BYTE_ORDER MSB_LAST /end MEASUREMENT
/begin COMPU_METHOD CU_MPL_TASK_10MS.TIMING.MAX_TA0 "Conversion method for mpl_task_10ms.timing.max_task_time" RAT_FUNC "%10.0" "microseconds" COEFFS 0.000000 100.000000 -0.000000 0.000000 0.000000 1.000000 /end COMPU_METHOD
/* Scalar measurable for DDE 'mpl_task_10ms.timing.overruns'. */
/begin MEASUREMENT mpl_task_10ms.timing.overruns ": task_10ms" UBYTE CU_MPL_TASK_10MS.TIMING.OVERRU0 1 100 0.0 255.0 ECU_ADDRESS 0x70016db8 BYTE_ORDER MSB_LAST /end MEASUREMENT
/begin COMPU_METHOD CU_MPL_TASK_10MS.TIMING.OVERRU0 "Conversion method for mpl_task_10ms.timing.overruns" RAT_FUNC "%10.0" "count" COEFFS 0.000000 1.000000 -0.000000 0.000000 0.000000 1.000000 /end COMPU_METHOD
/* Scalar measurable for DDE 'mpl_task_10ms.timing.runs'. */
/begin MEASUREMENT mpl_task_10ms.timing.runs ": task_10ms" ULONG CU_MPL_TASK_10MS.TIMING.RUNS 1 100 0.0 4294967295.0 ECU_ADDRESS 0x70016db4 BYTE_ORDER MSB_LAST /end MEASUREMENT
/begin COMPU_METHOD CU_MPL_TASK_10MS.TIMING.RUNS "Conversion method for mpl_task_10ms.timing.runs" RAT_FUNC "%10.0" "count" COEFFS 0.000000 1.000000 -0.000000 0.000000 0.000000 1.000000 /end COMPU_METHOD
/* Scalar measurable for DDE 'mpl_task_10ms.timing.task_time'. */
/begin MEASUREMENT mpl_task_10ms.timing.task_time "Duration of task: task_10ms" ULONG CU_MPL_TASK_10MS.TIMING.TASK_T0 1 100 0.0 42949672.0 ECU_ADDRESS 0x7001ca38 BYTE_ORDER MSB_LAST /end MEASUREMENT
/begin COMPU_METHOD CU_MPL_TASK_10MS.TIMING.TASK_T0 "Conversion method for mpl_task_10ms.timing.task_time" RAT_FUNC "%10.0" "microseconds" COEFFS 0.000000 100.000000 -0.000000 0.000000 0.000000 1.000000 /end COMPU_METHOD
/* Scalar measurable for DDE 'mpl_unstable_reset_count'. */
/begin MEASUREMENT mpl_unstable_reset_count "Number of resets since power-up, or since the application was last stable." ULONG CU_MPL_UNSTABLE_RESET_COUNT 1 100 0.0 4294967295.0 ECU_ADDRESS 0x70013cec BYTE_ORDER MSB_LAST /end MEASUREMENT
/begin COMPU_METHOD CU_MPL_UNSTABLE_RESET_COUNT "Conversion method for mpl_unstable_reset_count" RAT_FUNC "%10.0" "events" COEFFS 0.000000 1.000000 -0.000000 0.000000 0.000000 1.000000 /end COMPU_METHOD
/begin FUNCTION Automatic "Group /ByType/Automatic"
 /begin LOC_MEASUREMENT mpl_pkn_pxros_performance.stac3 mpl_pkn_pxros_performance.stac1 mpl_pkn_pxros_performance.stac0 mpl_pkn_pxros_performance.stac2 mpl_pkn_pxros_performance.timi1 mpl_pkn_pxros_performance.timi3 mpl_pkn_pxros_performance.timi2 mpl_pkn_pxros_performance.timi0 mpl_pkn_pxros_pm_entry_invalid0 mpl_pkn_pxros_pm_entry_invalid1 mpl_pkn_pxros_pm_exit_invalid_1 mpl_pkn_pxros_pm_exit_invalid_0 mpl_pkn_pxros_pm_invalid_event0 mpl_pkn_pxros_pm_invalid_msg_c0 mpl_plat_build_day mpl_plat_build_month mpl_plat_build_year mpl_plat_part_num_group mpl_plat_part_num_id mpl_plat_part_num_issue mpl_plat_part_num_letter mpl_plat_ver_major mpl_plat_ver_minor mpl_plat_ver_sub mpl_pqca_client.stack.isr.stat0 mpl_pqca_client.stack.isr.used mpl_pqca_client.stack.task.sta0 mpl_pqca_client.stack.task.used mpl_pqca_client.timing.max_tas0 mpl_pqca_client.timing.overruns mpl_pqca_client.timing.runs mpl_pqca_client.timing.task_ti0 mpl_prg_build_day mpl_prg_build_month mpl_prg_build_year mpl_prg_part_num_group mpl_prg_part_num_id mpl_prg_part_num_issue mpl_prg_part_num_letter mpl_prg_ver_major mpl_prg_ver_minor mpl_prg_ver_sub mpl_psaf_pfm_task.stack.isr.st0 mpl_psaf_pfm_task.stack.isr.us0 mpl_psaf_pfm_task.stack.task.s0 mpl_psaf_pfm_task.stack.task.u0 mpl_psaf_pfm_task.timing.max_t0 mpl_psaf_pfm_task.timing.overr0 mpl_psaf_pfm_task.timing.runs mpl_psaf_pfm_task.timing.task_0 mpl_psaf_task.stack.isr.status mpl_psaf_task.stack.isr.used mpl_psaf_task.stack.task.status mpl_psaf_task.stack.task.used mpl_psaf_task.timing.max_task_0 mpl_psaf_task.timing.overruns mpl_psaf_task.timing.runs mpl_psaf_task.timing.task_time mpl_psaf_tst_task.stack.isr.st0 mpl_psaf_tst_task.stack.isr.us0 mpl_psaf_tst_task.stack.task.s0 mpl_psaf_tst_task.stack.task.u0 mpl_psaf_tst_task.timing.max_t0 mpl_psaf_tst_task.timing.overr0 mpl_psaf_tst_task.timing.runs mpl_psaf_tst_task.timing.task_0 mpl_psec_task.stack.isr.status mpl_psec_task.stack.isr.used mpl_psec_task.stack.task.status mpl_psec_task.stack.task.used mpl_psec_task.timing.max_task_0 mpl_psec_task.timing.overruns mpl_psec_task.timing.runs mpl_psec_task.timing.task_time mpl_pv2g_client.stack.isr.stat0 mpl_pv2g_client.stack.isr.used mpl_pv2g_client.stack.task.sta0 mpl_pv2g_client.stack.task.used mpl_pv2g_client.timing.max_tas0 mpl_pv2g_client.timing.overruns mpl_pv2g_client.timing.runs mpl_pv2g_client.timing.task_ti0 mpl_reset_count mpl_run_time mpl_task_10ms.stack.isr.status mpl_task_10ms.stack.isr.used mpl_task_10ms.stack.task.status mpl_task_10ms.stack.task.used mpl_task_10ms.timing.max_task_0 mpl_task_10ms.timing.overruns mpl_task_10ms.timing.runs mpl_task_10ms.timing.task_time mpl_unstable_reset_count /end LOC_MEASUREMENT
/end FUNCTION
/begin FUNCTION Scalars "Group /ByType/Scalars"
 /begin REF_CHARACTERISTIC A2_vproxim_FltMax_C A2_vproxim_FltMin_C A2_vproxim_ScaleFactor_C A3_vpilot_FltMax_C A3_vpilot_FltMin_C A3_vpilot_Offset_C A3_vpilot_ScaleFactor_C A3_vpilpeak_FltMax_C A3_vpilpeak_FltMin_C A3_vpilpeak_Offset_C A3_vpilpeak_ScaleFactor_C B4_vtempc_FltMax_C B4_vtempc_FltMin_C C2_vtempd_FltMax_C C2_vtempd_FltMin_C CANFDData_override_C CANFDIncrement_C CANFDInitCount_C CANFDResetCounter_C CANFDTrig_C CANFDTrig_override_C CANFDTxTimeoutDur_C CANLoad10_C CANLoad11_C CANLoad12_C CANLoad13_C CANLoad14_C CANLoad15_C CANLoad16_C CANLoad17_C CANLoad18_C CANLoad19_C CANLoad1_C CANLoad20_C CANLoad21_C CANLoad22_C CANLoad23_C CANLoad24_C CANLoad25_C CANLoad26_C CANLoad27_C CANLoad28_C CANLoad29_C CANLoad2_C CANLoad30_C CANLoad31_C CANLoad32_C CANLoad33_C CANLoad34_C CANLoad35_C CANLoad36_C CANLoad37_C CANLoad38_C CANLoad39_C CANLoad3_C CANLoad40_C CANLoad41_C CANLoad42_C CANLoad43_C CANLoad44_C CANLoad4_C CANLoad5_C CANLoad6_C CANLoad7_C CANLoad8_C CANLoad9_C CcsCtlEcuHoldQcaPwrReqTime_C CcsCtlEcuHoldQcaPwrReq_C CcsCtlStopCpEStopMask_C CcsCtlStopCpNStopMask_C CcsCtlStopCpRStopMask_C CcsCtlStopIntFltEStopMask_C CcsCtlStopIntFltNStopMask_C CcsCtlStopIntFltRStopMask_C CcsCtlStopPpEStopMask_C CcsCtlStopPpNStopMask_C CcsCtlStopPpRStopMask_C CcsCtlStopRxEgyTypeEStopMask_C CcsCtlStopRxEgyTypeNStopMask_C CcsCtlStopRxEgyTypeRStopMask_C CcsCtlStopRxEvVoltEStopMask_C CcsCtlStopRxEvVoltNStopMask_C CcsCtlStopRxEvVoltRStopMask_C CcsCtlStopRxEvseCrntEStopMask_C CcsCtlStopRxEvseCrntNStopMask_C CcsCtlStopRxEvseCrntRStopMask_C CcsCtlStopRxEvseIsolEStopMask_C CcsCtlStopRxEvseIsolNStopMask_C CcsCtlStopRxEvseIsolRStopMask_C CcsCtlStopRxEvseProcEStopMask_C CcsCtlStopRxEvseProcNStopMask_C CcsCtlStopRxEvseProcRStopMask_C CcsCtlStopRxEvsePwrEStopMask_C CcsCtlStopRxEvsePwrNStopMask_C CcsCtlStopRxEvsePwrRStopMask_C CcsCtlStopRxEvseStEStopMask_C CcsCtlStopRxEvseStNStopMask_C CcsCtlStopRxEvseStRStopMask_C CcsCtlStopRxEvseVoltEStopMask_C CcsCtlStopRxEvseVoltNStopMask_C CcsCtlStopRxEvseVoltRStopMask_C CcsCtlStopSeqEStopMask_C CcsCtlStopSeqNStopMask_C CcsCtlStopSeqRStopMask_C CcsCtlStopSupPrtclEStopMask_C CcsCtlStopSupPrtclNStopMask_C CcsCtlStopSupPrtclRStopMask_C CcsCtlStopV2gMsgEStopMask_C CcsCtlStopV2gMsgNStopMask_C CcsCtlStopV2gMsgRStopMask_C CcsCtlSvcDetailMsgEnable_C CcsFltCpDutcycOorhCmax_C CcsFltCpDutcycOorhLim_C CcsFltCpDutcycOorlCmax_C CcsFltCpDutcycOorlLim_C CcsFltCpEn_C CcsFltCpErrStOorCmax_C CcsFltCpErrStOorhLim_C CcsFltCpErrStOorlLim_C CcsFltCpFrqOorCmax_C CcsFltCpFrqOorhLim_C CcsFltCpFrqOorlLim_C CcsFltCpPwmtoCmax_C CcsFltEvseProcV2GtoLim_C CcsFltInternalFaultsEn_C CcsFltLinkEn_C CcsFltPpCpRatCmax_C CcsFltPpEn_C CcsFltPpVoltOorhCmax_C CcsFltPpVoltOorhLim_C CcsFltPpVoltOorlCmax_C CcsFltPpVoltOorlLim_C CcsFltPpVrefOorCmax_C CcsFltPpVrefOorhLim_C CcsFltPpVrefOorlLim_C CcsFltRxEgyTrnsTypeEn_C CcsFltRxEvVoltEn_C CcsFltRxEvseCrntEn_C CcsFltRxEvseCrntPortOocCmax_C CcsFltRxEvseCrntPortOocLim_C CcsFltRxEvseIsolStEn_C CcsFltRxEvseProcStEn_C CcsFltRxEvsePwrEn_C CcsFltRxEvseStCodeEn_C CcsFltRxEvseVoltEn_C CcsFltRxEvseVoltPortOocCmax_C CcsFltRxEvseVoltPortOocLim_C CcsFltRxEvseVoltRessOocCmax_C CcsFltRxEvseVoltRessOocLim_C CcsFltRxSvcDiscEn_C CcsFltSeqChgReadyVstoCmax_C CcsFltSeqChgReadyVstoLim_C CcsFltSeqCommSetupVstoCmax_C CcsFltSeqCommSetupVstoLim_C CcsFltSeqEn_C CcsFltSeqIsolCheckVstoCmax_C CcsFltSeqIsolCheckVstoLim_C CcsFltSeqIsolStopVstoCmax_C CcsFltSeqIsolStopVstoLim_C CcsFltSeqLockEnVstoCmax_C CcsFltSeqLockEnVstoLim_C CcsFltSeqPrechgVstoCmax_C CcsFltSeqPrechgVstoLim_C CcsFltSeqRlyCloseVstoCmax_C CcsFltSeqRlyCloseVstoLim_C CcsFltStopFltResponseOf_C CcsFltStopFltResponseOv_C CcsFltV2gMsgAuthVmto_C CcsFltV2gMsgBptCtrlVmto_C CcsFltV2gMsgCblChkVmto_C CcsFltV2gMsgCrntDmdIsoVmto_C CcsFltV2gMsgCrntDmdVmto_C CcsFltV2gMsgEn_C CcsFltV2gMsgParamDiscVmto_C CcsFltV2gMsgPrechglVmto_C CcsFltV2gMsgPwrDelivIsoVmto_C CcsFltV2gMsgPwrDelivVmto_C CcsFltV2gMsgPymtSelVmto_C CcsFltV2gMsgSesSetupVmto_C CcsFltV2gMsgSesStopVmto_C CcsFltV2gMsgSupPrtclVmto_C CcsFltV2gMsgSvcDetailVmto_C CcsFltV2gMsgSvcDiscVmto_C CcsFltV2gMsgWeldDetVmto_C CcsIprAcdMaxAcCrntRange4Ofst1_C CcsIprAcdMaxAcCrntRange5Gain1_C CcsIprAcdMaxAcCrntRange5Ofst1_C CcsIprAcdMaxAcCrntRange6Gain1_C CcsIprAcdMaxAcCrntRange6Gain2_C CcsIprAcdMaxAcCrntRange7Gain1_C CcsIprAcdMaxAcCrntRange7Gain2_C CcsIprAcdMaxAcCrntRange7Ofst1_C CcsIprAcdMaxAcCrntRange8Gain1_C CcsIprAcdMaxAcCrntRange8Ofst1_C CcsIprCpChargingModeOf_C CcsIprCpChargingModeOv_C CcsIprCpDutcycAcDbncTime_C CcsIprCpDutcycPct5DbncTime_C CcsIprCpDutyRangeAcLimHi_C CcsIprCpDutyRangeAcLimLo_C CcsIprCpDutyRangeDcLimHi_C CcsIprCpDutyRangeDcLimLo_C CcsIprDcChgCrntNearZeroThrsh_C CcsIprDcChgInletCrntSafeOf_C CcsIprDcChgInletCrntSafeOv_C CcsIprDcChgInletCrntSafeThrsh_C CcsIprDcChgInletVoltSafeOf_C CcsIprDcChgInletVoltSafeOv_C CcsIprDcChgInletVoltSafeThrsh_C CcsIprDcPrechgCompleteOf_C CcsIprDcPrechgCompleteOv_C CcsIprDcPrechgDoneDbncTime_C CcsIprDcPrechgVoltThrsh_C CcsIprDisPmaxDefault_C CcsIprPmaxDefault_C CcsIprPmaxEnable_C CcsIprPpDbncTime_C CcsIprPpPosOf_C CcsIprPpPosOv_C CcsIprPpStOf_C CcsIprPpStOv_C CcsIprPpSupplyInvalidInitTime_C CcsIprPrtVehChargingPortStOf_C CcsIprPrtVehChargingPortStOv_C CcsIprPrxEvseCrntMaxOf_C CcsIprPrxEvseCrntMaxOv_C CcsIprPrxEvseCrntMinOf_C CcsIprPrxEvseCrntMinOv_C CcsIprPrxEvseCrntValidTimeout_C CcsIprPrxEvseDchgCrntMaxOf_C CcsIprPrxEvseDchgCrntMaxOv_C CcsIprPrxEvseDchgCrntMinOf_C CcsIprPrxEvseDchgCrntMinOv_C CcsIprPrxEvseDchgPwrMaxOf_C CcsIprPrxEvseDchgPwrMaxOv_C CcsIprPrxEvsePwrMaxOf_C CcsIprPrxEvsePwrMaxOv_C CcsIprPrxEvseVoltMaxOf_C CcsIprPrxEvseVoltMaxOv_C CcsIprPrxEvseVoltMinOf_C CcsIprPrxEvseVoltMinOv_C CcsIprPrxEvseVoltValidTimeout_C CcsOprPrechgTargetCrnt_C CcsOprSessionCompleteSocThrsh_C CcsOprV2gTxEvCabinConditionOf_C CcsOprV2gTxEvCabinConditionOv_C CcsOprV2gTxReadyToChargeOf_C CcsOprV2gTxReadyToChargeOv_C CcsStmChgInletLockEnOf_C CcsStmChgInletLockEnOv_C CcsStmChgRelayEnOf_C CcsStmChgRelayEnOv_C CcsStmChgRelayWeldCheckEnOf_C CcsStmChgRelayWeldCheckEnOv_C CcsStmDelayQcaStartup_C CcsStmEvIsolCheckInhibitOf_C CcsStmEvIsolCheckInhibitOv_C CcsStmStateOf_C CcsStmStateOv_C CcsStmV2gConnectInitOf_C CcsStmV2gConnectInitOv_C CcsStmV2gConnectTerminateOf_C CcsStmV2gConnectTerminateOv_C CcsStmV2gPilotPulldownEnOf_C CcsStmV2gPilotPulldownEnOv_C CcsStmV2gStMsgTxOf_C CcsStmV2gStMsgTxOv_C D3_AinE_FltMax_C D3_AinE_FltMin_C D3_AinE_ScaleFactor_C F2_LedA_FltMax_C F2_LedA_FltMin_C F2_LedA_ScaleFactor_C F3_LedB_FltMax_C F3_LedB_FltMin_C F3_LedB_ScaleFactor_C F4_LedC_FltMax_C F4_LedC_FltMin_C F4_LedC_ScaleFactor_C HostAcCrntPresAtPortEnOf_C HostAcCrntPresAtPortEnOv_C HostAcCrntPresentAtPortOf_C HostAcCrntPresentAtPortOv_C HostAcVltPresAtPortEnOf_C HostAcVltPresAtPortEnOv_C HostAcVoltPresentAtPortOf_C HostAcVoltPresentAtPortOv_C HostAinEvsePilotVoltPeakRawOf_C HostAinEvsePilotVoltPeakRawOv_C HostAinEvsePilotVoltRawOf_C HostAinEvsePilotVoltRawOv_C HostAinEvseProximityVoltRawOf_C HostAinEvseProximityVoltRawOv_C HostAinProximitySupplyFdbkOf_C HostAinProximitySupplyFdbkOv_C HostAllChargeRelaysClosedDelay0 HostAllChgRelaysClosedOf_C HostAllChgRelaysClosedOv_C HostBptModePriorityOf_C HostBptModePriorityOv_C HostBptModePriority_C HostChargeEmergStop_C HostChargeEmergencyStopOf_C HostChargeEmergencyStopOv_C HostChargeInletLockStatusDelay0 HostChargeNormalStopOf_C HostChargeNormalStopOv_C HostChargeNormalStop_C HostChgInletLockStatusOf_C HostChgInletLockStatusOv_C HostChgPortCrntAcEn_C HostChgPortCrntAc_C HostChgPortCrntDcOf_C HostChgPortCrntDcOv_C HostChgPortCrntDcValidOf_C HostChgPortCrntDcValidOv_C HostChgPortCrntDcValid_C HostChgPortCrntDc_C HostChgPortVoltAcEn_C HostChgPortVoltAc_C HostChgPortVoltDcOf_C HostChgPortVoltDcOv_C HostChgPortVoltDcValidOf_C HostChgPortVoltDcValidOv_C HostChgPortVoltDcValid_C HostChgPortVoltDc_C HostChgRlyWeldCheckDoneDelay_C HostChgRlyWeldCheckDoneOf_C HostChgRlyWeldCheckDoneOv_C HostDepartureTimeOf_C HostDepartureTimeOv_C HostDepartureTime_C HostDesiredEgyTransferMode_C HostDesiredEgyTrnsfrMdeOf_C HostDesiredEgyTrnsfrMdeOv_C HostDinProtocolEnable_C HostDinProtocolPriority_C HostDynamicModePriorityOf_C HostDynamicModePriorityOv_C HostDynamicModePriority_C HostEvCrntMaxLim_C HostEvCrntMinLim_C HostEvCurrMaxLimOf_C HostEvCurrMaxLimOv_C HostEvCurrMinLimOf_C HostEvCurrMinLimOv_C HostEvDchgCrntMaxLim_C HostEvDchgCrntMinLim_C HostEvDchgPwrMaxLim_C HostEvDchgPwrMinLim_C HostEvDisChgCurrMaxLimOf_C HostEvDisChgCurrMaxLimOv_C HostEvDisChgCurrMinLimOf_C HostEvDisChgCurrMinLimOv_C HostEvDisChgPwrMaxLimOf_C HostEvDisChgPwrMaxLimOv_C HostEvDisChgPwrMinLimOf_C HostEvDisChgPwrMinLimOv_C HostEvEgyCapacityOf_C HostEvEgyCapacityOv_C HostEvEgyCapacity_C HostEvEgyMax_C HostEvEgyMin_C HostEvEgyReqAmountOf_C HostEvEgyReqAmountOv_C HostEvEgyReqAmount_C HostEvIsolCheckDisabledDelay_C HostEvIsolCheckDisabledOf_C HostEvIsolCheckDisabledOv_C HostEvMaxEgyOf_C HostEvMaxEgyOv_C HostEvMinEgyOf_C HostEvMinEgyOv_C HostEvPwrMaxLimOf_C HostEvPwrMaxLimOv_C HostEvPwrMaxLim_C HostEvPwrMinLimOf_C HostEvPwrMinLimOv_C HostEvPwrMinLim_C HostEvTargetCrntOf_C HostEvTargetCrntOv_C HostEvTargetCrnt_C HostEvTargetVoltOf_C HostEvTargetVoltOv_C HostEvTargetVolt_C HostEvVoltMaxLimOf_C HostEvVoltMaxLimOv_C HostEvVoltMaxLim_C HostEvVoltMinLimOf_C HostEvVoltMinLimOv_C HostEvVoltMinLim_C HostIgnoreIsolWarningOf_C HostIgnoreIsolWarningOv_C HostIgnoreIsolWarning_C HostIso1ProtocolEnable_C HostIso1ProtocolPriority_C HostIso2ProtocolEnable_C HostIso2ProtocolPriority_C HostPriorityDinOf_C HostPriorityDinOv_C HostPriorityIsoV1Of_C HostPriorityIsoV1Ov_C HostPriorityIsoV2Of_C HostPriorityIsoV2Ov_C HostProtocolDinEnblOf_C HostProtocolDinEnblOv_C HostProtocolIsoV1EnblOf_C HostProtocolIsoV1EnblOv_C HostProtocolIsoV2EnblOf_C HostProtocolIsoV2EnblOv_C HostPwminEvsePilotDutcycOf_C HostPwminEvsePilotDutcycOv_C HostPwminEvsePilotFreqOf_C HostPwminEvsePilotFreqOv_C HostPwminEvsePilotTimeoutOf_C HostPwminEvsePilotTimeoutOv_C HostRelayWeldCheckEn_C HostRelayWeldCheckEnableOf_C HostRelayWeldCheckEnableOv_C HostRemainTimeToBulkSoc_C HostRemainTimeToFullSocOf_C HostRemainTimeToFullSocOv_C HostRemainTimeToFullSoc_C HostRemainTimetoBulkSocOf_C HostRemainTimetoBulkSocOv_C HostRessBulkSocOf_C HostRessBulkSocOv_C HostRessBulkSoc_C HostRessFullSoc_C HostRessSocOf_C HostRessSocOv_C HostRessTargetSocOf_C HostRessTargetSocOv_C HostRessVoltOf_C HostRessVoltOv_C K3_ignition_FltMax_C K3_ignition_FltMin_C K3_ignition_ScaleFactor_C M2_HbrNVmon_FltMax_C M2_HbrNVmon_FltMin_C M2_HbrNVmon_ScaleFactor_C M3_HbrPVmon_FltMax_C M3_HbrPVmon_FltMin_C M3_HbrPVmon_ScaleFactor_C SimRessCapacity_C SimRessChgCrntMax_C SimRessChgVoltMax_C SimRessFullSoc_C SimRessInitSoc_C SimRessSocOf_C SimRessSocOv_C SimRessVoltOf_C SimRessVoltOv_C SvcSearchStOf_C SvcSearchStOv_C SysModuleReset_C TLF35584CmdOvrdFlg_C TLF35584DEVCTRLCmdB0_C TLF35584DEVCTRLCmdB1_C TLF35584DEVCTRLCmdB2_C TLF35584DEVCTRLCmdB3_C TLF35584DEVCTRLCmdB4_C TLF35584DataStartupOvrdFlg_C TLF35584DataVrefOffOvrdFlg_C TLF35584DefaultSize_C TLF35584GetJobResultOvrdFlg_C TLF35584GetJobResult_C TLF35584RqstCmdDEVCTRLOvrdFlg_C TLF35584SendOvrdFlg_C TLF35584Send_C TLF35584Size_C TLF35584StartupCmdB0_C TLF35584StartupCmdB1_C TLF35584StartupCmdB2_C TLF35584StartupCmdB3_C TLF35584StartupCmdB4_C TLF35584StartupDataB0_C TLF35584StartupDataB1_C TLF35584StartupDataB2_C TLF35584StartupDataB3_C TLF35584StartupDataB4_C TempIntDegC_FltMax_C TempIntDegC_FltMin_C TempInt_FltMax_C TempInt_FltMin_C TempInt_ScaleFactor_C V2gRxMsgSupPrtclRescodeOf_C V2gRxMsgSupPrtclRescodeOv_C V2gRxMsgSupPrtclRxTrgOf_C V2gRxMsgSupPrtclRxTrgOv_C V2gRxSigCrntLimReachedOf_C V2gRxSigCrntLimReachedOv_C V2gRxSigEvseCurrentOf_C V2gRxSigEvseCurrentOv_C V2gRxSigEvseIdLenOf_C V2gRxSigEvseIdLenOv_C V2gRxSigEvseIdOf_C V2gRxSigEvseMaxDchgCrntOf_C V2gRxSigEvseMaxDchgCrntOv_C V2gRxSigEvseMaxDchgCrnt_flgOf_C V2gRxSigEvseMaxDchgCrnt_flgOv_C V2gRxSigEvseMaxDchgPwrOf_C V2gRxSigEvseMaxDchgPwrOv_C V2gRxSigEvseMaxDchgPwr_flgOf_C V2gRxSigEvseMaxDchgPwr_flgOv_C V2gRxSigEvseMinCrntOf_C V2gRxSigEvseMinCrntOv_C V2gRxSigEvseMinCrnt_flgOf_C V2gRxSigEvseMinCrnt_flgOv_C V2gRxSigEvseMinDchgCrntOf_C V2gRxSigEvseMinDchgCrntOv_C V2gRxSigEvseMinDchgCrnt_flgOf_C V2gRxSigEvseMinDchgCrnt_flgOv_C V2gRxSigEvseProcessingOf_C V2gRxSigEvseProcessingOv_C V2gRxSigEvseStatusOf_C V2gRxSigEvseStatusOv_C V2gRxSigEvseStatus_flgOf_C V2gRxSigEvseStatus_flgOv_C V2gRxSigEvseVoltageOf_C V2gRxSigEvseVoltageOv_C V2gRxSigIsolStatusOf_C V2gRxSigIsolStatusOv_C V2gRxSigIsolStatus_flgOf_C V2gRxSigIsolStatus_flgOv_C V2gRxSigMaxCrntOf_C V2gRxSigMaxCrntOv_C V2gRxSigMaxCrnt_flgOf_C V2gRxSigMaxCrnt_flgOv_C V2gRxSigMaxPwrOf_C V2gRxSigMaxPwrOv_C V2gRxSigMaxPwr_flgOf_C V2gRxSigMaxPwr_flgOv_C V2gRxSigMaxVoltOf_C V2gRxSigMaxVoltOv_C V2gRxSigMaxVolt_flgOf_C V2gRxSigMaxVolt_flgOv_C V2gRxSigMinVoltOf_C V2gRxSigMinVoltOv_C V2gRxSigMinVolt_flgOf_C V2gRxSigMinVolt_flgOv_C V2gRxSigNotifFlgOf_C V2gRxSigNotifFlgOv_C V2gRxSigNotifMaxDelayOf_C V2gRxSigNotifMaxDelayOv_C V2gRxSigNotifOf_C V2gRxSigNotifOv_C V2gRxSigPwrLimReachedOf_C V2gRxSigPwrLimReachedOv_C V2gRxSigRescodeOf_C V2gRxSigRescodeOv_C V2gRxSigSASchTupIdFlgOf_C V2gRxSigSASchTupIdFlgOv_C V2gRxSigSASchTupIdOf_C V2gRxSigSASchTupIdOv_C V2gRxSigTrgOf_C V2gRxSigTrgOv_C V2gRxSigVoltLimReachedOf_C V2gRxSigVoltLimReachedOv_C V2gSlacLinkStOf_C V2gSlacLinkStOv_C V2gSlacTcpStOf_C V2gSlacTcpStOv_C V2gSupPrtclSelectedOf_C V2gSupPrtclSelectedOv_C V2gTxBptParamEnableOf_C V2gTxBptParamEnableOv_C V2gTxBulkChargingCompleteOf_C V2gTxBulkChargingCompleteOv_C V2gTxBulkSocOf_C V2gTxBulkSocOv_C V2gTxChargeProgressOf_C V2gTxChargeProgressOv_C V2gTxChargingCompleteOf_C V2gTxChargingCompleteOv_C V2gTxDcChgParamEnableOf_C V2gTxDcChgParamEnableOv_C V2gTxEvCrntMaxLimOf_C V2gTxEvCrntMaxLimOv_C V2gTxEvCrntMinLimOf_C V2gTxEvCrntMinLimOv_C V2gTxEvDisChgCrntMaxLimOf_C V2gTxEvDisChgCrntMaxLimOv_C V2gTxEvDisChgCrntMinLimOf_C V2gTxEvDisChgCrntMinLimOv_C V2gTxEvDisChgPwrMaxLimOf_C V2gTxEvDisChgPwrMaxLimOv_C V2gTxEvDisChgPwrMinLimOf_C V2gTxEvDisChgPwrMinLimOv_C V2gTxEvEgyCapacityOf_C V2gTxEvEgyCapacityOv_C V2gTxEvEgyReqAmountOf_C V2gTxEvEgyReqAmountOv_C V2gTxEvErrorCodeOf_C V2gTxEvErrorCodeOv_C V2gTxEvMaxEgyReqOf_C V2gTxEvMaxEgyReqOv_C V2gTxEvMinEgyReqOf_C V2gTxEvMinEgyReqOv_C V2gTxEvOperationEnOf_C V2gTxEvOperationEnOv_C V2gTxEvOperationOf_C V2gTxEvOperationOv_C V2gTxEvPwrMaxLimOf_C V2gTxEvPwrMaxLimOv_C V2gTxEvPwrMinLimOf_C V2gTxEvPwrMinLimOv_C V2gTxEvReadyOf_C V2gTxEvReadyOv_C V2gTxEvRessConditionOf_C V2gTxEvRessConditionOv_C V2gTxEvRessSocOf_C V2gTxEvRessSocOv_C V2gTxEvTargetCrntOf_C V2gTxEvTargetCrntOv_C V2gTxEvTargetVoltOf_C V2gTxEvTargetVoltOv_C V2gTxEvVoltMaxLimOf_C V2gTxEvVoltMaxLimOv_C V2gTxEvVoltMinLimOf_C V2gTxEvVoltMinLimOv_C V2gTxFullSocOf_C V2gTxFullSocOv_C V2gTxParameterSetIdOf_C V2gTxParameterSetIdOv_C V2gTxProfileEntryCntOf_C V2gTxProfileEntryCntOv_C V2gTxRemainTimeToFullSocOf_C V2gTxRemainTimeToFullSocOv_C V2gTxRemainTimetoBulkSocOf_C V2gTxRemainTimetoBulkSocOv_C V2gTxSaSchdlTupleIdOf_C V2gTxSaSchdlTupleIdOv_C V2gTxServiceIdOf_C V2gTxServiceIdOv_C V2gTxSupSvcIdsLenOf_C V2gTxSupSvcIdsLenOv_C V2gTxSupSvcIdsOf_C V2gTxTargetSocOf_C V2gTxTargetSocOv_C Vbat_FltMax_C Vbat_FltMin_C Vbat_ScaleFactor_C VrefA_FltMax_C VrefA_FltMin_C VrefA_ScaleFactor_C VrefB_FltMax_C VrefB_FltMin_C VrefB_ScaleFactor_C ainc_an15_vtempa_a_max ainc_an15_vtempa_a_min ainc_an17_vtempb_a_max ainc_an17_vtempb_a_min dotc_DsblPowerHold dotc_Enbl_OverrideCanawake dotc_Enbl_OverrideDsblPwrHld dotc_Enbl_OverrideShutdown dotc_Enbl_OverrideTlt9255 dotc_Enbl_OverrideVpkClr dotc_OverrideVpilpeakClear dotc_PowerHold dotc_ShutdownSignal dotc_leda_dcycle dotc_leda_freq dotc_ledb_dcycle dotc_ledb_freq dotc_ledc_dcycle dotc_ledc_freq dotc_p00_6_canawake dotc_p11_1_pilots2 dotc_p11_9_hpenab dotc_p22_1_qbootsel dotc_p22_2_qspisel dotc_p33_2_pilwkclr dotc_p33_3_pilwkdis dotc_qca_enable dotc_tlt9255_SleepRequest genc_IgnitionEnableThreshold genc_ShutdownDelay genc_VBatShutdownThreshold ihbr_FltMax_C ihbr_FltMin_C ihbr_ScaleFactor_C lpfc_tc_3V3io lpfc_tc_3V3qca lpfc_tc_3V3uc lpfc_tc_5vdd lpfc_tc_A2_vproxim lpfc_tc_A3_vpilot lpfc_tc_A3_vpilpeak lpfc_tc_B2_vtempa lpfc_tc_B3_vtempb lpfc_tc_B4_vtempc lpfc_tc_C2_vtempd lpfc_tc_D3_AinE lpfc_tc_F2_VLEDA lpfc_tc_F3_VLEDB lpfc_tc_F4_VLEDC lpfc_tc_K3_ignition lpfc_tc_M2_HbrNVmon lpfc_tc_M3_HbrPVmon lpfc_tc_TempInt lpfc_tc_Vbat lpfc_tc_VrefA lpfc_tc_VrefB lpfc_tc_ihbr mbec_b_clearfault mbec_s_fltdebounce outc_hbrcmd1_dcycle outc_hbrcmd1_freq outc_hbrcmd2_dcycle outc_hbrcmd2_freq outc_p11_7_sleep outc_p14_7_hbrmode v3V3io_FltMax_C v3V3io_FltMin_C v3V3io_ScaleFactor_C v3V3qca_FltMax_C v3V3qca_FltMin_C v3V3qca_ScaleFactor_C v3V3uc_FltMax_C v3V3uc_FltMin_C v3V3uc_ScaleFactor_C v5vdd_FltMax_C v5vdd_FltMin_C v5vdd_ScaleFactor_C /end REF_CHARACTERISTIC
/end FUNCTION
/begin FUNCTION Signals "Group /ByType/Signals"
 /begin LOC_MEASUREMENT A2_vproxim_MaxFlt A2_vproxim_MaxFltActv A2_vproxim_MinFlt A2_vproxim_MinFltActv A3_vpilot_MaxFlt A3_vpilot_MaxFltActv A3_vpilot_MinFlt A3_vpilot_MinFltActv A3_vpilpeak_MaxFlt A3_vpilpeak_MaxFltActv A3_vpilpeak_MinFlt A3_vpilpeak_MinFltActv AnyECUWakeSignal B2_vtempa_MaxFlt B2_vtempa_MaxFltActv B2_vtempa_MinFlt B2_vtempa_MinFltActv B3_vtempb_MaxFlt B3_vtempb_MaxFltActv B3_vtempb_MinFlt B3_vtempb_MinFltActv B4_vtempc_MaxFlt B4_vtempc_MaxFltActv B4_vtempc_MinFlt B4_vtempc_MinFltActv C2_vtempd_MaxFlt C2_vtempd_MaxFltActv C2_vtempd_MinFlt C2_vtempd_MinFltActv CANBusStatus CANFDCounter CANFDRxErr CANFDRxOverrun CANFDRxTrig CANFDRxTxCompare[0] CANFDRxTxCompare[1] CANFDRxTxCompare[2] CANFDRxTxCompare[3] CANFDRxTxCompare[4] CANFDRxTxCompare[5] CANFDRxTxCompare[6] CANFDRxTxCompare[7] CANFDRxTxFault CANFDRx[0] CANFDRx[1] CANFDRx[2] CANFDRx[3] CANFDRx[4] CANFDRx[5] CANFDRx[6] CANFDRx[7] CANFDTrig CANFDTxAckCnt CANFDTxData[0] CANFDTxData[1] CANFDTxData[2] CANFDTxData[3] CANFDTxData[4] CANFDTxData[5] CANFDTxData[6] CANFDTxData[7] CANFDTxErrFlg CANFDTxTimeout CcsCtlEcuHoldEcuPwrReq CcsCtlEcuHoldQcaPwrReq CcsCtlStopCpEStop CcsCtlStopCpNStop CcsCtlStopCpRStop CcsCtlStopIntFltEStop CcsCtlStopIntFltNStop CcsCtlStopIntFltRStop CcsCtlStopPpEStop CcsCtlStopPpNStop CcsCtlStopPpRStop CcsCtlStopRxEgyTypeEStop CcsCtlStopRxEgyTypeNStop CcsCtlStopRxEgyTypeRStop CcsCtlStopRxEvVoltEStop CcsCtlStopRxEvVoltNStop CcsCtlStopRxEvVoltRStop CcsCtlStopRxEvseCrntEStop CcsCtlStopRxEvseCrntNStop CcsCtlStopRxEvseCrntRStop CcsCtlStopRxEvseIsolEStop CcsCtlStopRxEvseIsolNStop CcsCtlStopRxEvseIsolRStop CcsCtlStopRxEvseProcEStop CcsCtlStopRxEvseProcNStop CcsCtlStopRxEvseProcRStop CcsCtlStopRxEvsePwrEStop CcsCtlStopRxEvsePwrNStop CcsCtlStopRxEvsePwrRStop CcsCtlStopRxEvseStEStop CcsCtlStopRxEvseStNStop CcsCtlStopRxEvseStRStop CcsCtlStopRxEvseVoltEStop CcsCtlStopRxEvseVoltNStop CcsCtlStopRxEvseVoltRStop CcsCtlStopSeqEStop CcsCtlStopSeqNStop CcsCtlStopSeqRStop CcsCtlStopSupPrtclEStop CcsCtlStopSupPrtclNStop CcsCtlStopSupPrtclRStop CcsCtlStopV2gMsgEStop CcsCtlStopV2gMsgNStop CcsCtlStopV2gMsgRStop CcsFltCpWrd CcsFltEvseSupPrtclWrd CcsFltInternalFaultsWrd CcsFltLinkWrd CcsFltPpWrd CcsFltRxEgyTrnsTypeWrd CcsFltRxEvVoltWrd CcsFltRxEvseCrntWrd CcsFltRxEvseIsolStWrd CcsFltRxEvseProcStWrd CcsFltRxEvsePwrWrd CcsFltRxEvseStCodeWrd CcsFltRxEvseVoltWrd CcsFltSeqWrd CcsFltStopFltResponse CcsFltV2gMsgWrd CcsIprAcdAvlbMaxAcChgCrnt CcsIprAcdAvlbMaxAcChgCrntPwm CcsIprChgPortCrntDc CcsIprChgPortVoltDc CcsIprCpChargingMode CcsIprCpDutcycAc CcsIprCpDutcycPct5 CcsIprCpDutcycRangeAc CcsIprCpDutyPct5InRange CcsIprCpOscillatorOff CcsIprCpSt CcsIprDcChgCrntNearZero CcsIprDcChgInletCrntSafe CcsIprDcChgInletVoltSafe CcsIprDcPrechgComplete CcsIprDisSchIdx CcsIprDisSchMaxIdx CcsIprDisSchPmaxClipped CcsIprDisSchTimer CcsIprPpPos CcsIprPpSt CcsIprPrtEvseCouplerPluggedIn CcsIprPrtHvPresent CcsIprPrtVehChargingPortSt CcsIprPrxDischargePmax CcsIprPrxEvseCrntMax CcsIprPrxEvseCrntMin CcsIprPrxEvseCrntValid CcsIprPrxEvseDchgCrntMax CcsIprPrxEvseDchgCrntMin CcsIprPrxEvseDchgPwrMax CcsIprPrxEvsePwrMax CcsIprPrxEvseVoltMax CcsIprPrxEvseVoltMin CcsIprPrxEvseVoltValid CcsIprPrxSchedulePmax CcsIprSchIdx CcsIprSchMaxIdx CcsIprSchPmaxClipped CcsIprSchTimer CcsOprHvEvTargetCrnt CcsOprHvEvTargetVolt CcsOprTargetCrntChgLimByPwr CcsOprTargetCrntDchgLimByPwr CcsOprV2gTxEvCabinCondition CcsOprV2gTxReadyToCharge CcsOutPtxDinAuthTxFlg CcsOutPtxDinCblChkTxFlg CcsOutPtxDinChgParDiscTxFlg CcsOutPtxDinCrntDmdTxFlg CcsOutPtxDinPmtSelTxFlg CcsOutPtxDinPreChgTxFlg CcsOutPtxDinPwrDelShtDnTxFlg CcsOutPtxDinPwrDelivTxFlg CcsOutPtxDinSesSetupTxFlg CcsOutPtxDinSesStopTxFlg CcsOutPtxDinSvcDiscTxFlg CcsOutPtxDinWeldDetTxFlg CcsOutPtxIso1AuthTxFlg CcsOutPtxIso1CblChkTxFlg CcsOutPtxIso1ChgParDiscTxFlg CcsOutPtxIso1CrntDmdTxFlg CcsOutPtxIso1PmtSelTxFlg CcsOutPtxIso1PreChgTxFlg CcsOutPtxIso1PwrDelShtDnTxFlg CcsOutPtxIso1PwrDelivTxFlg CcsOutPtxIso1SesSetupTxFlg CcsOutPtxIso1SesStopTxFlg CcsOutPtxIso1SvcDetailTxFlg CcsOutPtxIso1SvcDiscTxFlg CcsOutPtxIso1WeldDetTxFlg CcsOutPtxIso2AuthTxFlg CcsOutPtxIso2BptCtrlTxFlg CcsOutPtxIso2CblChkTxFlg CcsOutPtxIso2ChgParDiscTxFlg CcsOutPtxIso2CrntDmdTxFlg CcsOutPtxIso2PmtSelTxFlg CcsOutPtxIso2PreChgTxFlg CcsOutPtxIso2PwrDelShtdnTxFlg CcsOutPtxIso2PwrDelivTxFlg CcsOutPtxIso2SesSetupTxFlg CcsOutPtxIso2SesStopTxFlg CcsOutPtxIso2SvcDetailTxFlg CcsOutPtxIso2SvcDiscTxFlg CcsOutPtxIso2WeldDetTxFlg CcsOutPtxMsgTransmitError CcsOutPtxSuppAppProtoTxFlg CcsPilotClear CcsStmState CcsStmV2gConnectInit CcsStmV2gConnectTerminate CcsStmV2gPilotPulldownEn CcsStmV2gQcaEn CcsStmV2gStMsgTx CcsVersionMajor CcsVersionMinor CcsVersionSubMinor CmdCANAWAKE CtlEcuPsuPowerHold D3_AinE_MaxFlt D3_AinE_MaxFltActv D3_AinE_MinFlt D3_AinE_MinFltActv DinAuthEvseProcessingSt DinCblChkEvseIsolStatusFlg DinChgParDiscRxTrg DinCrntDmdEvseCrntMaxLimFlg DinCrntDmdEvseIsolStatusFlg DinCrntDmdEvsePwrLimReached DinCrntDmdEvseStatusCode DinCrntDmdEvseVolt DinCrntDmdEvseVoltMaxLim DinCrntDmdEvseVoltMaxLimFlg DinDcChgParDiscEvseEgyDelivera0 DinDcChgParDiscEvsePwrMaxLimFlg DinDcChgParDiscEvseVoltMaxLim DinPmtSelRxTrg DinPreChgResponseCode DinPwrDelivDcEvseStatusFlg DinPwrDelivEvseIsolSt DinPwrDelivEvseStatusCode DinPwrDelivResponseCode DinPwrDelivRxTrg DinSesSetupEvseIdLen DinSesStopResponseCode /end LOC_MEASUREMENT
/end FUNCTION
/end MODULE
/end PROJECT
