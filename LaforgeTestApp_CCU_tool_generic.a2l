ASAP2_VERSION 1 31
/begin PROJECT LaForge_CCU_TestApp "Test Application for LaForge TC367"
/begin HEADER "Dana" VERSION "0_3_1" /end HEADER
/begin MODULE OpenECU_TC367_001 ""
/* Scalar measurable for DDE 'V2gRxMsgCrntDmdEvseId[24]'. */
/begin MEASUREMENT V2gRxMsgCrntDmdEvseId[24] "The ID that uniquely identifies the EVSE. Format is defined in DIN SPEC 91286" UBYTE CU_V2GRXMSGCRNTDMDEVSEID[24] 1 100 0.0 255.0 ECU_ADDRESS 0x70018074 BYTE_ORDER MSB_LAST /end MEASUREMENT
/begin COMPU_METHOD CU_V2GRXMSGCRNTDMDEVSEID[24] "Conversion method for V2gRxMsgCrntDmdEvseId[24]" RAT_FUNC "%10.0" "1" COEFFS 0.000000 1.000000 -0.000000 0.000000 0.000000 1.000000 /end COMPU_METHOD
/* Scalar measurable for DDE 'V2gRxMsgCrntDmdEvseId[25]'. */
/begin MEASUREMENT V2gRxMsgCrntDmdEvseId[25] "The ID that uniquely identifies the EVSE. Format is defined in DIN SPEC 91286" UBYTE CU_V2GRXMSGCRNTDMDEVSEID[25] 1 100 0.0 255.0 ECU_ADDRESS 0x70018075 BYTE_ORDER MSB_LAST /end MEASUREMENT
/begin COMPU_METHOD CU_V2GRXMSGCRNTDMDEVSEID[25] "Conversion method for V2gRxMsgCrntDmdEvseId[25]" RAT_FUNC "%10.0" "1" COEFFS 0.000000 1.000000 -0.000000 0.000000 0.000000 1.000000 /end COMPU_METHOD
/* Scalar measurable for DDE 'V2gRxMsgCrntDmdEvseId[26]'. */
/begin MEASUREMENT V2gRxMsgCrntDmdEvseId[26] "The ID that uniquely identifies the EVSE. Format is defined in DIN SPEC 91286" UBYTE CU_V2GRXMSGCRNTDMDEVSEID[26] 1 100 0.0 255.0 ECU_ADDRESS 0x70018076 BYTE_ORDER MSB_LAST /end MEASUREMENT
/begin COMPU_METHOD CU_V2GRXMSGCRNTDMDEVSEID[26] "Conversion method for V2gRxMsgCrntDmdEvseId[26]" RAT_FUNC "%10.0" "1" COEFFS 0.000000 1.000000 -0.000000 0.000000 0.000000 1.000000 /end COMPU_METHOD
/* Scalar measurable for DDE 'V2gRxMsgCrntDmdEvseId[27]'. */
/begin MEASUREMENT V2gRxMsgCrntDmdEvseId[27] "The ID that uniquely identifies the EVSE. Format is defined in DIN SPEC 91286" UBYTE CU_V2GRXMSGCRNTDMDEVSEID[27] 1 100 0.0 255.0 ECU_ADDRESS 0x70018077 BYTE_ORDER MSB_LAST /end MEASUREMENT
/begin COMPU_METHOD CU_V2GRXMSGCRNTDMDEVSEID[27] "Conversion method for V2gRxMsgCrntDmdEvseId[27]" RAT_FUNC "%10.0" "1" COEFFS 0.000000 1.000000 -0.000000 0.000000 0.000000 1.000000 /end COMPU_METHOD
/* Scalar measurable for DDE 'V2gRxMsgCrntDmdEvseId[28]'. */
/begin MEASUREMENT V2gRxMsgCrntDmdEvseId[28] "The ID that uniquely identifies the EVSE. Format is defined in DIN SPEC 91286" UBYTE CU_V2GRXMSGCRNTDMDEVSEID[28] 1 100 0.0 255.0 ECU_ADDRESS 0x70018078 BYTE_ORDER MSB_LAST /end MEASUREMENT
/begin COMPU_METHOD CU_V2GRXMSGCRNTDMDEVSEID[28] "Conversion method for V2gRxMsgCrntDmdEvseId[28]" RAT_FUNC "%10.0" "1" COEFFS 0.000000 1.000000 -0.000000 0.000000 0.000000 1.000000 /end COMPU_METHOD
/* Scalar measurable for DDE 'V2gRxMsgCrntDmdEvseId[29]'. */
/begin MEASUREMENT V2gRxMsgCrntDmdEvseId[29] "The ID that uniquely identifies the EVSE. Format is defined in DIN SPEC 91286" UBYTE CU_V2GRXMSGCRNTDMDEVSEID[29] 1 100 0.0 255.0 ECU_ADDRESS 0x70018079 BYTE_ORDER MSB_LAST /end MEASUREMENT
/begin COMPU_METHOD CU_V2GRXMSGCRNTDMDEVSEID[29] "Conversion method for V2gRxMsgCrntDmdEvseId[29]" RAT_FUNC "%10.0" "1" COEFFS 0.000000 1.000000 -0.000000 0.000000 0.000000 1.000000 /end COMPU_METHOD
/* Scalar measurable for DDE 'V2gRxMsgCrntDmdEvseId[2]'. */
/begin MEASUREMENT V2gRxMsgCrntDmdEvseId[2] "The ID that uniquely identifies the EVSE. Format is defined in DIN SPEC 91286" UBYTE CU_V2GRXMSGCRNTDMDEVSEID[2] 1 100 0.0 255.0 ECU_ADDRESS 0x7001805e BYTE_ORDER MSB_LAST /end MEASUREMENT
/begin COMPU_METHOD CU_V2GRXMSGCRNTDMDEVSEID[2] "Conversion method for V2gRxMsgCrntDmdEvseId[2]" RAT_FUNC "%10.0" "1" COEFFS 0.000000 1.000000 -0.000000 0.000000 0.000000 1.000000 /end COMPU_METHOD
/* Scalar measurable for DDE 'V2gRxMsgCrntDmdEvseId[30]'. */
/begin MEASUREMENT V2gRxMsgCrntDmdEvseId[30] "The ID that uniquely identifies the EVSE. Format is defined in DIN SPEC 91286" UBYTE CU_V2GRXMSGCRNTDMDEVSEID[30] 1 100 0.0 255.0 ECU_ADDRESS 0x7001807a BYTE_ORDER MSB_LAST /end MEASUREMENT
/begin COMPU_METHOD CU_V2GRXMSGCRNTDMDEVSEID[30] "Conversion method for V2gRxMsgCrntDmdEvseId[30]" RAT_FUNC "%10.0" "1" COEFFS 0.000000 1.000000 -0.000000 0.000000 0.000000 1.000000 /end COMPU_METHOD
/* Scalar measurable for DDE 'V2gRxMsgCrntDmdEvseId[31]'. */
/begin MEASUREMENT V2gRxMsgCrntDmdEvseId[31] "The ID that uniquely identifies the EVSE. Format is defined in DIN SPEC 91286" UBYTE CU_V2GRXMSGCRNTDMDEVSEID[31] 1 100 0.0 255.0 ECU_ADDRESS 0x7001807b BYTE_ORDER MSB_LAST /end MEASUREMENT
/begin COMPU_METHOD CU_V2GRXMSGCRNTDMDEVSEID[31] "Conversion method for V2gRxMsgCrntDmdEvseId[31]" RAT_FUNC "%10.0" "1" COEFFS 0.000000 1.000000 -0.000000 0.000000 0.000000 1.000000 /end COMPU_METHOD
/* Scalar measurable for DDE 'V2gRxMsgCrntDmdEvseId[32]'. */
/begin MEASUREMENT V2gRxMsgCrntDmdEvseId[32] "The ID that uniquely identifies the EVSE. Format is defined in DIN SPEC 91286" UBYTE CU_V2GRXMSGCRNTDMDEVSEID[32] 1 100 0.0 255.0 ECU_ADDRESS 0x7001807c BYTE_ORDER MSB_LAST /end MEASUREMENT
/begin COMPU_METHOD CU_V2GRXMSGCRNTDMDEVSEID[32] "Conversion method for V2gRxMsgCrntDmdEvseId[32]" RAT_FUNC "%10.0" "1" COEFFS 0.000000 1.000000 -0.000000 0.000000 0.000000 1.000000 /end COMPU_METHOD
/* Scalar measurable for DDE 'V2gRxMsgCrntDmdEvseId[33]'. */
/begin MEASUREMENT V2gRxMsgCrntDmdEvseId[33] "The ID that uniquely identifies the EVSE. Format is defined in DIN SPEC 91286" UBYTE CU_V2GRXMSGCRNTDMDEVSEID[33] 1 100 0.0 255.0 ECU_ADDRESS 0x7001807d BYTE_ORDER MSB_LAST /end MEASUREMENT
/begin COMPU_METHOD CU_V2GRXMSGCRNTDMDEVSEID[33] "Conversion method for V2gRxMsgCrntDmdEvseId[33]" RAT_FUNC "%10.0" "1" COEFFS 0.000000 1.000000 -0.000000 0.000000 0.000000 1.000000 /end COMPU_METHOD
/* Scalar measurable for DDE 'V2gRxMsgCrntDmdEvseId[34]'. */
/begin MEASUREMENT V2gRxMsgCrntDmdEvseId[34] "The ID that uniquely identifies the EVSE. Format is defined in DIN SPEC 91286" UBYTE CU_V2GRXMSGCRNTDMDEVSEID[34] 1 100 0.0 255.0 ECU_ADDRESS 0x7001807e BYTE_ORDER MSB_LAST /end MEASUREMENT
/begin COMPU_METHOD CU_V2GRXMSGCRNTDMDEVSEID[34] "Conversion method for V2gRxMsgCrntDmdEvseId[34]" RAT_FUNC "%10.0" "1" COEFFS 0.000000 1.000000 -0.000000 0.000000 0.000000 1.000000 /end COMPU_METHOD
/* Scalar measurable for DDE 'V2gRxMsgCrntDmdEvseId[35]'. */
/begin MEASUREMENT V2gRxMsgCrntDmdEvseId[35] "The ID that uniquely identifies the EVSE. Format is defined in DIN SPEC 91286" UBYTE CU_V2GRXMSGCRNTDMDEVSEID[35] 1 100 0.0 255.0 ECU_ADDRESS 0x7001807f BYTE_ORDER MSB_LAST /end MEASUREMENT
/begin COMPU_METHOD CU_V2GRXMSGCRNTDMDEVSEID[35] "Conversion method for V2gRxMsgCrntDmdEvseId[35]" RAT_FUNC "%10.0" "1" COEFFS 0.000000 1.000000 -0.000000 0.000000 0.000000 1.000000 /end COMPU_METHOD
/* Scalar measurable for DDE 'V2gRxMsgCrntDmdEvseId[36]'. */
/begin MEASUREMENT V2gRxMsgCrntDmdEvseId[36] "The ID that uniquely identifies the EVSE. Format is defined in DIN SPEC 91286" UBYTE CU_V2GRXMSGCRNTDMDEVSEID[36] 1 100 0.0 255.0 ECU_ADDRESS 0x70018080 BYTE_ORDER MSB_LAST /end MEASUREMENT
/begin COMPU_METHOD CU_V2GRXMSGCRNTDMDEVSEID[36] "Conversion method for V2gRxMsgCrntDmdEvseId[36]" RAT_FUNC "%10.0" "1" COEFFS 0.000000 1.000000 -0.000000 0.000000 0.000000 1.000000 /end COMPU_METHOD
/* Scalar measurable for DDE 'V2gRxMsgCrntDmdEvseId[37]'. */
/begin MEASUREMENT V2gRxMsgCrntDmdEvseId[37] "The ID that uniquely identifies the EVSE. Format is defined in DIN SPEC 91286" UBYTE CU_V2GRXMSGCRNTDMDEVSEID[37] 1 100 0.0 255.0 ECU_ADDRESS 0x70018081 BYTE_ORDER MSB_LAST /end MEASUREMENT
/begin COMPU_METHOD CU_V2GRXMSGCRNTDMDEVSEID[37] "Conversion method for V2gRxMsgCrntDmdEvseId[37]" RAT_FUNC "%10.0" "1" COEFFS 0.000000 1.000000 -0.000000 0.000000 0.000000 1.000000 /end COMPU_METHOD
/* Scalar measurable for DDE 'V2gRxMsgCrntDmdEvseId[3]'. */
/begin MEASUREMENT V2gRxMsgCrntDmdEvseId[3] "The ID that uniquely identifies the EVSE. Format is defined in DIN SPEC 91286" UBYTE CU_V2GRXMSGCRNTDMDEVSEID[3] 1 100 0.0 255.0 ECU_ADDRESS 0x7001805f BYTE_ORDER MSB_LAST /end MEASUREMENT
/begin COMPU_METHOD CU_V2GRXMSGCRNTDMDEVSEID[3] "Conversion method for V2gRxMsgCrntDmdEvseId[3]" RAT_FUNC "%10.0" "1" COEFFS 0.000000 1.000000 -0.000000 0.000000 0.000000 1.000000 /end COMPU_METHOD
/* Scalar measurable for DDE 'V2gRxMsgCrntDmdEvseId[4]'. */
/begin MEASUREMENT V2gRxMsgCrntDmdEvseId[4] "The ID that uniquely identifies the EVSE. Format is defined in DIN SPEC 91286" UBYTE CU_V2GRXMSGCRNTDMDEVSEID[4] 1 100 0.0 255.0 ECU_ADDRESS 0x70018060 BYTE_ORDER MSB_LAST /end MEASUREMENT
/begin COMPU_METHOD CU_V2GRXMSGCRNTDMDEVSEID[4] "Conversion method for V2gRxMsgCrntDmdEvseId[4]" RAT_FUNC "%10.0" "1" COEFFS 0.000000 1.000000 -0.000000 0.000000 0.000000 1.000000 /end COMPU_METHOD
/* Scalar measurable for DDE 'V2gRxMsgCrntDmdEvseId[5]'. */
/begin MEASUREMENT V2gRxMsgCrntDmdEvseId[5] "The ID that uniquely identifies the EVSE. Format is defined in DIN SPEC 91286" UBYTE CU_V2GRXMSGCRNTDMDEVSEID[5] 1 100 0.0 255.0 ECU_ADDRESS 0x70018061 BYTE_ORDER MSB_LAST /end MEASUREMENT
/begin COMPU_METHOD CU_V2GRXMSGCRNTDMDEVSEID[5] "Conversion method for V2gRxMsgCrntDmdEvseId[5]" RAT_FUNC "%10.0" "1" COEFFS 0.000000 1.000000 -0.000000 0.000000 0.000000 1.000000 /end COMPU_METHOD
/* Scalar measurable for DDE 'V2gRxMsgCrntDmdEvseId[6]'. */
/begin MEASUREMENT V2gRxMsgCrntDmdEvseId[6] "The ID that uniquely identifies the EVSE. Format is defined in DIN SPEC 91286" UBYTE CU_V2GRXMSGCRNTDMDEVSEID[6] 1 100 0.0 255.0 ECU_ADDRESS 0x70018062 BYTE_ORDER MSB_LAST /end MEASUREMENT
/begin COMPU_METHOD CU_V2GRXMSGCRNTDMDEVSEID[6] "Conversion method for V2gRxMsgCrntDmdEvseId[6]" RAT_FUNC "%10.0" "1" COEFFS 0.000000 1.000000 -0.000000 0.000000 0.000000 1.000000 /end COMPU_METHOD
/* Scalar measurable for DDE 'V2gRxMsgCrntDmdEvseId[7]'. */
/begin MEASUREMENT V2gRxMsgCrntDmdEvseId[7] "The ID that uniquely identifies the EVSE. Format is defined in DIN SPEC 91286" UBYTE CU_V2GRXMSGCRNTDMDEVSEID[7] 1 100 0.0 255.0 ECU_ADDRESS 0x70018063 BYTE_ORDER MSB_LAST /end MEASUREMENT
/begin COMPU_METHOD CU_V2GRXMSGCRNTDMDEVSEID[7] "Conversion method for V2gRxMsgCrntDmdEvseId[7]" RAT_FUNC "%10.0" "1" COEFFS 0.000000 1.000000 -0.000000 0.000000 0.000000 1.000000 /end COMPU_METHOD
/* Scalar measurable for DDE 'V2gRxMsgCrntDmdEvseId[8]'. */
/begin MEASUREMENT V2gRxMsgCrntDmdEvseId[8] "The ID that uniquely identifies the EVSE. Format is defined in DIN SPEC 91286" UBYTE CU_V2GRXMSGCRNTDMDEVSEID[8] 1 100 0.0 255.0 ECU_ADDRESS 0x70018064 BYTE_ORDER MSB_LAST /end MEASUREMENT
/begin COMPU_METHOD CU_V2GRXMSGCRNTDMDEVSEID[8] "Conversion method for V2gRxMsgCrntDmdEvseId[8]" RAT_FUNC "%10.0" "1" COEFFS 0.000000 1.000000 -0.000000 0.000000 0.000000 1.000000 /end COMPU_METHOD
/* Scalar measurable for DDE 'V2gRxMsgCrntDmdEvseId[9]'. */
/begin MEASUREMENT V2gRxMsgCrntDmdEvseId[9] "The ID that uniquely identifies the EVSE. Format is defined in DIN SPEC 91286" UBYTE CU_V2GRXMSGCRNTDMDEVSEID[9] 1 100 0.0 255.0 ECU_ADDRESS 0x70018065 BYTE_ORDER MSB_LAST /end MEASUREMENT
/begin COMPU_METHOD CU_V2GRXMSGCRNTDMDEVSEID[9] "Conversion method for V2gRxMsgCrntDmdEvseId[9]" RAT_FUNC "%10.0" "1" COEFFS 0.000000 1.000000 -0.000000 0.000000 0.000000 1.000000 /end COMPU_METHOD
/* Scalar measurable for DDE 'V2gRxMsgCrntDmdEvseStatus'. */
/begin MEASUREMENT V2gRxMsgCrntDmdEvseStatus "Indicates the internal state of the EVSE." SLONG CU_V2GRXMSGCRNTDMDEVSESTATUS 1 100 -2147483648.0 2147483647.0 ECU_ADDRESS 0x700181d4 BYTE_ORDER MSB_LAST /end MEASUREMENT
/begin COMPU_METHOD CU_V2GRXMSGCRNTDMDEVSESTATUS "Conversion method for V2gRxMsgCrntDmdEvseStatus" TAB_VERB "%12.0" "enum" COMPU_TAB_REF CT_V2GRXMSGCRNTDMDEVSESTATUS /end COMPU_METHOD
/begin COMPU_VTAB CT_V2GRXMSGCRNTDMDEVSESTATUS "Conversion method for V2gRxMsgCrntDmdEvseStatus" TAB_VERB 12 0 "EVSE_NOT_READY" 1 "EVSE_READY" 2 "EVSE_SHUTDOWN" 3 "EVSE_UTILITY_INTERRUPT" 4 "EVSE_ISOLATION_MONITOR_ACTV" 5 "EVSE_EMERGENCY_SHUTDOWN" 6 "EVSE_MALFUNCTION" 7 "EVSE_STATUS_RESERVED1" 8 "EVSE_STATUS_RESERVED2" 9 "EVSE_STATUS_RESERVED3" 10 "EVSE_STATUS_RESERVED4" 11 "EVSE_STATUS_RESERVED5" /end COMPU_VTAB
/* Scalar measurable for DDE 'V2gRxMsgCrntDmdEvseVoltage'. */
/begin MEASUREMENT V2gRxMsgCrntDmdEvseVoltage "Present voltage of EVSE" FLOAT32_IEEE CU_V2GRXMSGCRNTDMDEVSEVOLTAGE 1 100 0.0 196605.0 ECU_ADDRESS 0x700184a0 BYTE_ORDER MSB_LAST /end MEASUREMENT
/begin COMPU_METHOD CU_V2GRXMSGCRNTDMDEVSEVOLTAGE "Conversion method for V2gRxMsgCrntDmdEvseVoltage" RAT_FUNC "%10.0" "V" COEFFS 0.000000 1.000000 -0.000000 0.000000 0.000000 1.000000 /end COMPU_METHOD
/* Scalar measurable for DDE 'V2gRxMsgCrntDmdIsolStatus'. */
/begin MEASUREMENT V2gRxMsgCrntDmdIsolStatus "Indicates the isolation condition" SLONG CU_V2GRXMSGCRNTDMDISOLSTATUS 1 100 -2147483648.0 2147483647.0 ECU_ADDRESS 0x700182dc BYTE_ORDER MSB_LAST /end MEASUREMENT
/begin COMPU_METHOD CU_V2GRXMSGCRNTDMDISOLSTATUS "Conversion method for V2gRxMsgCrntDmdIsolStatus" TAB_VERB "%12.0" "enum" COMPU_TAB_REF CT_V2GRXMSGCRNTDMDISOLSTATUS /end COMPU_METHOD
/begin COMPU_VTAB CT_V2GRXMSGCRNTDMDISOLSTATUS "Conversion method for V2gRxMsgCrntDmdIsolStatus" TAB_VERB 4 0 "ISOLATION_INVALID" 1 "ISOLATION_VALID" 2 "ISOLATION_WARNING" 3 "ISOLATION_FAULT" /end COMPU_VTAB
/* Scalar measurable for DDE 'V2gRxMsgCrntDmdIsolStatus_flg'. */
/begin MEASUREMENT V2gRxMsgCrntDmdIsolStatus_flg "Identifies the presence of the EVSEIsolationStatus parameter." UBYTE CU_V2GRXMSGCRNTDMDISOLSTATUS_F0 1 100 0.0 1.0 ECU_ADDRESS 0x70017db2 BYTE_ORDER MSB_LAST /end MEASUREMENT
/begin COMPU_METHOD CU_V2GRXMSGCRNTDMDISOLSTATUS_F0 "Conversion method for V2gRxMsgCrntDmdIsolStatus_flg" RAT_FUNC "%10.0" "b" COEFFS 0.000000 1.000000 -0.000000 0.000000 0.000000 1.000000 /end COMPU_METHOD
/* Scalar measurable for DDE 'V2gRxMsgCrntDmdMaxCrnt'. */
/begin MEASUREMENT V2gRxMsgCrntDmdMaxCrnt "Maximum current the EVSE can deliver" FLOAT32_IEEE CU_V2GRXMSGCRNTDMDMAXCRNT 1 100 0.0 196605.0 ECU_ADDRESS 0x7001848c BYTE_ORDER MSB_LAST /end MEASUREMENT
/begin COMPU_METHOD CU_V2GRXMSGCRNTDMDMAXCRNT "Conversion method for V2gRxMsgCrntDmdMaxCrnt" RAT_FUNC "%10.0" "A" COEFFS 0.000000 1.000000 -0.000000 0.000000 0.000000 1.000000 /end COMPU_METHOD
/* Scalar measurable for DDE 'V2gRxMsgCrntDmdMaxCrnt_flg'. */
/begin MEASUREMENT V2gRxMsgCrntDmdMaxCrnt_flg "Indicates that the EVSEMaximumCurrentLimit parameter is available." UBYTE CU_V2GRXMSGCRNTDMDMAXCRNT_FLG 1 100 0.0 1.0 ECU_ADDRESS 0x700183a0 BYTE_ORDER MSB_LAST /end MEASUREMENT
/begin COMPU_METHOD CU_V2GRXMSGCRNTDMDMAXCRNT_FLG "Conversion method for V2gRxMsgCrntDmdMaxCrnt_flg" RAT_FUNC "%10.0" "b" COEFFS 0.000000 1.000000 -0.000000 0.000000 0.000000 1.000000 /end COMPU_METHOD
/* Scalar measurable for DDE 'V2gRxMsgCrntDmdMaxPwr'. */
/begin MEASUREMENT V2gRxMsgCrntDmdMaxPwr "Maximum power the EVSE can deliver" FLOAT32_IEEE CU_V2GRXMSGCRNTDMDMAXPWR 1 100 0.0 500000.0 ECU_ADDRESS 0x70017cac BYTE_ORDER MSB_LAST /end MEASUREMENT
/begin COMPU_METHOD CU_V2GRXMSGCRNTDMDMAXPWR "Conversion method for V2gRxMsgCrntDmdMaxPwr" RAT_FUNC "%10.0" "W" COEFFS 0.000000 1.000000 -0.000000 0.000000 0.000000 1.000000 /end COMPU_METHOD
/* Scalar measurable for DDE 'V2gRxMsgCrntDmdMaxPwr_flg'. */
/begin MEASUREMENT V2gRxMsgCrntDmdMaxPwr_flg "Indicates that the EVSEMaximumPowerLimit parameter is available." UBYTE CU_V2GRXMSGCRNTDMDMAXPWR_FLG 1 100 0.0 1.0 ECU_ADDRESS 0x7001849c BYTE_ORDER MSB_LAST /end MEASUREMENT
/begin COMPU_METHOD CU_V2GRXMSGCRNTDMDMAXPWR_FLG "Conversion method for V2gRxMsgCrntDmdMaxPwr_flg" RAT_FUNC "%10.0" "b" COEFFS 0.000000 1.000000 -0.000000 0.000000 0.000000 1.000000 /end COMPU_METHOD
/* Scalar measurable for DDE 'V2gRxMsgCrntDmdMaxVolt'. */
/begin MEASUREMENT V2gRxMsgCrntDmdMaxVolt "Maximum voltage the EVSE can deliver" FLOAT32_IEEE CU_V2GRXMSGCRNTDMDMAXVOLT 1 100 0.0 196605.0 ECU_ADDRESS 0x700184b8 BYTE_ORDER MSB_LAST /end MEASUREMENT
/begin COMPU_METHOD CU_V2GRXMSGCRNTDMDMAXVOLT "Conversion method for V2gRxMsgCrntDmdMaxVolt" RAT_FUNC "%10.0" "V" COEFFS 0.000000 1.000000 -0.000000 0.000000 0.000000 1.000000 /end COMPU_METHOD
/* Scalar measurable for DDE 'V2gRxMsgCrntDmdMaxVolt_flg'. */
/begin MEASUREMENT V2gRxMsgCrntDmdMaxVolt_flg "Indicates that the EVSEMaximumVoltageLimit parameter is available." UBYTE CU_V2GRXMSGCRNTDMDMAXVOLT_FLG 1 100 0.0 1.0 ECU_ADDRESS 0x70017e9c BYTE_ORDER MSB_LAST /end MEASUREMENT
/begin COMPU_METHOD CU_V2GRXMSGCRNTDMDMAXVOLT_FLG "Conversion method for V2gRxMsgCrntDmdMaxVolt_flg" RAT_FUNC "%10.0" "b" COEFFS 0.000000 1.000000 -0.000000 0.000000 0.000000 1.000000 /end COMPU_METHOD
/* Scalar measurable for DDE 'V2gRxMsgCrntDmdNotif'. */
/begin MEASUREMENT V2gRxMsgCrntDmdNotif "The arbitrated Notification Max Delay parameter in the received message from EVSE" SLONG CU_V2GRXMSGCRNTDMDNOTIF 1 100 -2147483648.0 2147483647.0 ECU_ADDRESS 0x700181f8 BYTE_ORDER MSB_LAST /end MEASUREMENT
/begin COMPU_METHOD CU_V2GRXMSGCRNTDMDNOTIF "Conversion method for V2gRxMsgCrntDmdNotif" TAB_VERB "%12.0" "1" COMPU_TAB_REF CT_V2GRXMSGCRNTDMDNOTIF /end COMPU_METHOD
/begin COMPU_VTAB CT_V2GRXMSGCRNTDMDNOTIF "Conversion method for V2gRxMsgCrntDmdNotif" TAB_VERB 3 0 "NONE" 1 "STOPCHARGING" 2 "RENEGOTIATION" /end COMPU_VTAB
/* Scalar measurable for DDE 'V2gRxMsgCrntDmdNotifFlg'. */
/begin MEASUREMENT V2gRxMsgCrntDmdNotifFlg "The arbitrated Notification parameter in the received message from EVSE" UBYTE CU_V2GRXMSGCRNTDMDNOTIFFLG 1 100 0.0 1.0 ECU_ADDRESS 0x70018082 BYTE_ORDER MSB_LAST /end MEASUREMENT
/begin COMPU_METHOD CU_V2GRXMSGCRNTDMDNOTIFFLG "Conversion method for V2gRxMsgCrntDmdNotifFlg" RAT_FUNC "%10.0" "b" COEFFS 0.000000 1.000000 -0.000000 0.000000 0.000000 1.000000 /end COMPU_METHOD
/* Scalar measurable for DDE 'V2gRxMsgCrntDmdNotifMaxDelay'. */
/begin MEASUREMENT V2gRxMsgCrntDmdNotifMaxDelay "The arbitrated Notification Max Delay parameter in the received message from EVSE" UWORD CU_V2GRXMSGCRNTDMDNOTIFMAXDELAY 1 100 0.0 65535.0 ECU_ADDRESS 0x70017f5a BYTE_ORDER MSB_LAST /end MEASUREMENT
/begin COMPU_METHOD CU_V2GRXMSGCRNTDMDNOTIFMAXDELAY "Conversion method for V2gRxMsgCrntDmdNotifMaxDelay" RAT_FUNC "%10.0" "s" COEFFS 0.000000 1.000000 -0.000000 0.000000 0.000000 1.000000 /end COMPU_METHOD
/* Scalar measurable for DDE 'V2gRxMsgCrntDmdPwrLimReached'. */
/begin MEASUREMENT V2gRxMsgCrntDmdPwrLimReached "If set to TRUE, the EVSE has reached its power limit." UBYTE CU_V2GRXMSGCRNTDMDPWRLIMREACHED 1 100 0.0 1.0 ECU_ADDRESS 0x70017da4 BYTE_ORDER MSB_LAST /end MEASUREMENT
/begin COMPU_METHOD CU_V2GRXMSGCRNTDMDPWRLIMREACHED "Conversion method for V2gRxMsgCrntDmdPwrLimReached" RAT_FUNC "%10.0" "b" COEFFS 0.000000 1.000000 -0.000000 0.000000 0.000000 1.000000 /end COMPU_METHOD
/* Scalar measurable for DDE 'V2gRxMsgCrntDmdRescode'. */
/begin MEASUREMENT V2gRxMsgCrntDmdRescode "for message 7b: indicates the acknowledgment status of  this V2G messages received by the SECC." UBYTE CU_V2GRXMSGCRNTDMDRESCODE 1 100 0.0 255.0 ECU_ADDRESS 0x70018096 BYTE_ORDER MSB_LAST /end MEASUREMENT
/begin COMPU_METHOD CU_V2GRXMSGCRNTDMDRESCODE "Conversion method for V2gRxMsgCrntDmdRescode" RAT_FUNC "%10.0" "1" COEFFS 0.000000 1.000000 -0.000000 0.000000 0.000000 1.000000 /end COMPU_METHOD
/* Scalar measurable for DDE 'V2gRxMsgCrntDmdSASchTupId'. */
/begin MEASUREMENT V2gRxMsgCrntDmdSASchTupId "The SaSchedule Tuple ID message received from the EVSE" UBYTE CU_V2GRXMSGCRNTDMDSASCHTUPID 1 100 0.0 255.0 ECU_ADDRESS 0x70018388 BYTE_ORDER MSB_LAST /end MEASUREMENT
/begin COMPU_METHOD CU_V2GRXMSGCRNTDMDSASCHTUPID "Conversion method for V2gRxMsgCrntDmdSASchTupId" RAT_FUNC "%10.0" "1" COEFFS 0.000000 1.000000 -0.000000 0.000000 0.000000 1.000000 /end COMPU_METHOD
/* Scalar measurable for DDE 'V2gRxMsgCrntDmdSASchTupIdFlg'. */
/begin MEASUREMENT V2gRxMsgCrntDmdSASchTupIdFlg "Identifies the presence of the SaSchedule Tuple ID message received from the EVSE" UBYTE CU_V2GRXMSGCRNTDMDSASCHTUPIDFLG 1 100 0.0 1.0 ECU_ADDRESS 0x70017e5a BYTE_ORDER MSB_LAST /end MEASUREMENT
/begin COMPU_METHOD CU_V2GRXMSGCRNTDMDSASCHTUPIDFLG "Conversion method for V2gRxMsgCrntDmdSASchTupIdFlg" RAT_FUNC "%10.0" "b" COEFFS 0.000000 1.000000 -0.000000 0.000000 0.000000 1.000000 /end COMPU_METHOD
/* Scalar measurable for DDE 'V2gRxMsgCrntDmdTrg'. */
/begin MEASUREMENT V2gRxMsgCrntDmdTrg "Trigger falg that on a rising edge indicates the event for receiving the PLC (V2G) message response 7b from EVSE" UBYTE CU_V2GRXMSGCRNTDMDTRG 1 100 0.0 1.0 ECU_ADDRESS 0x70017c68 BYTE_ORDER MSB_LAST /end MEASUREMENT
/begin COMPU_METHOD CU_V2GRXMSGCRNTDMDTRG "Conversion method for V2gRxMsgCrntDmdTrg" RAT_FUNC "%10.0" "b" COEFFS 0.000000 1.000000 -0.000000 0.000000 0.000000 1.000000 /end COMPU_METHOD
/* Scalar measurable for DDE 'V2gRxMsgCrntDmdVoltLimReached'. */
/begin MEASUREMENT V2gRxMsgCrntDmdVoltLimReached "f set to TRUE, the EVSE has reached its voltage limit." UBYTE CU_V2GRXMSGCRNTDMDVOLTLIMREACH0 1 100 0.0 1.0 ECU_ADDRESS 0x70018464 BYTE_ORDER MSB_LAST /end MEASUREMENT
/begin COMPU_METHOD CU_V2GRXMSGCRNTDMDVOLTLIMREACH0 "Conversion method for V2gRxMsgCrntDmdVoltLimReached" RAT_FUNC "%10.0" "b" COEFFS 0.000000 1.000000 -0.000000 0.000000 0.000000 1.000000 /end COMPU_METHOD
/* Scalar measurable for DDE 'V2gRxMsgPmtSelNotif'. */
/begin MEASUREMENT V2gRxMsgPmtSelNotif "The arbitrated Notification Max Delay parameter in the received message from EVSE" SLONG CU_V2GRXMSGPMTSELNOTIF 1 100 -2147483648.0 2147483647.0 ECU_ADDRESS 0x70017d98 BYTE_ORDER MSB_LAST /end MEASUREMENT
/begin COMPU_METHOD CU_V2GRXMSGPMTSELNOTIF "Conversion method for V2gRxMsgPmtSelNotif" TAB_VERB "%12.0" "1" COMPU_TAB_REF CT_V2GRXMSGPMTSELNOTIF /end COMPU_METHOD
/begin COMPU_VTAB CT_V2GRXMSGPMTSELNOTIF "Conversion method for V2gRxMsgPmtSelNotif" TAB_VERB 3 0 "NONE" 1 "STOPCHARGING" 2 "RENEGOTIATION" /end COMPU_VTAB
/* Scalar measurable for DDE 'V2gRxMsgPmtSelNotifFlg'. */
/begin MEASUREMENT V2gRxMsgPmtSelNotifFlg "The arbitrated Notification parameter in the received message from EVSE" UBYTE CU_V2GRXMSGPMTSELNOTIFFLG 1 100 0.0 1.0 ECU_ADDRESS 0x70017c84 BYTE_ORDER MSB_LAST /end MEASUREMENT
/begin COMPU_METHOD CU_V2GRXMSGPMTSELNOTIFFLG "Conversion method for V2gRxMsgPmtSelNotifFlg" RAT_FUNC "%10.0" "b" COEFFS 0.000000 1.000000 -0.000000 0.000000 0.000000 1.000000 /end COMPU_METHOD
/* Scalar measurable for DDE 'V2gRxMsgPmtSelNotifMaxDelay'. */
/begin MEASUREMENT V2gRxMsgPmtSelNotifMaxDelay "The arbitrated Notification Max Delay parameter in the received message from EVSE" UWORD CU_V2GRXMSGPMTSELNOTIFMAXDELAY 1 100 0.0 65535.0 ECU_ADDRESS 0x70017e90 BYTE_ORDER MSB_LAST /end MEASUREMENT
/begin COMPU_METHOD CU_V2GRXMSGPMTSELNOTIFMAXDELAY "Conversion method for V2gRxMsgPmtSelNotifMaxDelay" RAT_FUNC "%10.0" "s" COEFFS 0.000000 1.000000 -0.000000 0.000000 0.000000 1.000000 /end COMPU_METHOD
/* Scalar measurable for DDE 'V2gRxMsgPmtSelRescode'. */
/begin MEASUREMENT V2gRxMsgPmtSelRescode "for message Xb: indicates the acknowledgment status of  this V2G messages received by the SECC." UBYTE CU_V2GRXMSGPMTSELRESCODE 1 100 0.0 255.0 ECU_ADDRESS 0x70017dae BYTE_ORDER MSB_LAST /end MEASUREMENT
/begin COMPU_METHOD CU_V2GRXMSGPMTSELRESCODE "Conversion method for V2gRxMsgPmtSelRescode" RAT_FUNC "%10.0" "1" COEFFS 0.000000 1.000000 -0.000000 0.000000 0.000000 1.000000 /end COMPU_METHOD
/* Scalar measurable for DDE 'V2gRxMsgPmtSelTrg'. */
/begin MEASUREMENT V2gRxMsgPmtSelTrg "Trigger falg that on a rising edge indicates the event for receiving the PLC (V2G) message response Xb from EVSE" UBYTE CU_V2GRXMSGPMTSELTRG 1 100 0.0 1.0 ECU_ADDRESS 0x70017f82 BYTE_ORDER MSB_LAST /end MEASUREMENT
/begin COMPU_METHOD CU_V2GRXMSGPMTSELTRG "Conversion method for V2gRxMsgPmtSelTrg" RAT_FUNC "%10.0" "b" COEFFS 0.000000 1.000000 -0.000000 0.000000 0.000000 1.000000 /end COMPU_METHOD
/* Scalar measurable for DDE 'V2gRxMsgPreChgEvseStatus'. */
/begin MEASUREMENT V2gRxMsgPreChgEvseStatus "Indicates the internal state of the EVSE." SLONG CU_V2GRXMSGPRECHGEVSESTATUS 1 100 -2147483648.0 2147483647.0 ECU_ADDRESS 0x70017f50 BYTE_ORDER MSB_LAST /end MEASUREMENT
/begin COMPU_METHOD CU_V2GRXMSGPRECHGEVSESTATUS "Conversion method for V2gRxMsgPreChgEvseStatus" TAB_VERB "%12.0" "enum" COMPU_TAB_REF CT_V2GRXMSGPRECHGEVSESTATUS /end COMPU_METHOD
/begin COMPU_VTAB CT_V2GRXMSGPRECHGEVSESTATUS "Conversion method for V2gRxMsgPreChgEvseStatus" TAB_VERB 12 0 "EVSE_NOT_READY" 1 "EVSE_READY" 2 "EVSE_SHUTDOWN" 3 "EVSE_UTILITY_INTERRUPT" 4 "EVSE_ISOLATION_MONITOR_ACTV" 5 "EVSE_EMERGENCY_SHUTDOWN" 6 "EVSE_MALFUNCTION" 7 "EVSE_STATUS_RESERVED1" 8 "EVSE_STATUS_RESERVED2" 9 "EVSE_STATUS_RESERVED3" 10 "EVSE_STATUS_RESERVED4" 11 "EVSE_STATUS_RESERVED5" /end COMPU_VTAB
/* Scalar measurable for DDE 'V2gRxMsgPreChgEvseVoltage'. */
/begin MEASUREMENT V2gRxMsgPreChgEvseVoltage "Present voltage of EVSE" FLOAT32_IEEE CU_V2GRXMSGPRECHGEVSEVOLTAGE 1 100 0.0 196605.0 ECU_ADDRESS 0x700181c4 BYTE_ORDER MSB_LAST /end MEASUREMENT
/begin COMPU_METHOD CU_V2GRXMSGPRECHGEVSEVOLTAGE "Conversion method for V2gRxMsgPreChgEvseVoltage" RAT_FUNC "%10.0" "V" COEFFS 0.000000 1.000000 -0.000000 0.000000 0.000000 1.000000 /end COMPU_METHOD
/* Scalar measurable for DDE 'V2gRxMsgPreChgIsolStatus'. */
/begin MEASUREMENT V2gRxMsgPreChgIsolStatus "Indicates the isolation condition" SLONG CU_V2GRXMSGPRECHGISOLSTATUS 1 100 -2147483648.0 2147483647.0 ECU_ADDRESS 0x70017c7c BYTE_ORDER MSB_LAST /end MEASUREMENT
/begin COMPU_METHOD CU_V2GRXMSGPRECHGISOLSTATUS "Conversion method for V2gRxMsgPreChgIsolStatus" TAB_VERB "%12.0" "enum" COMPU_TAB_REF CT_V2GRXMSGPRECHGISOLSTATUS /end COMPU_METHOD
/begin COMPU_VTAB CT_V2GRXMSGPRECHGISOLSTATUS "Conversion method for V2gRxMsgPreChgIsolStatus" TAB_VERB 4 0 "ISOLATION_INVALID" 1 "ISOLATION_VALID" 2 "ISOLATION_WARNING" 3 "ISOLATION_FAULT" /end COMPU_VTAB
/* Scalar measurable for DDE 'V2gRxMsgPreChgIsolStatus_flg'. */
/begin MEASUREMENT V2gRxMsgPreChgIsolStatus_flg "Identifies the presence of the EVSEIsolationStatus parameter." UBYTE CU_V2GRXMSGPRECHGISOLSTATUS_FLG 1 100 0.0 1.0 ECU_ADDRESS 0x700183a9 BYTE_ORDER MSB_LAST /end MEASUREMENT
/begin COMPU_METHOD CU_V2GRXMSGPRECHGISOLSTATUS_FLG "Conversion method for V2gRxMsgPreChgIsolStatus_flg" RAT_FUNC "%10.0" "b" COEFFS 0.000000 1.000000 -0.000000 0.000000 0.000000 1.000000 /end COMPU_METHOD
/* Scalar measurable for DDE 'V2gRxMsgPreChgNotif'. */
/begin MEASUREMENT V2gRxMsgPreChgNotif "The arbitrated Notification Max Delay parameter in the received message from EVSE" SLONG CU_V2GRXMSGPRECHGNOTIF 1 100 -2147483648.0 2147483647.0 ECU_ADDRESS 0x70017da8 BYTE_ORDER MSB_LAST /end MEASUREMENT
/begin COMPU_METHOD CU_V2GRXMSGPRECHGNOTIF "Conversion method for V2gRxMsgPreChgNotif" TAB_VERB "%12.0" "1" COMPU_TAB_REF CT_V2GRXMSGPRECHGNOTIF /end COMPU_METHOD
/begin COMPU_VTAB CT_V2GRXMSGPRECHGNOTIF "Conversion method for V2gRxMsgPreChgNotif" TAB_VERB 3 0 "NONE" 1 "STOPCHARGING" 2 "RENEGOTIATION" /end COMPU_VTAB
/* Scalar measurable for DDE 'V2gRxMsgPreChgNotifFlg'. */
/begin MEASUREMENT V2gRxMsgPreChgNotifFlg "The arbitrated Notification parameter in the received message from EVSE" UBYTE CU_V2GRXMSGPRECHGNOTIFFLG 1 100 0.0 1.0 ECU_ADDRESS 0x70017db3 BYTE_ORDER MSB_LAST /end MEASUREMENT
/begin COMPU_METHOD CU_V2GRXMSGPRECHGNOTIFFLG "Conversion method for V2gRxMsgPreChgNotifFlg" RAT_FUNC "%10.0" "b" COEFFS 0.000000 1.000000 -0.000000 0.000000 0.000000 1.000000 /end COMPU_METHOD
/* Scalar measurable for DDE 'V2gRxMsgPreChgNotifMaxDelay'. */
/begin MEASUREMENT V2gRxMsgPreChgNotifMaxDelay "The arbitrated Notification Max Delay parameter in the received message from EVSE" UWORD CU_V2GRXMSGPRECHGNOTIFMAXDELAY 1 100 0.0 65535.0 ECU_ADDRESS 0x70018490 BYTE_ORDER MSB_LAST /end MEASUREMENT
/begin COMPU_METHOD CU_V2GRXMSGPRECHGNOTIFMAXDELAY "Conversion method for V2gRxMsgPreChgNotifMaxDelay" RAT_FUNC "%10.0" "s" COEFFS 0.000000 1.000000 -0.000000 0.000000 0.000000 1.000000 /end COMPU_METHOD
/* Scalar measurable for DDE 'V2gRxMsgPreChgRescode'. */
/begin MEASUREMENT V2gRxMsgPreChgRescode "for message 5b: indicates the acknowledgment status of  this V2G messages received by the SECC." UBYTE CU_V2GRXMSGPRECHGRESCODE 1 100 0.0 255.0 ECU_ADDRESS 0x700183a1 BYTE_ORDER MSB_LAST /end MEASUREMENT
/begin COMPU_METHOD CU_V2GRXMSGPRECHGRESCODE "Conversion method for V2gRxMsgPreChgRescode" RAT_FUNC "%10.0" "1" COEFFS 0.000000 1.000000 -0.000000 0.000000 0.000000 1.000000 /end COMPU_METHOD
/* Scalar measurable for DDE 'V2gRxMsgPreChgTrg'. */
/begin MEASUREMENT V2gRxMsgPreChgTrg "Trigger falg that on a rising edge indicates the event for receiving the PLC (V2G) message response 5b from EVSE" UBYTE CU_V2GRXMSGPRECHGTRG 1 100 0.0 1.0 ECU_ADDRESS 0x70017d9c BYTE_ORDER MSB_LAST /end MEASUREMENT
/begin COMPU_METHOD CU_V2GRXMSGPRECHGTRG "Conversion method for V2gRxMsgPreChgTrg" RAT_FUNC "%10.0" "b" COEFFS 0.000000 1.000000 -0.000000 0.000000 0.000000 1.000000 /end COMPU_METHOD
/* Scalar measurable for DDE 'V2gRxMsgPwrDelivEvseProcessing'. */
/begin MEASUREMENT V2gRxMsgPwrDelivEvseProcessing "Message 4b: Parameter indicating that the EVSE has finished the processing that was initiated after the ContractAuthenticationReq or that the EVSE is still processing at the time the response message was sent." SLONG CU_V2GRXMSGPWRDELIVEVSEPROCESS0 1 100 -2147483648.0 2147483647.0 ECU_ADDRESS 0x700181a4 BYTE_ORDER MSB_LAST /end MEASUREMENT
/begin COMPU_METHOD CU_V2GRXMSGPWRDELIVEVSEPROCESS0 "Conversion method for V2gRxMsgPwrDelivEvseProcessing" TAB_VERB "%12.0" "enum" COMPU_TAB_REF CT_V2GRXMSGPWRDELIVEVSEPROCESS0 /end COMPU_METHOD
/begin COMPU_VTAB CT_V2GRXMSGPWRDELIVEVSEPROCESS0 "Conversion method for V2gRxMsgPwrDelivEvseProcessing" TAB_VERB 3 0 "FINISHED" 1 "ONGOING" 2 "ONGOING_WAITINGFORCUSTOMERINTERACTION" /end COMPU_VTAB
/* Scalar measurable for DDE 'V2gRxMsgPwrDelivEvseStatus'. */
/begin MEASUREMENT V2gRxMsgPwrDelivEvseStatus "Indicates the internal state of the EVSE." SLONG CU_V2GRXMSGPWRDELIVEVSESTATUS 1 100 -2147483648.0 2147483647.0 ECU_ADDRESS 0x70018384 BYTE_ORDER MSB_LAST /end MEASUREMENT
/begin COMPU_METHOD CU_V2GRXMSGPWRDELIVEVSESTATUS "Conversion method for V2gRxMsgPwrDelivEvseStatus" TAB_VERB "%12.0" "enum" COMPU_TAB_REF CT_V2GRXMSGPWRDELIVEVSESTATUS /end COMPU_METHOD
/begin COMPU_VTAB CT_V2GRXMSGPWRDELIVEVSESTATUS "Conversion method for V2gRxMsgPwrDelivEvseStatus" TAB_VERB 12 0 "EVSE_NOT_READY" 1 "EVSE_READY" 2 "EVSE_SHUTDOWN" 3 "EVSE_UTILITY_INTERRUPT" 4 "EVSE_ISOLATION_MONITOR_ACTV" 5 "EVSE_EMERGENCY_SHUTDOWN" 6 "EVSE_MALFUNCTION" 7 "EVSE_STATUS_RESERVED1" 8 "EVSE_STATUS_RESERVED2" 9 "EVSE_STATUS_RESERVED3" 10 "EVSE_STATUS_RESERVED4" 11 "EVSE_STATUS_RESERVED5" /end COMPU_VTAB
/* Scalar measurable for DDE 'V2gRxMsgPwrDelivEvseStatus_flg'. */
/begin MEASUREMENT V2gRxMsgPwrDelivEvseStatus_flg "Identifies the presence of the EVSEStatusCode_present, and EVSEStatusCode parameters." UBYTE CU_V2GRXMSGPWRDELIVEVSESTATUS_0 1 100 0.0 1.0 ECU_ADDRESS 0x700182a5 BYTE_ORDER MSB_LAST /end MEASUREMENT
/begin COMPU_METHOD CU_V2GRXMSGPWRDELIVEVSESTATUS_0 "Conversion method for V2gRxMsgPwrDelivEvseStatus_flg" RAT_FUNC "%10.0" "b" COEFFS 0.000000 1.000000 -0.000000 0.000000 0.000000 1.000000 /end COMPU_METHOD
/* Scalar measurable for DDE 'V2gRxMsgPwrDelivIsolStatus'. */
/begin MEASUREMENT V2gRxMsgPwrDelivIsolStatus "Indicates the isolation condition" SLONG CU_V2GRXMSGPWRDELIVISOLSTATUS 1 100 -2147483648.0 2147483647.0 ECU_ADDRESS 0x70018050 BYTE_ORDER MSB_LAST /end MEASUREMENT
/begin COMPU_METHOD CU_V2GRXMSGPWRDELIVISOLSTATUS "Conversion method for V2gRxMsgPwrDelivIsolStatus" TAB_VERB "%12.0" "enum" COMPU_TAB_REF CT_V2GRXMSGPWRDELIVISOLSTATUS /end COMPU_METHOD
/begin COMPU_VTAB CT_V2GRXMSGPWRDELIVISOLSTATUS "Conversion method for V2gRxMsgPwrDelivIsolStatus" TAB_VERB 4 0 "ISOLATION_INVALID" 1 "ISOLATION_VALID" 2 "ISOLATION_WARNING" 3 "ISOLATION_FAULT" /end COMPU_VTAB
/* Scalar measurable for DDE 'V2gRxMsgPwrDelivIsolStatus_flg'. */
/begin MEASUREMENT V2gRxMsgPwrDelivIsolStatus_flg "Identifies the presence of the EVSEIsolationStatus_present, EVSEIsolationStatus" UBYTE CU_V2GRXMSGPWRDELIVISOLSTATUS_0 1 100 0.0 1.0 ECU_ADDRESS 0x70017fe5 BYTE_ORDER MSB_LAST /end MEASUREMENT
/begin COMPU_METHOD CU_V2GRXMSGPWRDELIVISOLSTATUS_0 "Conversion method for V2gRxMsgPwrDelivIsolStatus_flg" RAT_FUNC "%10.0" "b" COEFFS 0.000000 1.000000 -0.000000 0.000000 0.000000 1.000000 /end COMPU_METHOD
/* Scalar measurable for DDE 'V2gRxMsgPwrDelivNotif'. */
/begin MEASUREMENT V2gRxMsgPwrDelivNotif "The arbitrated Notification Max Delay parameter in the received message from EVSE" SLONG CU_V2GRXMSGPWRDELIVNOTIF 1 100 -2147483648.0 2147483647.0 ECU_ADDRESS 0x70018288 BYTE_ORDER MSB_LAST /end MEASUREMENT
/begin COMPU_METHOD CU_V2GRXMSGPWRDELIVNOTIF "Conversion method for V2gRxMsgPwrDelivNotif" TAB_VERB "%12.0" "1" COMPU_TAB_REF CT_V2GRXMSGPWRDELIVNOTIF /end COMPU_METHOD
/begin COMPU_VTAB CT_V2GRXMSGPWRDELIVNOTIF "Conversion method for V2gRxMsgPwrDelivNotif" TAB_VERB 3 0 "NONE" 1 "STOPCHARGING" 2 "RENEGOTIATION" /end COMPU_VTAB
/* Scalar measurable for DDE 'V2gRxMsgPwrDelivNotifFlg'. */
/begin MEASUREMENT V2gRxMsgPwrDelivNotifFlg "The arbitrated Notification parameter in the received message from EVSE" UBYTE CU_V2GRXMSGPWRDELIVNOTIFFLG 1 100 0.0 1.0 ECU_ADDRESS 0x70017d50 BYTE_ORDER MSB_LAST /end MEASUREMENT
/begin COMPU_METHOD CU_V2GRXMSGPWRDELIVNOTIFFLG "Conversion method for V2gRxMsgPwrDelivNotifFlg" RAT_FUNC "%10.0" "b" COEFFS 0.000000 1.000000 -0.000000 0.000000 0.000000 1.000000 /end COMPU_METHOD
/* Scalar measurable for DDE 'V2gRxMsgPwrDelivNotifMaxDelay'. */
/begin MEASUREMENT V2gRxMsgPwrDelivNotifMaxDelay "The arbitrated Notification Max Delay parameter in the received message from EVSE" UWORD CU_V2GRXMSGPWRDELIVNOTIFMAXDEL0 1 100 0.0 65535.0 ECU_ADDRESS 0x7001846e BYTE_ORDER MSB_LAST /end MEASUREMENT
/begin COMPU_METHOD CU_V2GRXMSGPWRDELIVNOTIFMAXDEL0 "Conversion method for V2gRxMsgPwrDelivNotifMaxDelay" RAT_FUNC "%10.0" "s" COEFFS 0.000000 1.000000 -0.000000 0.000000 0.000000 1.000000 /end COMPU_METHOD
/* Scalar measurable for DDE 'V2gRxMsgPwrDelivRescode'. */
/begin MEASUREMENT V2gRxMsgPwrDelivRescode "for message 6b: indicates the acknowledgment status of  this V2G messages received by the SECC." UBYTE CU_V2GRXMSGPWRDELIVRESCODE 1 100 0.0 255.0 ECU_ADDRESS 0x70017e40 BYTE_ORDER MSB_LAST /end MEASUREMENT
/begin COMPU_METHOD CU_V2GRXMSGPWRDELIVRESCODE "Conversion method for V2gRxMsgPwrDelivRescode" RAT_FUNC "%10.0" "1" COEFFS 0.000000 1.000000 -0.000000 0.000000 0.000000 1.000000 /end COMPU_METHOD
/* Scalar measurable for DDE 'V2gRxMsgPwrDelivTrg'. */
/begin MEASUREMENT V2gRxMsgPwrDelivTrg "Trigger falg that on a rising edge indicates the event for receiving the PLC (V2G) message response 6b from EVSE" UBYTE CU_V2GRXMSGPWRDELIVTRG 1 100 0.0 1.0 ECU_ADDRESS 0x70017c8a BYTE_ORDER MSB_LAST /end MEASUREMENT
/begin COMPU_METHOD CU_V2GRXMSGPWRDELIVTRG "Conversion method for V2gRxMsgPwrDelivTrg" RAT_FUNC "%10.0" "b" COEFFS 0.000000 1.000000 -0.000000 0.000000 0.000000 1.000000 /end COMPU_METHOD
/* Scalar measurable for DDE 'V2gRxMsgSesSetupEvseIdLen'. */
/begin MEASUREMENT V2gRxMsgSesSetupEvseIdLen "Number of bytes in EVSE ID" UBYTE CU_V2GRXMSGSESSETUPEVSEIDLEN 1 100 0.0 37.0 ECU_ADDRESS 0x700182b0 BYTE_ORDER MSB_LAST /end MEASUREMENT
/begin COMPU_METHOD CU_V2GRXMSGSESSETUPEVSEIDLEN "Conversion method for V2gRxMsgSesSetupEvseIdLen" RAT_FUNC "%10.0" "1" COEFFS 0.000000 1.000000 -0.000000 0.000000 0.000000 1.000000 /end COMPU_METHOD
/* Scalar measurable for DDE 'V2gRxMsgSesSetupEvseId[0]'. */
/begin MEASUREMENT V2gRxMsgSesSetupEvseId[0] "The ID that uniquely identifies the EVSE. Format is defined in DIN SPEC 91286" UBYTE CU_V2GRXMSGSESSETUPEVSEID[0] 1 100 0.0 255.0 ECU_ADDRESS 0x70017f21 BYTE_ORDER MSB_LAST /end MEASUREMENT
/begin COMPU_METHOD CU_V2GRXMSGSESSETUPEVSEID[0] "Conversion method for V2gRxMsgSesSetupEvseId[0]" RAT_FUNC "%10.0" "1" COEFFS 0.000000 1.000000 -0.000000 0.000000 0.000000 1.000000 /end COMPU_METHOD
/* Scalar measurable for DDE 'V2gRxMsgSesSetupEvseId[10]'. */
/begin MEASUREMENT V2gRxMsgSesSetupEvseId[10] "The ID that uniquely identifies the EVSE. Format is defined in DIN SPEC 91286" UBYTE CU_V2GRXMSGSESSETUPEVSEID[10] 1 100 0.0 255.0 ECU_ADDRESS 0x70017f2b BYTE_ORDER MSB_LAST /end MEASUREMENT
/begin COMPU_METHOD CU_V2GRXMSGSESSETUPEVSEID[10] "Conversion method for V2gRxMsgSesSetupEvseId[10]" RAT_FUNC "%10.0" "1" COEFFS 0.000000 1.000000 -0.000000 0.000000 0.000000 1.000000 /end COMPU_METHOD
/* Scalar measurable for DDE 'V2gRxMsgSesSetupEvseId[11]'. */
/begin MEASUREMENT V2gRxMsgSesSetupEvseId[11] "The ID that uniquely identifies the EVSE. Format is defined in DIN SPEC 91286" UBYTE CU_V2GRXMSGSESSETUPEVSEID[11] 1 100 0.0 255.0 ECU_ADDRESS 0x70017f2c BYTE_ORDER MSB_LAST /end MEASUREMENT
/begin COMPU_METHOD CU_V2GRXMSGSESSETUPEVSEID[11] "Conversion method for V2gRxMsgSesSetupEvseId[11]" RAT_FUNC "%10.0" "1" COEFFS 0.000000 1.000000 -0.000000 0.000000 0.000000 1.000000 /end COMPU_METHOD
/* Scalar measurable for DDE 'V2gRxMsgSesSetupEvseId[12]'. */
/begin MEASUREMENT V2gRxMsgSesSetupEvseId[12] "The ID that uniquely identifies the EVSE. Format is defined in DIN SPEC 91286" UBYTE CU_V2GRXMSGSESSETUPEVSEID[12] 1 100 0.0 255.0 ECU_ADDRESS 0x70017f2d BYTE_ORDER MSB_LAST /end MEASUREMENT
/begin COMPU_METHOD CU_V2GRXMSGSESSETUPEVSEID[12] "Conversion method for V2gRxMsgSesSetupEvseId[12]" RAT_FUNC "%10.0" "1" COEFFS 0.000000 1.000000 -0.000000 0.000000 0.000000 1.000000 /end COMPU_METHOD
/* Scalar measurable for DDE 'V2gRxMsgSesSetupEvseId[13]'. */
/begin MEASUREMENT V2gRxMsgSesSetupEvseId[13] "The ID that uniquely identifies the EVSE. Format is defined in DIN SPEC 91286" UBYTE CU_V2GRXMSGSESSETUPEVSEID[13] 1 100 0.0 255.0 ECU_ADDRESS 0x70017f2e BYTE_ORDER MSB_LAST /end MEASUREMENT
/begin COMPU_METHOD CU_V2GRXMSGSESSETUPEVSEID[13] "Conversion method for V2gRxMsgSesSetupEvseId[13]" RAT_FUNC "%10.0" "1" COEFFS 0.000000 1.000000 -0.000000 0.000000 0.000000 1.000000 /end COMPU_METHOD
/* Scalar measurable for DDE 'V2gRxMsgSesSetupEvseId[14]'. */
/begin MEASUREMENT V2gRxMsgSesSetupEvseId[14] "The ID that uniquely identifies the EVSE. Format is defined in DIN SPEC 91286" UBYTE CU_V2GRXMSGSESSETUPEVSEID[14] 1 100 0.0 255.0 ECU_ADDRESS 0x70017f2f BYTE_ORDER MSB_LAST /end MEASUREMENT
/begin COMPU_METHOD CU_V2GRXMSGSESSETUPEVSEID[14] "Conversion method for V2gRxMsgSesSetupEvseId[14]" RAT_FUNC "%10.0" "1" COEFFS 0.000000 1.000000 -0.000000 0.000000 0.000000 1.000000 /end COMPU_METHOD
/* Scalar measurable for DDE 'V2gRxMsgSesSetupEvseId[15]'. */
/begin MEASUREMENT V2gRxMsgSesSetupEvseId[15] "The ID that uniquely identifies the EVSE. Format is defined in DIN SPEC 91286" UBYTE CU_V2GRXMSGSESSETUPEVSEID[15] 1 100 0.0 255.0 ECU_ADDRESS 0x70017f30 BYTE_ORDER MSB_LAST /end MEASUREMENT
/begin COMPU_METHOD CU_V2GRXMSGSESSETUPEVSEID[15] "Conversion method for V2gRxMsgSesSetupEvseId[15]" RAT_FUNC "%10.0" "1" COEFFS 0.000000 1.000000 -0.000000 0.000000 0.000000 1.000000 /end COMPU_METHOD
/* Scalar measurable for DDE 'V2gRxMsgSesSetupEvseId[16]'. */
/begin MEASUREMENT V2gRxMsgSesSetupEvseId[16] "The ID that uniquely identifies the EVSE. Format is defined in DIN SPEC 91286" UBYTE CU_V2GRXMSGSESSETUPEVSEID[16] 1 100 0.0 255.0 ECU_ADDRESS 0x70017f31 BYTE_ORDER MSB_LAST /end MEASUREMENT
/begin COMPU_METHOD CU_V2GRXMSGSESSETUPEVSEID[16] "Conversion method for V2gRxMsgSesSetupEvseId[16]" RAT_FUNC "%10.0" "1" COEFFS 0.000000 1.000000 -0.000000 0.000000 0.000000 1.000000 /end COMPU_METHOD
/* Scalar measurable for DDE 'V2gRxMsgSesSetupEvseId[17]'. */
/begin MEASUREMENT V2gRxMsgSesSetupEvseId[17] "The ID that uniquely identifies the EVSE. Format is defined in DIN SPEC 91286" UBYTE CU_V2GRXMSGSESSETUPEVSEID[17] 1 100 0.0 255.0 ECU_ADDRESS 0x70017f32 BYTE_ORDER MSB_LAST /end MEASUREMENT
/begin COMPU_METHOD CU_V2GRXMSGSESSETUPEVSEID[17] "Conversion method for V2gRxMsgSesSetupEvseId[17]" RAT_FUNC "%10.0" "1" COEFFS 0.000000 1.000000 -0.000000 0.000000 0.000000 1.000000 /end COMPU_METHOD
/* Scalar measurable for DDE 'V2gRxMsgSesSetupEvseId[18]'. */
/begin MEASUREMENT V2gRxMsgSesSetupEvseId[18] "The ID that uniquely identifies the EVSE. Format is defined in DIN SPEC 91286" UBYTE CU_V2GRXMSGSESSETUPEVSEID[18] 1 100 0.0 255.0 ECU_ADDRESS 0x70017f33 BYTE_ORDER MSB_LAST /end MEASUREMENT
/begin COMPU_METHOD CU_V2GRXMSGSESSETUPEVSEID[18] "Conversion method for V2gRxMsgSesSetupEvseId[18]" RAT_FUNC "%10.0" "1" COEFFS 0.000000 1.000000 -0.000000 0.000000 0.000000 1.000000 /end COMPU_METHOD
/* Scalar measurable for DDE 'V2gRxMsgSesSetupEvseId[19]'. */
/begin MEASUREMENT V2gRxMsgSesSetupEvseId[19] "The ID that uniquely identifies the EVSE. Format is defined in DIN SPEC 91286" UBYTE CU_V2GRXMSGSESSETUPEVSEID[19] 1 100 0.0 255.0 ECU_ADDRESS 0x70017f34 BYTE_ORDER MSB_LAST /end MEASUREMENT
/begin COMPU_METHOD CU_V2GRXMSGSESSETUPEVSEID[19] "Conversion method for V2gRxMsgSesSetupEvseId[19]" RAT_FUNC "%10.0" "1" COEFFS 0.000000 1.000000 -0.000000 0.000000 0.000000 1.000000 /end COMPU_METHOD
/* Scalar measurable for DDE 'V2gRxMsgSesSetupEvseId[1]'. */
/begin MEASUREMENT V2gRxMsgSesSetupEvseId[1] "The ID that uniquely identifies the EVSE. Format is defined in DIN SPEC 91286" UBYTE CU_V2GRXMSGSESSETUPEVSEID[1] 1 100 0.0 255.0 ECU_ADDRESS 0x70017f22 BYTE_ORDER MSB_LAST /end MEASUREMENT
/begin COMPU_METHOD CU_V2GRXMSGSESSETUPEVSEID[1] "Conversion method for V2gRxMsgSesSetupEvseId[1]" RAT_FUNC "%10.0" "1" COEFFS 0.000000 1.000000 -0.000000 0.000000 0.000000 1.000000 /end COMPU_METHOD
/* Scalar measurable for DDE 'V2gRxMsgSesSetupEvseId[20]'. */
/begin MEASUREMENT V2gRxMsgSesSetupEvseId[20] "The ID that uniquely identifies the EVSE. Format is defined in DIN SPEC 91286" UBYTE CU_V2GRXMSGSESSETUPEVSEID[20] 1 100 0.0 255.0 ECU_ADDRESS 0x70017f35 BYTE_ORDER MSB_LAST /end MEASUREMENT
/begin COMPU_METHOD CU_V2GRXMSGSESSETUPEVSEID[20] "Conversion method for V2gRxMsgSesSetupEvseId[20]" RAT_FUNC "%10.0" "1" COEFFS 0.000000 1.000000 -0.000000 0.000000 0.000000 1.000000 /end COMPU_METHOD
/* Scalar measurable for DDE 'V2gRxMsgSesSetupEvseId[21]'. */
/begin MEASUREMENT V2gRxMsgSesSetupEvseId[21] "The ID that uniquely identifies the EVSE. Format is defined in DIN SPEC 91286" UBYTE CU_V2GRXMSGSESSETUPEVSEID[21] 1 100 0.0 255.0 ECU_ADDRESS 0x70017f36 BYTE_ORDER MSB_LAST /end MEASUREMENT
/begin COMPU_METHOD CU_V2GRXMSGSESSETUPEVSEID[21] "Conversion method for V2gRxMsgSesSetupEvseId[21]" RAT_FUNC "%10.0" "1" COEFFS 0.000000 1.000000 -0.000000 0.000000 0.000000 1.000000 /end COMPU_METHOD
/* Scalar measurable for DDE 'V2gRxMsgSesSetupEvseId[22]'. */
/begin MEASUREMENT V2gRxMsgSesSetupEvseId[22] "The ID that uniquely identifies the EVSE. Format is defined in DIN SPEC 91286" UBYTE CU_V2GRXMSGSESSETUPEVSEID[22] 1 100 0.0 255.0 ECU_ADDRESS 0x70017f37 BYTE_ORDER MSB_LAST /end MEASUREMENT
/begin COMPU_METHOD CU_V2GRXMSGSESSETUPEVSEID[22] "Conversion method for V2gRxMsgSesSetupEvseId[22]" RAT_FUNC "%10.0" "1" COEFFS 0.000000 1.000000 -0.000000 0.000000 0.000000 1.000000 /end COMPU_METHOD
/* Scalar measurable for DDE 'V2gRxMsgSesSetupEvseId[23]'. */
/begin MEASUREMENT V2gRxMsgSesSetupEvseId[23] "The ID that uniquely identifies the EVSE. Format is defined in DIN SPEC 91286" UBYTE CU_V2GRXMSGSESSETUPEVSEID[23] 1 100 0.0 255.0 ECU_ADDRESS 0x70017f38 BYTE_ORDER MSB_LAST /end MEASUREMENT
/begin COMPU_METHOD CU_V2GRXMSGSESSETUPEVSEID[23] "Conversion method for V2gRxMsgSesSetupEvseId[23]" RAT_FUNC "%10.0" "1" COEFFS 0.000000 1.000000 -0.000000 0.000000 0.000000 1.000000 /end COMPU_METHOD
/* Scalar measurable for DDE 'V2gRxMsgSesSetupEvseId[24]'. */
/begin MEASUREMENT V2gRxMsgSesSetupEvseId[24] "The ID that uniquely identifies the EVSE. Format is defined in DIN SPEC 91286" UBYTE CU_V2GRXMSGSESSETUPEVSEID[24] 1 100 0.0 255.0 ECU_ADDRESS 0x70017f39 BYTE_ORDER MSB_LAST /end MEASUREMENT
/begin COMPU_METHOD CU_V2GRXMSGSESSETUPEVSEID[24] "Conversion method for V2gRxMsgSesSetupEvseId[24]" RAT_FUNC "%10.0" "1" COEFFS 0.000000 1.000000 -0.000000 0.000000 0.000000 1.000000 /end COMPU_METHOD
/* Scalar measurable for DDE 'V2gRxMsgSesSetupEvseId[25]'. */
/begin MEASUREMENT V2gRxMsgSesSetupEvseId[25] "The ID that uniquely identifies the EVSE. Format is defined in DIN SPEC 91286" UBYTE CU_V2GRXMSGSESSETUPEVSEID[25] 1 100 0.0 255.0 ECU_ADDRESS 0x70017f3a BYTE_ORDER MSB_LAST /end MEASUREMENT
/begin COMPU_METHOD CU_V2GRXMSGSESSETUPEVSEID[25] "Conversion method for V2gRxMsgSesSetupEvseId[25]" RAT_FUNC "%10.0" "1" COEFFS 0.000000 1.000000 -0.000000 0.000000 0.000000 1.000000 /end COMPU_METHOD
/* Scalar measurable for DDE 'V2gRxMsgSesSetupEvseId[26]'. */
/begin MEASUREMENT V2gRxMsgSesSetupEvseId[26] "The ID that uniquely identifies the EVSE. Format is defined in DIN SPEC 91286" UBYTE CU_V2GRXMSGSESSETUPEVSEID[26] 1 100 0.0 255.0 ECU_ADDRESS 0x70017f3b BYTE_ORDER MSB_LAST /end MEASUREMENT
/begin COMPU_METHOD CU_V2GRXMSGSESSETUPEVSEID[26] "Conversion method for V2gRxMsgSesSetupEvseId[26]" RAT_FUNC "%10.0" "1" COEFFS 0.000000 1.000000 -0.000000 0.000000 0.000000 1.000000 /end COMPU_METHOD
/* Scalar measurable for DDE 'V2gRxMsgSesSetupEvseId[27]'. */
/begin MEASUREMENT V2gRxMsgSesSetupEvseId[27] "The ID that uniquely identifies the EVSE. Format is defined in DIN SPEC 91286" UBYTE CU_V2GRXMSGSESSETUPEVSEID[27] 1 100 0.0 255.0 ECU_ADDRESS 0x70017f3c BYTE_ORDER MSB_LAST /end MEASUREMENT
/begin COMPU_METHOD CU_V2GRXMSGSESSETUPEVSEID[27] "Conversion method for V2gRxMsgSesSetupEvseId[27]" RAT_FUNC "%10.0" "1" COEFFS 0.000000 1.000000 -0.000000 0.000000 0.000000 1.000000 /end COMPU_METHOD
/* Scalar measurable for DDE 'V2gRxMsgSesSetupEvseId[28]'. */
/begin MEASUREMENT V2gRxMsgSesSetupEvseId[28] "The ID that uniquely identifies the EVSE. Format is defined in DIN SPEC 91286" UBYTE CU_V2GRXMSGSESSETUPEVSEID[28] 1 100 0.0 255.0 ECU_ADDRESS 0x70017f3d BYTE_ORDER MSB_LAST /end MEASUREMENT
/begin COMPU_METHOD CU_V2GRXMSGSESSETUPEVSEID[28] "Conversion method for V2gRxMsgSesSetupEvseId[28]" RAT_FUNC "%10.0" "1" COEFFS 0.000000 1.000000 -0.000000 0.000000 0.000000 1.000000 /end COMPU_METHOD
/* Scalar measurable for DDE 'V2gRxMsgSesSetupEvseId[29]'. */
/begin MEASUREMENT V2gRxMsgSesSetupEvseId[29] "The ID that uniquely identifies the EVSE. Format is defined in DIN SPEC 91286" UBYTE CU_V2GRXMSGSESSETUPEVSEID[29] 1 100 0.0 255.0 ECU_ADDRESS 0x70017f3e BYTE_ORDER MSB_LAST /end MEASUREMENT
/begin COMPU_METHOD CU_V2GRXMSGSESSETUPEVSEID[29] "Conversion method for V2gRxMsgSesSetupEvseId[29]" RAT_FUNC "%10.0" "1" COEFFS 0.000000 1.000000 -0.000000 0.000000 0.000000 1.000000 /end COMPU_METHOD
/* Scalar measurable for DDE 'V2gRxMsgSesSetupEvseId[2]'. */
/begin MEASUREMENT V2gRxMsgSesSetupEvseId[2] "The ID that uniquely identifies the EVSE. Format is defined in DIN SPEC 91286" UBYTE CU_V2GRXMSGSESSETUPEVSEID[2] 1 100 0.0 255.0 ECU_ADDRESS 0x70017f23 BYTE_ORDER MSB_LAST /end MEASUREMENT
/begin COMPU_METHOD CU_V2GRXMSGSESSETUPEVSEID[2] "Conversion method for V2gRxMsgSesSetupEvseId[2]" RAT_FUNC "%10.0" "1" COEFFS 0.000000 1.000000 -0.000000 0.000000 0.000000 1.000000 /end COMPU_METHOD
/* Scalar measurable for DDE 'V2gRxMsgSesSetupEvseId[30]'. */
/begin MEASUREMENT V2gRxMsgSesSetupEvseId[30] "The ID that uniquely identifies the EVSE. Format is defined in DIN SPEC 91286" UBYTE CU_V2GRXMSGSESSETUPEVSEID[30] 1 100 0.0 255.0 ECU_ADDRESS 0x70017f3f BYTE_ORDER MSB_LAST /end MEASUREMENT
/begin COMPU_METHOD CU_V2GRXMSGSESSETUPEVSEID[30] "Conversion method for V2gRxMsgSesSetupEvseId[30]" RAT_FUNC "%10.0" "1" COEFFS 0.000000 1.000000 -0.000000 0.000000 0.000000 1.000000 /end COMPU_METHOD
/* Scalar measurable for DDE 'V2gRxMsgSesSetupEvseId[31]'. */
/begin MEASUREMENT V2gRxMsgSesSetupEvseId[31] "The ID that uniquely identifies the EVSE. Format is defined in DIN SPEC 91286" UBYTE CU_V2GRXMSGSESSETUPEVSEID[31] 1 100 0.0 255.0 ECU_ADDRESS 0x70017f40 BYTE_ORDER MSB_LAST /end MEASUREMENT
/begin COMPU_METHOD CU_V2GRXMSGSESSETUPEVSEID[31] "Conversion method for V2gRxMsgSesSetupEvseId[31]" RAT_FUNC "%10.0" "1" COEFFS 0.000000 1.000000 -0.000000 0.000000 0.000000 1.000000 /end COMPU_METHOD
/* Scalar measurable for DDE 'V2gRxMsgSesSetupEvseId[32]'. */
/begin MEASUREMENT V2gRxMsgSesSetupEvseId[32] "The ID that uniquely identifies the EVSE. Format is defined in DIN SPEC 91286" UBYTE CU_V2GRXMSGSESSETUPEVSEID[32] 1 100 0.0 255.0 ECU_ADDRESS 0x70017f41 BYTE_ORDER MSB_LAST /end MEASUREMENT
/begin COMPU_METHOD CU_V2GRXMSGSESSETUPEVSEID[32] "Conversion method for V2gRxMsgSesSetupEvseId[32]" RAT_FUNC "%10.0" "1" COEFFS 0.000000 1.000000 -0.000000 0.000000 0.000000 1.000000 /end COMPU_METHOD
/* Scalar measurable for DDE 'V2gRxMsgSesSetupEvseId[33]'. */
/begin MEASUREMENT V2gRxMsgSesSetupEvseId[33] "The ID that uniquely identifies the EVSE. Format is defined in DIN SPEC 91286" UBYTE CU_V2GRXMSGSESSETUPEVSEID[33] 1 100 0.0 255.0 ECU_ADDRESS 0x70017f42 BYTE_ORDER MSB_LAST /end MEASUREMENT
/begin COMPU_METHOD CU_V2GRXMSGSESSETUPEVSEID[33] "Conversion method for V2gRxMsgSesSetupEvseId[33]" RAT_FUNC "%10.0" "1" COEFFS 0.000000 1.000000 -0.000000 0.000000 0.000000 1.000000 /end COMPU_METHOD
/* Scalar measurable for DDE 'V2gRxMsgSesSetupEvseId[34]'. */
/begin MEASUREMENT V2gRxMsgSesSetupEvseId[34] "The ID that uniquely identifies the EVSE. Format is defined in DIN SPEC 91286" UBYTE CU_V2GRXMSGSESSETUPEVSEID[34] 1 100 0.0 255.0 ECU_ADDRESS 0x70017f43 BYTE_ORDER MSB_LAST /end MEASUREMENT
/begin COMPU_METHOD CU_V2GRXMSGSESSETUPEVSEID[34] "Conversion method for V2gRxMsgSesSetupEvseId[34]" RAT_FUNC "%10.0" "1" COEFFS 0.000000 1.000000 -0.000000 0.000000 0.000000 1.000000 /end COMPU_METHOD
/* Scalar measurable for DDE 'V2gRxMsgSesSetupEvseId[35]'. */
/begin MEASUREMENT V2gRxMsgSesSetupEvseId[35] "The ID that uniquely identifies the EVSE. Format is defined in DIN SPEC 91286" UBYTE CU_V2GRXMSGSESSETUPEVSEID[35] 1 100 0.0 255.0 ECU_ADDRESS 0x70017f44 BYTE_ORDER MSB_LAST /end MEASUREMENT
/begin COMPU_METHOD CU_V2GRXMSGSESSETUPEVSEID[35] "Conversion method for V2gRxMsgSesSetupEvseId[35]" RAT_FUNC "%10.0" "1" COEFFS 0.000000 1.000000 -0.000000 0.000000 0.000000 1.000000 /end COMPU_METHOD
/* Scalar measurable for DDE 'V2gRxMsgSesSetupEvseId[36]'. */
/begin MEASUREMENT V2gRxMsgSesSetupEvseId[36] "The ID that uniquely identifies the EVSE. Format is defined in DIN SPEC 91286" UBYTE CU_V2GRXMSGSESSETUPEVSEID[36] 1 100 0.0 255.0 ECU_ADDRESS 0x70017f45 BYTE_ORDER MSB_LAST /end MEASUREMENT
/begin COMPU_METHOD CU_V2GRXMSGSESSETUPEVSEID[36] "Conversion method for V2gRxMsgSesSetupEvseId[36]" RAT_FUNC "%10.0" "1" COEFFS 0.000000 1.000000 -0.000000 0.000000 0.000000 1.000000 /end COMPU_METHOD
/* Scalar measurable for DDE 'V2gRxMsgSesSetupEvseId[37]'. */
/begin MEASUREMENT V2gRxMsgSesSetupEvseId[37] "The ID that uniquely identifies the EVSE. Format is defined in DIN SPEC 91286" UBYTE CU_V2GRXMSGSESSETUPEVSEID[37] 1 100 0.0 255.0 ECU_ADDRESS 0x70017f46 BYTE_ORDER MSB_LAST /end MEASUREMENT
/begin COMPU_METHOD CU_V2GRXMSGSESSETUPEVSEID[37] "Conversion method for V2gRxMsgSesSetupEvseId[37]" RAT_FUNC "%10.0" "1" COEFFS 0.000000 1.000000 -0.000000 0.000000 0.000000 1.000000 /end COMPU_METHOD
/* Scalar measurable for DDE 'V2gRxMsgSesSetupEvseId[3]'. */
/begin MEASUREMENT V2gRxMsgSesSetupEvseId[3] "The ID that uniquely identifies the EVSE. Format is defined in DIN SPEC 91286" UBYTE CU_V2GRXMSGSESSETUPEVSEID[3] 1 100 0.0 255.0 ECU_ADDRESS 0x70017f24 BYTE_ORDER MSB_LAST /end MEASUREMENT
/begin COMPU_METHOD CU_V2GRXMSGSESSETUPEVSEID[3] "Conversion method for V2gRxMsgSesSetupEvseId[3]" RAT_FUNC "%10.0" "1" COEFFS 0.000000 1.000000 -0.000000 0.000000 0.000000 1.000000 /end COMPU_METHOD
/* Scalar measurable for DDE 'V2gRxMsgSesSetupEvseId[4]'. */
/begin MEASUREMENT V2gRxMsgSesSetupEvseId[4] "The ID that uniquely identifies the EVSE. Format is defined in DIN SPEC 91286" UBYTE CU_V2GRXMSGSESSETUPEVSEID[4] 1 100 0.0 255.0 ECU_ADDRESS 0x70017f25 BYTE_ORDER MSB_LAST /end MEASUREMENT
/begin COMPU_METHOD CU_V2GRXMSGSESSETUPEVSEID[4] "Conversion method for V2gRxMsgSesSetupEvseId[4]" RAT_FUNC "%10.0" "1" COEFFS 0.000000 1.000000 -0.000000 0.000000 0.000000 1.000000 /end COMPU_METHOD
/* Scalar measurable for DDE 'V2gRxMsgSesSetupEvseId[5]'. */
/begin MEASUREMENT V2gRxMsgSesSetupEvseId[5] "The ID that uniquely identifies the EVSE. Format is defined in DIN SPEC 91286" UBYTE CU_V2GRXMSGSESSETUPEVSEID[5] 1 100 0.0 255.0 ECU_ADDRESS 0x70017f26 BYTE_ORDER MSB_LAST /end MEASUREMENT
/begin COMPU_METHOD CU_V2GRXMSGSESSETUPEVSEID[5] "Conversion method for V2gRxMsgSesSetupEvseId[5]" RAT_FUNC "%10.0" "1" COEFFS 0.000000 1.000000 -0.000000 0.000000 0.000000 1.000000 /end COMPU_METHOD
/* Scalar measurable for DDE 'V2gRxMsgSesSetupEvseId[6]'. */
/begin MEASUREMENT V2gRxMsgSesSetupEvseId[6] "The ID that uniquely identifies the EVSE. Format is defined in DIN SPEC 91286" UBYTE CU_V2GRXMSGSESSETUPEVSEID[6] 1 100 0.0 255.0 ECU_ADDRESS 0x70017f27 BYTE_ORDER MSB_LAST /end MEASUREMENT
/begin COMPU_METHOD CU_V2GRXMSGSESSETUPEVSEID[6] "Conversion method for V2gRxMsgSesSetupEvseId[6]" RAT_FUNC "%10.0" "1" COEFFS 0.000000 1.000000 -0.000000 0.000000 0.000000 1.000000 /end COMPU_METHOD
/* Scalar measurable for DDE 'V2gRxMsgSesSetupEvseId[7]'. */
/begin MEASUREMENT V2gRxMsgSesSetupEvseId[7] "The ID that uniquely identifies the EVSE. Format is defined in DIN SPEC 91286" UBYTE CU_V2GRXMSGSESSETUPEVSEID[7] 1 100 0.0 255.0 ECU_ADDRESS 0x70017f28 BYTE_ORDER MSB_LAST /end MEASUREMENT
/begin COMPU_METHOD CU_V2GRXMSGSESSETUPEVSEID[7] "Conversion method for V2gRxMsgSesSetupEvseId[7]" RAT_FUNC "%10.0" "1" COEFFS 0.000000 1.000000 -0.000000 0.000000 0.000000 1.000000 /end COMPU_METHOD
/* Scalar measurable for DDE 'V2gRxMsgSesSetupEvseId[8]'. */
/begin MEASUREMENT V2gRxMsgSesSetupEvseId[8] "The ID that uniquely identifies the EVSE. Format is defined in DIN SPEC 91286" UBYTE CU_V2GRXMSGSESSETUPEVSEID[8] 1 100 0.0 255.0 ECU_ADDRESS 0x70017f29 BYTE_ORDER MSB_LAST /end MEASUREMENT
/begin COMPU_METHOD CU_V2GRXMSGSESSETUPEVSEID[8] "Conversion method for V2gRxMsgSesSetupEvseId[8]" RAT_FUNC "%10.0" "1" COEFFS 0.000000 1.000000 -0.000000 0.000000 0.000000 1.000000 /end COMPU_METHOD
/* Scalar measurable for DDE 'V2gRxMsgSesSetupEvseId[9]'. */
/begin MEASUREMENT V2gRxMsgSesSetupEvseId[9] "The ID that uniquely identifies the EVSE. Format is defined in DIN SPEC 91286" UBYTE CU_V2GRXMSGSESSETUPEVSEID[9] 1 100 0.0 255.0 ECU_ADDRESS 0x70017f2a BYTE_ORDER MSB_LAST /end MEASUREMENT
/begin COMPU_METHOD CU_V2GRXMSGSESSETUPEVSEID[9] "Conversion method for V2gRxMsgSesSetupEvseId[9]" RAT_FUNC "%10.0" "1" COEFFS 0.000000 1.000000 -0.000000 0.000000 0.000000 1.000000 /end COMPU_METHOD
/* Scalar measurable for DDE 'V2gRxMsgSesSetupNotif'. */
/begin MEASUREMENT V2gRxMsgSesSetupNotif "The arbitrated Notification Max Delay parameter in the received message from EVSE" SLONG CU_V2GRXMSGSESSETUPNOTIF 1 100 -2147483648.0 2147483647.0 ECU_ADDRESS 0x70018198 BYTE_ORDER MSB_LAST /end MEASUREMENT
/begin COMPU_METHOD CU_V2GRXMSGSESSETUPNOTIF "Conversion method for V2gRxMsgSesSetupNotif" TAB_VERB "%12.0" "1" COMPU_TAB_REF CT_V2GRXMSGSESSETUPNOTIF /end COMPU_METHOD
/begin COMPU_VTAB CT_V2GRXMSGSESSETUPNOTIF "Conversion method for V2gRxMsgSesSetupNotif" TAB_VERB 3 0 "NONE" 1 "STOPCHARGING" 2 "RENEGOTIATION" /end COMPU_VTAB
/* Scalar measurable for DDE 'V2gRxMsgSesSetupNotifFlg'. */
/begin MEASUREMENT V2gRxMsgSesSetupNotifFlg "The arbitrated Notification parameter in the received message from EVSE" UBYTE CU_V2GRXMSGSESSETUPNOTIFFLG 1 100 0.0 1.0 ECU_ADDRESS 0x7001846c BYTE_ORDER MSB_LAST /end MEASUREMENT
/begin COMPU_METHOD CU_V2GRXMSGSESSETUPNOTIFFLG "Conversion method for V2gRxMsgSesSetupNotifFlg" RAT_FUNC "%10.0" "b" COEFFS 0.000000 1.000000 -0.000000 0.000000 0.000000 1.000000 /end COMPU_METHOD
/* Scalar measurable for DDE 'V2gRxMsgSesSetupNotifMaxDelay'. */
/begin MEASUREMENT V2gRxMsgSesSetupNotifMaxDelay "The arbitrated Notification Max Delay parameter in the received message from EVSE" UWORD CU_V2GRXMSGSESSETUPNOTIFMAXDEL0 1 100 0.0 65535.0 ECU_ADDRESS 0x70018298 BYTE_ORDER MSB_LAST /end MEASUREMENT
/begin COMPU_METHOD CU_V2GRXMSGSESSETUPNOTIFMAXDEL0 "Conversion method for V2gRxMsgSesSetupNotifMaxDelay" RAT_FUNC "%10.0" "s" COEFFS 0.000000 1.000000 -0.000000 0.000000 0.000000 1.000000 /end COMPU_METHOD
/* Scalar measurable for DDE 'V2gRxMsgSesSetupRescode'. */
/begin MEASUREMENT V2gRxMsgSesSetupRescode "for message 1b: indicates the acknowledgment status of  this V2G messages received by the SECC." UBYTE CU_V2GRXMSGSESSETUPRESCODE 1 100 0.0 255.0 ECU_ADDRESS 0x70017c88 BYTE_ORDER MSB_LAST /end MEASUREMENT
/begin COMPU_METHOD CU_V2GRXMSGSESSETUPRESCODE "Conversion method for V2gRxMsgSesSetupRescode" RAT_FUNC "%10.0" "1" COEFFS 0.000000 1.000000 -0.000000 0.000000 0.000000 1.000000 /end COMPU_METHOD
/* Scalar measurable for DDE 'V2gRxMsgSesSetupTimestamp'. */
/begin MEASUREMENT V2gRxMsgSesSetupTimestamp "Timestamp of the current SECC time using the Unix Time Stamp format." SLONG CU_V2GRXMSGSESSETUPTIMESTAMP 1 100 -2147480000.0 2147480000.0 ECU_ADDRESS 0x7001838c BYTE_ORDER MSB_LAST /end MEASUREMENT
/begin COMPU_METHOD CU_V2GRXMSGSESSETUPTIMESTAMP "Conversion method for V2gRxMsgSesSetupTimestamp" RAT_FUNC "%10.0" "s" COEFFS 0.000000 1.000000 -0.000000 0.000000 0.000000 1.000000 /end COMPU_METHOD
/* Scalar measurable for DDE 'V2gRxMsgSesSetupTimestamp_flg'. */
/begin MEASUREMENT V2gRxMsgSesSetupTimestamp_flg "Identifies the presence of the DateTimeNow parameter in the received message from EVSE" UBYTE CU_V2GRXMSGSESSETUPTIMESTAMP_F0 1 100 0.0 1.0 ECU_ADDRESS 0x70017f54 BYTE_ORDER MSB_LAST /end MEASUREMENT
/begin COMPU_METHOD CU_V2GRXMSGSESSETUPTIMESTAMP_F0 "Conversion method for V2gRxMsgSesSetupTimestamp_flg" RAT_FUNC "%10.0" "b" COEFFS 0.000000 1.000000 -0.000000 0.000000 0.000000 1.000000 /end COMPU_METHOD
/* Scalar measurable for DDE 'V2gRxMsgSesSetupTrg'. */
/begin MEASUREMENT V2gRxMsgSesSetupTrg "Trigger falg that on a rising edge indicates the event for receiving the PLC (V2G) message response 1b from EVSE" UBYTE CU_V2GRXMSGSESSETUPTRG 1 100 0.0 1.0 ECU_ADDRESS 0x700181c8 BYTE_ORDER MSB_LAST /end MEASUREMENT
/begin COMPU_METHOD CU_V2GRXMSGSESSETUPTRG "Conversion method for V2gRxMsgSesSetupTrg" RAT_FUNC "%10.0" "b" COEFFS 0.000000 1.000000 -0.000000 0.000000 0.000000 1.000000 /end COMPU_METHOD
/* Scalar measurable for DDE 'V2gRxMsgSesStopNotif'. */
/begin MEASUREMENT V2gRxMsgSesStopNotif "The arbitrated Notification Max Delay parameter in the received message from EVSE" SLONG CU_V2GRXMSGSESSTOPNOTIF 1 100 -2147483648.0 2147483647.0 ECU_ADDRESS 0x70017c80 BYTE_ORDER MSB_LAST /end MEASUREMENT
/begin COMPU_METHOD CU_V2GRXMSGSESSTOPNOTIF "Conversion method for V2gRxMsgSesStopNotif" TAB_VERB "%12.0" "1" COMPU_TAB_REF CT_V2GRXMSGSESSTOPNOTIF /end COMPU_METHOD
/begin COMPU_VTAB CT_V2GRXMSGSESSTOPNOTIF "Conversion method for V2gRxMsgSesStopNotif" TAB_VERB 3 0 "NONE" 1 "STOPCHARGING" 2 "RENEGOTIATION" /end COMPU_VTAB
/* Scalar measurable for DDE 'V2gRxMsgSesStopNotifFlg'. */
/begin MEASUREMENT V2gRxMsgSesStopNotifFlg "The arbitrated Notification parameter in the received message from EVSE" UBYTE CU_V2GRXMSGSESSTOPNOTIFFLG 1 100 0.0 1.0 ECU_ADDRESS 0x70018383 BYTE_ORDER MSB_LAST /end MEASUREMENT
/begin COMPU_METHOD CU_V2GRXMSGSESSTOPNOTIFFLG "Conversion method for V2gRxMsgSesStopNotifFlg" RAT_FUNC "%10.0" "b" COEFFS 0.000000 1.000000 -0.000000 0.000000 0.000000 1.000000 /end COMPU_METHOD
/* Scalar measurable for DDE 'V2gRxMsgSesStopNotifMaxDelay'. */
/begin MEASUREMENT V2gRxMsgSesStopNotifMaxDelay "The arbitrated Notification Max Delay parameter in the received message from EVSE" UWORD CU_V2GRXMSGSESSTOPNOTIFMAXDELAY 1 100 0.0 65535.0 ECU_ADDRESS 0x70018350 BYTE_ORDER MSB_LAST /end MEASUREMENT
/begin COMPU_METHOD CU_V2GRXMSGSESSTOPNOTIFMAXDELAY "Conversion method for V2gRxMsgSesStopNotifMaxDelay" RAT_FUNC "%10.0" "s" COEFFS 0.000000 1.000000 -0.000000 0.000000 0.000000 1.000000 /end COMPU_METHOD
/* Scalar measurable for DDE 'V2gRxMsgSesStopRescode'. */
/begin MEASUREMENT V2gRxMsgSesStopRescode "for message 10b: indicates the acknowledgment status of  this V2G messages received by the SECC." UBYTE CU_V2GRXMSGSESSTOPRESCODE 1 100 0.0 255.0 ECU_ADDRESS 0x700181ac BYTE_ORDER MSB_LAST /end MEASUREMENT
/begin COMPU_METHOD CU_V2GRXMSGSESSTOPRESCODE "Conversion method for V2gRxMsgSesStopRescode" RAT_FUNC "%10.0" "1" COEFFS 0.000000 1.000000 -0.000000 0.000000 0.000000 1.000000 /end COMPU_METHOD
/* Scalar measurable for DDE 'V2gRxMsgSesStopTrg'. */
/begin MEASUREMENT V2gRxMsgSesStopTrg "Trigger falg that on a rising edge indicates the event for receiving the PLC (V2G) message response 10b from EVSE" UBYTE CU_V2GRXMSGSESSTOPTRG 1 100 0.0 1.0 ECU_ADDRESS 0x7001845c BYTE_ORDER MSB_LAST /end MEASUREMENT
/begin COMPU_METHOD CU_V2GRXMSGSESSTOPTRG "Conversion method for V2gRxMsgSesStopTrg" RAT_FUNC "%10.0" "b" COEFFS 0.000000 1.000000 -0.000000 0.000000 0.000000 1.000000 /end COMPU_METHOD
/* Scalar measurable for DDE 'V2gRxMsgSupPrtclRescode'. */
/begin MEASUREMENT V2gRxMsgSupPrtclRescode "for message SupportedAppProtocolRes: indicates the acknowledgment status of  this V2G messages received by the SECC." UBYTE CU_V2GRXMSGSUPPRTCLRESCODE 1 100 0.0 255.0 ECU_ADDRESS 0x70018365 BYTE_ORDER MSB_LAST /end MEASUREMENT
/begin COMPU_METHOD CU_V2GRXMSGSUPPRTCLRESCODE "Conversion method for V2gRxMsgSupPrtclRescode" RAT_FUNC "%10.0" "1" COEFFS 0.000000 1.000000 -0.000000 0.000000 0.000000 1.000000 /end COMPU_METHOD
/* Scalar measurable for DDE 'V2gRxMsgSupPrtclRxTrg'. */
/begin MEASUREMENT V2gRxMsgSupPrtclRxTrg "Trigger falg that on a rising edge indicates the event for receiving the PLC (V2G) message response SupportedAppProtocolRes from EVSE" UBYTE CU_V2GRXMSGSUPPRTCLRXTRG 1 100 0.0 1.0 ECU_ADDRESS 0x70018249 BYTE_ORDER MSB_LAST /end MEASUREMENT
/begin COMPU_METHOD CU_V2GRXMSGSUPPRTCLRXTRG "Conversion method for V2gRxMsgSupPrtclRxTrg" RAT_FUNC "%10.0" "b" COEFFS 0.000000 1.000000 -0.000000 0.000000 0.000000 1.000000 /end COMPU_METHOD
/* Scalar measurable for DDE 'V2gRxMsgSvcDetailNotif'. */
/begin MEASUREMENT V2gRxMsgSvcDetailNotif "The arbitrated Notification parameter in the received message from EVSE" SLONG CU_V2GRXMSGSVCDETAILNOTIF 1 100 -2147483648.0 2147483647.0 ECU_ADDRESS 0x70017c3c BYTE_ORDER MSB_LAST /end MEASUREMENT
/begin COMPU_METHOD CU_V2GRXMSGSVCDETAILNOTIF "Conversion method for V2gRxMsgSvcDetailNotif" TAB_VERB "%12.0" "1" COMPU_TAB_REF CT_V2GRXMSGSVCDETAILNOTIF /end COMPU_METHOD
/begin COMPU_VTAB CT_V2GRXMSGSVCDETAILNOTIF "Conversion method for V2gRxMsgSvcDetailNotif" TAB_VERB 3 0 "NONE" 1 "STOPCHARGING" 2 "RENEGOTIATION" /end COMPU_VTAB
/* Scalar measurable for DDE 'V2gRxMsgSvcDetailNotifFlg'. */
/begin MEASUREMENT V2gRxMsgSvcDetailNotifFlg "The arbitrated Notification parameter in the received message from EVSE" UBYTE CU_V2GRXMSGSVCDETAILNOTIFFLG 1 100 0.0 1.0 ECU_ADDRESS 0x70018348 BYTE_ORDER MSB_LAST /end MEASUREMENT
/begin COMPU_METHOD CU_V2GRXMSGSVCDETAILNOTIFFLG "Conversion method for V2gRxMsgSvcDetailNotifFlg" RAT_FUNC "%10.0" "b" COEFFS 0.000000 1.000000 -0.000000 0.000000 0.000000 1.000000 /end COMPU_METHOD
/* Scalar measurable for DDE 'V2gRxMsgSvcDetailNotifMaxDelay'. */
/begin MEASUREMENT V2gRxMsgSvcDetailNotifMaxDelay "The arbitrated Notification Max Delay parameter in the received message from EVSE" UWORD CU_V2GRXMSGSVCDETAILNOTIFMAXDE0 1 100 0.0 65535.0 ECU_ADDRESS 0x70017d70 BYTE_ORDER MSB_LAST /end MEASUREMENT
/begin COMPU_METHOD CU_V2GRXMSGSVCDETAILNOTIFMAXDE0 "Conversion method for V2gRxMsgSvcDetailNotifMaxDelay" RAT_FUNC "%10.0" "s" COEFFS 0.000000 1.000000 -0.000000 0.000000 0.000000 1.000000 /end COMPU_METHOD
/* Scalar measurable for DDE 'V2gRxMsgSvcDetailParamSetLen'. */
/begin MEASUREMENT V2gRxMsgSvcDetailParamSetLen "The arbitrated Parameter Set Length signal in the received message from EVSE" UBYTE CU_V2GRXMSGSVCDETAILPARAMSETLEN 1 100 0.0 5.0 ECU_ADDRESS 0x70018458 BYTE_ORDER MSB_LAST /end MEASUREMENT
/begin COMPU_METHOD CU_V2GRXMSGSVCDETAILPARAMSETLEN "Conversion method for V2gRxMsgSvcDetailParamSetLen" RAT_FUNC "%10.0" "1" COEFFS 0.000000 1.000000 -0.000000 0.000000 0.000000 1.000000 /end COMPU_METHOD
/* Scalar measurable for DDE 'V2gRxMsgSvcDetailParamSetSizes[0]'. */
/begin MEASUREMENT V2gRxMsgSvcDetailParamSetSizes4 "The arbitrated Parameter Set Sizes signal in the received message from EVSE" UBYTE CU_V2GRXMSGSVCDETAILPARAMSETSI4 1 100 0.0 5.0 ECU_ADDRESS 0x70017e5b BYTE_ORDER MSB_LAST /end MEASUREMENT
/begin COMPU_METHOD CU_V2GRXMSGSVCDETAILPARAMSETSI4 "Conversion method for V2gRxMsgSvcDetailParamSetSizes[0]" RAT_FUNC "%10.0" "1" COEFFS 0.000000 1.000000 -0.000000 0.000000 0.000000 1.000000 /end COMPU_METHOD
/* Scalar measurable for DDE 'V2gRxMsgSvcDetailParamSetSizes[1]'. */
/begin MEASUREMENT V2gRxMsgSvcDetailParamSetSizes3 "The arbitrated Parameter Set Sizes signal in the received message from EVSE" UBYTE CU_V2GRXMSGSVCDETAILPARAMSETSI3 1 100 0.0 5.0 ECU_ADDRESS 0x70017e5c BYTE_ORDER MSB_LAST /end MEASUREMENT
/begin COMPU_METHOD CU_V2GRXMSGSVCDETAILPARAMSETSI3 "Conversion method for V2gRxMsgSvcDetailParamSetSizes[1]" RAT_FUNC "%10.0" "1" COEFFS 0.000000 1.000000 -0.000000 0.000000 0.000000 1.000000 /end COMPU_METHOD
/* Scalar measurable for DDE 'V2gRxMsgSvcDetailParamSetSizes[2]'. */
/begin MEASUREMENT V2gRxMsgSvcDetailParamSetSizes2 "The arbitrated Parameter Set Sizes signal in the received message from EVSE" UBYTE CU_V2GRXMSGSVCDETAILPARAMSETSI2 1 100 0.0 5.0 ECU_ADDRESS 0x70017e5d BYTE_ORDER MSB_LAST /end MEASUREMENT
/begin COMPU_METHOD CU_V2GRXMSGSVCDETAILPARAMSETSI2 "Conversion method for V2gRxMsgSvcDetailParamSetSizes[2]" RAT_FUNC "%10.0" "1" COEFFS 0.000000 1.000000 -0.000000 0.000000 0.000000 1.000000 /end COMPU_METHOD
/* Scalar measurable for DDE 'V2gRxMsgSvcDetailParamSetSizes[3]'. */
/begin MEASUREMENT V2gRxMsgSvcDetailParamSetSizes0 "The arbitrated Parameter Set Sizes signal in the received message from EVSE" UBYTE CU_V2GRXMSGSVCDETAILPARAMSETSI0 1 100 0.0 5.0 ECU_ADDRESS 0x70017e5e BYTE_ORDER MSB_LAST /end MEASUREMENT
/begin COMPU_METHOD CU_V2GRXMSGSVCDETAILPARAMSETSI0 "Conversion method for V2gRxMsgSvcDetailParamSetSizes[3]" RAT_FUNC "%10.0" "1" COEFFS 0.000000 1.000000 -0.000000 0.000000 0.000000 1.000000 /end COMPU_METHOD
/* Scalar measurable for DDE 'V2gRxMsgSvcDetailParamSetSizes[4]'. */
/begin MEASUREMENT V2gRxMsgSvcDetailParamSetSizes1 "The arbitrated Parameter Set Sizes signal in the received message from EVSE" UBYTE CU_V2GRXMSGSVCDETAILPARAMSETSI1 1 100 0.0 5.0 ECU_ADDRESS 0x70017e5f BYTE_ORDER MSB_LAST /end MEASUREMENT
/begin COMPU_METHOD CU_V2GRXMSGSVCDETAILPARAMSETSI1 "Conversion method for V2gRxMsgSvcDetailParamSetSizes[4]" RAT_FUNC "%10.0" "1" COEFFS 0.000000 1.000000 -0.000000 0.000000 0.000000 1.000000 /end COMPU_METHOD
/* Scalar measurable for DDE 'V2gRxMsgSvcDetailRescode'. */
/begin MEASUREMENT V2gRxMsgSvcDetailRescode "for message 10b: indicates the acknowledgment status of  this V2G messages received by the SECC." UBYTE CU_V2GRXMSGSVCDETAILRESCODE 1 100 0.0 255.0 ECU_ADDRESS 0x70017c69 BYTE_ORDER MSB_LAST /end MEASUREMENT
/begin COMPU_METHOD CU_V2GRXMSGSVCDETAILRESCODE "Conversion method for V2gRxMsgSvcDetailRescode" RAT_FUNC "%10.0" "1" COEFFS 0.000000 1.000000 -0.000000 0.000000 0.000000 1.000000 /end COMPU_METHOD
/* Scalar measurable for DDE 'V2gRxMsgSvcDetailSvcId'. */
/begin MEASUREMENT V2gRxMsgSvcDetailSvcId "The arbitrated Service ID signal in the received message from EVSE" UWORD CU_V2GRXMSGSVCDETAILSVCID 1 100 0.0 65535.0 ECU_ADDRESS 0x70018466 BYTE_ORDER MSB_LAST /end MEASUREMENT
/begin COMPU_METHOD CU_V2GRXMSGSVCDETAILSVCID "Conversion method for V2gRxMsgSvcDetailSvcId" RAT_FUNC "%10.0" "1" COEFFS 0.000000 1.000000 -0.000000 0.000000 0.000000 1.000000 /end COMPU_METHOD
/* Scalar measurable for DDE 'V2gRxMsgSvcDetailTrg'. */
/begin MEASUREMENT V2gRxMsgSvcDetailTrg "Trigger falg that on a rising edge indicates the event for receiving the PLC (V2G) message response 10b from EVSE" UBYTE CU_V2GRXMSGSVCDETAILTRG 1 100 0.0 1.0 ECU_ADDRESS 0x70017e37 BYTE_ORDER MSB_LAST /end MEASUREMENT
/begin COMPU_METHOD CU_V2GRXMSGSVCDETAILTRG "Conversion method for V2gRxMsgSvcDetailTrg" RAT_FUNC "%10.0" "b" COEFFS 0.000000 1.000000 -0.000000 0.000000 0.000000 1.000000 /end COMPU_METHOD
/* Scalar measurable for DDE 'V2gRxMsgSvcDiscEgyTransferModeSize'. */
/begin MEASUREMENT V2gRxMsgSvcDiscEgyTransferMode1 "The arbitrated Transfer Mode Size parameter in the received message from EVSE" UBYTE CU_V2GRXMSGSVCDISCEGYTRANSFERM1 1 100 0.0 255.0 ECU_ADDRESS 0x70017f17 BYTE_ORDER MSB_LAST /end MEASUREMENT
/begin COMPU_METHOD CU_V2GRXMSGSVCDISCEGYTRANSFERM1 "Conversion method for V2gRxMsgSvcDiscEgyTransferModeSize" RAT_FUNC "%10.0" "1" COEFFS 0.000000 1.000000 -0.000000 0.000000 0.000000 1.000000 /end COMPU_METHOD
/* Scalar measurable for DDE 'V2gRxMsgSvcDiscEgyTransferMode[0]'. */
/begin MEASUREMENT V2gRxMsgSvcDiscEgyTransferMode4 "The arbitrated Transfer Mode parameter in the received message from EVSE" SLONG CU_V2GRXMSGSVCDISCEGYTRANSFERM4 1 100 -2147483648.0 2147483647.0 ECU_ADDRESS 0x70017d54 BYTE_ORDER MSB_LAST /end MEASUREMENT
/begin COMPU_METHOD CU_V2GRXMSGSVCDISCEGYTRANSFERM4 "Conversion method for V2gRxMsgSvcDiscEgyTransferMode[0]" TAB_VERB "%12.0" "enum" COMPU_TAB_REF CT_V2GRXMSGSVCDISCEGYTRANSFERM4 /end COMPU_METHOD
/begin COMPU_VTAB CT_V2GRXMSGSVCDISCEGYTRANSFERM4 "Conversion method for V2gRxMsgSvcDiscEgyTransferMode[0]" TAB_VERB 8 0 "AC_SINGLE_PHASE" 1 "AC_THREE_PHASE" 2 "DC_CORE" 3 "DC_EXTENDED" 4 "DC_COMBO" 5 "DC_UNIQUE" 6 "DUAL_2" 7 "DUAL_4" /end COMPU_VTAB
/* Scalar measurable for DDE 'V2gRxMsgSvcDiscEgyTransferMode[1]'. */
/begin MEASUREMENT V2gRxMsgSvcDiscEgyTransferMode3 "The arbitrated Transfer Mode parameter in the received message from EVSE" SLONG CU_V2GRXMSGSVCDISCEGYTRANSFERM3 1 100 -2147483648.0 2147483647.0 ECU_ADDRESS 0x70017d58 BYTE_ORDER MSB_LAST /end MEASUREMENT
/begin COMPU_METHOD CU_V2GRXMSGSVCDISCEGYTRANSFERM3 "Conversion method for V2gRxMsgSvcDiscEgyTransferMode[1]" TAB_VERB "%12.0" "enum" COMPU_TAB_REF CT_V2GRXMSGSVCDISCEGYTRANSFERM3 /end COMPU_METHOD
/begin COMPU_VTAB CT_V2GRXMSGSVCDISCEGYTRANSFERM3 "Conversion method for V2gRxMsgSvcDiscEgyTransferMode[1]" TAB_VERB 8 0 "AC_SINGLE_PHASE" 1 "AC_THREE_PHASE" 2 "DC_CORE" 3 "DC_EXTENDED" 4 "DC_COMBO" 5 "DC_UNIQUE" 6 "DUAL_2" 7 "DUAL_4" /end COMPU_VTAB
/* Scalar measurable for DDE 'V2gRxMsgSvcDiscEgyTransferMode[2]'. */
/begin MEASUREMENT V2gRxMsgSvcDiscEgyTransferMode2 "The arbitrated Transfer Mode parameter in the received message from EVSE" SLONG CU_V2GRXMSGSVCDISCEGYTRANSFERM2 1 100 -2147483648.0 2147483647.0 ECU_ADDRESS 0x70017d5c BYTE_ORDER MSB_LAST /end MEASUREMENT
/begin COMPU_METHOD CU_V2GRXMSGSVCDISCEGYTRANSFERM2 "Conversion method for V2gRxMsgSvcDiscEgyTransferMode[2]" TAB_VERB "%12.0" "enum" COMPU_TAB_REF CT_V2GRXMSGSVCDISCEGYTRANSFERM2 /end COMPU_METHOD
/begin COMPU_VTAB CT_V2GRXMSGSVCDISCEGYTRANSFERM2 "Conversion method for V2gRxMsgSvcDiscEgyTransferMode[2]" TAB_VERB 8 0 "AC_SINGLE_PHASE" 1 "AC_THREE_PHASE" 2 "DC_CORE" 3 "DC_EXTENDED" 4 "DC_COMBO" 5 "DC_UNIQUE" 6 "DUAL_2" 7 "DUAL_4" /end COMPU_VTAB
/* Scalar measurable for DDE 'V2gRxMsgSvcDiscEgyTransferMode[3]'. */
/begin MEASUREMENT V2gRxMsgSvcDiscEgyTransferMode0 "The arbitrated Transfer Mode parameter in the received message from EVSE" SLONG CU_V2GRXMSGSVCDISCEGYTRANSFERM0 1 100 -2147483648.0 2147483647.0 ECU_ADDRESS 0x70017d60 BYTE_ORDER MSB_LAST /end MEASUREMENT
/begin COMPU_METHOD CU_V2GRXMSGSVCDISCEGYTRANSFERM0 "Conversion method for V2gRxMsgSvcDiscEgyTransferMode[3]" TAB_VERB "%12.0" "enum" COMPU_TAB_REF CT_V2GRXMSGSVCDISCEGYTRANSFERM0 /end COMPU_METHOD
/begin COMPU_VTAB CT_V2GRXMSGSVCDISCEGYTRANSFERM0 "Conversion method for V2gRxMsgSvcDiscEgyTransferMode[3]" TAB_VERB 8 0 "AC_SINGLE_PHASE" 1 "AC_THREE_PHASE" 2 "DC_CORE" 3 "DC_EXTENDED" 4 "DC_COMBO" 5 "DC_UNIQUE" 6 "DUAL_2" 7 "DUAL_4" /end COMPU_VTAB
/* Scalar measurable for DDE 'V2gRxMsgSvcDiscEgyTransferMode[4]'. */
/begin MEASUREMENT V2gRxMsgSvcDiscEgyTransferMode6 "The arbitrated Transfer Mode parameter in the received message from EVSE" SLONG CU_V2GRXMSGSVCDISCEGYTRANSFERM6 1 100 -2147483648.0 2147483647.0 ECU_ADDRESS 0x70017d64 BYTE_ORDER MSB_LAST /end MEASUREMENT
/begin COMPU_METHOD CU_V2GRXMSGSVCDISCEGYTRANSFERM6 "Conversion method for V2gRxMsgSvcDiscEgyTransferMode[4]" TAB_VERB "%12.0" "enum" COMPU_TAB_REF CT_V2GRXMSGSVCDISCEGYTRANSFERM6 /end COMPU_METHOD
/begin COMPU_VTAB CT_V2GRXMSGSVCDISCEGYTRANSFERM6 "Conversion method for V2gRxMsgSvcDiscEgyTransferMode[4]" TAB_VERB 8 0 "AC_SINGLE_PHASE" 1 "AC_THREE_PHASE" 2 "DC_CORE" 3 "DC_EXTENDED" 4 "DC_COMBO" 5 "DC_UNIQUE" 6 "DUAL_2" 7 "DUAL_4" /end COMPU_VTAB
/* Scalar measurable for DDE 'V2gRxMsgSvcDiscEgyTransferMode[5]'. */
/begin MEASUREMENT V2gRxMsgSvcDiscEgyTransferMode5 "The arbitrated Transfer Mode parameter in the received message from EVSE" SLONG CU_V2GRXMSGSVCDISCEGYTRANSFERM5 1 100 -2147483648.0 2147483647.0 ECU_ADDRESS 0x70017d68 BYTE_ORDER MSB_LAST /end MEASUREMENT
/begin COMPU_METHOD CU_V2GRXMSGSVCDISCEGYTRANSFERM5 "Conversion method for V2gRxMsgSvcDiscEgyTransferMode[5]" TAB_VERB "%12.0" "enum" COMPU_TAB_REF CT_V2GRXMSGSVCDISCEGYTRANSFERM5 /end COMPU_METHOD
/begin COMPU_VTAB CT_V2GRXMSGSVCDISCEGYTRANSFERM5 "Conversion method for V2gRxMsgSvcDiscEgyTransferMode[5]" TAB_VERB 8 0 "AC_SINGLE_PHASE" 1 "AC_THREE_PHASE" 2 "DC_CORE" 3 "DC_EXTENDED" 4 "DC_COMBO" 5 "DC_UNIQUE" 6 "DUAL_2" 7 "DUAL_4" /end COMPU_VTAB
/* Scalar measurable for DDE 'V2gRxMsgSvcDiscEgyTransferSvcIdsLen'. */
/begin MEASUREMENT V2gRxMsgSvcDiscEgyTransferSvcI1 "The arbitrated Transfer Service IDs Length parameter in the received message from EVSE" UBYTE CU_V2GRXMSGSVCDISCEGYTRANSFERS1 1 100 0.0 255.0 ECU_ADDRESS 0x70018054 BYTE_ORDER MSB_LAST /end MEASUREMENT
/begin COMPU_METHOD CU_V2GRXMSGSVCDISCEGYTRANSFERS1 "Conversion method for V2gRxMsgSvcDiscEgyTransferSvcIdsLen" RAT_FUNC "%10.0" "1" COEFFS 0.000000 1.000000 -0.000000 0.000000 0.000000 1.000000 /end COMPU_METHOD
/* Scalar measurable for DDE 'V2gRxMsgSvcDiscEgyTransferSvcIds[0]'. */
/begin MEASUREMENT V2gRxMsgSvcDiscEgyTransferSvcI8 "The arbitrated Transfer Service IDs parameter in the received message from EVSE" UWORD CU_V2GRXMSGSVCDISCEGYTRANSFERS8 1 100 0.0 65535.0 ECU_ADDRESS 0x70017e4a BYTE_ORDER MSB_LAST /end MEASUREMENT
/begin COMPU_METHOD CU_V2GRXMSGSVCDISCEGYTRANSFERS8 "Conversion method for V2gRxMsgSvcDiscEgyTransferSvcIds[0]" RAT_FUNC "%10.0" "1" COEFFS 0.000000 1.000000 -0.000000 0.000000 0.000000 1.000000 /end COMPU_METHOD
/* Scalar measurable for DDE 'V2gRxMsgSvcDiscEgyTransferSvcIds[1]'. */
/begin MEASUREMENT V2gRxMsgSvcDiscEgyTransferSvcI4 "The arbitrated Transfer Service IDs parameter in the received message from EVSE" UWORD CU_V2GRXMSGSVCDISCEGYTRANSFERS4 1 100 0.0 65535.0 ECU_ADDRESS 0x70017e4c BYTE_ORDER MSB_LAST /end MEASUREMENT
/begin COMPU_METHOD CU_V2GRXMSGSVCDISCEGYTRANSFERS4 "Conversion method for V2gRxMsgSvcDiscEgyTransferSvcIds[1]" RAT_FUNC "%10.0" "1" COEFFS 0.000000 1.000000 -0.000000 0.000000 0.000000 1.000000 /end COMPU_METHOD
/* Scalar measurable for DDE 'V2gRxMsgSvcDiscEgyTransferSvcIds[2]'. */
/begin MEASUREMENT V2gRxMsgSvcDiscEgyTransferSvcI0 "The arbitrated Transfer Service IDs parameter in the received message from EVSE" UWORD CU_V2GRXMSGSVCDISCEGYTRANSFERS0 1 100 0.0 65535.0 ECU_ADDRESS 0x70017e4e BYTE_ORDER MSB_LAST /end MEASUREMENT
/begin COMPU_METHOD CU_V2GRXMSGSVCDISCEGYTRANSFERS0 "Conversion method for V2gRxMsgSvcDiscEgyTransferSvcIds[2]" RAT_FUNC "%10.0" "1" COEFFS 0.000000 1.000000 -0.000000 0.000000 0.000000 1.000000 /end COMPU_METHOD
/* Scalar measurable for DDE 'V2gRxMsgSvcDiscEgyTransferSvcIds[3]'. */
/begin MEASUREMENT V2gRxMsgSvcDiscEgyTransferSvcI7 "The arbitrated Transfer Service IDs parameter in the received message from EVSE" UWORD CU_V2GRXMSGSVCDISCEGYTRANSFERS7 1 100 0.0 65535.0 ECU_ADDRESS 0x70017e50 BYTE_ORDER MSB_LAST /end MEASUREMENT
/begin COMPU_METHOD CU_V2GRXMSGSVCDISCEGYTRANSFERS7 "Conversion method for V2gRxMsgSvcDiscEgyTransferSvcIds[3]" RAT_FUNC "%10.0" "1" COEFFS 0.000000 1.000000 -0.000000 0.000000 0.000000 1.000000 /end COMPU_METHOD
/* Scalar measurable for DDE 'V2gRxMsgSvcDiscEgyTransferSvcIds[4]'. */
/begin MEASUREMENT V2gRxMsgSvcDiscEgyTransferSvcI5 "The arbitrated Transfer Service IDs parameter in the received message from EVSE" UWORD CU_V2GRXMSGSVCDISCEGYTRANSFERS5 1 100 0.0 65535.0 ECU_ADDRESS 0x70017e52 BYTE_ORDER MSB_LAST /end MEASUREMENT
/begin COMPU_METHOD CU_V2GRXMSGSVCDISCEGYTRANSFERS5 "Conversion method for V2gRxMsgSvcDiscEgyTransferSvcIds[4]" RAT_FUNC "%10.0" "1" COEFFS 0.000000 1.000000 -0.000000 0.000000 0.000000 1.000000 /end COMPU_METHOD
/* Scalar measurable for DDE 'V2gRxMsgSvcDiscEgyTransferSvcIds[5]'. */
/begin MEASUREMENT V2gRxMsgSvcDiscEgyTransferSvcI6 "The arbitrated Transfer Service IDs parameter in the received message from EVSE" UWORD CU_V2GRXMSGSVCDISCEGYTRANSFERS6 1 100 0.0 65535.0 ECU_ADDRESS 0x70017e54 BYTE_ORDER MSB_LAST /end MEASUREMENT
/begin COMPU_METHOD CU_V2GRXMSGSVCDISCEGYTRANSFERS6 "Conversion method for V2gRxMsgSvcDiscEgyTransferSvcIds[5]" RAT_FUNC "%10.0" "1" COEFFS 0.000000 1.000000 -0.000000 0.000000 0.000000 1.000000 /end COMPU_METHOD
/* Scalar measurable for DDE 'V2gRxMsgSvcDiscEgyTransferSvcIds[6]'. */
/begin MEASUREMENT V2gRxMsgSvcDiscEgyTransferSvcI2 "The arbitrated Transfer Service IDs parameter in the received message from EVSE" UWORD CU_V2GRXMSGSVCDISCEGYTRANSFERS2 1 100 0.0 65535.0 ECU_ADDRESS 0x70017e56 BYTE_ORDER MSB_LAST /end MEASUREMENT
/begin COMPU_METHOD CU_V2GRXMSGSVCDISCEGYTRANSFERS2 "Conversion method for V2gRxMsgSvcDiscEgyTransferSvcIds[6]" RAT_FUNC "%10.0" "1" COEFFS 0.000000 1.000000 -0.000000 0.000000 0.000000 1.000000 /end COMPU_METHOD
/* Scalar measurable for DDE 'V2gRxMsgSvcDiscEgyTransferSvcIds[7]'. */
/begin MEASUREMENT V2gRxMsgSvcDiscEgyTransferSvcI3 "The arbitrated Transfer Service IDs parameter in the received message from EVSE" UWORD CU_V2GRXMSGSVCDISCEGYTRANSFERS3 1 100 0.0 65535.0 ECU_ADDRESS 0x70017e58 BYTE_ORDER MSB_LAST /end MEASUREMENT
/begin COMPU_METHOD CU_V2GRXMSGSVCDISCEGYTRANSFERS3 "Conversion method for V2gRxMsgSvcDiscEgyTransferSvcIds[7]" RAT_FUNC "%10.0" "1" COEFFS 0.000000 1.000000 -0.000000 0.000000 0.000000 1.000000 /end COMPU_METHOD
/* Scalar measurable for DDE 'V2gRxMsgSvcDiscEgyTxfrType'. */
/begin MEASUREMENT V2gRxMsgSvcDiscEgyTxfrType "Identifies the energy transfer type for charging." SLONG CU_V2GRXMSGSVCDISCEGYTXFRTYPE 1 100 -2147483648.0 2147483647.0 ECU_ADDRESS 0x7001819c BYTE_ORDER MSB_LAST /end MEASUREMENT
/begin COMPU_METHOD CU_V2GRXMSGSVCDISCEGYTXFRTYPE "Conversion method for V2gRxMsgSvcDiscEgyTxfrType" TAB_VERB "%12.0" "enum" COMPU_TAB_REF CT_V2GRXMSGSVCDISCEGYTXFRTYPE /end COMPU_METHOD
/begin COMPU_VTAB CT_V2GRXMSGSVCDISCEGYTXFRTYPE "Conversion method for V2gRxMsgSvcDiscEgyTxfrType" TAB_VERB 8 0 "AC_SINGLE_PHASE" 1 "AC_THREE_PHASE" 2 "DC_CORE" 3 "DC_EXTENDED" 4 "DC_COMBO" 5 "DC_UNIQUE" 6 "DUAL_2" 7 "DUAL_4" /end COMPU_VTAB
/* Scalar measurable for DDE 'V2gRxMsgSvcDiscFreeService[0]'. */
/begin MEASUREMENT V2gRxMsgSvcDiscFreeService[0] "If true, indicates that the service can be used free of charge." UBYTE CU_V2GRXMSGSVCDISCFREESERVICE[5 1 100 0.0 1.0 ECU_ADDRESS 0x70017f5c BYTE_ORDER MSB_LAST /end MEASUREMENT
/begin COMPU_METHOD CU_V2GRXMSGSVCDISCFREESERVICE[5 "Conversion method for V2gRxMsgSvcDiscFreeService[0]" RAT_FUNC "%10.0" "b" COEFFS 0.000000 1.000000 -0.000000 0.000000 0.000000 1.000000 /end COMPU_METHOD
/* Scalar measurable for DDE 'V2gRxMsgSvcDiscFreeService[1]'. */
/begin MEASUREMENT V2gRxMsgSvcDiscFreeService[1] "If true, indicates that the service can be used free of charge." UBYTE CU_V2GRXMSGSVCDISCFREESERVICE[4 1 100 0.0 1.0 ECU_ADDRESS 0x70017f5d BYTE_ORDER MSB_LAST /end MEASUREMENT
/begin COMPU_METHOD CU_V2GRXMSGSVCDISCFREESERVICE[4 "Conversion method for V2gRxMsgSvcDiscFreeService[1]" RAT_FUNC "%10.0" "b" COEFFS 0.000000 1.000000 -0.000000 0.000000 0.000000 1.000000 /end COMPU_METHOD
/* Scalar measurable for DDE 'V2gRxMsgSvcDiscFreeService[2]'. */
/begin MEASUREMENT V2gRxMsgSvcDiscFreeService[2] "If true, indicates that the service can be used free of charge." UBYTE CU_V2GRXMSGSVCDISCFREESERVICE[7 1 100 0.0 1.0 ECU_ADDRESS 0x70017f5e BYTE_ORDER MSB_LAST /end MEASUREMENT
/begin COMPU_METHOD CU_V2GRXMSGSVCDISCFREESERVICE[7 "Conversion method for V2gRxMsgSvcDiscFreeService[2]" RAT_FUNC "%10.0" "b" COEFFS 0.000000 1.000000 -0.000000 0.000000 0.000000 1.000000 /end COMPU_METHOD
/* Scalar measurable for DDE 'V2gRxMsgSvcDiscFreeService[3]'. */
/begin MEASUREMENT V2gRxMsgSvcDiscFreeService[3] "If true, indicates that the service can be used free of charge." UBYTE CU_V2GRXMSGSVCDISCFREESERVICE[6 1 100 0.0 1.0 ECU_ADDRESS 0x70017f5f BYTE_ORDER MSB_LAST /end MEASUREMENT
/begin COMPU_METHOD CU_V2GRXMSGSVCDISCFREESERVICE[6 "Conversion method for V2gRxMsgSvcDiscFreeService[3]" RAT_FUNC "%10.0" "b" COEFFS 0.000000 1.000000 -0.000000 0.000000 0.000000 1.000000 /end COMPU_METHOD
/* Scalar measurable for DDE 'V2gRxMsgSvcDiscFreeService[4]'. */
/begin MEASUREMENT V2gRxMsgSvcDiscFreeService[4] "If true, indicates that the service can be used free of charge." UBYTE CU_V2GRXMSGSVCDISCFREESERVICE[1 1 100 0.0 1.0 ECU_ADDRESS 0x70017f60 BYTE_ORDER MSB_LAST /end MEASUREMENT
/begin COMPU_METHOD CU_V2GRXMSGSVCDISCFREESERVICE[1 "Conversion method for V2gRxMsgSvcDiscFreeService[4]" RAT_FUNC "%10.0" "b" COEFFS 0.000000 1.000000 -0.000000 0.000000 0.000000 1.000000 /end COMPU_METHOD
/* Scalar measurable for DDE 'V2gRxMsgSvcDiscFreeService[5]'. */
/begin MEASUREMENT V2gRxMsgSvcDiscFreeService[5] "If true, indicates that the service can be used free of charge." UBYTE CU_V2GRXMSGSVCDISCFREESERVICE[0 1 100 0.0 1.0 ECU_ADDRESS 0x70017f61 BYTE_ORDER MSB_LAST /end MEASUREMENT
/begin COMPU_METHOD CU_V2GRXMSGSVCDISCFREESERVICE[0 "Conversion method for V2gRxMsgSvcDiscFreeService[5]" RAT_FUNC "%10.0" "b" COEFFS 0.000000 1.000000 -0.000000 0.000000 0.000000 1.000000 /end COMPU_METHOD
/* Scalar measurable for DDE 'V2gRxMsgSvcDiscFreeService[6]'. */
/begin MEASUREMENT V2gRxMsgSvcDiscFreeService[6] "If true, indicates that the service can be used free of charge." UBYTE CU_V2GRXMSGSVCDISCFREESERVICE[3 1 100 0.0 1.0 ECU_ADDRESS 0x70017f62 BYTE_ORDER MSB_LAST /end MEASUREMENT
/begin COMPU_METHOD CU_V2GRXMSGSVCDISCFREESERVICE[3 "Conversion method for V2gRxMsgSvcDiscFreeService[6]" RAT_FUNC "%10.0" "b" COEFFS 0.000000 1.000000 -0.000000 0.000000 0.000000 1.000000 /end COMPU_METHOD
/* Scalar measurable for DDE 'V2gRxMsgSvcDiscFreeService[7]'. */
/begin MEASUREMENT V2gRxMsgSvcDiscFreeService[7] "If true, indicates that the service can be used free of charge." UBYTE CU_V2GRXMSGSVCDISCFREESERVICE[2 1 100 0.0 1.0 ECU_ADDRESS 0x70017f63 BYTE_ORDER MSB_LAST /end MEASUREMENT
/begin COMPU_METHOD CU_V2GRXMSGSVCDISCFREESERVICE[2 "Conversion method for V2gRxMsgSvcDiscFreeService[7]" RAT_FUNC "%10.0" "b" COEFFS 0.000000 1.000000 -0.000000 0.000000 0.000000 1.000000 /end COMPU_METHOD
/* Scalar measurable for DDE 'V2gRxMsgSvcDiscNotif'. */
/begin MEASUREMENT V2gRxMsgSvcDiscNotif "The arbitrated Notification Max Delay parameter in the received message from EVSE" SLONG CU_V2GRXMSGSVCDISCNOTIF 1 100 -2147483648.0 2147483647.0 ECU_ADDRESS 0x70017e3c BYTE_ORDER MSB_LAST /end MEASUREMENT
/begin COMPU_METHOD CU_V2GRXMSGSVCDISCNOTIF "Conversion method for V2gRxMsgSvcDiscNotif" TAB_VERB "%12.0" "1" COMPU_TAB_REF CT_V2GRXMSGSVCDISCNOTIF /end COMPU_METHOD
/begin COMPU_VTAB CT_V2GRXMSGSVCDISCNOTIF "Conversion method for V2gRxMsgSvcDiscNotif" TAB_VERB 3 0 "NONE" 1 "STOPCHARGING" 2 "RENEGOTIATION" /end COMPU_VTAB
/* Scalar measurable for DDE 'V2gRxMsgSvcDiscNotifFlg'. */
/begin MEASUREMENT V2gRxMsgSvcDiscNotifFlg "The arbitrated Notification parameter in the received message from EVSE" UBYTE CU_V2GRXMSGSVCDISCNOTIFFLG 1 100 0.0 1.0 ECU_ADDRESS 0x70017d72 BYTE_ORDER MSB_LAST /end MEASUREMENT
/begin COMPU_METHOD CU_V2GRXMSGSVCDISCNOTIFFLG "Conversion method for V2gRxMsgSvcDiscNotifFlg" RAT_FUNC "%10.0" "b" COEFFS 0.000000 1.000000 -0.000000 0.000000 0.000000 1.000000 /end COMPU_METHOD
/* Scalar measurable for DDE 'V2gRxMsgSvcDiscNotifMaxDelay'. */
/begin MEASUREMENT V2gRxMsgSvcDiscNotifMaxDelay "The arbitrated Notification Max Delay parameter in the received message from EVSE" UWORD CU_V2GRXMSGSVCDISCNOTIFMAXDELAY 1 100 0.0 65535.0 ECU_ADDRESS 0x70017fdc BYTE_ORDER MSB_LAST /end MEASUREMENT
/begin COMPU_METHOD CU_V2GRXMSGSVCDISCNOTIFMAXDELAY "Conversion method for V2gRxMsgSvcDiscNotifMaxDelay" RAT_FUNC "%10.0" "s" COEFFS 0.000000 1.000000 -0.000000 0.000000 0.000000 1.000000 /end COMPU_METHOD
/* Scalar measurable for DDE 'V2gRxMsgSvcDiscRescode'. */
/begin MEASUREMENT V2gRxMsgSvcDiscRescode "for message 2b: indicates the acknowledgment status of  this V2G messages received by the SECC." UBYTE CU_V2GRXMSGSVCDISCRESCODE 1 100 0.0 255.0 ECU_ADDRESS 0x70018364 BYTE_ORDER MSB_LAST /end MEASUREMENT
/begin COMPU_METHOD CU_V2GRXMSGSVCDISCRESCODE "Conversion method for V2gRxMsgSvcDiscRescode" RAT_FUNC "%10.0" "1" COEFFS 0.000000 1.000000 -0.000000 0.000000 0.000000 1.000000 /end COMPU_METHOD
/* Scalar measurable for DDE 'V2gRxMsgSvcDiscServiceId'. */
/begin MEASUREMENT V2gRxMsgSvcDiscServiceId "Unique identifier of the service from EVSE" UWORD CU_V2GRXMSGSVCDISCSERVICEID 1 100 0.0 65535.0 ECU_ADDRESS 0x70018196 BYTE_ORDER MSB_LAST /end MEASUREMENT
/begin COMPU_METHOD CU_V2GRXMSGSVCDISCSERVICEID "Conversion method for V2gRxMsgSvcDiscServiceId" RAT_FUNC "%10.0" "1" COEFFS 0.000000 1.000000 -0.000000 0.000000 0.000000 1.000000 /end COMPU_METHOD
/* Scalar measurable for DDE 'V2gRxMsgSvcDiscSvcCategory'. */
/begin MEASUREMENT V2gRxMsgSvcDiscSvcCategory "The arbitrated Service Category parameter in the received message from EVSE" UBYTE CU_V2GRXMSGSVCDISCSVCCATEGORY 1 100 0.0 4.0 ECU_ADDRESS 0x70017c38 BYTE_ORDER MSB_LAST /end MEASUREMENT
/begin COMPU_METHOD CU_V2GRXMSGSVCDISCSVCCATEGORY "Conversion method for V2gRxMsgSvcDiscSvcCategory" RAT_FUNC "%10.0" "1" COEFFS 0.000000 1.000000 -0.000000 0.000000 0.000000 1.000000 /end COMPU_METHOD
/* Scalar measurable for DDE 'V2gRxMsgSvcDiscSvcListSize'. */
/begin MEASUREMENT V2gRxMsgSvcDiscSvcListSize "The arbitrated Service List Size parameter in the received message from EVSE" UBYTE CU_V2GRXMSGSVCDISCSVCLISTSIZE 1 100 0.0 255.0 ECU_ADDRESS 0x70017ed9 BYTE_ORDER MSB_LAST /end MEASUREMENT
/begin COMPU_METHOD CU_V2GRXMSGSVCDISCSVCLISTSIZE "Conversion method for V2gRxMsgSvcDiscSvcListSize" RAT_FUNC "%10.0" "1" COEFFS 0.000000 1.000000 -0.000000 0.000000 0.000000 1.000000 /end COMPU_METHOD
/* Scalar measurable for DDE 'V2gRxMsgSvcDiscSvcNameLen'. */
/begin MEASUREMENT V2gRxMsgSvcDiscSvcNameLen "The arbitrated Service Name Length parameter in the received message from EVSE" UBYTE CU_V2GRXMSGSVCDISCSVCNAMELEN 1 100 0.0 255.0 ECU_ADDRESS 0x70018151 BYTE_ORDER MSB_LAST /end MEASUREMENT
/begin COMPU_METHOD CU_V2GRXMSGSVCDISCSVCNAMELEN "Conversion method for V2gRxMsgSvcDiscSvcNameLen" RAT_FUNC "%10.0" "1" COEFFS 0.000000 1.000000 -0.000000 0.000000 0.000000 1.000000 /end COMPU_METHOD
/* Scalar measurable for DDE 'V2gRxMsgSvcDiscSvcName[0]'. */
/begin MEASUREMENT V2gRxMsgSvcDiscSvcName[0] "The arbitrated Service Name parameter in the received message from EVSE" UBYTE CU_V2GRXMSGSVCDISCSVCNAME[0] 1 100 0.0 255.0 ECU_ADDRESS 0x700183cc BYTE_ORDER MSB_LAST /end MEASUREMENT
/begin COMPU_METHOD CU_V2GRXMSGSVCDISCSVCNAME[0] "Conversion method for V2gRxMsgSvcDiscSvcName[0]" RAT_FUNC "%10.0" "1" COEFFS 0.000000 1.000000 -0.000000 0.000000 0.000000 1.000000 /end COMPU_METHOD
/* Scalar measurable for DDE 'V2gRxMsgSvcDiscSvcName[10]'. */
/begin MEASUREMENT V2gRxMsgSvcDiscSvcName[10] "The arbitrated Service Name parameter in the received message from EVSE" UBYTE CU_V2GRXMSGSVCDISCSVCNAME[10] 1 100 0.0 255.0 ECU_ADDRESS 0x700183d6 BYTE_ORDER MSB_LAST /end MEASUREMENT
/begin COMPU_METHOD CU_V2GRXMSGSVCDISCSVCNAME[10] "Conversion method for V2gRxMsgSvcDiscSvcName[10]" RAT_FUNC "%10.0" "1" COEFFS 0.000000 1.000000 -0.000000 0.000000 0.000000 1.000000 /end COMPU_METHOD
/* Scalar measurable for DDE 'V2gRxMsgSvcDiscSvcName[11]'. */
/begin MEASUREMENT V2gRxMsgSvcDiscSvcName[11] "The arbitrated Service Name parameter in the received message from EVSE" UBYTE CU_V2GRXMSGSVCDISCSVCNAME[11] 1 100 0.0 255.0 ECU_ADDRESS 0x700183d7 BYTE_ORDER MSB_LAST /end MEASUREMENT
/begin COMPU_METHOD CU_V2GRXMSGSVCDISCSVCNAME[11] "Conversion method for V2gRxMsgSvcDiscSvcName[11]" RAT_FUNC "%10.0" "1" COEFFS 0.000000 1.000000 -0.000000 0.000000 0.000000 1.000000 /end COMPU_METHOD
/* Scalar measurable for DDE 'V2gRxMsgSvcDiscSvcName[12]'. */
/begin MEASUREMENT V2gRxMsgSvcDiscSvcName[12] "The arbitrated Service Name parameter in the received message from EVSE" UBYTE CU_V2GRXMSGSVCDISCSVCNAME[12] 1 100 0.0 255.0 ECU_ADDRESS 0x700183d8 BYTE_ORDER MSB_LAST /end MEASUREMENT
/begin COMPU_METHOD CU_V2GRXMSGSVCDISCSVCNAME[12] "Conversion method for V2gRxMsgSvcDiscSvcName[12]" RAT_FUNC "%10.0" "1" COEFFS 0.000000 1.000000 -0.000000 0.000000 0.000000 1.000000 /end COMPU_METHOD
/* Scalar measurable for DDE 'V2gRxMsgSvcDiscSvcName[13]'. */
/begin MEASUREMENT V2gRxMsgSvcDiscSvcName[13] "The arbitrated Service Name parameter in the received message from EVSE" UBYTE CU_V2GRXMSGSVCDISCSVCNAME[13] 1 100 0.0 255.0 ECU_ADDRESS 0x700183d9 BYTE_ORDER MSB_LAST /end MEASUREMENT
/begin COMPU_METHOD CU_V2GRXMSGSVCDISCSVCNAME[13] "Conversion method for V2gRxMsgSvcDiscSvcName[13]" RAT_FUNC "%10.0" "1" COEFFS 0.000000 1.000000 -0.000000 0.000000 0.000000 1.000000 /end COMPU_METHOD
/* Scalar measurable for DDE 'V2gRxMsgSvcDiscSvcName[14]'. */
/begin MEASUREMENT V2gRxMsgSvcDiscSvcName[14] "The arbitrated Service Name parameter in the received message from EVSE" UBYTE CU_V2GRXMSGSVCDISCSVCNAME[14] 1 100 0.0 255.0 ECU_ADDRESS 0x700183da BYTE_ORDER MSB_LAST /end MEASUREMENT
/begin COMPU_METHOD CU_V2GRXMSGSVCDISCSVCNAME[14] "Conversion method for V2gRxMsgSvcDiscSvcName[14]" RAT_FUNC "%10.0" "1" COEFFS 0.000000 1.000000 -0.000000 0.000000 0.000000 1.000000 /end COMPU_METHOD
/* Scalar measurable for DDE 'V2gRxMsgSvcDiscSvcName[15]'. */
/begin MEASUREMENT V2gRxMsgSvcDiscSvcName[15] "The arbitrated Service Name parameter in the received message from EVSE" UBYTE CU_V2GRXMSGSVCDISCSVCNAME[15] 1 100 0.0 255.0 ECU_ADDRESS 0x700183db BYTE_ORDER MSB_LAST /end MEASUREMENT
/begin COMPU_METHOD CU_V2GRXMSGSVCDISCSVCNAME[15] "Conversion method for V2gRxMsgSvcDiscSvcName[15]" RAT_FUNC "%10.0" "1" COEFFS 0.000000 1.000000 -0.000000 0.000000 0.000000 1.000000 /end COMPU_METHOD
/* Scalar measurable for DDE 'V2gRxMsgSvcDiscSvcName[16]'. */
/begin MEASUREMENT V2gRxMsgSvcDiscSvcName[16] "The arbitrated Service Name parameter in the received message from EVSE" UBYTE CU_V2GRXMSGSVCDISCSVCNAME[16] 1 100 0.0 255.0 ECU_ADDRESS 0x700183dc BYTE_ORDER MSB_LAST /end MEASUREMENT
/begin COMPU_METHOD CU_V2GRXMSGSVCDISCSVCNAME[16] "Conversion method for V2gRxMsgSvcDiscSvcName[16]" RAT_FUNC "%10.0" "1" COEFFS 0.000000 1.000000 -0.000000 0.000000 0.000000 1.000000 /end COMPU_METHOD
/* Scalar measurable for DDE 'V2gRxMsgSvcDiscSvcName[17]'. */
/begin MEASUREMENT V2gRxMsgSvcDiscSvcName[17] "The arbitrated Service Name parameter in the received message from EVSE" UBYTE CU_V2GRXMSGSVCDISCSVCNAME[17] 1 100 0.0 255.0 ECU_ADDRESS 0x700183dd BYTE_ORDER MSB_LAST /end MEASUREMENT
/begin COMPU_METHOD CU_V2GRXMSGSVCDISCSVCNAME[17] "Conversion method for V2gRxMsgSvcDiscSvcName[17]" RAT_FUNC "%10.0" "1" COEFFS 0.000000 1.000000 -0.000000 0.000000 0.000000 1.000000 /end COMPU_METHOD
/* Scalar measurable for DDE 'V2gRxMsgSvcDiscSvcName[18]'. */
/begin MEASUREMENT V2gRxMsgSvcDiscSvcName[18] "The arbitrated Service Name parameter in the received message from EVSE" UBYTE CU_V2GRXMSGSVCDISCSVCNAME[18] 1 100 0.0 255.0 ECU_ADDRESS 0x700183de BYTE_ORDER MSB_LAST /end MEASUREMENT
/begin COMPU_METHOD CU_V2GRXMSGSVCDISCSVCNAME[18] "Conversion method for V2gRxMsgSvcDiscSvcName[18]" RAT_FUNC "%10.0" "1" COEFFS 0.000000 1.000000 -0.000000 0.000000 0.000000 1.000000 /end COMPU_METHOD
/* Scalar measurable for DDE 'V2gRxMsgSvcDiscSvcName[19]'. */
/begin MEASUREMENT V2gRxMsgSvcDiscSvcName[19] "The arbitrated Service Name parameter in the received message from EVSE" UBYTE CU_V2GRXMSGSVCDISCSVCNAME[19] 1 100 0.0 255.0 ECU_ADDRESS 0x700183df BYTE_ORDER MSB_LAST /end MEASUREMENT
/begin COMPU_METHOD CU_V2GRXMSGSVCDISCSVCNAME[19] "Conversion method for V2gRxMsgSvcDiscSvcName[19]" RAT_FUNC "%10.0" "1" COEFFS 0.000000 1.000000 -0.000000 0.000000 0.000000 1.000000 /end COMPU_METHOD
/* Scalar measurable for DDE 'V2gRxMsgSvcDiscSvcName[1]'. */
/begin MEASUREMENT V2gRxMsgSvcDiscSvcName[1] "The arbitrated Service Name parameter in the received message from EVSE" UBYTE CU_V2GRXMSGSVCDISCSVCNAME[1] 1 100 0.0 255.0 ECU_ADDRESS 0x700183cd BYTE_ORDER MSB_LAST /end MEASUREMENT
/begin COMPU_METHOD CU_V2GRXMSGSVCDISCSVCNAME[1] "Conversion method for V2gRxMsgSvcDiscSvcName[1]" RAT_FUNC "%10.0" "1" COEFFS 0.000000 1.000000 -0.000000 0.000000 0.000000 1.000000 /end COMPU_METHOD
/* Scalar measurable for DDE 'V2gRxMsgSvcDiscSvcName[20]'. */
/begin MEASUREMENT V2gRxMsgSvcDiscSvcName[20] "The arbitrated Service Name parameter in the received message from EVSE" UBYTE CU_V2GRXMSGSVCDISCSVCNAME[20] 1 100 0.0 255.0 ECU_ADDRESS 0x700183e0 BYTE_ORDER MSB_LAST /end MEASUREMENT
/begin COMPU_METHOD CU_V2GRXMSGSVCDISCSVCNAME[20] "Conversion method for V2gRxMsgSvcDiscSvcName[20]" RAT_FUNC "%10.0" "1" COEFFS 0.000000 1.000000 -0.000000 0.000000 0.000000 1.000000 /end COMPU_METHOD
/* Scalar measurable for DDE 'V2gRxMsgSvcDiscSvcName[21]'. */
/begin MEASUREMENT V2gRxMsgSvcDiscSvcName[21] "The arbitrated Service Name parameter in the received message from EVSE" UBYTE CU_V2GRXMSGSVCDISCSVCNAME[21] 1 100 0.0 255.0 ECU_ADDRESS 0x700183e1 BYTE_ORDER MSB_LAST /end MEASUREMENT
/begin COMPU_METHOD CU_V2GRXMSGSVCDISCSVCNAME[21] "Conversion method for V2gRxMsgSvcDiscSvcName[21]" RAT_FUNC "%10.0" "1" COEFFS 0.000000 1.000000 -0.000000 0.000000 0.000000 1.000000 /end COMPU_METHOD
/* Scalar measurable for DDE 'V2gRxMsgSvcDiscSvcName[22]'. */
/begin MEASUREMENT V2gRxMsgSvcDiscSvcName[22] "The arbitrated Service Name parameter in the received message from EVSE" UBYTE CU_V2GRXMSGSVCDISCSVCNAME[22] 1 100 0.0 255.0 ECU_ADDRESS 0x700183e2 BYTE_ORDER MSB_LAST /end MEASUREMENT
/begin COMPU_METHOD CU_V2GRXMSGSVCDISCSVCNAME[22] "Conversion method for V2gRxMsgSvcDiscSvcName[22]" RAT_FUNC "%10.0" "1" COEFFS 0.000000 1.000000 -0.000000 0.000000 0.000000 1.000000 /end COMPU_METHOD
/* Scalar measurable for DDE 'V2gRxMsgSvcDiscSvcName[23]'. */
/begin MEASUREMENT V2gRxMsgSvcDiscSvcName[23] "The arbitrated Service Name parameter in the received message from EVSE" UBYTE CU_V2GRXMSGSVCDISCSVCNAME[23] 1 100 0.0 255.0 ECU_ADDRESS 0x700183e3 BYTE_ORDER MSB_LAST /end MEASUREMENT
/begin COMPU_METHOD CU_V2GRXMSGSVCDISCSVCNAME[23] "Conversion method for V2gRxMsgSvcDiscSvcName[23]" RAT_FUNC "%10.0" "1" COEFFS 0.000000 1.000000 -0.000000 0.000000 0.000000 1.000000 /end COMPU_METHOD
/* Scalar measurable for DDE 'V2gRxMsgSvcDiscSvcName[24]'. */
/begin MEASUREMENT V2gRxMsgSvcDiscSvcName[24] "The arbitrated Service Name parameter in the received message from EVSE" UBYTE CU_V2GRXMSGSVCDISCSVCNAME[24] 1 100 0.0 255.0 ECU_ADDRESS 0x700183e4 BYTE_ORDER MSB_LAST /end MEASUREMENT
/begin COMPU_METHOD CU_V2GRXMSGSVCDISCSVCNAME[24] "Conversion method for V2gRxMsgSvcDiscSvcName[24]" RAT_FUNC "%10.0" "1" COEFFS 0.000000 1.000000 -0.000000 0.000000 0.000000 1.000000 /end COMPU_METHOD
/* Scalar measurable for DDE 'V2gRxMsgSvcDiscSvcName[25]'. */
/begin MEASUREMENT V2gRxMsgSvcDiscSvcName[25] "The arbitrated Service Name parameter in the received message from EVSE" UBYTE CU_V2GRXMSGSVCDISCSVCNAME[25] 1 100 0.0 255.0 ECU_ADDRESS 0x700183e5 BYTE_ORDER MSB_LAST /end MEASUREMENT
/begin COMPU_METHOD CU_V2GRXMSGSVCDISCSVCNAME[25] "Conversion method for V2gRxMsgSvcDiscSvcName[25]" RAT_FUNC "%10.0" "1" COEFFS 0.000000 1.000000 -0.000000 0.000000 0.000000 1.000000 /end COMPU_METHOD
/* Scalar measurable for DDE 'V2gRxMsgSvcDiscSvcName[26]'. */
/begin MEASUREMENT V2gRxMsgSvcDiscSvcName[26] "The arbitrated Service Name parameter in the received message from EVSE" UBYTE CU_V2GRXMSGSVCDISCSVCNAME[26] 1 100 0.0 255.0 ECU_ADDRESS 0x700183e6 BYTE_ORDER MSB_LAST /end MEASUREMENT
/begin COMPU_METHOD CU_V2GRXMSGSVCDISCSVCNAME[26] "Conversion method for V2gRxMsgSvcDiscSvcName[26]" RAT_FUNC "%10.0" "1" COEFFS 0.000000 1.000000 -0.000000 0.000000 0.000000 1.000000 /end COMPU_METHOD
/* Scalar measurable for DDE 'V2gRxMsgSvcDiscSvcName[27]'. */
/begin MEASUREMENT V2gRxMsgSvcDiscSvcName[27] "The arbitrated Service Name parameter in the received message from EVSE" UBYTE CU_V2GRXMSGSVCDISCSVCNAME[27] 1 100 0.0 255.0 ECU_ADDRESS 0x700183e7 BYTE_ORDER MSB_LAST /end MEASUREMENT
/begin COMPU_METHOD CU_V2GRXMSGSVCDISCSVCNAME[27] "Conversion method for V2gRxMsgSvcDiscSvcName[27]" RAT_FUNC "%10.0" "1" COEFFS 0.000000 1.000000 -0.000000 0.000000 0.000000 1.000000 /end COMPU_METHOD
/* Scalar measurable for DDE 'V2gRxMsgSvcDiscSvcName[28]'. */
/begin MEASUREMENT V2gRxMsgSvcDiscSvcName[28] "The arbitrated Service Name parameter in the received message from EVSE" UBYTE CU_V2GRXMSGSVCDISCSVCNAME[28] 1 100 0.0 255.0 ECU_ADDRESS 0x700183e8 BYTE_ORDER MSB_LAST /end MEASUREMENT
/begin COMPU_METHOD CU_V2GRXMSGSVCDISCSVCNAME[28] "Conversion method for V2gRxMsgSvcDiscSvcName[28]" RAT_FUNC "%10.0" "1" COEFFS 0.000000 1.000000 -0.000000 0.000000 0.000000 1.000000 /end COMPU_METHOD
/* Scalar measurable for DDE 'V2gRxMsgSvcDiscSvcName[29]'. */
/begin MEASUREMENT V2gRxMsgSvcDiscSvcName[29] "The arbitrated Service Name parameter in the received message from EVSE" UBYTE CU_V2GRXMSGSVCDISCSVCNAME[29] 1 100 0.0 255.0 ECU_ADDRESS 0x700183e9 BYTE_ORDER MSB_LAST /end MEASUREMENT
/begin COMPU_METHOD CU_V2GRXMSGSVCDISCSVCNAME[29] "Conversion method for V2gRxMsgSvcDiscSvcName[29]" RAT_FUNC "%10.0" "1" COEFFS 0.000000 1.000000 -0.000000 0.000000 0.000000 1.000000 /end COMPU_METHOD
/* Scalar measurable for DDE 'V2gRxMsgSvcDiscSvcName[2]'. */
/begin MEASUREMENT V2gRxMsgSvcDiscSvcName[2] "The arbitrated Service Name parameter in the received message from EVSE" UBYTE CU_V2GRXMSGSVCDISCSVCNAME[2] 1 100 0.0 255.0 ECU_ADDRESS 0x700183ce BYTE_ORDER MSB_LAST /end MEASUREMENT
/begin COMPU_METHOD CU_V2GRXMSGSVCDISCSVCNAME[2] "Conversion method for V2gRxMsgSvcDiscSvcName[2]" RAT_FUNC "%10.0" "1" COEFFS 0.000000 1.000000 -0.000000 0.000000 0.000000 1.000000 /end COMPU_METHOD
/* Scalar measurable for DDE 'V2gRxMsgSvcDiscSvcName[30]'. */
/begin MEASUREMENT V2gRxMsgSvcDiscSvcName[30] "The arbitrated Service Name parameter in the received message from EVSE" UBYTE CU_V2GRXMSGSVCDISCSVCNAME[30] 1 100 0.0 255.0 ECU_ADDRESS 0x700183ea BYTE_ORDER MSB_LAST /end MEASUREMENT
/begin COMPU_METHOD CU_V2GRXMSGSVCDISCSVCNAME[30] "Conversion method for V2gRxMsgSvcDiscSvcName[30]" RAT_FUNC "%10.0" "1" COEFFS 0.000000 1.000000 -0.000000 0.000000 0.000000 1.000000 /end COMPU_METHOD
/* Scalar measurable for DDE 'V2gRxMsgSvcDiscSvcName[31]'. */
/begin MEASUREMENT V2gRxMsgSvcDiscSvcName[31] "The arbitrated Service Name parameter in the received message from EVSE" UBYTE CU_V2GRXMSGSVCDISCSVCNAME[31] 1 100 0.0 255.0 ECU_ADDRESS 0x700183eb BYTE_ORDER MSB_LAST /end MEASUREMENT
/begin COMPU_METHOD CU_V2GRXMSGSVCDISCSVCNAME[31] "Conversion method for V2gRxMsgSvcDiscSvcName[31]" RAT_FUNC "%10.0" "1" COEFFS 0.000000 1.000000 -0.000000 0.000000 0.000000 1.000000 /end COMPU_METHOD
/* Scalar measurable for DDE 'V2gRxMsgSvcDiscSvcName[32]'. */
/begin MEASUREMENT V2gRxMsgSvcDiscSvcName[32] "The arbitrated Service Name parameter in the received message from EVSE" UBYTE CU_V2GRXMSGSVCDISCSVCNAME[32] 1 100 0.0 255.0 ECU_ADDRESS 0x700183ec BYTE_ORDER MSB_LAST /end MEASUREMENT
/begin COMPU_METHOD CU_V2GRXMSGSVCDISCSVCNAME[32] "Conversion method for V2gRxMsgSvcDiscSvcName[32]" RAT_FUNC "%10.0" "1" COEFFS 0.000000 1.000000 -0.000000 0.000000 0.000000 1.000000 /end COMPU_METHOD
/* Scalar measurable for DDE 'V2gRxMsgSvcDiscSvcName[3]'. */
/begin MEASUREMENT V2gRxMsgSvcDiscSvcName[3] "The arbitrated Service Name parameter in the received message from EVSE" UBYTE CU_V2GRXMSGSVCDISCSVCNAME[3] 1 100 0.0 255.0 ECU_ADDRESS 0x700183cf BYTE_ORDER MSB_LAST /end MEASUREMENT
/begin COMPU_METHOD CU_V2GRXMSGSVCDISCSVCNAME[3] "Conversion method for V2gRxMsgSvcDiscSvcName[3]" RAT_FUNC "%10.0" "1" COEFFS 0.000000 1.000000 -0.000000 0.000000 0.000000 1.000000 /end COMPU_METHOD
/* Scalar measurable for DDE 'V2gRxMsgSvcDiscSvcName[4]'. */
/begin MEASUREMENT V2gRxMsgSvcDiscSvcName[4] "The arbitrated Service Name parameter in the received message from EVSE" UBYTE CU_V2GRXMSGSVCDISCSVCNAME[4] 1 100 0.0 255.0 ECU_ADDRESS 0x700183d0 BYTE_ORDER MSB_LAST /end MEASUREMENT
/begin COMPU_METHOD CU_V2GRXMSGSVCDISCSVCNAME[4] "Conversion method for V2gRxMsgSvcDiscSvcName[4]" RAT_FUNC "%10.0" "1" COEFFS 0.000000 1.000000 -0.000000 0.000000 0.000000 1.000000 /end COMPU_METHOD
/* Scalar measurable for DDE 'V2gRxMsgSvcDiscSvcName[5]'. */
/begin MEASUREMENT V2gRxMsgSvcDiscSvcName[5] "The arbitrated Service Name parameter in the received message from EVSE" UBYTE CU_V2GRXMSGSVCDISCSVCNAME[5] 1 100 0.0 255.0 ECU_ADDRESS 0x700183d1 BYTE_ORDER MSB_LAST /end MEASUREMENT
/begin COMPU_METHOD CU_V2GRXMSGSVCDISCSVCNAME[5] "Conversion method for V2gRxMsgSvcDiscSvcName[5]" RAT_FUNC "%10.0" "1" COEFFS 0.000000 1.000000 -0.000000 0.000000 0.000000 1.000000 /end COMPU_METHOD
/* Scalar measurable for DDE 'V2gRxMsgSvcDiscSvcName[6]'. */
/begin MEASUREMENT V2gRxMsgSvcDiscSvcName[6] "The arbitrated Service Name parameter in the received message from EVSE" UBYTE CU_V2GRXMSGSVCDISCSVCNAME[6] 1 100 0.0 255.0 ECU_ADDRESS 0x700183d2 BYTE_ORDER MSB_LAST /end MEASUREMENT
/begin COMPU_METHOD CU_V2GRXMSGSVCDISCSVCNAME[6] "Conversion method for V2gRxMsgSvcDiscSvcName[6]" RAT_FUNC "%10.0" "1" COEFFS 0.000000 1.000000 -0.000000 0.000000 0.000000 1.000000 /end COMPU_METHOD
/* Scalar measurable for DDE 'V2gRxMsgSvcDiscSvcName[7]'. */
/begin MEASUREMENT V2gRxMsgSvcDiscSvcName[7] "The arbitrated Service Name parameter in the received message from EVSE" UBYTE CU_V2GRXMSGSVCDISCSVCNAME[7] 1 100 0.0 255.0 ECU_ADDRESS 0x700183d3 BYTE_ORDER MSB_LAST /end MEASUREMENT
/begin COMPU_METHOD CU_V2GRXMSGSVCDISCSVCNAME[7] "Conversion method for V2gRxMsgSvcDiscSvcName[7]" RAT_FUNC "%10.0" "1" COEFFS 0.000000 1.000000 -0.000000 0.000000 0.000000 1.000000 /end COMPU_METHOD
/* Scalar measurable for DDE 'V2gRxMsgSvcDiscSvcName[8]'. */
/begin MEASUREMENT V2gRxMsgSvcDiscSvcName[8] "The arbitrated Service Name parameter in the received message from EVSE" UBYTE CU_V2GRXMSGSVCDISCSVCNAME[8] 1 100 0.0 255.0 ECU_ADDRESS 0x700183d4 BYTE_ORDER MSB_LAST /end MEASUREMENT
/begin COMPU_METHOD CU_V2GRXMSGSVCDISCSVCNAME[8] "Conversion method for V2gRxMsgSvcDiscSvcName[8]" RAT_FUNC "%10.0" "1" COEFFS 0.000000 1.000000 -0.000000 0.000000 0.000000 1.000000 /end COMPU_METHOD
/* Scalar measurable for DDE 'V2gRxMsgSvcDiscSvcName[9]'. */
/begin MEASUREMENT V2gRxMsgSvcDiscSvcName[9] "The arbitrated Service Name parameter in the received message from EVSE" UBYTE CU_V2GRXMSGSVCDISCSVCNAME[9] 1 100 0.0 255.0 ECU_ADDRESS 0x700183d5 BYTE_ORDER MSB_LAST /end MEASUREMENT
/begin COMPU_METHOD CU_V2GRXMSGSVCDISCSVCNAME[9] "Conversion method for V2gRxMsgSvcDiscSvcName[9]" RAT_FUNC "%10.0" "1" COEFFS 0.000000 1.000000 -0.000000 0.000000 0.000000 1.000000 /end COMPU_METHOD
/* Scalar measurable for DDE 'V2gRxMsgSvcDiscSvcScopeLen'. */
/begin MEASUREMENT V2gRxMsgSvcDiscSvcScopeLen "The arbitrated Service Scope Length parameter in the received message from EVSE" UBYTE CU_V2GRXMSGSVCDISCSVCSCOPELEN 1 100 0.0 255.0 ECU_ADDRESS 0x70017c24 BYTE_ORDER MSB_LAST /end MEASUREMENT
/begin COMPU_METHOD CU_V2GRXMSGSVCDISCSVCSCOPELEN "Conversion method for V2gRxMsgSvcDiscSvcScopeLen" RAT_FUNC "%10.0" "1" COEFFS 0.000000 1.000000 -0.000000 0.000000 0.000000 1.000000 /end COMPU_METHOD
/* Scalar measurable for DDE 'V2gRxMsgSvcDiscSvcScope[0]'. */
/begin MEASUREMENT V2gRxMsgSvcDiscSvcScope[0] "The arbitrated Service Scope parameter in the received message from EVSE" UBYTE CU_V2GRXMSGSVCDISCSVCSCOPE[0] 1 100 0.0 255.0 ECU_ADDRESS 0x700180a0 BYTE_ORDER MSB_LAST /end MEASUREMENT
/begin COMPU_METHOD CU_V2GRXMSGSVCDISCSVCSCOPE[0] "Conversion method for V2gRxMsgSvcDiscSvcScope[0]" RAT_FUNC "%10.0" "1" COEFFS 0.000000 1.000000 -0.000000 0.000000 0.000000 1.000000 /end COMPU_METHOD
/* Scalar measurable for DDE 'V2gRxMsgSvcDiscSvcScope[10]'. */
/begin MEASUREMENT V2gRxMsgSvcDiscSvcScope[10] "The arbitrated Service Scope parameter in the received message from EVSE" UBYTE CU_V2GRXMSGSVCDISCSVCSCOPE[10] 1 100 0.0 255.0 ECU_ADDRESS 0x700180aa BYTE_ORDER MSB_LAST /end MEASUREMENT
/begin COMPU_METHOD CU_V2GRXMSGSVCDISCSVCSCOPE[10] "Conversion method for V2gRxMsgSvcDiscSvcScope[10]" RAT_FUNC "%10.0" "1" COEFFS 0.000000 1.000000 -0.000000 0.000000 0.000000 1.000000 /end COMPU_METHOD
/* Scalar measurable for DDE 'V2gRxMsgSvcDiscSvcScope[11]'. */
/begin MEASUREMENT V2gRxMsgSvcDiscSvcScope[11] "The arbitrated Service Scope parameter in the received message from EVSE" UBYTE CU_V2GRXMSGSVCDISCSVCSCOPE[11] 1 100 0.0 255.0 ECU_ADDRESS 0x700180ab BYTE_ORDER MSB_LAST /end MEASUREMENT
/begin COMPU_METHOD CU_V2GRXMSGSVCDISCSVCSCOPE[11] "Conversion method for V2gRxMsgSvcDiscSvcScope[11]" RAT_FUNC "%10.0" "1" COEFFS 0.000000 1.000000 -0.000000 0.000000 0.000000 1.000000 /end COMPU_METHOD
/* Scalar measurable for DDE 'V2gRxMsgSvcDiscSvcScope[12]'. */
/begin MEASUREMENT V2gRxMsgSvcDiscSvcScope[12] "The arbitrated Service Scope parameter in the received message from EVSE" UBYTE CU_V2GRXMSGSVCDISCSVCSCOPE[12] 1 100 0.0 255.0 ECU_ADDRESS 0x700180ac BYTE_ORDER MSB_LAST /end MEASUREMENT
/begin COMPU_METHOD CU_V2GRXMSGSVCDISCSVCSCOPE[12] "Conversion method for V2gRxMsgSvcDiscSvcScope[12]" RAT_FUNC "%10.0" "1" COEFFS 0.000000 1.000000 -0.000000 0.000000 0.000000 1.000000 /end COMPU_METHOD
/* Scalar measurable for DDE 'V2gRxMsgSvcDiscSvcScope[13]'. */
/begin MEASUREMENT V2gRxMsgSvcDiscSvcScope[13] "The arbitrated Service Scope parameter in the received message from EVSE" UBYTE CU_V2GRXMSGSVCDISCSVCSCOPE[13] 1 100 0.0 255.0 ECU_ADDRESS 0x700180ad BYTE_ORDER MSB_LAST /end MEASUREMENT
/begin COMPU_METHOD CU_V2GRXMSGSVCDISCSVCSCOPE[13] "Conversion method for V2gRxMsgSvcDiscSvcScope[13]" RAT_FUNC "%10.0" "1" COEFFS 0.000000 1.000000 -0.000000 0.000000 0.000000 1.000000 /end COMPU_METHOD
/* Scalar measurable for DDE 'V2gRxMsgSvcDiscSvcScope[14]'. */
/begin MEASUREMENT V2gRxMsgSvcDiscSvcScope[14] "The arbitrated Service Scope parameter in the received message from EVSE" UBYTE CU_V2GRXMSGSVCDISCSVCSCOPE[14] 1 100 0.0 255.0 ECU_ADDRESS 0x700180ae BYTE_ORDER MSB_LAST /end MEASUREMENT
/begin COMPU_METHOD CU_V2GRXMSGSVCDISCSVCSCOPE[14] "Conversion method for V2gRxMsgSvcDiscSvcScope[14]" RAT_FUNC "%10.0" "1" COEFFS 0.000000 1.000000 -0.000000 0.000000 0.000000 1.000000 /end COMPU_METHOD
/* Scalar measurable for DDE 'V2gRxMsgSvcDiscSvcScope[15]'. */
/begin MEASUREMENT V2gRxMsgSvcDiscSvcScope[15] "The arbitrated Service Scope parameter in the received message from EVSE" UBYTE CU_V2GRXMSGSVCDISCSVCSCOPE[15] 1 100 0.0 255.0 ECU_ADDRESS 0x700180af BYTE_ORDER MSB_LAST /end MEASUREMENT
/begin COMPU_METHOD CU_V2GRXMSGSVCDISCSVCSCOPE[15] "Conversion method for V2gRxMsgSvcDiscSvcScope[15]" RAT_FUNC "%10.0" "1" COEFFS 0.000000 1.000000 -0.000000 0.000000 0.000000 1.000000 /end COMPU_METHOD
/* Scalar measurable for DDE 'V2gRxMsgSvcDiscSvcScope[16]'. */
/begin MEASUREMENT V2gRxMsgSvcDiscSvcScope[16] "The arbitrated Service Scope parameter in the received message from EVSE" UBYTE CU_V2GRXMSGSVCDISCSVCSCOPE[16] 1 100 0.0 255.0 ECU_ADDRESS 0x700180b0 BYTE_ORDER MSB_LAST /end MEASUREMENT
/begin COMPU_METHOD CU_V2GRXMSGSVCDISCSVCSCOPE[16] "Conversion method for V2gRxMsgSvcDiscSvcScope[16]" RAT_FUNC "%10.0" "1" COEFFS 0.000000 1.000000 -0.000000 0.000000 0.000000 1.000000 /end COMPU_METHOD
/* Scalar measurable for DDE 'V2gRxMsgSvcDiscSvcScope[17]'. */
/begin MEASUREMENT V2gRxMsgSvcDiscSvcScope[17] "The arbitrated Service Scope parameter in the received message from EVSE" UBYTE CU_V2GRXMSGSVCDISCSVCSCOPE[17] 1 100 0.0 255.0 ECU_ADDRESS 0x700180b1 BYTE_ORDER MSB_LAST /end MEASUREMENT
/begin COMPU_METHOD CU_V2GRXMSGSVCDISCSVCSCOPE[17] "Conversion method for V2gRxMsgSvcDiscSvcScope[17]" RAT_FUNC "%10.0" "1" COEFFS 0.000000 1.000000 -0.000000 0.000000 0.000000 1.000000 /end COMPU_METHOD
/* Scalar measurable for DDE 'V2gRxMsgSvcDiscSvcScope[18]'. */
/begin MEASUREMENT V2gRxMsgSvcDiscSvcScope[18] "The arbitrated Service Scope parameter in the received message from EVSE" UBYTE CU_V2GRXMSGSVCDISCSVCSCOPE[18] 1 100 0.0 255.0 ECU_ADDRESS 0x700180b2 BYTE_ORDER MSB_LAST /end MEASUREMENT
/begin COMPU_METHOD CU_V2GRXMSGSVCDISCSVCSCOPE[18] "Conversion method for V2gRxMsgSvcDiscSvcScope[18]" RAT_FUNC "%10.0" "1" COEFFS 0.000000 1.000000 -0.000000 0.000000 0.000000 1.000000 /end COMPU_METHOD
/* Scalar measurable for DDE 'V2gRxMsgSvcDiscSvcScope[19]'. */
/begin MEASUREMENT V2gRxMsgSvcDiscSvcScope[19] "The arbitrated Service Scope parameter in the received message from EVSE" UBYTE CU_V2GRXMSGSVCDISCSVCSCOPE[19] 1 100 0.0 255.0 ECU_ADDRESS 0x700180b3 BYTE_ORDER MSB_LAST /end MEASUREMENT
/begin COMPU_METHOD CU_V2GRXMSGSVCDISCSVCSCOPE[19] "Conversion method for V2gRxMsgSvcDiscSvcScope[19]" RAT_FUNC "%10.0" "1" COEFFS 0.000000 1.000000 -0.000000 0.000000 0.000000 1.000000 /end COMPU_METHOD
/* Scalar measurable for DDE 'V2gRxMsgSvcDiscSvcScope[1]'. */
/begin MEASUREMENT V2gRxMsgSvcDiscSvcScope[1] "The arbitrated Service Scope parameter in the received message from EVSE" UBYTE CU_V2GRXMSGSVCDISCSVCSCOPE[1] 1 100 0.0 255.0 ECU_ADDRESS 0x700180a1 BYTE_ORDER MSB_LAST /end MEASUREMENT
/begin COMPU_METHOD CU_V2GRXMSGSVCDISCSVCSCOPE[1] "Conversion method for V2gRxMsgSvcDiscSvcScope[1]" RAT_FUNC "%10.0" "1" COEFFS 0.000000 1.000000 -0.000000 0.000000 0.000000 1.000000 /end COMPU_METHOD
/* Scalar measurable for DDE 'V2gRxMsgSvcDiscSvcScope[20]'. */
/begin MEASUREMENT V2gRxMsgSvcDiscSvcScope[20] "The arbitrated Service Scope parameter in the received message from EVSE" UBYTE CU_V2GRXMSGSVCDISCSVCSCOPE[20] 1 100 0.0 255.0 ECU_ADDRESS 0x700180b4 BYTE_ORDER MSB_LAST /end MEASUREMENT
/begin COMPU_METHOD CU_V2GRXMSGSVCDISCSVCSCOPE[20] "Conversion method for V2gRxMsgSvcDiscSvcScope[20]" RAT_FUNC "%10.0" "1" COEFFS 0.000000 1.000000 -0.000000 0.000000 0.000000 1.000000 /end COMPU_METHOD
/* Scalar measurable for DDE 'V2gRxMsgSvcDiscSvcScope[21]'. */
/begin MEASUREMENT V2gRxMsgSvcDiscSvcScope[21] "The arbitrated Service Scope parameter in the received message from EVSE" UBYTE CU_V2GRXMSGSVCDISCSVCSCOPE[21] 1 100 0.0 255.0 ECU_ADDRESS 0x700180b5 BYTE_ORDER MSB_LAST /end MEASUREMENT
/begin COMPU_METHOD CU_V2GRXMSGSVCDISCSVCSCOPE[21] "Conversion method for V2gRxMsgSvcDiscSvcScope[21]" RAT_FUNC "%10.0" "1" COEFFS 0.000000 1.000000 -0.000000 0.000000 0.000000 1.000000 /end COMPU_METHOD
/* Scalar measurable for DDE 'V2gRxMsgSvcDiscSvcScope[22]'. */
/begin MEASUREMENT V2gRxMsgSvcDiscSvcScope[22] "The arbitrated Service Scope parameter in the received message from EVSE" UBYTE CU_V2GRXMSGSVCDISCSVCSCOPE[22] 1 100 0.0 255.0 ECU_ADDRESS 0x700180b6 BYTE_ORDER MSB_LAST /end MEASUREMENT
/begin COMPU_METHOD CU_V2GRXMSGSVCDISCSVCSCOPE[22] "Conversion method for V2gRxMsgSvcDiscSvcScope[22]" RAT_FUNC "%10.0" "1" COEFFS 0.000000 1.000000 -0.000000 0.000000 0.000000 1.000000 /end COMPU_METHOD
/* Scalar measurable for DDE 'V2gRxMsgSvcDiscSvcScope[23]'. */
/begin MEASUREMENT V2gRxMsgSvcDiscSvcScope[23] "The arbitrated Service Scope parameter in the received message from EVSE" UBYTE CU_V2GRXMSGSVCDISCSVCSCOPE[23] 1 100 0.0 255.0 ECU_ADDRESS 0x700180b7 BYTE_ORDER MSB_LAST /end MEASUREMENT
/begin COMPU_METHOD CU_V2GRXMSGSVCDISCSVCSCOPE[23] "Conversion method for V2gRxMsgSvcDiscSvcScope[23]" RAT_FUNC "%10.0" "1" COEFFS 0.000000 1.000000 -0.000000 0.000000 0.000000 1.000000 /end COMPU_METHOD
/* Scalar measurable for DDE 'V2gRxMsgSvcDiscSvcScope[24]'. */
/begin MEASUREMENT V2gRxMsgSvcDiscSvcScope[24] "The arbitrated Service Scope parameter in the received message from EVSE" UBYTE CU_V2GRXMSGSVCDISCSVCSCOPE[24] 1 100 0.0 255.0 ECU_ADDRESS 0x700180b8 BYTE_ORDER MSB_LAST /end MEASUREMENT
/begin COMPU_METHOD CU_V2GRXMSGSVCDISCSVCSCOPE[24] "Conversion method for V2gRxMsgSvcDiscSvcScope[24]" RAT_FUNC "%10.0" "1" COEFFS 0.000000 1.000000 -0.000000 0.000000 0.000000 1.000000 /end COMPU_METHOD
/* Scalar measurable for DDE 'V2gRxMsgSvcDiscSvcScope[25]'. */
/begin MEASUREMENT V2gRxMsgSvcDiscSvcScope[25] "The arbitrated Service Scope parameter in the received message from EVSE" UBYTE CU_V2GRXMSGSVCDISCSVCSCOPE[25] 1 100 0.0 255.0 ECU_ADDRESS 0x700180b9 BYTE_ORDER MSB_LAST /end MEASUREMENT
/begin COMPU_METHOD CU_V2GRXMSGSVCDISCSVCSCOPE[25] "Conversion method for V2gRxMsgSvcDiscSvcScope[25]" RAT_FUNC "%10.0" "1" COEFFS 0.000000 1.000000 -0.000000 0.000000 0.000000 1.000000 /end COMPU_METHOD
/* Scalar measurable for DDE 'V2gRxMsgSvcDiscSvcScope[26]'. */
/begin MEASUREMENT V2gRxMsgSvcDiscSvcScope[26] "The arbitrated Service Scope parameter in the received message from EVSE" UBYTE CU_V2GRXMSGSVCDISCSVCSCOPE[26] 1 100 0.0 255.0 ECU_ADDRESS 0x700180ba BYTE_ORDER MSB_LAST /end MEASUREMENT
/begin COMPU_METHOD CU_V2GRXMSGSVCDISCSVCSCOPE[26] "Conversion method for V2gRxMsgSvcDiscSvcScope[26]" RAT_FUNC "%10.0" "1" COEFFS 0.000000 1.000000 -0.000000 0.000000 0.000000 1.000000 /end COMPU_METHOD
/* Scalar measurable for DDE 'V2gRxMsgSvcDiscSvcScope[27]'. */
/begin MEASUREMENT V2gRxMsgSvcDiscSvcScope[27] "The arbitrated Service Scope parameter in the received message from EVSE" UBYTE CU_V2GRXMSGSVCDISCSVCSCOPE[27] 1 100 0.0 255.0 ECU_ADDRESS 0x700180bb BYTE_ORDER MSB_LAST /end MEASUREMENT
/begin COMPU_METHOD CU_V2GRXMSGSVCDISCSVCSCOPE[27] "Conversion method for V2gRxMsgSvcDiscSvcScope[27]" RAT_FUNC "%10.0" "1" COEFFS 0.000000 1.000000 -0.000000 0.000000 0.000000 1.000000 /end COMPU_METHOD
/* Scalar measurable for DDE 'V2gRxMsgSvcDiscSvcScope[28]'. */
/begin MEASUREMENT V2gRxMsgSvcDiscSvcScope[28] "The arbitrated Service Scope parameter in the received message from EVSE" UBYTE CU_V2GRXMSGSVCDISCSVCSCOPE[28] 1 100 0.0 255.0 ECU_ADDRESS 0x700180bc BYTE_ORDER MSB_LAST /end MEASUREMENT
/begin COMPU_METHOD CU_V2GRXMSGSVCDISCSVCSCOPE[28] "Conversion method for V2gRxMsgSvcDiscSvcScope[28]" RAT_FUNC "%10.0" "1" COEFFS 0.000000 1.000000 -0.000000 0.000000 0.000000 1.000000 /end COMPU_METHOD
/* Scalar measurable for DDE 'V2gRxMsgSvcDiscSvcScope[29]'. */
/begin MEASUREMENT V2gRxMsgSvcDiscSvcScope[29] "The arbitrated Service Scope parameter in the received message from EVSE" UBYTE CU_V2GRXMSGSVCDISCSVCSCOPE[29] 1 100 0.0 255.0 ECU_ADDRESS 0x700180bd BYTE_ORDER MSB_LAST /end MEASUREMENT
/begin COMPU_METHOD CU_V2GRXMSGSVCDISCSVCSCOPE[29] "Conversion method for V2gRxMsgSvcDiscSvcScope[29]" RAT_FUNC "%10.0" "1" COEFFS 0.000000 1.000000 -0.000000 0.000000 0.000000 1.000000 /end COMPU_METHOD
/* Scalar measurable for DDE 'V2gRxMsgSvcDiscSvcScope[2]'. */
/begin MEASUREMENT V2gRxMsgSvcDiscSvcScope[2] "The arbitrated Service Scope parameter in the received message from EVSE" UBYTE CU_V2GRXMSGSVCDISCSVCSCOPE[2] 1 100 0.0 255.0 ECU_ADDRESS 0x700180a2 BYTE_ORDER MSB_LAST /end MEASUREMENT
/begin COMPU_METHOD CU_V2GRXMSGSVCDISCSVCSCOPE[2] "Conversion method for V2gRxMsgSvcDiscSvcScope[2]" RAT_FUNC "%10.0" "1" COEFFS 0.000000 1.000000 -0.000000 0.000000 0.000000 1.000000 /end COMPU_METHOD
/* Scalar measurable for DDE 'V2gRxMsgSvcDiscSvcScope[30]'. */
/begin MEASUREMENT V2gRxMsgSvcDiscSvcScope[30] "The arbitrated Service Scope parameter in the received message from EVSE" UBYTE CU_V2GRXMSGSVCDISCSVCSCOPE[30] 1 100 0.0 255.0 ECU_ADDRESS 0x700180be BYTE_ORDER MSB_LAST /end MEASUREMENT
/begin COMPU_METHOD CU_V2GRXMSGSVCDISCSVCSCOPE[30] "Conversion method for V2gRxMsgSvcDiscSvcScope[30]" RAT_FUNC "%10.0" "1" COEFFS 0.000000 1.000000 -0.000000 0.000000 0.000000 1.000000 /end COMPU_METHOD
/* Scalar measurable for DDE 'V2gRxMsgSvcDiscSvcScope[31]'. */
/begin MEASUREMENT V2gRxMsgSvcDiscSvcScope[31] "The arbitrated Service Scope parameter in the received message from EVSE" UBYTE CU_V2GRXMSGSVCDISCSVCSCOPE[31] 1 100 0.0 255.0 ECU_ADDRESS 0x700180bf BYTE_ORDER MSB_LAST /end MEASUREMENT
/begin COMPU_METHOD CU_V2GRXMSGSVCDISCSVCSCOPE[31] "Conversion method for V2gRxMsgSvcDiscSvcScope[31]" RAT_FUNC "%10.0" "1" COEFFS 0.000000 1.000000 -0.000000 0.000000 0.000000 1.000000 /end COMPU_METHOD
/* Scalar measurable for DDE 'V2gRxMsgSvcDiscSvcScope[32]'. */
/begin MEASUREMENT V2gRxMsgSvcDiscSvcScope[32] "The arbitrated Service Scope parameter in the received message from EVSE" UBYTE CU_V2GRXMSGSVCDISCSVCSCOPE[32] 1 100 0.0 255.0 ECU_ADDRESS 0x700180c0 BYTE_ORDER MSB_LAST /end MEASUREMENT
/begin COMPU_METHOD CU_V2GRXMSGSVCDISCSVCSCOPE[32] "Conversion method for V2gRxMsgSvcDiscSvcScope[32]" RAT_FUNC "%10.0" "1" COEFFS 0.000000 1.000000 -0.000000 0.000000 0.000000 1.000000 /end COMPU_METHOD
/* Scalar measurable for DDE 'V2gRxMsgSvcDiscSvcScope[33]'. */
/begin MEASUREMENT V2gRxMsgSvcDiscSvcScope[33] "The arbitrated Service Scope parameter in the received message from EVSE" UBYTE CU_V2GRXMSGSVCDISCSVCSCOPE[33] 1 100 0.0 255.0 ECU_ADDRESS 0x700180c1 BYTE_ORDER MSB_LAST /end MEASUREMENT
/begin COMPU_METHOD CU_V2GRXMSGSVCDISCSVCSCOPE[33] "Conversion method for V2gRxMsgSvcDiscSvcScope[33]" RAT_FUNC "%10.0" "1" COEFFS 0.000000 1.000000 -0.000000 0.000000 0.000000 1.000000 /end COMPU_METHOD
/* Scalar measurable for DDE 'V2gRxMsgSvcDiscSvcScope[34]'. */
/begin MEASUREMENT V2gRxMsgSvcDiscSvcScope[34] "The arbitrated Service Scope parameter in the received message from EVSE" UBYTE CU_V2GRXMSGSVCDISCSVCSCOPE[34] 1 100 0.0 255.0 ECU_ADDRESS 0x700180c2 BYTE_ORDER MSB_LAST /end MEASUREMENT
/begin COMPU_METHOD CU_V2GRXMSGSVCDISCSVCSCOPE[34] "Conversion method for V2gRxMsgSvcDiscSvcScope[34]" RAT_FUNC "%10.0" "1" COEFFS 0.000000 1.000000 -0.000000 0.000000 0.000000 1.000000 /end COMPU_METHOD
/* Scalar measurable for DDE 'V2gRxMsgSvcDiscSvcScope[35]'. */
/begin MEASUREMENT V2gRxMsgSvcDiscSvcScope[35] "The arbitrated Service Scope parameter in the received message from EVSE" UBYTE CU_V2GRXMSGSVCDISCSVCSCOPE[35] 1 100 0.0 255.0 ECU_ADDRESS 0x700180c3 BYTE_ORDER MSB_LAST /end MEASUREMENT
/begin COMPU_METHOD CU_V2GRXMSGSVCDISCSVCSCOPE[35] "Conversion method for V2gRxMsgSvcDiscSvcScope[35]" RAT_FUNC "%10.0" "1" COEFFS 0.000000 1.000000 -0.000000 0.000000 0.000000 1.000000 /end COMPU_METHOD
/* Scalar measurable for DDE 'V2gRxMsgSvcDiscSvcScope[36]'. */
/begin MEASUREMENT V2gRxMsgSvcDiscSvcScope[36] "The arbitrated Service Scope parameter in the received message from EVSE" UBYTE CU_V2GRXMSGSVCDISCSVCSCOPE[36] 1 100 0.0 255.0 ECU_ADDRESS 0x700180c4 BYTE_ORDER MSB_LAST /end MEASUREMENT
/begin COMPU_METHOD CU_V2GRXMSGSVCDISCSVCSCOPE[36] "Conversion method for V2gRxMsgSvcDiscSvcScope[36]" RAT_FUNC "%10.0" "1" COEFFS 0.000000 1.000000 -0.000000 0.000000 0.000000 1.000000 /end COMPU_METHOD
/* Scalar measurable for DDE 'V2gRxMsgSvcDiscSvcScope[37]'. */
/begin MEASUREMENT V2gRxMsgSvcDiscSvcScope[37] "The arbitrated Service Scope parameter in the received message from EVSE" UBYTE CU_V2GRXMSGSVCDISCSVCSCOPE[37] 1 100 0.0 255.0 ECU_ADDRESS 0x700180c5 BYTE_ORDER MSB_LAST /end MEASUREMENT
/begin COMPU_METHOD CU_V2GRXMSGSVCDISCSVCSCOPE[37] "Conversion method for V2gRxMsgSvcDiscSvcScope[37]" RAT_FUNC "%10.0" "1" COEFFS 0.000000 1.000000 -0.000000 0.000000 0.000000 1.000000 /end COMPU_METHOD
/* Scalar measurable for DDE 'V2gRxMsgSvcDiscSvcScope[38]'. */
/begin MEASUREMENT V2gRxMsgSvcDiscSvcScope[38] "The arbitrated Service Scope parameter in the received message from EVSE" UBYTE CU_V2GRXMSGSVCDISCSVCSCOPE[38] 1 100 0.0 255.0 ECU_ADDRESS 0x700180c6 BYTE_ORDER MSB_LAST /end MEASUREMENT
/begin COMPU_METHOD CU_V2GRXMSGSVCDISCSVCSCOPE[38] "Conversion method for V2gRxMsgSvcDiscSvcScope[38]" RAT_FUNC "%10.0" "1" COEFFS 0.000000 1.000000 -0.000000 0.000000 0.000000 1.000000 /end COMPU_METHOD
/* Scalar measurable for DDE 'V2gRxMsgSvcDiscSvcScope[39]'. */
/begin MEASUREMENT V2gRxMsgSvcDiscSvcScope[39] "The arbitrated Service Scope parameter in the received message from EVSE" UBYTE CU_V2GRXMSGSVCDISCSVCSCOPE[39] 1 100 0.0 255.0 ECU_ADDRESS 0x700180c7 BYTE_ORDER MSB_LAST /end MEASUREMENT
/begin COMPU_METHOD CU_V2GRXMSGSVCDISCSVCSCOPE[39] "Conversion method for V2gRxMsgSvcDiscSvcScope[39]" RAT_FUNC "%10.0" "1" COEFFS 0.000000 1.000000 -0.000000 0.000000 0.000000 1.000000 /end COMPU_METHOD
/* Scalar measurable for DDE 'V2gRxMsgSvcDiscSvcScope[3]'. */
/begin MEASUREMENT V2gRxMsgSvcDiscSvcScope[3] "The arbitrated Service Scope parameter in the received message from EVSE" UBYTE CU_V2GRXMSGSVCDISCSVCSCOPE[3] 1 100 0.0 255.0 ECU_ADDRESS 0x700180a3 BYTE_ORDER MSB_LAST /end MEASUREMENT
/begin COMPU_METHOD CU_V2GRXMSGSVCDISCSVCSCOPE[3] "Conversion method for V2gRxMsgSvcDiscSvcScope[3]" RAT_FUNC "%10.0" "1" COEFFS 0.000000 1.000000 -0.000000 0.000000 0.000000 1.000000 /end COMPU_METHOD
/* Scalar measurable for DDE 'V2gRxMsgSvcDiscSvcScope[40]'. */
/begin MEASUREMENT V2gRxMsgSvcDiscSvcScope[40] "The arbitrated Service Scope parameter in the received message from EVSE" UBYTE CU_V2GRXMSGSVCDISCSVCSCOPE[40] 1 100 0.0 255.0 ECU_ADDRESS 0x700180c8 BYTE_ORDER MSB_LAST /end MEASUREMENT
/begin COMPU_METHOD CU_V2GRXMSGSVCDISCSVCSCOPE[40] "Conversion method for V2gRxMsgSvcDiscSvcScope[40]" RAT_FUNC "%10.0" "1" COEFFS 0.000000 1.000000 -0.000000 0.000000 0.000000 1.000000 /end COMPU_METHOD
/* Scalar measurable for DDE 'V2gRxMsgSvcDiscSvcScope[41]'. */
/begin MEASUREMENT V2gRxMsgSvcDiscSvcScope[41] "The arbitrated Service Scope parameter in the received message from EVSE" UBYTE CU_V2GRXMSGSVCDISCSVCSCOPE[41] 1 100 0.0 255.0 ECU_ADDRESS 0x700180c9 BYTE_ORDER MSB_LAST /end MEASUREMENT
/begin COMPU_METHOD CU_V2GRXMSGSVCDISCSVCSCOPE[41] "Conversion method for V2gRxMsgSvcDiscSvcScope[41]" RAT_FUNC "%10.0" "1" COEFFS 0.000000 1.000000 -0.000000 0.000000 0.000000 1.000000 /end COMPU_METHOD
/* Scalar measurable for DDE 'V2gRxMsgSvcDiscSvcScope[42]'. */
/begin MEASUREMENT V2gRxMsgSvcDiscSvcScope[42] "The arbitrated Service Scope parameter in the received message from EVSE" UBYTE CU_V2GRXMSGSVCDISCSVCSCOPE[42] 1 100 0.0 255.0 ECU_ADDRESS 0x700180ca BYTE_ORDER MSB_LAST /end MEASUREMENT
/begin COMPU_METHOD CU_V2GRXMSGSVCDISCSVCSCOPE[42] "Conversion method for V2gRxMsgSvcDiscSvcScope[42]" RAT_FUNC "%10.0" "1" COEFFS 0.000000 1.000000 -0.000000 0.000000 0.000000 1.000000 /end COMPU_METHOD
/* Scalar measurable for DDE 'V2gRxMsgSvcDiscSvcScope[43]'. */
/begin MEASUREMENT V2gRxMsgSvcDiscSvcScope[43] "The arbitrated Service Scope parameter in the received message from EVSE" UBYTE CU_V2GRXMSGSVCDISCSVCSCOPE[43] 1 100 0.0 255.0 ECU_ADDRESS 0x700180cb BYTE_ORDER MSB_LAST /end MEASUREMENT
/begin COMPU_METHOD CU_V2GRXMSGSVCDISCSVCSCOPE[43] "Conversion method for V2gRxMsgSvcDiscSvcScope[43]" RAT_FUNC "%10.0" "1" COEFFS 0.000000 1.000000 -0.000000 0.000000 0.000000 1.000000 /end COMPU_METHOD
/* Scalar measurable for DDE 'V2gRxMsgSvcDiscSvcScope[44]'. */
/begin MEASUREMENT V2gRxMsgSvcDiscSvcScope[44] "The arbitrated Service Scope parameter in the received message from EVSE" UBYTE CU_V2GRXMSGSVCDISCSVCSCOPE[44] 1 100 0.0 255.0 ECU_ADDRESS 0x700180cc BYTE_ORDER MSB_LAST /end MEASUREMENT
/begin COMPU_METHOD CU_V2GRXMSGSVCDISCSVCSCOPE[44] "Conversion method for V2gRxMsgSvcDiscSvcScope[44]" RAT_FUNC "%10.0" "1" COEFFS 0.000000 1.000000 -0.000000 0.000000 0.000000 1.000000 /end COMPU_METHOD
/* Scalar measurable for DDE 'V2gRxMsgSvcDiscSvcScope[45]'. */
/begin MEASUREMENT V2gRxMsgSvcDiscSvcScope[45] "The arbitrated Service Scope parameter in the received message from EVSE" UBYTE CU_V2GRXMSGSVCDISCSVCSCOPE[45] 1 100 0.0 255.0 ECU_ADDRESS 0x700180cd BYTE_ORDER MSB_LAST /end MEASUREMENT
/begin COMPU_METHOD CU_V2GRXMSGSVCDISCSVCSCOPE[45] "Conversion method for V2gRxMsgSvcDiscSvcScope[45]" RAT_FUNC "%10.0" "1" COEFFS 0.000000 1.000000 -0.000000 0.000000 0.000000 1.000000 /end COMPU_METHOD
/* Scalar measurable for DDE 'V2gRxMsgSvcDiscSvcScope[46]'. */
/begin MEASUREMENT V2gRxMsgSvcDiscSvcScope[46] "The arbitrated Service Scope parameter in the received message from EVSE" UBYTE CU_V2GRXMSGSVCDISCSVCSCOPE[46] 1 100 0.0 255.0 ECU_ADDRESS 0x700180ce BYTE_ORDER MSB_LAST /end MEASUREMENT
/begin COMPU_METHOD CU_V2GRXMSGSVCDISCSVCSCOPE[46] "Conversion method for V2gRxMsgSvcDiscSvcScope[46]" RAT_FUNC "%10.0" "1" COEFFS 0.000000 1.000000 -0.000000 0.000000 0.000000 1.000000 /end COMPU_METHOD
/* Scalar measurable for DDE 'V2gRxMsgSvcDiscSvcScope[47]'. */
/begin MEASUREMENT V2gRxMsgSvcDiscSvcScope[47] "The arbitrated Service Scope parameter in the received message from EVSE" UBYTE CU_V2GRXMSGSVCDISCSVCSCOPE[47] 1 100 0.0 255.0 ECU_ADDRESS 0x700180cf BYTE_ORDER MSB_LAST /end MEASUREMENT
/begin COMPU_METHOD CU_V2GRXMSGSVCDISCSVCSCOPE[47] "Conversion method for V2gRxMsgSvcDiscSvcScope[47]" RAT_FUNC "%10.0" "1" COEFFS 0.000000 1.000000 -0.000000 0.000000 0.000000 1.000000 /end COMPU_METHOD
/* Scalar measurable for DDE 'V2gRxMsgSvcDiscSvcScope[48]'. */
/begin MEASUREMENT V2gRxMsgSvcDiscSvcScope[48] "The arbitrated Service Scope parameter in the received message from EVSE" UBYTE CU_V2GRXMSGSVCDISCSVCSCOPE[48] 1 100 0.0 255.0 ECU_ADDRESS 0x700180d0 BYTE_ORDER MSB_LAST /end MEASUREMENT
/begin COMPU_METHOD CU_V2GRXMSGSVCDISCSVCSCOPE[48] "Conversion method for V2gRxMsgSvcDiscSvcScope[48]" RAT_FUNC "%10.0" "1" COEFFS 0.000000 1.000000 -0.000000 0.000000 0.000000 1.000000 /end COMPU_METHOD
/* Scalar measurable for DDE 'V2gRxMsgSvcDiscSvcScope[49]'. */
/begin MEASUREMENT V2gRxMsgSvcDiscSvcScope[49] "The arbitrated Service Scope parameter in the received message from EVSE" UBYTE CU_V2GRXMSGSVCDISCSVCSCOPE[49] 1 100 0.0 255.0 ECU_ADDRESS 0x700180d1 BYTE_ORDER MSB_LAST /end MEASUREMENT
/begin COMPU_METHOD CU_V2GRXMSGSVCDISCSVCSCOPE[49] "Conversion method for V2gRxMsgSvcDiscSvcScope[49]" RAT_FUNC "%10.0" "1" COEFFS 0.000000 1.000000 -0.000000 0.000000 0.000000 1.000000 /end COMPU_METHOD
/* Scalar measurable for DDE 'V2gRxMsgSvcDiscSvcScope[4]'. */
/begin MEASUREMENT V2gRxMsgSvcDiscSvcScope[4] "The arbitrated Service Scope parameter in the received message from EVSE" UBYTE CU_V2GRXMSGSVCDISCSVCSCOPE[4] 1 100 0.0 255.0 ECU_ADDRESS 0x700180a4 BYTE_ORDER MSB_LAST /end MEASUREMENT
/begin COMPU_METHOD CU_V2GRXMSGSVCDISCSVCSCOPE[4] "Conversion method for V2gRxMsgSvcDiscSvcScope[4]" RAT_FUNC "%10.0" "1" COEFFS 0.000000 1.000000 -0.000000 0.000000 0.000000 1.000000 /end COMPU_METHOD
/* Scalar measurable for DDE 'V2gRxMsgSvcDiscSvcScope[50]'. */
/begin MEASUREMENT V2gRxMsgSvcDiscSvcScope[50] "The arbitrated Service Scope parameter in the received message from EVSE" UBYTE CU_V2GRXMSGSVCDISCSVCSCOPE[50] 1 100 0.0 255.0 ECU_ADDRESS 0x700180d2 BYTE_ORDER MSB_LAST /end MEASUREMENT
/begin COMPU_METHOD CU_V2GRXMSGSVCDISCSVCSCOPE[50] "Conversion method for V2gRxMsgSvcDiscSvcScope[50]" RAT_FUNC "%10.0" "1" COEFFS 0.000000 1.000000 -0.000000 0.000000 0.000000 1.000000 /end COMPU_METHOD
/* Scalar measurable for DDE 'V2gRxMsgSvcDiscSvcScope[51]'. */
/begin MEASUREMENT V2gRxMsgSvcDiscSvcScope[51] "The arbitrated Service Scope parameter in the received message from EVSE" UBYTE CU_V2GRXMSGSVCDISCSVCSCOPE[51] 1 100 0.0 255.0 ECU_ADDRESS 0x700180d3 BYTE_ORDER MSB_LAST /end MEASUREMENT
/begin COMPU_METHOD CU_V2GRXMSGSVCDISCSVCSCOPE[51] "Conversion method for V2gRxMsgSvcDiscSvcScope[51]" RAT_FUNC "%10.0" "1" COEFFS 0.000000 1.000000 -0.000000 0.000000 0.000000 1.000000 /end COMPU_METHOD
/* Scalar measurable for DDE 'V2gRxMsgSvcDiscSvcScope[52]'. */
/begin MEASUREMENT V2gRxMsgSvcDiscSvcScope[52] "The arbitrated Service Scope parameter in the received message from EVSE" UBYTE CU_V2GRXMSGSVCDISCSVCSCOPE[52] 1 100 0.0 255.0 ECU_ADDRESS 0x700180d4 BYTE_ORDER MSB_LAST /end MEASUREMENT
/begin COMPU_METHOD CU_V2GRXMSGSVCDISCSVCSCOPE[52] "Conversion method for V2gRxMsgSvcDiscSvcScope[52]" RAT_FUNC "%10.0" "1" COEFFS 0.000000 1.000000 -0.000000 0.000000 0.000000 1.000000 /end COMPU_METHOD
/* Scalar measurable for DDE 'V2gRxMsgSvcDiscSvcScope[53]'. */
/begin MEASUREMENT V2gRxMsgSvcDiscSvcScope[53] "The arbitrated Service Scope parameter in the received message from EVSE" UBYTE CU_V2GRXMSGSVCDISCSVCSCOPE[53] 1 100 0.0 255.0 ECU_ADDRESS 0x700180d5 BYTE_ORDER MSB_LAST /end MEASUREMENT
/begin COMPU_METHOD CU_V2GRXMSGSVCDISCSVCSCOPE[53] "Conversion method for V2gRxMsgSvcDiscSvcScope[53]" RAT_FUNC "%10.0" "1" COEFFS 0.000000 1.000000 -0.000000 0.000000 0.000000 1.000000 /end COMPU_METHOD
/* Scalar measurable for DDE 'V2gRxMsgSvcDiscSvcScope[54]'. */
/begin MEASUREMENT V2gRxMsgSvcDiscSvcScope[54] "The arbitrated Service Scope parameter in the received message from EVSE" UBYTE CU_V2GRXMSGSVCDISCSVCSCOPE[54] 1 100 0.0 255.0 ECU_ADDRESS 0x700180d6 BYTE_ORDER MSB_LAST /end MEASUREMENT
/begin COMPU_METHOD CU_V2GRXMSGSVCDISCSVCSCOPE[54] "Conversion method for V2gRxMsgSvcDiscSvcScope[54]" RAT_FUNC "%10.0" "1" COEFFS 0.000000 1.000000 -0.000000 0.000000 0.000000 1.000000 /end COMPU_METHOD
/* Scalar measurable for DDE 'V2gRxMsgSvcDiscSvcScope[55]'. */
/begin MEASUREMENT V2gRxMsgSvcDiscSvcScope[55] "The arbitrated Service Scope parameter in the received message from EVSE" UBYTE CU_V2GRXMSGSVCDISCSVCSCOPE[55] 1 100 0.0 255.0 ECU_ADDRESS 0x700180d7 BYTE_ORDER MSB_LAST /end MEASUREMENT
/begin COMPU_METHOD CU_V2GRXMSGSVCDISCSVCSCOPE[55] "Conversion method for V2gRxMsgSvcDiscSvcScope[55]" RAT_FUNC "%10.0" "1" COEFFS 0.000000 1.000000 -0.000000 0.000000 0.000000 1.000000 /end COMPU_METHOD
/* Scalar measurable for DDE 'V2gRxMsgSvcDiscSvcScope[56]'. */
/begin MEASUREMENT V2gRxMsgSvcDiscSvcScope[56] "The arbitrated Service Scope parameter in the received message from EVSE" UBYTE CU_V2GRXMSGSVCDISCSVCSCOPE[56] 1 100 0.0 255.0 ECU_ADDRESS 0x700180d8 BYTE_ORDER MSB_LAST /end MEASUREMENT
/begin COMPU_METHOD CU_V2GRXMSGSVCDISCSVCSCOPE[56] "Conversion method for V2gRxMsgSvcDiscSvcScope[56]" RAT_FUNC "%10.0" "1" COEFFS 0.000000 1.000000 -0.000000 0.000000 0.000000 1.000000 /end COMPU_METHOD
/* Scalar measurable for DDE 'V2gRxMsgSvcDiscSvcScope[57]'. */
/begin MEASUREMENT V2gRxMsgSvcDiscSvcScope[57] "The arbitrated Service Scope parameter in the received message from EVSE" UBYTE CU_V2GRXMSGSVCDISCSVCSCOPE[57] 1 100 0.0 255.0 ECU_ADDRESS 0x700180d9 BYTE_ORDER MSB_LAST /end MEASUREMENT
/begin COMPU_METHOD CU_V2GRXMSGSVCDISCSVCSCOPE[57] "Conversion method for V2gRxMsgSvcDiscSvcScope[57]" RAT_FUNC "%10.0" "1" COEFFS 0.000000 1.000000 -0.000000 0.000000 0.000000 1.000000 /end COMPU_METHOD
/* Scalar measurable for DDE 'V2gRxMsgSvcDiscSvcScope[58]'. */
/begin MEASUREMENT V2gRxMsgSvcDiscSvcScope[58] "The arbitrated Service Scope parameter in the received message from EVSE" UBYTE CU_V2GRXMSGSVCDISCSVCSCOPE[58] 1 100 0.0 255.0 ECU_ADDRESS 0x700180da BYTE_ORDER MSB_LAST /end MEASUREMENT
/begin COMPU_METHOD CU_V2GRXMSGSVCDISCSVCSCOPE[58] "Conversion method for V2gRxMsgSvcDiscSvcScope[58]" RAT_FUNC "%10.0" "1" COEFFS 0.000000 1.000000 -0.000000 0.000000 0.000000 1.000000 /end COMPU_METHOD
/* Scalar measurable for DDE 'V2gRxMsgSvcDiscSvcScope[59]'. */
/begin MEASUREMENT V2gRxMsgSvcDiscSvcScope[59] "The arbitrated Service Scope parameter in the received message from EVSE" UBYTE CU_V2GRXMSGSVCDISCSVCSCOPE[59] 1 100 0.0 255.0 ECU_ADDRESS 0x700180db BYTE_ORDER MSB_LAST /end MEASUREMENT
/begin COMPU_METHOD CU_V2GRXMSGSVCDISCSVCSCOPE[59] "Conversion method for V2gRxMsgSvcDiscSvcScope[59]" RAT_FUNC "%10.0" "1" COEFFS 0.000000 1.000000 -0.000000 0.000000 0.000000 1.000000 /end COMPU_METHOD
/* Scalar measurable for DDE 'V2gRxMsgSvcDiscSvcScope[5]'. */
/begin MEASUREMENT V2gRxMsgSvcDiscSvcScope[5] "The arbitrated Service Scope parameter in the received message from EVSE" UBYTE CU_V2GRXMSGSVCDISCSVCSCOPE[5] 1 100 0.0 255.0 ECU_ADDRESS 0x700180a5 BYTE_ORDER MSB_LAST /end MEASUREMENT
/begin COMPU_METHOD CU_V2GRXMSGSVCDISCSVCSCOPE[5] "Conversion method for V2gRxMsgSvcDiscSvcScope[5]" RAT_FUNC "%10.0" "1" COEFFS 0.000000 1.000000 -0.000000 0.000000 0.000000 1.000000 /end COMPU_METHOD
/* Scalar measurable for DDE 'V2gRxMsgSvcDiscSvcScope[60]'. */
/begin MEASUREMENT V2gRxMsgSvcDiscSvcScope[60] "The arbitrated Service Scope parameter in the received message from EVSE" UBYTE CU_V2GRXMSGSVCDISCSVCSCOPE[60] 1 100 0.0 255.0 ECU_ADDRESS 0x700180dc BYTE_ORDER MSB_LAST /end MEASUREMENT
/begin COMPU_METHOD CU_V2GRXMSGSVCDISCSVCSCOPE[60] "Conversion method for V2gRxMsgSvcDiscSvcScope[60]" RAT_FUNC "%10.0" "1" COEFFS 0.000000 1.000000 -0.000000 0.000000 0.000000 1.000000 /end COMPU_METHOD
/* Scalar measurable for DDE 'V2gRxMsgSvcDiscSvcScope[61]'. */
/begin MEASUREMENT V2gRxMsgSvcDiscSvcScope[61] "The arbitrated Service Scope parameter in the received message from EVSE" UBYTE CU_V2GRXMSGSVCDISCSVCSCOPE[61] 1 100 0.0 255.0 ECU_ADDRESS 0x700180dd BYTE_ORDER MSB_LAST /end MEASUREMENT
/begin COMPU_METHOD CU_V2GRXMSGSVCDISCSVCSCOPE[61] "Conversion method for V2gRxMsgSvcDiscSvcScope[61]" RAT_FUNC "%10.0" "1" COEFFS 0.000000 1.000000 -0.000000 0.000000 0.000000 1.000000 /end COMPU_METHOD
/* Scalar measurable for DDE 'V2gRxMsgSvcDiscSvcScope[62]'. */
/begin MEASUREMENT V2gRxMsgSvcDiscSvcScope[62] "The arbitrated Service Scope parameter in the received message from EVSE" UBYTE CU_V2GRXMSGSVCDISCSVCSCOPE[62] 1 100 0.0 255.0 ECU_ADDRESS 0x700180de BYTE_ORDER MSB_LAST /end MEASUREMENT
/begin COMPU_METHOD CU_V2GRXMSGSVCDISCSVCSCOPE[62] "Conversion method for V2gRxMsgSvcDiscSvcScope[62]" RAT_FUNC "%10.0" "1" COEFFS 0.000000 1.000000 -0.000000 0.000000 0.000000 1.000000 /end COMPU_METHOD
/* Scalar measurable for DDE 'V2gRxMsgSvcDiscSvcScope[63]'. */
/begin MEASUREMENT V2gRxMsgSvcDiscSvcScope[63] "The arbitrated Service Scope parameter in the received message from EVSE" UBYTE CU_V2GRXMSGSVCDISCSVCSCOPE[63] 1 100 0.0 255.0 ECU_ADDRESS 0x700180df BYTE_ORDER MSB_LAST /end MEASUREMENT
/begin COMPU_METHOD CU_V2GRXMSGSVCDISCSVCSCOPE[63] "Conversion method for V2gRxMsgSvcDiscSvcScope[63]" RAT_FUNC "%10.0" "1" COEFFS 0.000000 1.000000 -0.000000 0.000000 0.000000 1.000000 /end COMPU_METHOD
/* Scalar measurable for DDE 'V2gRxMsgSvcDiscSvcScope[64]'. */
/begin MEASUREMENT V2gRxMsgSvcDiscSvcScope[64] "The arbitrated Service Scope parameter in the received message from EVSE" UBYTE CU_V2GRXMSGSVCDISCSVCSCOPE[64] 1 100 0.0 255.0 ECU_ADDRESS 0x700180e0 BYTE_ORDER MSB_LAST /end MEASUREMENT
/begin COMPU_METHOD CU_V2GRXMSGSVCDISCSVCSCOPE[64] "Conversion method for V2gRxMsgSvcDiscSvcScope[64]" RAT_FUNC "%10.0" "1" COEFFS 0.000000 1.000000 -0.000000 0.000000 0.000000 1.000000 /end COMPU_METHOD
/* Scalar measurable for DDE 'V2gRxMsgSvcDiscSvcScope[6]'. */
/begin MEASUREMENT V2gRxMsgSvcDiscSvcScope[6] "The arbitrated Service Scope parameter in the received message from EVSE" UBYTE CU_V2GRXMSGSVCDISCSVCSCOPE[6] 1 100 0.0 255.0 ECU_ADDRESS 0x700180a6 BYTE_ORDER MSB_LAST /end MEASUREMENT
/begin COMPU_METHOD CU_V2GRXMSGSVCDISCSVCSCOPE[6] "Conversion method for V2gRxMsgSvcDiscSvcScope[6]" RAT_FUNC "%10.0" "1" COEFFS 0.000000 1.000000 -0.000000 0.000000 0.000000 1.000000 /end COMPU_METHOD
/* Scalar measurable for DDE 'V2gRxMsgSvcDiscSvcScope[7]'. */
/begin MEASUREMENT V2gRxMsgSvcDiscSvcScope[7] "The arbitrated Service Scope parameter in the received message from EVSE" UBYTE CU_V2GRXMSGSVCDISCSVCSCOPE[7] 1 100 0.0 255.0 ECU_ADDRESS 0x700180a7 BYTE_ORDER MSB_LAST /end MEASUREMENT
/begin COMPU_METHOD CU_V2GRXMSGSVCDISCSVCSCOPE[7] "Conversion method for V2gRxMsgSvcDiscSvcScope[7]" RAT_FUNC "%10.0" "1" COEFFS 0.000000 1.000000 -0.000000 0.000000 0.000000 1.000000 /end COMPU_METHOD
/* Scalar measurable for DDE 'V2gRxMsgSvcDiscSvcScope[8]'. */
/begin MEASUREMENT V2gRxMsgSvcDiscSvcScope[8] "The arbitrated Service Scope parameter in the received message from EVSE" UBYTE CU_V2GRXMSGSVCDISCSVCSCOPE[8] 1 100 0.0 255.0 ECU_ADDRESS 0x700180a8 BYTE_ORDER MSB_LAST /end MEASUREMENT
/begin COMPU_METHOD CU_V2GRXMSGSVCDISCSVCSCOPE[8] "Conversion method for V2gRxMsgSvcDiscSvcScope[8]" RAT_FUNC "%10.0" "1" COEFFS 0.000000 1.000000 -0.000000 0.000000 0.000000 1.000000 /end COMPU_METHOD
/* Scalar measurable for DDE 'V2gRxMsgSvcDiscSvcScope[9]'. */
/begin MEASUREMENT V2gRxMsgSvcDiscSvcScope[9] "The arbitrated Service Scope parameter in the received message from EVSE" UBYTE CU_V2GRXMSGSVCDISCSVCSCOPE[9] 1 100 0.0 255.0 ECU_ADDRESS 0x700180a9 BYTE_ORDER MSB_LAST /end MEASUREMENT
/begin COMPU_METHOD CU_V2GRXMSGSVCDISCSVCSCOPE[9] "Conversion method for V2gRxMsgSvcDiscSvcScope[9]" RAT_FUNC "%10.0" "1" COEFFS 0.000000 1.000000 -0.000000 0.000000 0.000000 1.000000 /end COMPU_METHOD
/* Scalar measurable for DDE 'V2gRxMsgSvcDiscTrg'. */
/begin MEASUREMENT V2gRxMsgSvcDiscTrg "Trigger falg that on a rising edge indicates the event for receiving the PLC (V2G) message response 2b from EVSE" UBYTE CU_V2GRXMSGSVCDISCTRG 1 100 0.0 1.0 ECU_ADDRESS 0x70017e38 BYTE_ORDER MSB_LAST /end MEASUREMENT
/begin COMPU_METHOD CU_V2GRXMSGSVCDISCTRG "Conversion method for V2gRxMsgSvcDiscTrg" RAT_FUNC "%10.0" "b" COEFFS 0.000000 1.000000 -0.000000 0.000000 0.000000 1.000000 /end COMPU_METHOD
/* Scalar measurable for DDE 'V2gRxMsgSvcDiscVasListFreeSvc[0]'. */
/begin MEASUREMENT V2gRxMsgSvcDiscVasListFreeSvc[0 "The arbitrated VAS List IDs Free Service parameter in the received message from EVSE" UBYTE CU_V2GRXMSGSVCDISCVASLISTFREES0 1 100 0.0 1.0 ECU_ADDRESS 0x70018168 BYTE_ORDER MSB_LAST /end MEASUREMENT
/begin COMPU_METHOD CU_V2GRXMSGSVCDISCVASLISTFREES0 "Conversion method for V2gRxMsgSvcDiscVasListFreeSvc[0]" RAT_FUNC "%10.0" "b" COEFFS 0.000000 1.000000 -0.000000 0.000000 0.000000 1.000000 /end COMPU_METHOD
/* Scalar measurable for DDE 'V2gRxMsgSvcDiscVasListFreeSvc[1]'. */
/begin MEASUREMENT V2gRxMsgSvcDiscVasListFreeSvc[1 "The arbitrated VAS List IDs Free Service parameter in the received message from EVSE" UBYTE CU_V2GRXMSGSVCDISCVASLISTFREES1 1 100 0.0 1.0 ECU_ADDRESS 0x70018169 BYTE_ORDER MSB_LAST /end MEASUREMENT
/begin COMPU_METHOD CU_V2GRXMSGSVCDISCVASLISTFREES1 "Conversion method for V2gRxMsgSvcDiscVasListFreeSvc[1]" RAT_FUNC "%10.0" "b" COEFFS 0.000000 1.000000 -0.000000 0.000000 0.000000 1.000000 /end COMPU_METHOD
/* Scalar measurable for DDE 'V2gRxMsgSvcDiscVasListFreeSvc[2]'. */
/begin MEASUREMENT V2gRxMsgSvcDiscVasListFreeSvc[6 "The arbitrated VAS List IDs Free Service parameter in the received message from EVSE" UBYTE CU_V2GRXMSGSVCDISCVASLISTFREES6 1 100 0.0 1.0 ECU_ADDRESS 0x7001816a BYTE_ORDER MSB_LAST /end MEASUREMENT
/begin COMPU_METHOD CU_V2GRXMSGSVCDISCVASLISTFREES6 "Conversion method for V2gRxMsgSvcDiscVasListFreeSvc[2]" RAT_FUNC "%10.0" "b" COEFFS 0.000000 1.000000 -0.000000 0.000000 0.000000 1.000000 /end COMPU_METHOD
/* Scalar measurable for DDE 'V2gRxMsgSvcDiscVasListFreeSvc[3]'. */
/begin MEASUREMENT V2gRxMsgSvcDiscVasListFreeSvc[7 "The arbitrated VAS List IDs Free Service parameter in the received message from EVSE" UBYTE CU_V2GRXMSGSVCDISCVASLISTFREES7 1 100 0.0 1.0 ECU_ADDRESS 0x7001816b BYTE_ORDER MSB_LAST /end MEASUREMENT
/begin COMPU_METHOD CU_V2GRXMSGSVCDISCVASLISTFREES7 "Conversion method for V2gRxMsgSvcDiscVasListFreeSvc[3]" RAT_FUNC "%10.0" "b" COEFFS 0.000000 1.000000 -0.000000 0.000000 0.000000 1.000000 /end COMPU_METHOD
/* Scalar measurable for DDE 'V2gRxMsgSvcDiscVasListFreeSvc[4]'. */
/begin MEASUREMENT V2gRxMsgSvcDiscVasListFreeSvc[4 "The arbitrated VAS List IDs Free Service parameter in the received message from EVSE" UBYTE CU_V2GRXMSGSVCDISCVASLISTFREES4 1 100 0.0 1.0 ECU_ADDRESS 0x7001816c BYTE_ORDER MSB_LAST /end MEASUREMENT
/begin COMPU_METHOD CU_V2GRXMSGSVCDISCVASLISTFREES4 "Conversion method for V2gRxMsgSvcDiscVasListFreeSvc[4]" RAT_FUNC "%10.0" "b" COEFFS 0.000000 1.000000 -0.000000 0.000000 0.000000 1.000000 /end COMPU_METHOD
/* Scalar measurable for DDE 'V2gRxMsgSvcDiscVasListFreeSvc[5]'. */
/begin MEASUREMENT V2gRxMsgSvcDiscVasListFreeSvc[5 "The arbitrated VAS List IDs Free Service parameter in the received message from EVSE" UBYTE CU_V2GRXMSGSVCDISCVASLISTFREES5 1 100 0.0 1.0 ECU_ADDRESS 0x7001816d BYTE_ORDER MSB_LAST /end MEASUREMENT
/begin COMPU_METHOD CU_V2GRXMSGSVCDISCVASLISTFREES5 "Conversion method for V2gRxMsgSvcDiscVasListFreeSvc[5]" RAT_FUNC "%10.0" "b" COEFFS 0.000000 1.000000 -0.000000 0.000000 0.000000 1.000000 /end COMPU_METHOD
/* Scalar measurable for DDE 'V2gRxMsgSvcDiscVasListFreeSvc[6]'. */
/begin MEASUREMENT V2gRxMsgSvcDiscVasListFreeSvc[2 "The arbitrated VAS List IDs Free Service parameter in the received message from EVSE" UBYTE CU_V2GRXMSGSVCDISCVASLISTFREES2 1 100 0.0 1.0 ECU_ADDRESS 0x7001816e BYTE_ORDER MSB_LAST /end MEASUREMENT
/begin COMPU_METHOD CU_V2GRXMSGSVCDISCVASLISTFREES2 "Conversion method for V2gRxMsgSvcDiscVasListFreeSvc[6]" RAT_FUNC "%10.0" "b" COEFFS 0.000000 1.000000 -0.000000 0.000000 0.000000 1.000000 /end COMPU_METHOD
/* Scalar measurable for DDE 'V2gRxMsgSvcDiscVasListFreeSvc[7]'. */
/begin MEASUREMENT V2gRxMsgSvcDiscVasListFreeSvc[3 "The arbitrated VAS List IDs Free Service parameter in the received message from EVSE" UBYTE CU_V2GRXMSGSVCDISCVASLISTFREES3 1 100 0.0 1.0 ECU_ADDRESS 0x7001816f BYTE_ORDER MSB_LAST /end MEASUREMENT
/begin COMPU_METHOD CU_V2GRXMSGSVCDISCVASLISTFREES3 "Conversion method for V2gRxMsgSvcDiscVasListFreeSvc[7]" RAT_FUNC "%10.0" "b" COEFFS 0.000000 1.000000 -0.000000 0.000000 0.000000 1.000000 /end COMPU_METHOD
/* Scalar measurable for DDE 'V2gRxMsgSvcDiscVasListIds[0]'. */
/begin MEASUREMENT V2gRxMsgSvcDiscVasListIds[0] "The arbitrated VAS List IDs parameter in the received message from EVSE" UWORD CU_V2GRXMSGSVCDISCVASLISTIDS[0] 1 100 0.0 65535.0 ECU_ADDRESS 0x7001832a BYTE_ORDER MSB_LAST /end MEASUREMENT
/begin COMPU_METHOD CU_V2GRXMSGSVCDISCVASLISTIDS[0] "Conversion method for V2gRxMsgSvcDiscVasListIds[0]" RAT_FUNC "%10.0" "1" COEFFS 0.000000 1.000000 -0.000000 0.000000 0.000000 1.000000 /end COMPU_METHOD
/* Scalar measurable for DDE 'V2gRxMsgSvcDiscVasListIds[1]'. */
/begin MEASUREMENT V2gRxMsgSvcDiscVasListIds[1] "The arbitrated VAS List IDs parameter in the received message from EVSE" UWORD CU_V2GRXMSGSVCDISCVASLISTIDS[1] 1 100 0.0 65535.0 ECU_ADDRESS 0x7001832c BYTE_ORDER MSB_LAST /end MEASUREMENT
/begin COMPU_METHOD CU_V2GRXMSGSVCDISCVASLISTIDS[1] "Conversion method for V2gRxMsgSvcDiscVasListIds[1]" RAT_FUNC "%10.0" "1" COEFFS 0.000000 1.000000 -0.000000 0.000000 0.000000 1.000000 /end COMPU_METHOD
/* Scalar measurable for DDE 'V2gRxMsgSvcDiscVasListIds[2]'. */
/begin MEASUREMENT V2gRxMsgSvcDiscVasListIds[2] "The arbitrated VAS List IDs parameter in the received message from EVSE" UWORD CU_V2GRXMSGSVCDISCVASLISTIDS[2] 1 100 0.0 65535.0 ECU_ADDRESS 0x7001832e BYTE_ORDER MSB_LAST /end MEASUREMENT
/begin COMPU_METHOD CU_V2GRXMSGSVCDISCVASLISTIDS[2] "Conversion method for V2gRxMsgSvcDiscVasListIds[2]" RAT_FUNC "%10.0" "1" COEFFS 0.000000 1.000000 -0.000000 0.000000 0.000000 1.000000 /end COMPU_METHOD
/* Scalar measurable for DDE 'V2gRxMsgSvcDiscVasListIds[3]'. */
/begin MEASUREMENT V2gRxMsgSvcDiscVasListIds[3] "The arbitrated VAS List IDs parameter in the received message from EVSE" UWORD CU_V2GRXMSGSVCDISCVASLISTIDS[3] 1 100 0.0 65535.0 ECU_ADDRESS 0x70018330 BYTE_ORDER MSB_LAST /end MEASUREMENT
/begin COMPU_METHOD CU_V2GRXMSGSVCDISCVASLISTIDS[3] "Conversion method for V2gRxMsgSvcDiscVasListIds[3]" RAT_FUNC "%10.0" "1" COEFFS 0.000000 1.000000 -0.000000 0.000000 0.000000 1.000000 /end COMPU_METHOD
/* Scalar measurable for DDE 'V2gRxMsgSvcDiscVasListIds[4]'. */
/begin MEASUREMENT V2gRxMsgSvcDiscVasListIds[4] "The arbitrated VAS List IDs parameter in the received message from EVSE" UWORD CU_V2GRXMSGSVCDISCVASLISTIDS[4] 1 100 0.0 65535.0 ECU_ADDRESS 0x70018332 BYTE_ORDER MSB_LAST /end MEASUREMENT
/begin COMPU_METHOD CU_V2GRXMSGSVCDISCVASLISTIDS[4] "Conversion method for V2gRxMsgSvcDiscVasListIds[4]" RAT_FUNC "%10.0" "1" COEFFS 0.000000 1.000000 -0.000000 0.000000 0.000000 1.000000 /end COMPU_METHOD
/* Scalar measurable for DDE 'V2gRxMsgSvcDiscVasListIds[5]'. */
/begin MEASUREMENT V2gRxMsgSvcDiscVasListIds[5] "The arbitrated VAS List IDs parameter in the received message from EVSE" UWORD CU_V2GRXMSGSVCDISCVASLISTIDS[5] 1 100 0.0 65535.0 ECU_ADDRESS 0x70018334 BYTE_ORDER MSB_LAST /end MEASUREMENT
/begin COMPU_METHOD CU_V2GRXMSGSVCDISCVASLISTIDS[5] "Conversion method for V2gRxMsgSvcDiscVasListIds[5]" RAT_FUNC "%10.0" "1" COEFFS 0.000000 1.000000 -0.000000 0.000000 0.000000 1.000000 /end COMPU_METHOD
/* Scalar measurable for DDE 'V2gRxMsgSvcDiscVasListIds[6]'. */
/begin MEASUREMENT V2gRxMsgSvcDiscVasListIds[6] "The arbitrated VAS List IDs parameter in the received message from EVSE" UWORD CU_V2GRXMSGSVCDISCVASLISTIDS[6] 1 100 0.0 65535.0 ECU_ADDRESS 0x70018336 BYTE_ORDER MSB_LAST /end MEASUREMENT
/begin COMPU_METHOD CU_V2GRXMSGSVCDISCVASLISTIDS[6] "Conversion method for V2gRxMsgSvcDiscVasListIds[6]" RAT_FUNC "%10.0" "1" COEFFS 0.000000 1.000000 -0.000000 0.000000 0.000000 1.000000 /end COMPU_METHOD
/* Scalar measurable for DDE 'V2gRxMsgSvcDiscVasListIds[7]'. */
/begin MEASUREMENT V2gRxMsgSvcDiscVasListIds[7] "The arbitrated VAS List IDs parameter in the received message from EVSE" UWORD CU_V2GRXMSGSVCDISCVASLISTIDS[7] 1 100 0.0 65535.0 ECU_ADDRESS 0x70018338 BYTE_ORDER MSB_LAST /end MEASUREMENT
/begin COMPU_METHOD CU_V2GRXMSGSVCDISCVASLISTIDS[7] "Conversion method for V2gRxMsgSvcDiscVasListIds[7]" RAT_FUNC "%10.0" "1" COEFFS 0.000000 1.000000 -0.000000 0.000000 0.000000 1.000000 /end COMPU_METHOD
/* Scalar measurable for DDE 'V2gRxMsgSvcDiscVasListLen'. */
/begin MEASUREMENT V2gRxMsgSvcDiscVasListLen "The arbitrated Transfer Service IDs Length parameter in the received message from EVSE" UBYTE CU_V2GRXMSGSVCDISCVASLISTLEN 1 100 0.0 255.0 ECU_ADDRESS 0x70017eea BYTE_ORDER MSB_LAST /end MEASUREMENT
/begin COMPU_METHOD CU_V2GRXMSGSVCDISCVASLISTLEN "Conversion method for V2gRxMsgSvcDiscVasListLen" RAT_FUNC "%10.0" "1" COEFFS 0.000000 1.000000 -0.000000 0.000000 0.000000 1.000000 /end COMPU_METHOD
/* Scalar measurable for DDE 'V2gRxMsgWeldDetEvseStatus'. */
/begin MEASUREMENT V2gRxMsgWeldDetEvseStatus "Indicates the internal state of the EVSE." SLONG CU_V2GRXMSGWELDDETEVSESTATUS 1 100 -2147483648.0 2147483647.0 ECU_ADDRESS 0x700182d8 BYTE_ORDER MSB_LAST /end MEASUREMENT
/begin COMPU_METHOD CU_V2GRXMSGWELDDETEVSESTATUS "Conversion method for V2gRxMsgWeldDetEvseStatus" TAB_VERB "%12.0" "enum" COMPU_TAB_REF CT_V2GRXMSGWELDDETEVSESTATUS /end COMPU_METHOD
/begin COMPU_VTAB CT_V2GRXMSGWELDDETEVSESTATUS "Conversion method for V2gRxMsgWeldDetEvseStatus" TAB_VERB 12 0 "EVSE_NOT_READY" 1 "EVSE_READY" 2 "EVSE_SHUTDOWN" 3 "EVSE_UTILITY_INTERRUPT" 4 "EVSE_ISOLATION_MONITOR_ACTV" 5 "EVSE_EMERGENCY_SHUTDOWN" 6 "EVSE_MALFUNCTION" 7 "EVSE_STATUS_RESERVED1" 8 "EVSE_STATUS_RESERVED2" 9 "EVSE_STATUS_RESERVED3" 10 "EVSE_STATUS_RESERVED4" 11 "EVSE_STATUS_RESERVED5" /end COMPU_VTAB
/* Scalar measurable for DDE 'V2gRxMsgWeldDetEvseVoltage'. */
/begin MEASUREMENT V2gRxMsgWeldDetEvseVoltage "Present voltage of EVSE" FLOAT32_IEEE CU_V2GRXMSGWELDDETEVSEVOLTAGE 1 100 0.0 196605.0 ECU_ADDRESS 0x70017ee0 BYTE_ORDER MSB_LAST /end MEASUREMENT
/begin COMPU_METHOD CU_V2GRXMSGWELDDETEVSEVOLTAGE "Conversion method for V2gRxMsgWeldDetEvseVoltage" RAT_FUNC "%10.0" "V" COEFFS 0.000000 1.000000 -0.000000 0.000000 0.000000 1.000000 /end COMPU_METHOD
/* Scalar measurable for DDE 'V2gRxMsgWeldDetIsolStatus'. */
/begin MEASUREMENT V2gRxMsgWeldDetIsolStatus "Indicates the isolation condition" SLONG CU_V2GRXMSGWELDDETISOLSTATUS 1 100 -2147483648.0 2147483647.0 ECU_ADDRESS 0x7001830c BYTE_ORDER MSB_LAST /end MEASUREMENT
/begin COMPU_METHOD CU_V2GRXMSGWELDDETISOLSTATUS "Conversion method for V2gRxMsgWeldDetIsolStatus" TAB_VERB "%12.0" "enum" COMPU_TAB_REF CT_V2GRXMSGWELDDETISOLSTATUS /end COMPU_METHOD
/begin COMPU_VTAB CT_V2GRXMSGWELDDETISOLSTATUS "Conversion method for V2gRxMsgWeldDetIsolStatus" TAB_VERB 4 0 "ISOLATION_INVALID" 1 "ISOLATION_VALID" 2 "ISOLATION_WARNING" 3 "ISOLATION_FAULT" /end COMPU_VTAB
/* Scalar measurable for DDE 'V2gRxMsgWeldDetIsolStatus_flg'. */
/begin MEASUREMENT V2gRxMsgWeldDetIsolStatus_flg "Identifies the presence of the EVSEIsolationStatus parameter." UBYTE CU_V2GRXMSGWELDDETISOLSTATUS_F0 1 100 0.0 1.0 ECU_ADDRESS 0x70018340 BYTE_ORDER MSB_LAST /end MEASUREMENT
/begin COMPU_METHOD CU_V2GRXMSGWELDDETISOLSTATUS_F0 "Conversion method for V2gRxMsgWeldDetIsolStatus_flg" RAT_FUNC "%10.0" "b" COEFFS 0.000000 1.000000 -0.000000 0.000000 0.000000 1.000000 /end COMPU_METHOD
/* Scalar measurable for DDE 'V2gRxMsgWeldDetNotif'. */
/begin MEASUREMENT V2gRxMsgWeldDetNotif "The arbitrated Notification Max Delay parameter in the received message from EVSE" SLONG CU_V2GRXMSGWELDDETNOTIF 1 100 -2147483648.0 2147483647.0 ECU_ADDRESS 0x70017d44 BYTE_ORDER MSB_LAST /end MEASUREMENT
/begin COMPU_METHOD CU_V2GRXMSGWELDDETNOTIF "Conversion method for V2gRxMsgWeldDetNotif" TAB_VERB "%12.0" "1" COMPU_TAB_REF CT_V2GRXMSGWELDDETNOTIF /end COMPU_METHOD
/begin COMPU_VTAB CT_V2GRXMSGWELDDETNOTIF "Conversion method for V2gRxMsgWeldDetNotif" TAB_VERB 3 0 "NONE" 1 "STOPCHARGING" 2 "RENEGOTIATION" /end COMPU_VTAB
/* Scalar measurable for DDE 'V2gRxMsgWeldDetNotifFlg'. */
/begin MEASUREMENT V2gRxMsgWeldDetNotifFlg "The arbitrated Notification parameter in the received message from EVSE" UBYTE CU_V2GRXMSGWELDDETNOTIFFLG 1 100 0.0 1.0 ECU_ADDRESS 0x70017ce6 BYTE_ORDER MSB_LAST /end MEASUREMENT
/begin COMPU_METHOD CU_V2GRXMSGWELDDETNOTIFFLG "Conversion method for V2gRxMsgWeldDetNotifFlg" RAT_FUNC "%10.0" "b" COEFFS 0.000000 1.000000 -0.000000 0.000000 0.000000 1.000000 /end COMPU_METHOD
/* Scalar measurable for DDE 'V2gRxMsgWeldDetNotifMaxDelay'. */
/begin MEASUREMENT V2gRxMsgWeldDetNotifMaxDelay "The arbitrated Notification Max Delay parameter in the received message from EVSE" UWORD CU_V2GRXMSGWELDDETNOTIFMAXDELAY 1 100 0.0 65535.0 ECU_ADDRESS 0x70017eb0 BYTE_ORDER MSB_LAST /end MEASUREMENT
/begin COMPU_METHOD CU_V2GRXMSGWELDDETNOTIFMAXDELAY "Conversion method for V2gRxMsgWeldDetNotifMaxDelay" RAT_FUNC "%10.0" "s" COEFFS 0.000000 1.000000 -0.000000 0.000000 0.000000 1.000000 /end COMPU_METHOD
/* Scalar measurable for DDE 'V2gRxMsgWeldDetRescode'. */
/begin MEASUREMENT V2gRxMsgWeldDetRescode "for message 9b: indicates the acknowledgment status of  this V2G messages received by the SECC." UBYTE CU_V2GRXMSGWELDDETRESCODE 1 100 0.0 255.0 ECU_ADDRESS 0x70017d51 BYTE_ORDER MSB_LAST /end MEASUREMENT
/begin COMPU_METHOD CU_V2GRXMSGWELDDETRESCODE "Conversion method for V2gRxMsgWeldDetRescode" RAT_FUNC "%10.0" "1" COEFFS 0.000000 1.000000 -0.000000 0.000000 0.000000 1.000000 /end COMPU_METHOD
/* Scalar measurable for DDE 'V2gRxMsgWeldDetTrg'. */
/begin MEASUREMENT V2gRxMsgWeldDetTrg "Trigger falg that on a rising edge indicates the event for receiving the PLC (V2G) message response 9b from EVSE" UBYTE CU_V2GRXMSGWELDDETTRG 1 100 0.0 1.0 ECU_ADDRESS 0x70017c21 BYTE_ORDER MSB_LAST /end MEASUREMENT
/begin COMPU_METHOD CU_V2GRXMSGWELDDETTRG "Conversion method for V2gRxMsgWeldDetTrg" RAT_FUNC "%10.0" "b" COEFFS 0.000000 1.000000 -0.000000 0.000000 0.000000 1.000000 /end COMPU_METHOD
/* Scalar measurable for DDE 'V2gRxSigCrntLimReached'. */
/begin MEASUREMENT V2gRxSigCrntLimReached "If set to TRUE, the EVSE has reached its current limit." UBYTE CU_V2GRXSIGCRNTLIMREACHED 1 100 0.0 1.0 ECU_ADDRESS 0x70017d49 BYTE_ORDER MSB_LAST /end MEASUREMENT
/begin COMPU_METHOD CU_V2GRXSIGCRNTLIMREACHED "Conversion method for V2gRxSigCrntLimReached" RAT_FUNC "%10.0" "b" COEFFS 0.000000 1.000000 -0.000000 0.000000 0.000000 1.000000 /end COMPU_METHOD
/* Scalar measurable for DDE 'V2gRxSigEvseCurrent'. */
/begin MEASUREMENT V2gRxSigEvseCurrent "Present current of EVSE" FLOAT32_IEEE CU_V2GRXSIGEVSECURRENT 1 100 -32768000.0 32767000.0 ECU_ADDRESS 0x700181f4 BYTE_ORDER MSB_LAST /end MEASUREMENT
/begin COMPU_METHOD CU_V2GRXSIGEVSECURRENT "Conversion method for V2gRxSigEvseCurrent" RAT_FUNC "%10.0" "A" COEFFS 0.000000 1.000000 -0.000000 0.000000 0.000000 1.000000 /end COMPU_METHOD
/* Scalar measurable for DDE 'V2gRxSigEvseIdLen'. */
/begin MEASUREMENT V2gRxSigEvseIdLen "Number of bytes in EVSE ID" UBYTE CU_V2GRXSIGEVSEIDLEN 1 100 0.0 37.0 ECU_ADDRESS 0x70017c20 BYTE_ORDER MSB_LAST /end MEASUREMENT
/begin COMPU_METHOD CU_V2GRXSIGEVSEIDLEN "Conversion method for V2gRxSigEvseIdLen" RAT_FUNC "%10.0" "1" COEFFS 0.000000 1.000000 -0.000000 0.000000 0.000000 1.000000 /end COMPU_METHOD
/* Scalar measurable for DDE 'V2gRxSigEvseId[0]'. */
/begin MEASUREMENT V2gRxSigEvseId[0] "The ID that uniquely identifies the EVSE. Format is defined in DIN SPEC 91286" UBYTE CU_V2GRXSIGEVSEID[0] 1 100 0.0 255.0 ECU_ADDRESS 0x70018400 BYTE_ORDER MSB_LAST /end MEASUREMENT
/begin COMPU_METHOD CU_V2GRXSIGEVSEID[0] "Conversion method for V2gRxSigEvseId[0]" RAT_FUNC "%10.0" "1" COEFFS 0.000000 1.000000 -0.000000 0.000000 0.000000 1.000000 /end COMPU_METHOD
/* Scalar measurable for DDE 'V2gRxSigEvseId[10]'. */
/begin MEASUREMENT V2gRxSigEvseId[10] "The ID that uniquely identifies the EVSE. Format is defined in DIN SPEC 91286" UBYTE CU_V2GRXSIGEVSEID[10] 1 100 0.0 255.0 ECU_ADDRESS 0x7001840a BYTE_ORDER MSB_LAST /end MEASUREMENT
/begin COMPU_METHOD CU_V2GRXSIGEVSEID[10] "Conversion method for V2gRxSigEvseId[10]" RAT_FUNC "%10.0" "1" COEFFS 0.000000 1.000000 -0.000000 0.000000 0.000000 1.000000 /end COMPU_METHOD
/* Scalar measurable for DDE 'V2gRxSigEvseId[11]'. */
/begin MEASUREMENT V2gRxSigEvseId[11] "The ID that uniquely identifies the EVSE. Format is defined in DIN SPEC 91286" UBYTE CU_V2GRXSIGEVSEID[11] 1 100 0.0 255.0 ECU_ADDRESS 0x7001840b BYTE_ORDER MSB_LAST /end MEASUREMENT
/begin COMPU_METHOD CU_V2GRXSIGEVSEID[11] "Conversion method for V2gRxSigEvseId[11]" RAT_FUNC "%10.0" "1" COEFFS 0.000000 1.000000 -0.000000 0.000000 0.000000 1.000000 /end COMPU_METHOD
/* Scalar measurable for DDE 'V2gRxSigEvseId[12]'. */
/begin MEASUREMENT V2gRxSigEvseId[12] "The ID that uniquely identifies the EVSE. Format is defined in DIN SPEC 91286" UBYTE CU_V2GRXSIGEVSEID[12] 1 100 0.0 255.0 ECU_ADDRESS 0x7001840c BYTE_ORDER MSB_LAST /end MEASUREMENT
/begin COMPU_METHOD CU_V2GRXSIGEVSEID[12] "Conversion method for V2gRxSigEvseId[12]" RAT_FUNC "%10.0" "1" COEFFS 0.000000 1.000000 -0.000000 0.000000 0.000000 1.000000 /end COMPU_METHOD
/* Scalar measurable for DDE 'V2gRxSigEvseId[13]'. */
/begin MEASUREMENT V2gRxSigEvseId[13] "The ID that uniquely identifies the EVSE. Format is defined in DIN SPEC 91286" UBYTE CU_V2GRXSIGEVSEID[13] 1 100 0.0 255.0 ECU_ADDRESS 0x7001840d BYTE_ORDER MSB_LAST /end MEASUREMENT
/begin COMPU_METHOD CU_V2GRXSIGEVSEID[13] "Conversion method for V2gRxSigEvseId[13]" RAT_FUNC "%10.0" "1" COEFFS 0.000000 1.000000 -0.000000 0.000000 0.000000 1.000000 /end COMPU_METHOD
/* Scalar measurable for DDE 'V2gRxSigEvseId[14]'. */
/begin MEASUREMENT V2gRxSigEvseId[14] "The ID that uniquely identifies the EVSE. Format is defined in DIN SPEC 91286" UBYTE CU_V2GRXSIGEVSEID[14] 1 100 0.0 255.0 ECU_ADDRESS 0x7001840e BYTE_ORDER MSB_LAST /end MEASUREMENT
/begin COMPU_METHOD CU_V2GRXSIGEVSEID[14] "Conversion method for V2gRxSigEvseId[14]" RAT_FUNC "%10.0" "1" COEFFS 0.000000 1.000000 -0.000000 0.000000 0.000000 1.000000 /end COMPU_METHOD
/* Scalar measurable for DDE 'V2gRxSigEvseId[15]'. */
/begin MEASUREMENT V2gRxSigEvseId[15] "The ID that uniquely identifies the EVSE. Format is defined in DIN SPEC 91286" UBYTE CU_V2GRXSIGEVSEID[15] 1 100 0.0 255.0 ECU_ADDRESS 0x7001840f BYTE_ORDER MSB_LAST /end MEASUREMENT
/begin COMPU_METHOD CU_V2GRXSIGEVSEID[15] "Conversion method for V2gRxSigEvseId[15]" RAT_FUNC "%10.0" "1" COEFFS 0.000000 1.000000 -0.000000 0.000000 0.000000 1.000000 /end COMPU_METHOD
/* Scalar measurable for DDE 'V2gRxSigEvseId[16]'. */
/begin MEASUREMENT V2gRxSigEvseId[16] "The ID that uniquely identifies the EVSE. Format is defined in DIN SPEC 91286" UBYTE CU_V2GRXSIGEVSEID[16] 1 100 0.0 255.0 ECU_ADDRESS 0x70018410 BYTE_ORDER MSB_LAST /end MEASUREMENT
/begin COMPU_METHOD CU_V2GRXSIGEVSEID[16] "Conversion method for V2gRxSigEvseId[16]" RAT_FUNC "%10.0" "1" COEFFS 0.000000 1.000000 -0.000000 0.000000 0.000000 1.000000 /end COMPU_METHOD
/* Scalar measurable for DDE 'V2gRxSigEvseId[17]'. */
/begin MEASUREMENT V2gRxSigEvseId[17] "The ID that uniquely identifies the EVSE. Format is defined in DIN SPEC 91286" UBYTE CU_V2GRXSIGEVSEID[17] 1 100 0.0 255.0 ECU_ADDRESS 0x70018411 BYTE_ORDER MSB_LAST /end MEASUREMENT
/begin COMPU_METHOD CU_V2GRXSIGEVSEID[17] "Conversion method for V2gRxSigEvseId[17]" RAT_FUNC "%10.0" "1" COEFFS 0.000000 1.000000 -0.000000 0.000000 0.000000 1.000000 /end COMPU_METHOD
/* Scalar measurable for DDE 'V2gRxSigEvseId[18]'. */
/begin MEASUREMENT V2gRxSigEvseId[18] "The ID that uniquely identifies the EVSE. Format is defined in DIN SPEC 91286" UBYTE CU_V2GRXSIGEVSEID[18] 1 100 0.0 255.0 ECU_ADDRESS 0x70018412 BYTE_ORDER MSB_LAST /end MEASUREMENT
/begin COMPU_METHOD CU_V2GRXSIGEVSEID[18] "Conversion method for V2gRxSigEvseId[18]" RAT_FUNC "%10.0" "1" COEFFS 0.000000 1.000000 -0.000000 0.000000 0.000000 1.000000 /end COMPU_METHOD
/* Scalar measurable for DDE 'V2gRxSigEvseId[19]'. */
/begin MEASUREMENT V2gRxSigEvseId[19] "The ID that uniquely identifies the EVSE. Format is defined in DIN SPEC 91286" UBYTE CU_V2GRXSIGEVSEID[19] 1 100 0.0 255.0 ECU_ADDRESS 0x70018413 BYTE_ORDER MSB_LAST /end MEASUREMENT
/begin COMPU_METHOD CU_V2GRXSIGEVSEID[19] "Conversion method for V2gRxSigEvseId[19]" RAT_FUNC "%10.0" "1" COEFFS 0.000000 1.000000 -0.000000 0.000000 0.000000 1.000000 /end COMPU_METHOD
/* Scalar measurable for DDE 'V2gRxSigEvseId[1]'. */
/begin MEASUREMENT V2gRxSigEvseId[1] "The ID that uniquely identifies the EVSE. Format is defined in DIN SPEC 91286" UBYTE CU_V2GRXSIGEVSEID[1] 1 100 0.0 255.0 ECU_ADDRESS 0x70018401 BYTE_ORDER MSB_LAST /end MEASUREMENT
/begin COMPU_METHOD CU_V2GRXSIGEVSEID[1] "Conversion method for V2gRxSigEvseId[1]" RAT_FUNC "%10.0" "1" COEFFS 0.000000 1.000000 -0.000000 0.000000 0.000000 1.000000 /end COMPU_METHOD
/* Scalar measurable for DDE 'V2gRxSigEvseId[20]'. */
/begin MEASUREMENT V2gRxSigEvseId[20] "The ID that uniquely identifies the EVSE. Format is defined in DIN SPEC 91286" UBYTE CU_V2GRXSIGEVSEID[20] 1 100 0.0 255.0 ECU_ADDRESS 0x70018414 BYTE_ORDER MSB_LAST /end MEASUREMENT
/begin COMPU_METHOD CU_V2GRXSIGEVSEID[20] "Conversion method for V2gRxSigEvseId[20]" RAT_FUNC "%10.0" "1" COEFFS 0.000000 1.000000 -0.000000 0.000000 0.000000 1.000000 /end COMPU_METHOD
/* Scalar measurable for DDE 'V2gRxSigEvseId[21]'. */
/begin MEASUREMENT V2gRxSigEvseId[21] "The ID that uniquely identifies the EVSE. Format is defined in DIN SPEC 91286" UBYTE CU_V2GRXSIGEVSEID[21] 1 100 0.0 255.0 ECU_ADDRESS 0x70018415 BYTE_ORDER MSB_LAST /end MEASUREMENT
/begin COMPU_METHOD CU_V2GRXSIGEVSEID[21] "Conversion method for V2gRxSigEvseId[21]" RAT_FUNC "%10.0" "1" COEFFS 0.000000 1.000000 -0.000000 0.000000 0.000000 1.000000 /end COMPU_METHOD
/* Scalar measurable for DDE 'V2gRxSigEvseId[22]'. */
/begin MEASUREMENT V2gRxSigEvseId[22] "The ID that uniquely identifies the EVSE. Format is defined in DIN SPEC 91286" UBYTE CU_V2GRXSIGEVSEID[22] 1 100 0.0 255.0 ECU_ADDRESS 0x70018416 BYTE_ORDER MSB_LAST /end MEASUREMENT
/begin COMPU_METHOD CU_V2GRXSIGEVSEID[22] "Conversion method for V2gRxSigEvseId[22]" RAT_FUNC "%10.0" "1" COEFFS 0.000000 1.000000 -0.000000 0.000000 0.000000 1.000000 /end COMPU_METHOD
/* Scalar measurable for DDE 'V2gRxSigEvseId[23]'. */
/begin MEASUREMENT V2gRxSigEvseId[23] "The ID that uniquely identifies the EVSE. Format is defined in DIN SPEC 91286" UBYTE CU_V2GRXSIGEVSEID[23] 1 100 0.0 255.0 ECU_ADDRESS 0x70018417 BYTE_ORDER MSB_LAST /end MEASUREMENT
/begin COMPU_METHOD CU_V2GRXSIGEVSEID[23] "Conversion method for V2gRxSigEvseId[23]" RAT_FUNC "%10.0" "1" COEFFS 0.000000 1.000000 -0.000000 0.000000 0.000000 1.000000 /end COMPU_METHOD
/* Scalar measurable for DDE 'V2gRxSigEvseId[24]'. */
/begin MEASUREMENT V2gRxSigEvseId[24] "The ID that uniquely identifies the EVSE. Format is defined in DIN SPEC 91286" UBYTE CU_V2GRXSIGEVSEID[24] 1 100 0.0 255.0 ECU_ADDRESS 0x70018418 BYTE_ORDER MSB_LAST /end MEASUREMENT
/begin COMPU_METHOD CU_V2GRXSIGEVSEID[24] "Conversion method for V2gRxSigEvseId[24]" RAT_FUNC "%10.0" "1" COEFFS 0.000000 1.000000 -0.000000 0.000000 0.000000 1.000000 /end COMPU_METHOD
/* Scalar measurable for DDE 'V2gRxSigEvseId[25]'. */
/begin MEASUREMENT V2gRxSigEvseId[25] "The ID that uniquely identifies the EVSE. Format is defined in DIN SPEC 91286" UBYTE CU_V2GRXSIGEVSEID[25] 1 100 0.0 255.0 ECU_ADDRESS 0x70018419 BYTE_ORDER MSB_LAST /end MEASUREMENT
/begin COMPU_METHOD CU_V2GRXSIGEVSEID[25] "Conversion method for V2gRxSigEvseId[25]" RAT_FUNC "%10.0" "1" COEFFS 0.000000 1.000000 -0.000000 0.000000 0.000000 1.000000 /end COMPU_METHOD
/* Scalar measurable for DDE 'V2gRxSigEvseId[26]'. */
/begin MEASUREMENT V2gRxSigEvseId[26] "The ID that uniquely identifies the EVSE. Format is defined in DIN SPEC 91286" UBYTE CU_V2GRXSIGEVSEID[26] 1 100 0.0 255.0 ECU_ADDRESS 0x7001841a BYTE_ORDER MSB_LAST /end MEASUREMENT
/begin COMPU_METHOD CU_V2GRXSIGEVSEID[26] "Conversion method for V2gRxSigEvseId[26]" RAT_FUNC "%10.0" "1" COEFFS 0.000000 1.000000 -0.000000 0.000000 0.000000 1.000000 /end COMPU_METHOD
/* Scalar measurable for DDE 'V2gRxSigEvseId[27]'. */
/begin MEASUREMENT V2gRxSigEvseId[27] "The ID that uniquely identifies the EVSE. Format is defined in DIN SPEC 91286" UBYTE CU_V2GRXSIGEVSEID[27] 1 100 0.0 255.0 ECU_ADDRESS 0x7001841b BYTE_ORDER MSB_LAST /end MEASUREMENT
/begin COMPU_METHOD CU_V2GRXSIGEVSEID[27] "Conversion method for V2gRxSigEvseId[27]" RAT_FUNC "%10.0" "1" COEFFS 0.000000 1.000000 -0.000000 0.000000 0.000000 1.000000 /end COMPU_METHOD
/* Scalar measurable for DDE 'V2gRxSigEvseId[28]'. */
/begin MEASUREMENT V2gRxSigEvseId[28] "The ID that uniquely identifies the EVSE. Format is defined in DIN SPEC 91286" UBYTE CU_V2GRXSIGEVSEID[28] 1 100 0.0 255.0 ECU_ADDRESS 0x7001841c BYTE_ORDER MSB_LAST /end MEASUREMENT
/begin COMPU_METHOD CU_V2GRXSIGEVSEID[28] "Conversion method for V2gRxSigEvseId[28]" RAT_FUNC "%10.0" "1" COEFFS 0.000000 1.000000 -0.000000 0.000000 0.000000 1.000000 /end COMPU_METHOD
/* Scalar measurable for DDE 'V2gRxSigEvseId[29]'. */
/begin MEASUREMENT V2gRxSigEvseId[29] "The ID that uniquely identifies the EVSE. Format is defined in DIN SPEC 91286" UBYTE CU_V2GRXSIGEVSEID[29] 1 100 0.0 255.0 ECU_ADDRESS 0x7001841d BYTE_ORDER MSB_LAST /end MEASUREMENT
/begin COMPU_METHOD CU_V2GRXSIGEVSEID[29] "Conversion method for V2gRxSigEvseId[29]" RAT_FUNC "%10.0" "1" COEFFS 0.000000 1.000000 -0.000000 0.000000 0.000000 1.000000 /end COMPU_METHOD
/* Scalar measurable for DDE 'V2gRxSigEvseId[2]'. */
/begin MEASUREMENT V2gRxSigEvseId[2] "The ID that uniquely identifies the EVSE. Format is defined in DIN SPEC 91286" UBYTE CU_V2GRXSIGEVSEID[2] 1 100 0.0 255.0 ECU_ADDRESS 0x70018402 BYTE_ORDER MSB_LAST /end MEASUREMENT
/begin COMPU_METHOD CU_V2GRXSIGEVSEID[2] "Conversion method for V2gRxSigEvseId[2]" RAT_FUNC "%10.0" "1" COEFFS 0.000000 1.000000 -0.000000 0.000000 0.000000 1.000000 /end COMPU_METHOD
/* Scalar measurable for DDE 'V2gRxSigEvseId[30]'. */
/begin MEASUREMENT V2gRxSigEvseId[30] "The ID that uniquely identifies the EVSE. Format is defined in DIN SPEC 91286" UBYTE CU_V2GRXSIGEVSEID[30] 1 100 0.0 255.0 ECU_ADDRESS 0x7001841e BYTE_ORDER MSB_LAST /end MEASUREMENT
/begin COMPU_METHOD CU_V2GRXSIGEVSEID[30] "Conversion method for V2gRxSigEvseId[30]" RAT_FUNC "%10.0" "1" COEFFS 0.000000 1.000000 -0.000000 0.000000 0.000000 1.000000 /end COMPU_METHOD
/* Scalar measurable for DDE 'V2gRxSigEvseId[31]'. */
/begin MEASUREMENT V2gRxSigEvseId[31] "The ID that uniquely identifies the EVSE. Format is defined in DIN SPEC 91286" UBYTE CU_V2GRXSIGEVSEID[31] 1 100 0.0 255.0 ECU_ADDRESS 0x7001841f BYTE_ORDER MSB_LAST /end MEASUREMENT
/begin COMPU_METHOD CU_V2GRXSIGEVSEID[31] "Conversion method for V2gRxSigEvseId[31]" RAT_FUNC "%10.0" "1" COEFFS 0.000000 1.000000 -0.000000 0.000000 0.000000 1.000000 /end COMPU_METHOD
/* Scalar measurable for DDE 'V2gRxSigEvseId[32]'. */
/begin MEASUREMENT V2gRxSigEvseId[32] "The ID that uniquely identifies the EVSE. Format is defined in DIN SPEC 91286" UBYTE CU_V2GRXSIGEVSEID[32] 1 100 0.0 255.0 ECU_ADDRESS 0x70018420 BYTE_ORDER MSB_LAST /end MEASUREMENT
/begin COMPU_METHOD CU_V2GRXSIGEVSEID[32] "Conversion method for V2gRxSigEvseId[32]" RAT_FUNC "%10.0" "1" COEFFS 0.000000 1.000000 -0.000000 0.000000 0.000000 1.000000 /end COMPU_METHOD
/* Scalar measurable for DDE 'V2gRxSigEvseId[33]'. */
/begin MEASUREMENT V2gRxSigEvseId[33] "The ID that uniquely identifies the EVSE. Format is defined in DIN SPEC 91286" UBYTE CU_V2GRXSIGEVSEID[33] 1 100 0.0 255.0 ECU_ADDRESS 0x70018421 BYTE_ORDER MSB_LAST /end MEASUREMENT
/begin COMPU_METHOD CU_V2GRXSIGEVSEID[33] "Conversion method for V2gRxSigEvseId[33]" RAT_FUNC "%10.0" "1" COEFFS 0.000000 1.000000 -0.000000 0.000000 0.000000 1.000000 /end COMPU_METHOD
/* Scalar measurable for DDE 'V2gRxSigEvseId[34]'. */
/begin MEASUREMENT V2gRxSigEvseId[34] "The ID that uniquely identifies the EVSE. Format is defined in DIN SPEC 91286" UBYTE CU_V2GRXSIGEVSEID[34] 1 100 0.0 255.0 ECU_ADDRESS 0x70018422 BYTE_ORDER MSB_LAST /end MEASUREMENT
/begin COMPU_METHOD CU_V2GRXSIGEVSEID[34] "Conversion method for V2gRxSigEvseId[34]" RAT_FUNC "%10.0" "1" COEFFS 0.000000 1.000000 -0.000000 0.000000 0.000000 1.000000 /end COMPU_METHOD
/* Scalar measurable for DDE 'V2gRxSigEvseId[35]'. */
/begin MEASUREMENT V2gRxSigEvseId[35] "The ID that uniquely identifies the EVSE. Format is defined in DIN SPEC 91286" UBYTE CU_V2GRXSIGEVSEID[35] 1 100 0.0 255.0 ECU_ADDRESS 0x70018423 BYTE_ORDER MSB_LAST /end MEASUREMENT
/begin COMPU_METHOD CU_V2GRXSIGEVSEID[35] "Conversion method for V2gRxSigEvseId[35]" RAT_FUNC "%10.0" "1" COEFFS 0.000000 1.000000 -0.000000 0.000000 0.000000 1.000000 /end COMPU_METHOD
/* Scalar measurable for DDE 'V2gRxSigEvseId[36]'. */
/begin MEASUREMENT V2gRxSigEvseId[36] "The ID that uniquely identifies the EVSE. Format is defined in DIN SPEC 91286" UBYTE CU_V2GRXSIGEVSEID[36] 1 100 0.0 255.0 ECU_ADDRESS 0x70018424 BYTE_ORDER MSB_LAST /end MEASUREMENT
/begin COMPU_METHOD CU_V2GRXSIGEVSEID[36] "Conversion method for V2gRxSigEvseId[36]" RAT_FUNC "%10.0" "1" COEFFS 0.000000 1.000000 -0.000000 0.000000 0.000000 1.000000 /end COMPU_METHOD
/* Scalar measurable for DDE 'V2gRxSigEvseId[37]'. */
/begin MEASUREMENT V2gRxSigEvseId[37] "The ID that uniquely identifies the EVSE. Format is defined in DIN SPEC 91286" UBYTE CU_V2GRXSIGEVSEID[37] 1 100 0.0 255.0 ECU_ADDRESS 0x70018425 BYTE_ORDER MSB_LAST /end MEASUREMENT
/begin COMPU_METHOD CU_V2GRXSIGEVSEID[37] "Conversion method for V2gRxSigEvseId[37]" RAT_FUNC "%10.0" "1" COEFFS 0.000000 1.000000 -0.000000 0.000000 0.000000 1.000000 /end COMPU_METHOD
/* Scalar measurable for DDE 'V2gRxSigEvseId[3]'. */
/begin MEASUREMENT V2gRxSigEvseId[3] "The ID that uniquely identifies the EVSE. Format is defined in DIN SPEC 91286" UBYTE CU_V2GRXSIGEVSEID[3] 1 100 0.0 255.0 ECU_ADDRESS 0x70018403 BYTE_ORDER MSB_LAST /end MEASUREMENT
/begin COMPU_METHOD CU_V2GRXSIGEVSEID[3] "Conversion method for V2gRxSigEvseId[3]" RAT_FUNC "%10.0" "1" COEFFS 0.000000 1.000000 -0.000000 0.000000 0.000000 1.000000 /end COMPU_METHOD
/* Scalar measurable for DDE 'V2gRxSigEvseId[4]'. */
/begin MEASUREMENT V2gRxSigEvseId[4] "The ID that uniquely identifies the EVSE. Format is defined in DIN SPEC 91286" UBYTE CU_V2GRXSIGEVSEID[4] 1 100 0.0 255.0 ECU_ADDRESS 0x70018404 BYTE_ORDER MSB_LAST /end MEASUREMENT
/begin COMPU_METHOD CU_V2GRXSIGEVSEID[4] "Conversion method for V2gRxSigEvseId[4]" RAT_FUNC "%10.0" "1" COEFFS 0.000000 1.000000 -0.000000 0.000000 0.000000 1.000000 /end COMPU_METHOD
/* Scalar measurable for DDE 'V2gRxSigEvseId[5]'. */
/begin MEASUREMENT V2gRxSigEvseId[5] "The ID that uniquely identifies the EVSE. Format is defined in DIN SPEC 91286" UBYTE CU_V2GRXSIGEVSEID[5] 1 100 0.0 255.0 ECU_ADDRESS 0x70018405 BYTE_ORDER MSB_LAST /end MEASUREMENT
/begin COMPU_METHOD CU_V2GRXSIGEVSEID[5] "Conversion method for V2gRxSigEvseId[5]" RAT_FUNC "%10.0" "1" COEFFS 0.000000 1.000000 -0.000000 0.000000 0.000000 1.000000 /end COMPU_METHOD
/* Scalar measurable for DDE 'V2gRxSigEvseId[6]'. */
/begin MEASUREMENT V2gRxSigEvseId[6] "The ID that uniquely identifies the EVSE. Format is defined in DIN SPEC 91286" UBYTE CU_V2GRXSIGEVSEID[6] 1 100 0.0 255.0 ECU_ADDRESS 0x70018406 BYTE_ORDER MSB_LAST /end MEASUREMENT
/begin COMPU_METHOD CU_V2GRXSIGEVSEID[6] "Conversion method for V2gRxSigEvseId[6]" RAT_FUNC "%10.0" "1" COEFFS 0.000000 1.000000 -0.000000 0.000000 0.000000 1.000000 /end COMPU_METHOD
/* Scalar measurable for DDE 'V2gRxSigEvseId[7]'. */
/begin MEASUREMENT V2gRxSigEvseId[7] "The ID that uniquely identifies the EVSE. Format is defined in DIN SPEC 91286" UBYTE CU_V2GRXSIGEVSEID[7] 1 100 0.0 255.0 ECU_ADDRESS 0x70018407 BYTE_ORDER MSB_LAST /end MEASUREMENT
/begin COMPU_METHOD CU_V2GRXSIGEVSEID[7] "Conversion method for V2gRxSigEvseId[7]" RAT_FUNC "%10.0" "1" COEFFS 0.000000 1.000000 -0.000000 0.000000 0.000000 1.000000 /end COMPU_METHOD
/* Scalar measurable for DDE 'V2gRxSigEvseId[8]'. */
/begin MEASUREMENT V2gRxSigEvseId[8] "The ID that uniquely identifies the EVSE. Format is defined in DIN SPEC 91286" UBYTE CU_V2GRXSIGEVSEID[8] 1 100 0.0 255.0 ECU_ADDRESS 0x70018408 BYTE_ORDER MSB_LAST /end MEASUREMENT
/begin COMPU_METHOD CU_V2GRXSIGEVSEID[8] "Conversion method for V2gRxSigEvseId[8]" RAT_FUNC "%10.0" "1" COEFFS 0.000000 1.000000 -0.000000 0.000000 0.000000 1.000000 /end COMPU_METHOD
/* Scalar measurable for DDE 'V2gRxSigEvseId[9]'. */
/begin MEASUREMENT V2gRxSigEvseId[9] "The ID that uniquely identifies the EVSE. Format is defined in DIN SPEC 91286" UBYTE CU_V2GRXSIGEVSEID[9] 1 100 0.0 255.0 ECU_ADDRESS 0x70018409 BYTE_ORDER MSB_LAST /end MEASUREMENT
/begin COMPU_METHOD CU_V2GRXSIGEVSEID[9] "Conversion method for V2gRxSigEvseId[9]" RAT_FUNC "%10.0" "1" COEFFS 0.000000 1.000000 -0.000000 0.000000 0.000000 1.000000 /end COMPU_METHOD
/* Scalar measurable for DDE 'V2gRxSigEvseMaxDchgCrnt'. */
/begin MEASUREMENT V2gRxSigEvseMaxDchgCrnt "Maximum discharge current the EVSE can deliver with the expected accuracy" FLOAT32_IEEE CU_V2GRXSIGEVSEMAXDCHGCRNT 1 100 -196604.0 0.0 ECU_ADDRESS 0x70018498 BYTE_ORDER MSB_LAST /end MEASUREMENT
/begin COMPU_METHOD CU_V2GRXSIGEVSEMAXDCHGCRNT "Conversion method for V2gRxSigEvseMaxDchgCrnt" RAT_FUNC "%10.0" "A" COEFFS 0.000000 1.000000 -0.000000 0.000000 0.000000 1.000000 /end COMPU_METHOD
/* Scalar measurable for DDE 'V2gRxSigEvseMaxDchgCrnt_flg'. */
/begin MEASUREMENT V2gRxSigEvseMaxDchgCrnt_flg "Indicates that the EVSE Maximum Discharge Current parameter is available." UBYTE CU_V2GRXSIGEVSEMAXDCHGCRNT_FLG1 1 100 0.0 1.0 ECU_ADDRESS 0x70018161 BYTE_ORDER MSB_LAST /end MEASUREMENT
/begin COMPU_METHOD CU_V2GRXSIGEVSEMAXDCHGCRNT_FLG1 "Conversion method for V2gRxSigEvseMaxDchgCrnt_flg" RAT_FUNC "%10.0" "b" COEFFS 0.000000 1.000000 -0.000000 0.000000 0.000000 1.000000 /end COMPU_METHOD
/* Scalar measurable for DDE 'V2gRxSigEvseMaxDchgPwr'. */
/begin MEASUREMENT V2gRxSigEvseMaxDchgPwr "Maximum discharge power the EVSE can accept" FLOAT32_IEEE CU_V2GRXSIGEVSEMAXDCHGPWR 1 100 -499999.0 0.0 ECU_ADDRESS 0x70017d78 BYTE_ORDER MSB_LAST /end MEASUREMENT
/begin COMPU_METHOD CU_V2GRXSIGEVSEMAXDCHGPWR "Conversion method for V2gRxSigEvseMaxDchgPwr" RAT_FUNC "%10.0" "W" COEFFS 0.000000 1.000000 -0.000000 0.000000 0.000000 1.000000 /end COMPU_METHOD
/* Scalar measurable for DDE 'V2gRxSigEvseMaxDchgPwr_flg'. */
/begin MEASUREMENT V2gRxSigEvseMaxDchgPwr_flg "Indicates that the EVSEMaximumDischargePowerLimit parameter is available." UBYTE CU_V2GRXSIGEVSEMAXDCHGPWR_FLG 1 100 0.0 1.0 ECU_ADDRESS 0x700181e4 BYTE_ORDER MSB_LAST /end MEASUREMENT
/begin COMPU_METHOD CU_V2GRXSIGEVSEMAXDCHGPWR_FLG "Conversion method for V2gRxSigEvseMaxDchgPwr_flg" RAT_FUNC "%10.0" "b" COEFFS 0.000000 1.000000 -0.000000 0.000000 0.000000 1.000000 /end COMPU_METHOD
/* Scalar measurable for DDE 'V2gRxSigEvseMinCrnt'. */
/begin MEASUREMENT V2gRxSigEvseMinCrnt "Minimum current the EVSE can deliver with the expected accuracy" FLOAT32_IEEE CU_V2GRXSIGEVSEMINCRNT 1 100 0.0 196605.0 ECU_ADDRESS 0x70018354 BYTE_ORDER MSB_LAST /end MEASUREMENT
/begin COMPU_METHOD CU_V2GRXSIGEVSEMINCRNT "Conversion method for V2gRxSigEvseMinCrnt" RAT_FUNC "%10.0" "A" COEFFS 0.000000 1.000000 -0.000000 0.000000 0.000000 1.000000 /end COMPU_METHOD
/* Scalar measurable for DDE 'V2gRxSigEvseMinCrnt_flg'. */
/begin MEASUREMENT V2gRxSigEvseMinCrnt_flg "Indicates that the EVSEMinimumCurrentLimit parameter is available." UBYTE CU_V2GRXSIGEVSEMINCRNT_FLG 1 100 0.0 1.0 ECU_ADDRESS 0x7001814d BYTE_ORDER MSB_LAST /end MEASUREMENT
/begin COMPU_METHOD CU_V2GRXSIGEVSEMINCRNT_FLG "Conversion method for V2gRxSigEvseMinCrnt_flg" RAT_FUNC "%10.0" "b" COEFFS 0.000000 1.000000 -0.000000 0.000000 0.000000 1.000000 /end COMPU_METHOD
/* Scalar measurable for DDE 'V2gRxSigEvseMinDchgCrnt'. */
/begin MEASUREMENT V2gRxSigEvseMinDchgCrnt "Minimum discharge current the EVSE can deliver with the expected accuracy" FLOAT32_IEEE CU_V2GRXSIGEVSEMINDCHGCRNT 1 100 -196604.0 0.0 ECU_ADDRESS 0x70018304 BYTE_ORDER MSB_LAST /end MEASUREMENT
/begin COMPU_METHOD CU_V2GRXSIGEVSEMINDCHGCRNT "Conversion method for V2gRxSigEvseMinDchgCrnt" RAT_FUNC "%10.0" "A" COEFFS 0.000000 1.000000 -0.000000 0.000000 0.000000 1.000000 /end COMPU_METHOD
/* Scalar measurable for DDE 'V2gRxSigEvseMinDchgCrnt_flg'. */
/begin MEASUREMENT V2gRxSigEvseMinDchgCrnt_flg "Indicates that the EVSE minimum discharge current parameter is available." UBYTE CU_V2GRXSIGEVSEMINDCHGCRNT_FLG 1 100 0.0 1.0 ECU_ADDRESS 0x70017ef3 BYTE_ORDER MSB_LAST /end MEASUREMENT
/begin COMPU_METHOD CU_V2GRXSIGEVSEMINDCHGCRNT_FLG "Conversion method for V2gRxSigEvseMinDchgCrnt_flg" RAT_FUNC "%10.0" "b" COEFFS 0.000000 1.000000 -0.000000 0.000000 0.000000 1.000000 /end COMPU_METHOD
/* Scalar measurable for DDE 'V2gRxSigEvseProcessing'. */
/begin MEASUREMENT V2gRxSigEvseProcessing "Parameter indicating that the EVSE has finished the processing that was initiated after the ContractAuthenticationReq or that the EVSE is still processing at the time the response message was sent." SLONG CU_V2GRXSIGEVSEPROCESSING 1 100 -2147483648.0 2147483647.0 ECU_ADDRESS 0x70018394 BYTE_ORDER MSB_LAST /end MEASUREMENT
/begin COMPU_METHOD CU_V2GRXSIGEVSEPROCESSING "Conversion method for V2gRxSigEvseProcessing" TAB_VERB "%12.0" "enum" COMPU_TAB_REF CT_V2GRXSIGEVSEPROCESSING /end COMPU_METHOD
/begin COMPU_VTAB CT_V2GRXSIGEVSEPROCESSING "Conversion method for V2gRxSigEvseProcessing" TAB_VERB 3 0 "FINISHED" 1 "ONGOING" 2 "ONGOING_WAITINGFORCUSTOMERINTERACTION" /end COMPU_VTAB
/* Scalar measurable for DDE 'V2gRxSigEvseStatus'. */
/begin MEASUREMENT V2gRxSigEvseStatus "Indicates the internal state of the EVSE." SLONG CU_V2GRXSIGEVSESTATUS 1 100 -2147483648.0 2147483647.0 ECU_ADDRESS 0x70017f94 BYTE_ORDER MSB_LAST /end MEASUREMENT
/begin COMPU_METHOD CU_V2GRXSIGEVSESTATUS "Conversion method for V2gRxSigEvseStatus" TAB_VERB "%12.0" "enum" COMPU_TAB_REF CT_V2GRXSIGEVSESTATUS /end COMPU_METHOD
/begin COMPU_VTAB CT_V2GRXSIGEVSESTATUS "Conversion method for V2gRxSigEvseStatus" TAB_VERB 12 0 "EVSE_NOT_READY" 1 "EVSE_READY" 2 "EVSE_SHUTDOWN" 3 "EVSE_UTILITY_INTERRUPT" 4 "EVSE_ISOLATION_MONITOR_ACTV" 5 "EVSE_EMERGENCY_SHUTDOWN" 6 "EVSE_MALFUNCTION" 7 "EVSE_STATUS_RESERVED1" 8 "EVSE_STATUS_RESERVED2" 9 "EVSE_STATUS_RESERVED3" 10 "EVSE_STATUS_RESERVED4" 11 "EVSE_STATUS_RESERVED5" /end COMPU_VTAB
/* Scalar measurable for DDE 'V2gRxSigEvseStatus_flg'. */
/begin MEASUREMENT V2gRxSigEvseStatus_flg "Identifies the presence of the DC_EVSEChargeParameter and its sub-parameters." UBYTE CU_V2GRXSIGEVSESTATUS_FLG 1 100 0.0 1.0 ECU_ADDRESS 0x700181a8 BYTE_ORDER MSB_LAST /end MEASUREMENT
/begin COMPU_METHOD CU_V2GRXSIGEVSESTATUS_FLG "Conversion method for V2gRxSigEvseStatus_flg" RAT_FUNC "%10.0" "b" COEFFS 0.000000 1.000000 -0.000000 0.000000 0.000000 1.000000 /end COMPU_METHOD
/* Scalar measurable for DDE 'V2gRxSigEvseVoltage'. */
/begin MEASUREMENT V2gRxSigEvseVoltage "Present voltage of EVSE" FLOAT32_IEEE CU_V2GRXSIGEVSEVOLTAGE 1 100 -32768000.0 32767000.0 ECU_ADDRESS 0x700183f0 BYTE_ORDER MSB_LAST /end MEASUREMENT
/begin COMPU_METHOD CU_V2GRXSIGEVSEVOLTAGE "Conversion method for V2gRxSigEvseVoltage" RAT_FUNC "%10.0" "V" COEFFS 0.000000 1.000000 -0.000000 0.000000 0.000000 1.000000 /end COMPU_METHOD
/* Scalar measurable for DDE 'V2gRxSigIsolStatus'. */
/begin MEASUREMENT V2gRxSigIsolStatus "Indicates the isolation condition" SLONG CU_V2GRXSIGISOLSTATUS 1 100 -2147483648.0 2147483647.0 ECU_ADDRESS 0x70017df8 BYTE_ORDER MSB_LAST /end MEASUREMENT
/begin COMPU_METHOD CU_V2GRXSIGISOLSTATUS "Conversion method for V2gRxSigIsolStatus" TAB_VERB "%12.0" "enum" COMPU_TAB_REF CT_V2GRXSIGISOLSTATUS /end COMPU_METHOD
/begin COMPU_VTAB CT_V2GRXSIGISOLSTATUS "Conversion method for V2gRxSigIsolStatus" TAB_VERB 4 0 "ISOLATION_INVALID" 1 "ISOLATION_VALID" 2 "ISOLATION_WARNING" 3 "ISOLATION_FAULT" /end COMPU_VTAB
/* Scalar measurable for DDE 'V2gRxSigIsolStatus_flg'. */
/begin MEASUREMENT V2gRxSigIsolStatus_flg "Identifies the presence of the EVSEIsolationStatus parameter." UBYTE CU_V2GRXSIGISOLSTATUS_FLG 1 100 0.0 1.0 ECU_ADDRESS 0x7001818c BYTE_ORDER MSB_LAST /end MEASUREMENT
/begin COMPU_METHOD CU_V2GRXSIGISOLSTATUS_FLG "Conversion method for V2gRxSigIsolStatus_flg" RAT_FUNC "%10.0" "b" COEFFS 0.000000 1.000000 -0.000000 0.000000 0.000000 1.000000 /end COMPU_METHOD
/* Scalar measurable for DDE 'V2gRxSigMaxCrnt'. */
/begin MEASUREMENT V2gRxSigMaxCrnt "Minimum discharge current that the EVSE can deliver" FLOAT32_IEEE CU_V2GRXSIGMAXCRNT 1 100 -32768000.0 32767000.0 ECU_ADDRESS 0x700181ec BYTE_ORDER MSB_LAST /end MEASUREMENT
/begin COMPU_METHOD CU_V2GRXSIGMAXCRNT "Conversion method for V2gRxSigMaxCrnt" RAT_FUNC "%10.0" "A" COEFFS 0.000000 1.000000 -0.000000 0.000000 0.000000 1.000000 /end COMPU_METHOD
/* Scalar measurable for DDE 'V2gRxSigMaxCrnt_flg'. */
/begin MEASUREMENT V2gRxSigMaxCrnt_flg "Identifies the presence of the maximum current to the EVSE" UBYTE CU_V2GRXSIGMAXCRNT_FLG 1 100 0.0 1.0 ECU_ADDRESS 0x70017e10 BYTE_ORDER MSB_LAST /end MEASUREMENT
/begin COMPU_METHOD CU_V2GRXSIGMAXCRNT_FLG "Conversion method for V2gRxSigMaxCrnt_flg" RAT_FUNC "%10.0" "b" COEFFS 0.000000 1.000000 -0.000000 0.000000 0.000000 1.000000 /end COMPU_METHOD
/* Scalar measurable for DDE 'V2gRxSigMaxPwr'. */
/begin MEASUREMENT V2gRxSigMaxPwr "Minimum discharge power that the EVSE can deliver" FLOAT32_IEEE CU_V2GRXSIGMAXPWR 1 100 -32768000.0 32767000.0 ECU_ADDRESS 0x70017cb8 BYTE_ORDER MSB_LAST /end MEASUREMENT
/begin COMPU_METHOD CU_V2GRXSIGMAXPWR "Conversion method for V2gRxSigMaxPwr" RAT_FUNC "%10.0" "W" COEFFS 0.000000 1.000000 -0.000000 0.000000 0.000000 1.000000 /end COMPU_METHOD
/* Scalar measurable for DDE 'V2gRxSigMaxPwr_flg'. */
/begin MEASUREMENT V2gRxSigMaxPwr_flg "Identifies the presence of the maximum power to the EVSE" UBYTE CU_V2GRXSIGMAXPWR_FLG 1 100 0.0 1.0 ECU_ADDRESS 0x7001825c BYTE_ORDER MSB_LAST /end MEASUREMENT
/begin COMPU_METHOD CU_V2GRXSIGMAXPWR_FLG "Conversion method for V2gRxSigMaxPwr_flg" RAT_FUNC "%10.0" "b" COEFFS 0.000000 1.000000 -0.000000 0.000000 0.000000 1.000000 /end COMPU_METHOD
/* Scalar measurable for DDE 'V2gRxSigMaxVolt'. */
/begin MEASUREMENT V2gRxSigMaxVolt "Maximum voltage the EVSE can deliver" FLOAT32_IEEE CU_V2GRXSIGMAXVOLT 1 100 -32768000.0 32767000.0 ECU_ADDRESS 0x70017c34 BYTE_ORDER MSB_LAST /end MEASUREMENT
/begin COMPU_METHOD CU_V2GRXSIGMAXVOLT "Conversion method for V2gRxSigMaxVolt" RAT_FUNC "%10.0" "V" COEFFS 0.000000 1.000000 -0.000000 0.000000 0.000000 1.000000 /end COMPU_METHOD
/* Scalar measurable for DDE 'V2gRxSigMaxVolt_flg'. */
/begin MEASUREMENT V2gRxSigMaxVolt_flg "Indicates that the EVSEMaximumVoltage parameter is available." UBYTE CU_V2GRXSIGMAXVOLT_FLG 1 100 0.0 1.0 ECU_ADDRESS 0x70017f84 BYTE_ORDER MSB_LAST /end MEASUREMENT
/begin COMPU_METHOD CU_V2GRXSIGMAXVOLT_FLG "Conversion method for V2gRxSigMaxVolt_flg" RAT_FUNC "%10.0" "b" COEFFS 0.000000 1.000000 -0.000000 0.000000 0.000000 1.000000 /end COMPU_METHOD
/* Scalar measurable for DDE 'V2gRxSigMinVolt'. */
/begin MEASUREMENT V2gRxSigMinVolt "Maximum voltage the EVSE can deliver" FLOAT32_IEEE CU_V2GRXSIGMINVOLT 1 100 -32768000.0 32767000.0 ECU_ADDRESS 0x70017cb4 BYTE_ORDER MSB_LAST /end MEASUREMENT
/begin COMPU_METHOD CU_V2GRXSIGMINVOLT "Conversion method for V2gRxSigMinVolt" RAT_FUNC "%10.0" "V" COEFFS 0.000000 1.000000 -0.000000 0.000000 0.000000 1.000000 /end COMPU_METHOD
/* Scalar measurable for DDE 'V2gRxSigMinVolt_flg'. */
/begin MEASUREMENT V2gRxSigMinVolt_flg "Indicates that the EVSEMaximumVoltage parameter is available." UBYTE CU_V2GRXSIGMINVOLT_FLG 1 100 0.0 1.0 ECU_ADDRESS 0x70018448 BYTE_ORDER MSB_LAST /end MEASUREMENT
/begin COMPU_METHOD CU_V2GRXSIGMINVOLT_FLG "Conversion method for V2gRxSigMinVolt_flg" RAT_FUNC "%10.0" "b" COEFFS 0.000000 1.000000 -0.000000 0.000000 0.000000 1.000000 /end COMPU_METHOD
/* Scalar measurable for DDE 'V2gRxSigNotif'. */
/begin MEASUREMENT V2gRxSigNotif "The arbitrated Notification parameter in the received message from EVSE" SLONG CU_V2GRXSIGNOTIF 1 100 -2147483648.0 2147483647.0 ECU_ADDRESS 0x700183f8 BYTE_ORDER MSB_LAST /end MEASUREMENT
/begin COMPU_METHOD CU_V2GRXSIGNOTIF "Conversion method for V2gRxSigNotif" TAB_VERB "%12.0" "1" COMPU_TAB_REF CT_V2GRXSIGNOTIF /end COMPU_METHOD
/begin COMPU_VTAB CT_V2GRXSIGNOTIF "Conversion method for V2gRxSigNotif" TAB_VERB 3 0 "NONE" 1 "STOPCHARGING" 2 "RENEGOTIATION" /end COMPU_VTAB
/* Scalar measurable for DDE 'V2gRxSigNotifFlg'. */
/begin MEASUREMENT V2gRxSigNotifFlg "The arbitrated Notification parameter in the received message from EVSE" UBYTE CU_V2GRXSIGNOTIFFLG 1 100 0.0 1.0 ECU_ADDRESS 0x70017ffe BYTE_ORDER MSB_LAST /end MEASUREMENT
/begin COMPU_METHOD CU_V2GRXSIGNOTIFFLG "Conversion method for V2gRxSigNotifFlg" RAT_FUNC "%10.0" "b" COEFFS 0.000000 1.000000 -0.000000 0.000000 0.000000 1.000000 /end COMPU_METHOD
/* Scalar measurable for DDE 'V2gRxSigNotifMaxDelay'. */
/begin MEASUREMENT V2gRxSigNotifMaxDelay "The arbitrated Notification Max Delay parameter in the received message from EVSE" UWORD CU_V2GRXSIGNOTIFMAXDELAY 1 100 0.0 65535.0 ECU_ADDRESS 0x70017f8c BYTE_ORDER MSB_LAST /end MEASUREMENT
/begin COMPU_METHOD CU_V2GRXSIGNOTIFMAXDELAY "Conversion method for V2gRxSigNotifMaxDelay" RAT_FUNC "%10.0" "s" COEFFS 0.000000 1.000000 -0.000000 0.000000 0.000000 1.000000 /end COMPU_METHOD
/* Scalar measurable for DDE 'V2gRxSigPwrLimReached'. */
/begin MEASUREMENT V2gRxSigPwrLimReached "If set to TRUE, the EVSE has reached its power limit." UBYTE CU_V2GRXSIGPWRLIMREACHED 1 100 0.0 1.0 ECU_ADDRESS 0x700182e4 BYTE_ORDER MSB_LAST /end MEASUREMENT
/begin COMPU_METHOD CU_V2GRXSIGPWRLIMREACHED "Conversion method for V2gRxSigPwrLimReached" RAT_FUNC "%10.0" "b" COEFFS 0.000000 1.000000 -0.000000 0.000000 0.000000 1.000000 /end COMPU_METHOD
/* Scalar measurable for DDE 'V2gRxSigRescode'. */
/begin MEASUREMENT V2gRxSigRescode "for message BidirectionalControlRes: indicates the acknowledgment status of  this V2G messages received by the SECC." UBYTE CU_V2GRXSIGRESCODE 1 100 0.0 255.0 ECU_ADDRESS 0x70017f90 BYTE_ORDER MSB_LAST /end MEASUREMENT
/begin COMPU_METHOD CU_V2GRXSIGRESCODE "Conversion method for V2gRxSigRescode" RAT_FUNC "%10.0" "1" COEFFS 0.000000 1.000000 -0.000000 0.000000 0.000000 1.000000 /end COMPU_METHOD
/* Scalar measurable for DDE 'V2gRxSigSASchTupId'. */
/begin MEASUREMENT V2gRxSigSASchTupId "The SaSchedule Tuple ID message received from the EVSE" UBYTE CU_V2GRXSIGSASCHTUPID 1 100 0.0 255.0 ECU_ADDRESS 0x700182d1 BYTE_ORDER MSB_LAST /end MEASUREMENT
/begin COMPU_METHOD CU_V2GRXSIGSASCHTUPID "Conversion method for V2gRxSigSASchTupId" RAT_FUNC "%10.0" "1" COEFFS 0.000000 1.000000 -0.000000 0.000000 0.000000 1.000000 /end COMPU_METHOD
/* Scalar measurable for DDE 'V2gRxSigSASchTupIdFlg'. */
/begin MEASUREMENT V2gRxSigSASchTupIdFlg "Identifies the presence of the SaSchedule Tuple ID message received from the EVSE" UBYTE CU_V2GRXSIGSASCHTUPIDFLG 1 100 0.0 1.0 ECU_ADDRESS 0x70017eda BYTE_ORDER MSB_LAST /end MEASUREMENT
/begin COMPU_METHOD CU_V2GRXSIGSASCHTUPIDFLG "Conversion method for V2gRxSigSASchTupIdFlg" RAT_FUNC "%10.0" "b" COEFFS 0.000000 1.000000 -0.000000 0.000000 0.000000 1.000000 /end COMPU_METHOD
/* Scalar measurable for DDE 'V2gRxSigTrg'. */
/begin MEASUREMENT V2gRxSigTrg "Trigger falg that on a rising edge indicates the event for receiving any PLC (V2G) message from EVSE" UBYTE CU_V2GRXSIGTRG 1 100 0.0 1.0 ECU_ADDRESS 0x70018094 BYTE_ORDER MSB_LAST /end MEASUREMENT
/begin COMPU_METHOD CU_V2GRXSIGTRG "Conversion method for V2gRxSigTrg" RAT_FUNC "%10.0" "b" COEFFS 0.000000 1.000000 -0.000000 0.000000 0.000000 1.000000 /end COMPU_METHOD
/* Scalar measurable for DDE 'V2gRxSigVoltLimReached'. */
/begin MEASUREMENT V2gRxSigVoltLimReached "f set to TRUE, the EVSE has reached its voltage limit." UBYTE CU_V2GRXSIGVOLTLIMREACHED 1 100 0.0 1.0 ECU_ADDRESS 0x700183fe BYTE_ORDER MSB_LAST /end MEASUREMENT
/begin COMPU_METHOD CU_V2GRXSIGVOLTLIMREACHED "Conversion method for V2gRxSigVoltLimReached" RAT_FUNC "%10.0" "b" COEFFS 0.000000 1.000000 -0.000000 0.000000 0.000000 1.000000 /end COMPU_METHOD
/* Scalar measurable for DDE 'V2gSlacLinkSt'. */
/begin MEASUREMENT V2gSlacLinkSt "Communication link status. Do not attempt to initiate communication unless the link status indicates connection." SLONG CU_V2GSLACLINKST 1 100 -2147483648.0 2147483647.0 ECU_ADDRESS 0x7001815c BYTE_ORDER MSB_LAST /end MEASUREMENT
/begin COMPU_METHOD CU_V2GSLACLINKST "Conversion method for V2gSlacLinkSt" TAB_VERB "%12.0" "enum" COMPU_TAB_REF CT_V2GSLACLINKST /end COMPU_METHOD
/begin COMPU_VTAB CT_V2GSLACLINKST "Conversion method for V2gSlacLinkSt" TAB_VERB 2 0 "PLC_LINK_DISCONNECTED" 1 "PLC_LINK_CONNECTED" /end COMPU_VTAB
/* Scalar measurable for DDE 'V2gSlacTcpSt'. */
/begin MEASUREMENT V2gSlacTcpSt "PLC Communication TCP connection status." SLONG CU_V2GSLACTCPST 1 100 -2147483648.0 2147483647.0 ECU_ADDRESS 0x700183c0 BYTE_ORDER MSB_LAST /end MEASUREMENT
/begin COMPU_METHOD CU_V2GSLACTCPST "Conversion method for V2gSlacTcpSt" TAB_VERB "%12.0" "enum" COMPU_TAB_REF CT_V2GSLACTCPST /end COMPU_METHOD
/begin COMPU_VTAB CT_V2GSLACTCPST "Conversion method for V2gSlacTcpSt" TAB_VERB 6 0 "PLC_TCP_DISCONNECTED" 1 "PLC_TCP_WAITING_SDP_RESPONSE" 2 "PLC_TCP_WAITING_SDP_READY" 3 "PLC_TCP_READY_TO_CONNECT" 4 "PLC_TCP_CONNECTING" 5 "PLC_TCP_CONNECTED" /end COMPU_VTAB
/begin FUNCTION Signals "Group /ByType/Signals"
 /begin LOC_MEASUREMENT V2gRxMsgCrntDmdEvseId[24] V2gRxMsgCrntDmdEvseId[25] V2gRxMsgCrntDmdEvseId[26] V2gRxMsgCrntDmdEvseId[27] V2gRxMsgCrntDmdEvseId[28] V2gRxMsgCrntDmdEvseId[29] V2gRxMsgCrntDmdEvseId[2] V2gRxMsgCrntDmdEvseId[30] V2gRxMsgCrntDmdEvseId[31] V2gRxMsgCrntDmdEvseId[32] V2gRxMsgCrntDmdEvseId[33] V2gRxMsgCrntDmdEvseId[34] V2gRxMsgCrntDmdEvseId[35] V2gRxMsgCrntDmdEvseId[36] V2gRxMsgCrntDmdEvseId[37] V2gRxMsgCrntDmdEvseId[3] V2gRxMsgCrntDmdEvseId[4] V2gRxMsgCrntDmdEvseId[5] V2gRxMsgCrntDmdEvseId[6] V2gRxMsgCrntDmdEvseId[7] V2gRxMsgCrntDmdEvseId[8] V2gRxMsgCrntDmdEvseId[9] V2gRxMsgCrntDmdEvseStatus V2gRxMsgCrntDmdEvseVoltage V2gRxMsgCrntDmdIsolStatus V2gRxMsgCrntDmdIsolStatus_flg V2gRxMsgCrntDmdMaxCrnt V2gRxMsgCrntDmdMaxCrnt_flg V2gRxMsgCrntDmdMaxPwr V2gRxMsgCrntDmdMaxPwr_flg V2gRxMsgCrntDmdMaxVolt V2gRxMsgCrntDmdMaxVolt_flg V2gRxMsgCrntDmdNotif V2gRxMsgCrntDmdNotifFlg V2gRxMsgCrntDmdNotifMaxDelay V2gRxMsgCrntDmdPwrLimReached V2gRxMsgCrntDmdRescode V2gRxMsgCrntDmdSASchTupId V2gRxMsgCrntDmdSASchTupIdFlg V2gRxMsgCrntDmdTrg V2gRxMsgCrntDmdVoltLimReached V2gRxMsgPmtSelNotif V2gRxMsgPmtSelNotifFlg V2gRxMsgPmtSelNotifMaxDelay V2gRxMsgPmtSelRescode V2gRxMsgPmtSelTrg V2gRxMsgPreChgEvseStatus V2gRxMsgPreChgEvseVoltage V2gRxMsgPreChgIsolStatus V2gRxMsgPreChgIsolStatus_flg V2gRxMsgPreChgNotif V2gRxMsgPreChgNotifFlg V2gRxMsgPreChgNotifMaxDelay V2gRxMsgPreChgRescode V2gRxMsgPreChgTrg V2gRxMsgPwrDelivEvseProcessing V2gRxMsgPwrDelivEvseStatus V2gRxMsgPwrDelivEvseStatus_flg V2gRxMsgPwrDelivIsolStatus V2gRxMsgPwrDelivIsolStatus_flg V2gRxMsgPwrDelivNotif V2gRxMsgPwrDelivNotifFlg V2gRxMsgPwrDelivNotifMaxDelay V2gRxMsgPwrDelivRescode V2gRxMsgPwrDelivTrg V2gRxMsgSesSetupEvseIdLen V2gRxMsgSesSetupEvseId[0] V2gRxMsgSesSetupEvseId[10] V2gRxMsgSesSetupEvseId[11] V2gRxMsgSesSetupEvseId[12] V2gRxMsgSesSetupEvseId[13] V2gRxMsgSesSetupEvseId[14] V2gRxMsgSesSetupEvseId[15] V2gRxMsgSesSetupEvseId[16] V2gRxMsgSesSetupEvseId[17] V2gRxMsgSesSetupEvseId[18] V2gRxMsgSesSetupEvseId[19] V2gRxMsgSesSetupEvseId[1] V2gRxMsgSesSetupEvseId[20] V2gRxMsgSesSetupEvseId[21] V2gRxMsgSesSetupEvseId[22] V2gRxMsgSesSetupEvseId[23] V2gRxMsgSesSetupEvseId[24] V2gRxMsgSesSetupEvseId[25] V2gRxMsgSesSetupEvseId[26] V2gRxMsgSesSetupEvseId[27] V2gRxMsgSesSetupEvseId[28] V2gRxMsgSesSetupEvseId[29] V2gRxMsgSesSetupEvseId[2] V2gRxMsgSesSetupEvseId[30] V2gRxMsgSesSetupEvseId[31] V2gRxMsgSesSetupEvseId[32] V2gRxMsgSesSetupEvseId[33] V2gRxMsgSesSetupEvseId[34] V2gRxMsgSesSetupEvseId[35] V2gRxMsgSesSetupEvseId[36] V2gRxMsgSesSetupEvseId[37] V2gRxMsgSesSetupEvseId[3] V2gRxMsgSesSetupEvseId[4] V2gRxMsgSesSetupEvseId[5] V2gRxMsgSesSetupEvseId[6] V2gRxMsgSesSetupEvseId[7] V2gRxMsgSesSetupEvseId[8] V2gRxMsgSesSetupEvseId[9] V2gRxMsgSesSetupNotif V2gRxMsgSesSetupNotifFlg V2gRxMsgSesSetupNotifMaxDelay V2gRxMsgSesSetupRescode V2gRxMsgSesSetupTimestamp V2gRxMsgSesSetupTimestamp_flg V2gRxMsgSesSetupTrg V2gRxMsgSesStopNotif V2gRxMsgSesStopNotifFlg V2gRxMsgSesStopNotifMaxDelay V2gRxMsgSesStopRescode V2gRxMsgSesStopTrg V2gRxMsgSupPrtclRescode V2gRxMsgSupPrtclRxTrg V2gRxMsgSvcDetailNotif V2gRxMsgSvcDetailNotifFlg V2gRxMsgSvcDetailNotifMaxDelay V2gRxMsgSvcDetailParamSetLen V2gRxMsgSvcDetailParamSetSizes4 V2gRxMsgSvcDetailParamSetSizes3 V2gRxMsgSvcDetailParamSetSizes2 V2gRxMsgSvcDetailParamSetSizes0 V2gRxMsgSvcDetailParamSetSizes1 V2gRxMsgSvcDetailRescode V2gRxMsgSvcDetailSvcId V2gRxMsgSvcDetailTrg V2gRxMsgSvcDiscEgyTransferMode1 V2gRxMsgSvcDiscEgyTransferMode4 V2gRxMsgSvcDiscEgyTransferMode3 V2gRxMsgSvcDiscEgyTransferMode2 V2gRxMsgSvcDiscEgyTransferMode0 V2gRxMsgSvcDiscEgyTransferMode6 V2gRxMsgSvcDiscEgyTransferMode5 V2gRxMsgSvcDiscEgyTransferSvcI1 V2gRxMsgSvcDiscEgyTransferSvcI8 V2gRxMsgSvcDiscEgyTransferSvcI4 V2gRxMsgSvcDiscEgyTransferSvcI0 V2gRxMsgSvcDiscEgyTransferSvcI7 V2gRxMsgSvcDiscEgyTransferSvcI5 V2gRxMsgSvcDiscEgyTransferSvcI6 V2gRxMsgSvcDiscEgyTransferSvcI2 V2gRxMsgSvcDiscEgyTransferSvcI3 V2gRxMsgSvcDiscEgyTxfrType V2gRxMsgSvcDiscFreeService[0] V2gRxMsgSvcDiscFreeService[1] V2gRxMsgSvcDiscFreeService[2] V2gRxMsgSvcDiscFreeService[3] V2gRxMsgSvcDiscFreeService[4] V2gRxMsgSvcDiscFreeService[5] V2gRxMsgSvcDiscFreeService[6] V2gRxMsgSvcDiscFreeService[7] V2gRxMsgSvcDiscNotif V2gRxMsgSvcDiscNotifFlg V2gRxMsgSvcDiscNotifMaxDelay V2gRxMsgSvcDiscRescode V2gRxMsgSvcDiscServiceId V2gRxMsgSvcDiscSvcCategory V2gRxMsgSvcDiscSvcListSize V2gRxMsgSvcDiscSvcNameLen V2gRxMsgSvcDiscSvcName[0] V2gRxMsgSvcDiscSvcName[10] V2gRxMsgSvcDiscSvcName[11] V2gRxMsgSvcDiscSvcName[12] V2gRxMsgSvcDiscSvcName[13] V2gRxMsgSvcDiscSvcName[14] V2gRxMsgSvcDiscSvcName[15] V2gRxMsgSvcDiscSvcName[16] V2gRxMsgSvcDiscSvcName[17] V2gRxMsgSvcDiscSvcName[18] V2gRxMsgSvcDiscSvcName[19] V2gRxMsgSvcDiscSvcName[1] V2gRxMsgSvcDiscSvcName[20] V2gRxMsgSvcDiscSvcName[21] V2gRxMsgSvcDiscSvcName[22] V2gRxMsgSvcDiscSvcName[23] V2gRxMsgSvcDiscSvcName[24] V2gRxMsgSvcDiscSvcName[25] V2gRxMsgSvcDiscSvcName[26] V2gRxMsgSvcDiscSvcName[27] V2gRxMsgSvcDiscSvcName[28] V2gRxMsgSvcDiscSvcName[29] V2gRxMsgSvcDiscSvcName[2] V2gRxMsgSvcDiscSvcName[30] V2gRxMsgSvcDiscSvcName[31] V2gRxMsgSvcDiscSvcName[32] V2gRxMsgSvcDiscSvcName[3] V2gRxMsgSvcDiscSvcName[4] V2gRxMsgSvcDiscSvcName[5] V2gRxMsgSvcDiscSvcName[6] V2gRxMsgSvcDiscSvcName[7] V2gRxMsgSvcDiscSvcName[8] V2gRxMsgSvcDiscSvcName[9] V2gRxMsgSvcDiscSvcScopeLen V2gRxMsgSvcDiscSvcScope[0] V2gRxMsgSvcDiscSvcScope[10] V2gRxMsgSvcDiscSvcScope[11] V2gRxMsgSvcDiscSvcScope[12] V2gRxMsgSvcDiscSvcScope[13] V2gRxMsgSvcDiscSvcScope[14] V2gRxMsgSvcDiscSvcScope[15] V2gRxMsgSvcDiscSvcScope[16] V2gRxMsgSvcDiscSvcScope[17] V2gRxMsgSvcDiscSvcScope[18] V2gRxMsgSvcDiscSvcScope[19] V2gRxMsgSvcDiscSvcScope[1] V2gRxMsgSvcDiscSvcScope[20] V2gRxMsgSvcDiscSvcScope[21] V2gRxMsgSvcDiscSvcScope[22] V2gRxMsgSvcDiscSvcScope[23] V2gRxMsgSvcDiscSvcScope[24] V2gRxMsgSvcDiscSvcScope[25] V2gRxMsgSvcDiscSvcScope[26] V2gRxMsgSvcDiscSvcScope[27] V2gRxMsgSvcDiscSvcScope[28] V2gRxMsgSvcDiscSvcScope[29] V2gRxMsgSvcDiscSvcScope[2] V2gRxMsgSvcDiscSvcScope[30] V2gRxMsgSvcDiscSvcScope[31] V2gRxMsgSvcDiscSvcScope[32] V2gRxMsgSvcDiscSvcScope[33] V2gRxMsgSvcDiscSvcScope[34] V2gRxMsgSvcDiscSvcScope[35] V2gRxMsgSvcDiscSvcScope[36] V2gRxMsgSvcDiscSvcScope[37] V2gRxMsgSvcDiscSvcScope[38] V2gRxMsgSvcDiscSvcScope[39] V2gRxMsgSvcDiscSvcScope[3] V2gRxMsgSvcDiscSvcScope[40] V2gRxMsgSvcDiscSvcScope[41] V2gRxMsgSvcDiscSvcScope[42] V2gRxMsgSvcDiscSvcScope[43] V2gRxMsgSvcDiscSvcScope[44] V2gRxMsgSvcDiscSvcScope[45] V2gRxMsgSvcDiscSvcScope[46] V2gRxMsgSvcDiscSvcScope[47] V2gRxMsgSvcDiscSvcScope[48] V2gRxMsgSvcDiscSvcScope[49] V2gRxMsgSvcDiscSvcScope[4] V2gRxMsgSvcDiscSvcScope[50] V2gRxMsgSvcDiscSvcScope[51] V2gRxMsgSvcDiscSvcScope[52] V2gRxMsgSvcDiscSvcScope[53] V2gRxMsgSvcDiscSvcScope[54] V2gRxMsgSvcDiscSvcScope[55] V2gRxMsgSvcDiscSvcScope[56] V2gRxMsgSvcDiscSvcScope[57] V2gRxMsgSvcDiscSvcScope[58] V2gRxMsgSvcDiscSvcScope[59] V2gRxMsgSvcDiscSvcScope[5] V2gRxMsgSvcDiscSvcScope[60] V2gRxMsgSvcDiscSvcScope[61] V2gRxMsgSvcDiscSvcScope[62] V2gRxMsgSvcDiscSvcScope[63] V2gRxMsgSvcDiscSvcScope[64] V2gRxMsgSvcDiscSvcScope[6] V2gRxMsgSvcDiscSvcScope[7] V2gRxMsgSvcDiscSvcScope[8] V2gRxMsgSvcDiscSvcScope[9] V2gRxMsgSvcDiscTrg V2gRxMsgSvcDiscVasListFreeSvc[0 V2gRxMsgSvcDiscVasListFreeSvc[1 V2gRxMsgSvcDiscVasListFreeSvc[6 V2gRxMsgSvcDiscVasListFreeSvc[7 V2gRxMsgSvcDiscVasListFreeSvc[4 V2gRxMsgSvcDiscVasListFreeSvc[5 V2gRxMsgSvcDiscVasListFreeSvc[2 V2gRxMsgSvcDiscVasListFreeSvc[3 V2gRxMsgSvcDiscVasListIds[0] V2gRxMsgSvcDiscVasListIds[1] V2gRxMsgSvcDiscVasListIds[2] V2gRxMsgSvcDiscVasListIds[3] V2gRxMsgSvcDiscVasListIds[4] V2gRxMsgSvcDiscVasListIds[5] V2gRxMsgSvcDiscVasListIds[6] V2gRxMsgSvcDiscVasListIds[7] V2gRxMsgSvcDiscVasListLen V2gRxMsgWeldDetEvseStatus V2gRxMsgWeldDetEvseVoltage V2gRxMsgWeldDetIsolStatus V2gRxMsgWeldDetIsolStatus_flg V2gRxMsgWeldDetNotif V2gRxMsgWeldDetNotifFlg V2gRxMsgWeldDetNotifMaxDelay V2gRxMsgWeldDetRescode V2gRxMsgWeldDetTrg V2gRxSigCrntLimReached V2gRxSigEvseCurrent V2gRxSigEvseIdLen V2gRxSigEvseId[0] V2gRxSigEvseId[10] V2gRxSigEvseId[11] V2gRxSigEvseId[12] V2gRxSigEvseId[13] V2gRxSigEvseId[14] V2gRxSigEvseId[15] V2gRxSigEvseId[16] V2gRxSigEvseId[17] V2gRxSigEvseId[18] V2gRxSigEvseId[19] V2gRxSigEvseId[1] V2gRxSigEvseId[20] V2gRxSigEvseId[21] V2gRxSigEvseId[22] V2gRxSigEvseId[23] V2gRxSigEvseId[24] V2gRxSigEvseId[25] V2gRxSigEvseId[26] V2gRxSigEvseId[27] V2gRxSigEvseId[28] V2gRxSigEvseId[29] V2gRxSigEvseId[2] V2gRxSigEvseId[30] V2gRxSigEvseId[31] V2gRxSigEvseId[32] V2gRxSigEvseId[33] V2gRxSigEvseId[34] V2gRxSigEvseId[35] V2gRxSigEvseId[36] V2gRxSigEvseId[37] V2gRxSigEvseId[3] V2gRxSigEvseId[4] V2gRxSigEvseId[5] V2gRxSigEvseId[6] V2gRxSigEvseId[7] V2gRxSigEvseId[8] V2gRxSigEvseId[9] V2gRxSigEvseMaxDchgCrnt V2gRxSigEvseMaxDchgCrnt_flg V2gRxSigEvseMaxDchgPwr V2gRxSigEvseMaxDchgPwr_flg V2gRxSigEvseMinCrnt V2gRxSigEvseMinCrnt_flg V2gRxSigEvseMinDchgCrnt V2gRxSigEvseMinDchgCrnt_flg V2gRxSigEvseProcessing V2gRxSigEvseStatus V2gRxSigEvseStatus_flg V2gRxSigEvseVoltage V2gRxSigIsolStatus V2gRxSigIsolStatus_flg V2gRxSigMaxCrnt V2gRxSigMaxCrnt_flg V2gRxSigMaxPwr V2gRxSigMaxPwr_flg V2gRxSigMaxVolt V2gRxSigMaxVolt_flg V2gRxSigMinVolt V2gRxSigMinVolt_flg V2gRxSigNotif V2gRxSigNotifFlg V2gRxSigNotifMaxDelay V2gRxSigPwrLimReached V2gRxSigRescode V2gRxSigSASchTupId V2gRxSigSASchTupIdFlg V2gRxSigTrg V2gRxSigVoltLimReached V2gSlacLinkSt V2gSlacTcpSt /end LOC_MEASUREMENT
/end FUNCTION
/end MODULE
/end PROJECT
