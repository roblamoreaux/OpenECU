ASAP2_VERSION 1 31
/begin PROJECT LaForge_CCU_TestApp "Test Application for LaForge TC367"
/begin HEADER "Dana" VERSION "0_3_1" /end HEADER
/begin MODULE OpenECU_TC367_001 ""
/* Scalar calibration for DDE 'CcsFltV2gMsgCrntDmdIsoVmto_C'. */
/begin CHARACTERISTIC CcsFltV2gMsgCrntDmdIsoVmto_C "Timeout Threshold for receiving the expected V2G response message CurrentDemand during ISO protocol" VALUE 0x70017678 RL_CCSFLTV2GMSGCRNTDMDISOVMTO_C 1000000.000000 CU_CCSFLTV2GMSGCRNTDMDISOVMTO_C 0.000000 1000000.000000 BYTE_ORDER MSB_LAST /end CHARACTERISTIC
/begin RECORD_LAYOUT RL_CCSFLTV2GMSGCRNTDMDISOVMTO_C FNC_VALUES 1 FLOAT32_IEEE COLUMN_DIR DIRECT /end RECORD_LAYOUT
/begin COMPU_METHOD CU_CCSFLTV2GMSGCRNTDMDISOVMTO_C "Conversion method for CcsFltV2gMsgCrntDmdIsoVmto_C" RAT_FUNC "%10.0" "s" COEFFS 0.000000 1.000000 -0.000000 0.000000 0.000000 1.000000 /end COMPU_METHOD
/* Scalar calibration for DDE 'CcsFltV2gMsgCrntDmdVmto_C'. */
/begin CHARACTERISTIC CcsFltV2gMsgCrntDmdVmto_C "Timeout Threshold for receiving the expected V2G response message CurrentDemand during DIN protocol" VALUE 0x70017664 RL_CCSFLTV2GMSGCRNTDMDVMTO_C 1000000.000000 CU_CCSFLTV2GMSGCRNTDMDVMTO_C 0.000000 1000000.000000 BYTE_ORDER MSB_LAST /end CHARACTERISTIC
/begin RECORD_LAYOUT RL_CCSFLTV2GMSGCRNTDMDVMTO_C FNC_VALUES 1 FLOAT32_IEEE COLUMN_DIR DIRECT /end RECORD_LAYOUT
/begin COMPU_METHOD CU_CCSFLTV2GMSGCRNTDMDVMTO_C "Conversion method for CcsFltV2gMsgCrntDmdVmto_C" RAT_FUNC "%10.0" "s" COEFFS 0.000000 1.000000 -0.000000 0.000000 0.000000 1.000000 /end COMPU_METHOD
/* Scalar calibration for DDE 'CcsFltV2gMsgEn_C'. */
/begin CHARACTERISTIC CcsFltV2gMsgEn_C "Each bit of this parameter, if set to 1, enables diagnostic of associated (with the same bit number) fault flag in CcsFltV2gMsgWrd" VALUE 0x70017504 RL_CCSFLTV2GMSGEN_C 255.000000 CU_CCSFLTV2GMSGEN_C 0.000000 255.000000 BYTE_ORDER MSB_LAST /end CHARACTERISTIC
/begin RECORD_LAYOUT RL_CCSFLTV2GMSGEN_C FNC_VALUES 1 UBYTE COLUMN_DIR DIRECT /end RECORD_LAYOUT
/begin COMPU_METHOD CU_CCSFLTV2GMSGEN_C "Conversion method for CcsFltV2gMsgEn_C" RAT_FUNC "%10.0" "1" COEFFS 0.000000 1.000000 -0.000000 0.000000 0.000000 1.000000 /end COMPU_METHOD
/* Scalar calibration for DDE 'CcsFltV2gMsgParamDiscVmto_C'. */
/begin CHARACTERISTIC CcsFltV2gMsgParamDiscVmto_C "Timeout Threshold for receiving the expected V2G response message ChargeParameterDiscoveryRes" VALUE 0x70017498 RL_CCSFLTV2GMSGPARAMDISCVMTO_C 1000000.000000 CU_CCSFLTV2GMSGPARAMDISCVMTO_C 0.000000 1000000.000000 BYTE_ORDER MSB_LAST /end CHARACTERISTIC
/begin RECORD_LAYOUT RL_CCSFLTV2GMSGPARAMDISCVMTO_C FNC_VALUES 1 FLOAT32_IEEE COLUMN_DIR DIRECT /end RECORD_LAYOUT
/begin COMPU_METHOD CU_CCSFLTV2GMSGPARAMDISCVMTO_C "Conversion method for CcsFltV2gMsgParamDiscVmto_C" RAT_FUNC "%10.0" "s" COEFFS 0.000000 1.000000 -0.000000 0.000000 0.000000 1.000000 /end COMPU_METHOD
/* Scalar calibration for DDE 'CcsFltV2gMsgPrechglVmto_C'. */
/begin CHARACTERISTIC CcsFltV2gMsgPrechglVmto_C "Timeout Threshold for receiving the expected V2G response message Pre-chargeRes" VALUE 0x700174a8 RL_CCSFLTV2GMSGPRECHGLVMTO_C 1000000.000000 CU_CCSFLTV2GMSGPRECHGLVMTO_C 0.000000 1000000.000000 BYTE_ORDER MSB_LAST /end CHARACTERISTIC
/begin RECORD_LAYOUT RL_CCSFLTV2GMSGPRECHGLVMTO_C FNC_VALUES 1 FLOAT32_IEEE COLUMN_DIR DIRECT /end RECORD_LAYOUT
/begin COMPU_METHOD CU_CCSFLTV2GMSGPRECHGLVMTO_C "Conversion method for CcsFltV2gMsgPrechglVmto_C" RAT_FUNC "%10.0" "s" COEFFS 0.000000 1.000000 -0.000000 0.000000 0.000000 1.000000 /end COMPU_METHOD
/* Scalar calibration for DDE 'CcsFltV2gMsgPwrDelivIsoVmto_C'. */
/begin CHARACTERISTIC CcsFltV2gMsgPwrDelivIsoVmto_C "Timeout Threshold for receiving the expected V2G response message PowerDeliveryRes (for ISO15118)" VALUE 0x700174f4 RL_CCSFLTV2GMSGPWRDELIVISOVMTO0 1000000.000000 CU_CCSFLTV2GMSGPWRDELIVISOVMTO0 0.000000 1000000.000000 BYTE_ORDER MSB_LAST /end CHARACTERISTIC
/begin RECORD_LAYOUT RL_CCSFLTV2GMSGPWRDELIVISOVMTO0 FNC_VALUES 1 FLOAT32_IEEE COLUMN_DIR DIRECT /end RECORD_LAYOUT
/begin COMPU_METHOD CU_CCSFLTV2GMSGPWRDELIVISOVMTO0 "Conversion method for CcsFltV2gMsgPwrDelivIsoVmto_C" RAT_FUNC "%10.0" "s" COEFFS 0.000000 1.000000 -0.000000 0.000000 0.000000 1.000000 /end COMPU_METHOD
/* Scalar calibration for DDE 'CcsFltV2gMsgPwrDelivVmto_C'. */
/begin CHARACTERISTIC CcsFltV2gMsgPwrDelivVmto_C "Timeout Threshold for receiving the expected V2G response message PowerDeliveryRes" VALUE 0x7001765c RL_CCSFLTV2GMSGPWRDELIVVMTO_C 1000000.000000 CU_CCSFLTV2GMSGPWRDELIVVMTO_C 0.000000 1000000.000000 BYTE_ORDER MSB_LAST /end CHARACTERISTIC
/begin RECORD_LAYOUT RL_CCSFLTV2GMSGPWRDELIVVMTO_C FNC_VALUES 1 FLOAT32_IEEE COLUMN_DIR DIRECT /end RECORD_LAYOUT
/begin COMPU_METHOD CU_CCSFLTV2GMSGPWRDELIVVMTO_C "Conversion method for CcsFltV2gMsgPwrDelivVmto_C" RAT_FUNC "%10.0" "s" COEFFS 0.000000 1.000000 -0.000000 0.000000 0.000000 1.000000 /end COMPU_METHOD
/* Scalar calibration for DDE 'CcsFltV2gMsgPymtSelVmto_C'. */
/begin CHARACTERISTIC CcsFltV2gMsgPymtSelVmto_C "Timeout Threshold for receiving the expected V2G response message ServicePaymentSelectionRes" VALUE 0x70017648 RL_CCSFLTV2GMSGPYMTSELVMTO_C 1000000.000000 CU_CCSFLTV2GMSGPYMTSELVMTO_C 0.000000 1000000.000000 BYTE_ORDER MSB_LAST /end CHARACTERISTIC
/begin RECORD_LAYOUT RL_CCSFLTV2GMSGPYMTSELVMTO_C FNC_VALUES 1 FLOAT32_IEEE COLUMN_DIR DIRECT /end RECORD_LAYOUT
/begin COMPU_METHOD CU_CCSFLTV2GMSGPYMTSELVMTO_C "Conversion method for CcsFltV2gMsgPymtSelVmto_C" RAT_FUNC "%10.0" "s" COEFFS 0.000000 1.000000 -0.000000 0.000000 0.000000 1.000000 /end COMPU_METHOD
/* Scalar calibration for DDE 'CcsFltV2gMsgSesSetupVmto_C'. */
/begin CHARACTERISTIC CcsFltV2gMsgSesSetupVmto_C "Timeout Threshold for receiving the expected V2G response message SessionSetupRes" VALUE 0x70017484 RL_CCSFLTV2GMSGSESSETUPVMTO_C 1000000.000000 CU_CCSFLTV2GMSGSESSETUPVMTO_C 0.000000 1000000.000000 BYTE_ORDER MSB_LAST /end CHARACTERISTIC
/begin RECORD_LAYOUT RL_CCSFLTV2GMSGSESSETUPVMTO_C FNC_VALUES 1 FLOAT32_IEEE COLUMN_DIR DIRECT /end RECORD_LAYOUT
/begin COMPU_METHOD CU_CCSFLTV2GMSGSESSETUPVMTO_C "Conversion method for CcsFltV2gMsgSesSetupVmto_C" RAT_FUNC "%10.0" "s" COEFFS 0.000000 1.000000 -0.000000 0.000000 0.000000 1.000000 /end COMPU_METHOD
/* Scalar calibration for DDE 'CcsFltV2gMsgSesStopVmto_C'. */
/begin CHARACTERISTIC CcsFltV2gMsgSesStopVmto_C "Timeout Threshold for receiving the expected V2G response message SessionStopRes" VALUE 0x70017670 RL_CCSFLTV2GMSGSESSTOPVMTO_C 1000000.000000 CU_CCSFLTV2GMSGSESSTOPVMTO_C 0.000000 1000000.000000 BYTE_ORDER MSB_LAST /end CHARACTERISTIC
/begin RECORD_LAYOUT RL_CCSFLTV2GMSGSESSTOPVMTO_C FNC_VALUES 1 FLOAT32_IEEE COLUMN_DIR DIRECT /end RECORD_LAYOUT
/begin COMPU_METHOD CU_CCSFLTV2GMSGSESSTOPVMTO_C "Conversion method for CcsFltV2gMsgSesStopVmto_C" RAT_FUNC "%10.0" "s" COEFFS 0.000000 1.000000 -0.000000 0.000000 0.000000 1.000000 /end COMPU_METHOD
/* Scalar calibration for DDE 'CcsFltV2gMsgSupPrtclVmto_C'. */
/begin CHARACTERISTIC CcsFltV2gMsgSupPrtclVmto_C "Timeout Threshold for receiving the expected V2G response message SupportedAppProtocolRes" VALUE 0x70017634 RL_CCSFLTV2GMSGSUPPRTCLVMTO_C 1000000.000000 CU_CCSFLTV2GMSGSUPPRTCLVMTO_C 0.000000 1000000.000000 BYTE_ORDER MSB_LAST /end CHARACTERISTIC
/begin RECORD_LAYOUT RL_CCSFLTV2GMSGSUPPRTCLVMTO_C FNC_VALUES 1 FLOAT32_IEEE COLUMN_DIR DIRECT /end RECORD_LAYOUT
/begin COMPU_METHOD CU_CCSFLTV2GMSGSUPPRTCLVMTO_C "Conversion method for CcsFltV2gMsgSupPrtclVmto_C" RAT_FUNC "%10.0" "s" COEFFS 0.000000 1.000000 -0.000000 0.000000 0.000000 1.000000 /end COMPU_METHOD
/* Scalar calibration for DDE 'CcsFltV2gMsgSvcDetailVmto_C'. */
/begin CHARACTERISTIC CcsFltV2gMsgSvcDetailVmto_C "Timeout Threshold for receiving the expected V2G response message Service Detail Response." VALUE 0x70017680 RL_CCSFLTV2GMSGSVCDETAILVMTO_C 1000000.000000 CU_CCSFLTV2GMSGSVCDETAILVMTO_C 0.000000 1000000.000000 BYTE_ORDER MSB_LAST /end CHARACTERISTIC
/begin RECORD_LAYOUT RL_CCSFLTV2GMSGSVCDETAILVMTO_C FNC_VALUES 1 FLOAT32_IEEE COLUMN_DIR DIRECT /end RECORD_LAYOUT
/begin COMPU_METHOD CU_CCSFLTV2GMSGSVCDETAILVMTO_C "Conversion method for CcsFltV2gMsgSvcDetailVmto_C" RAT_FUNC "%10.0" "s" COEFFS 0.000000 1.000000 -0.000000 0.000000 0.000000 1.000000 /end COMPU_METHOD
/* Scalar calibration for DDE 'CcsFltV2gMsgSvcDiscVmto_C'. */
/begin CHARACTERISTIC CcsFltV2gMsgSvcDiscVmto_C "Timeout Threshold for receiving the expected V2G response message ServiceDiscoveryRes" VALUE 0x7001748c RL_CCSFLTV2GMSGSVCDISCVMTO_C 1000000.000000 CU_CCSFLTV2GMSGSVCDISCVMTO_C 0.000000 1000000.000000 BYTE_ORDER MSB_LAST /end CHARACTERISTIC
/begin RECORD_LAYOUT RL_CCSFLTV2GMSGSVCDISCVMTO_C FNC_VALUES 1 FLOAT32_IEEE COLUMN_DIR DIRECT /end RECORD_LAYOUT
/begin COMPU_METHOD CU_CCSFLTV2GMSGSVCDISCVMTO_C "Conversion method for CcsFltV2gMsgSvcDiscVmto_C" RAT_FUNC "%10.0" "s" COEFFS 0.000000 1.000000 -0.000000 0.000000 0.000000 1.000000 /end COMPU_METHOD
/* Scalar calibration for DDE 'CcsFltV2gMsgWeldDetVmto_C'. */
/begin CHARACTERISTIC CcsFltV2gMsgWeldDetVmto_C "Timeout Threshold for receiving the expected V2G response message WeldingDetectionRes" VALUE 0x7001766c RL_CCSFLTV2GMSGWELDDETVMTO_C 1000000.000000 CU_CCSFLTV2GMSGWELDDETVMTO_C 0.000000 1000000.000000 BYTE_ORDER MSB_LAST /end CHARACTERISTIC
/begin RECORD_LAYOUT RL_CCSFLTV2GMSGWELDDETVMTO_C FNC_VALUES 1 FLOAT32_IEEE COLUMN_DIR DIRECT /end RECORD_LAYOUT
/begin COMPU_METHOD CU_CCSFLTV2GMSGWELDDETVMTO_C "Conversion method for CcsFltV2gMsgWeldDetVmto_C" RAT_FUNC "%10.0" "s" COEFFS 0.000000 1.000000 -0.000000 0.000000 0.000000 1.000000 /end COMPU_METHOD
/* Scalar calibration for DDE 'CcsIprAcdMaxAcCrntRange4Ofst1_C'. */
/begin CHARACTERISTIC CcsIprAcdMaxAcCrntRange4Ofst1_C "Maximuim AC charge current when CP dutycycle is between 9.5 to 10 %" VALUE 0x700175e4 RL_CCSIPRACDMAXACCRNTRANGE4OFS0 100.000000 CU_CCSIPRACDMAXACCRNTRANGE4OFS0 0.000000 100.000000 BYTE_ORDER MSB_LAST /end CHARACTERISTIC
/begin RECORD_LAYOUT RL_CCSIPRACDMAXACCRNTRANGE4OFS0 FNC_VALUES 1 FLOAT32_IEEE COLUMN_DIR DIRECT /end RECORD_LAYOUT
/begin COMPU_METHOD CU_CCSIPRACDMAXACCRNTRANGE4OFS0 "Conversion method for CcsIprAcdMaxAcCrntRange4Ofst1_C" RAT_FUNC "%10.0" "A" COEFFS 0.000000 1.000000 -0.000000 0.000000 0.000000 1.000000 /end COMPU_METHOD
/* Scalar calibration for DDE 'CcsIprAcdMaxAcCrntRange5Gain1_C'. */
/begin CHARACTERISTIC CcsIprAcdMaxAcCrntRange5Gain1_C "Gain that converts dutycycle to max AC current based on Table 5 in SAE J!772 for dytycycle range between 10 to 20 %" VALUE 0x70017410 RL_CCSIPRACDMAXACCRNTRANGE5GAI0 10.000000 CU_CCSIPRACDMAXACCRNTRANGE5GAI0 0.000000 10.000000 BYTE_ORDER MSB_LAST /end CHARACTERISTIC
/begin RECORD_LAYOUT RL_CCSIPRACDMAXACCRNTRANGE5GAI0 FNC_VALUES 1 FLOAT32_IEEE COLUMN_DIR DIRECT /end RECORD_LAYOUT
/begin COMPU_METHOD CU_CCSIPRACDMAXACCRNTRANGE5GAI0 "Conversion method for CcsIprAcdMaxAcCrntRange5Gain1_C" RAT_FUNC "%10.0" "A/pct" COEFFS 0.000000 1.000000 -0.000000 0.000000 0.000000 1.000000 /end COMPU_METHOD
/* Scalar calibration for DDE 'CcsIprAcdMaxAcCrntRange5Ofst1_C'. */
/begin CHARACTERISTIC CcsIprAcdMaxAcCrntRange5Ofst1_C "offset for maximum AC current after applying the gain  CcsIprAcdMaxAcCrntRange5Gain1_C that converts dutycycle to max AC current based on Table 5 in SAE J!772 for dytycycle range between 10 to 20 %" VALUE 0x70019e74 RL_CCSIPRACDMAXACCRNTRANGE5OFS0 100.000000 CU_CCSIPRACDMAXACCRNTRANGE5OFS0 0.000000 100.000000 BYTE_ORDER MSB_LAST /end CHARACTERISTIC
/begin RECORD_LAYOUT RL_CCSIPRACDMAXACCRNTRANGE5OFS0 FNC_VALUES 1 FLOAT32_IEEE COLUMN_DIR DIRECT /end RECORD_LAYOUT
/begin COMPU_METHOD CU_CCSIPRACDMAXACCRNTRANGE5OFS0 "Conversion method for CcsIprAcdMaxAcCrntRange5Ofst1_C" RAT_FUNC "%10.0" "A" COEFFS 0.000000 1.000000 -0.000000 0.000000 0.000000 1.000000 /end COMPU_METHOD
/* Scalar calibration for DDE 'CcsIprAcdMaxAcCrntRange6Gain1_C'. */
/begin CHARACTERISTIC CcsIprAcdMaxAcCrntRange6Gain1_C "Gain that converts dutycycle to max AC current based on Table 5 in SAE J!772 for dytycycle range between 20 to 85 %" VALUE 0x700175ec RL_CCSIPRACDMAXACCRNTRANGE6GAI1 10.000000 CU_CCSIPRACDMAXACCRNTRANGE6GAI1 0.000000 10.000000 BYTE_ORDER MSB_LAST /end CHARACTERISTIC
/begin RECORD_LAYOUT RL_CCSIPRACDMAXACCRNTRANGE6GAI1 FNC_VALUES 1 FLOAT32_IEEE COLUMN_DIR DIRECT /end RECORD_LAYOUT
/begin COMPU_METHOD CU_CCSIPRACDMAXACCRNTRANGE6GAI1 "Conversion method for CcsIprAcdMaxAcCrntRange6Gain1_C" RAT_FUNC "%10.0" "A/pct" COEFFS 0.000000 1.000000 -0.000000 0.000000 0.000000 1.000000 /end COMPU_METHOD
/* Scalar calibration for DDE 'CcsIprAcdMaxAcCrntRange6Gain2_C'. */
/begin CHARACTERISTIC CcsIprAcdMaxAcCrntRange6Gain2_C "Gain for maximum AC current after applying the gain  CcsIprAcdMaxAcCrntRange6Gain1_C that converts dutycycle to max AC current based on Table 5 in SAE J!772 for dytycycle range between 20 to 85 %" VALUE 0x70017418 RL_CCSIPRACDMAXACCRNTRANGE6GAI0 100.000000 CU_CCSIPRACDMAXACCRNTRANGE6GAI0 0.000000 100.000000 BYTE_ORDER MSB_LAST /end CHARACTERISTIC
/begin RECORD_LAYOUT RL_CCSIPRACDMAXACCRNTRANGE6GAI0 FNC_VALUES 1 FLOAT32_IEEE COLUMN_DIR DIRECT /end RECORD_LAYOUT
/begin COMPU_METHOD CU_CCSIPRACDMAXACCRNTRANGE6GAI0 "Conversion method for CcsIprAcdMaxAcCrntRange6Gain2_C" RAT_FUNC "%10.0" "1" COEFFS 0.000000 1.000000 -0.000000 0.000000 0.000000 1.000000 /end COMPU_METHOD
/* Scalar calibration for DDE 'CcsIprAcdMaxAcCrntRange7Gain1_C'. */
/begin CHARACTERISTIC CcsIprAcdMaxAcCrntRange7Gain1_C "Gain that converts dutycycle to max AC current based on Table 5 in SAE J!772 for dytycycle range between  85 to 96 %" VALUE 0x70017420 RL_CCSIPRACDMAXACCRNTRANGE7GAI0 10.000000 CU_CCSIPRACDMAXACCRNTRANGE7GAI0 0.000000 10.000000 BYTE_ORDER MSB_LAST /end CHARACTERISTIC
/begin RECORD_LAYOUT RL_CCSIPRACDMAXACCRNTRANGE7GAI0 FNC_VALUES 1 FLOAT32_IEEE COLUMN_DIR DIRECT /end RECORD_LAYOUT
/begin COMPU_METHOD CU_CCSIPRACDMAXACCRNTRANGE7GAI0 "Conversion method for CcsIprAcdMaxAcCrntRange7Gain1_C" RAT_FUNC "%10.0" "A/pct" COEFFS 0.000000 1.000000 -0.000000 0.000000 0.000000 1.000000 /end COMPU_METHOD
/* Scalar calibration for DDE 'CcsIprAcdMaxAcCrntRange7Gain2_C'. */
/begin CHARACTERISTIC CcsIprAcdMaxAcCrntRange7Gain2_C "Gain for maximum AC current after applying the gain  CcsIprAcdMaxAcCrntRange7Gain1_C that converts dutycycle to max AC current based on Table 5 in SAE J!772 for dytycycle range between  85 to 96 %" VALUE 0x700175fc RL_CCSIPRACDMAXACCRNTRANGE7GAI1 100.000000 CU_CCSIPRACDMAXACCRNTRANGE7GAI1 0.000000 100.000000 BYTE_ORDER MSB_LAST /end CHARACTERISTIC
/begin RECORD_LAYOUT RL_CCSIPRACDMAXACCRNTRANGE7GAI1 FNC_VALUES 1 FLOAT32_IEEE COLUMN_DIR DIRECT /end RECORD_LAYOUT
/begin COMPU_METHOD CU_CCSIPRACDMAXACCRNTRANGE7GAI1 "Conversion method for CcsIprAcdMaxAcCrntRange7Gain2_C" RAT_FUNC "%10.0" "1" COEFFS 0.000000 1.000000 -0.000000 0.000000 0.000000 1.000000 /end COMPU_METHOD
/* Scalar calibration for DDE 'CcsIprAcdMaxAcCrntRange7Ofst1_C'. */
/begin CHARACTERISTIC CcsIprAcdMaxAcCrntRange7Ofst1_C "Maximuim AC charge current when CP dutycycle is between 85 to 96 %" VALUE 0x700175f4 RL_CCSIPRACDMAXACCRNTRANGE7OFS0 200.000000 CU_CCSIPRACDMAXACCRNTRANGE7OFS0 -100.000000 100.000000 BYTE_ORDER MSB_LAST /end CHARACTERISTIC
/begin RECORD_LAYOUT RL_CCSIPRACDMAXACCRNTRANGE7OFS0 FNC_VALUES 1 FLOAT32_IEEE COLUMN_DIR DIRECT /end RECORD_LAYOUT
/begin COMPU_METHOD CU_CCSIPRACDMAXACCRNTRANGE7OFS0 "Conversion method for CcsIprAcdMaxAcCrntRange7Ofst1_C" RAT_FUNC "%10.0" "%" COEFFS 0.000000 1.000000 -0.000000 0.000000 0.000000 1.000000 /end COMPU_METHOD
/* Scalar calibration for DDE 'CcsIprAcdMaxAcCrntRange8Gain1_C'. */
/begin CHARACTERISTIC CcsIprAcdMaxAcCrntRange8Gain1_C "gain for Maximuim AC charge current when CP dutycycle is between 96 to 96.5 %" VALUE 0x70017428 RL_CCSIPRACDMAXACCRNTRANGE8GAI0 100.000000 CU_CCSIPRACDMAXACCRNTRANGE8GAI0 0.000000 100.000000 BYTE_ORDER MSB_LAST /end CHARACTERISTIC
/begin RECORD_LAYOUT RL_CCSIPRACDMAXACCRNTRANGE8GAI0 FNC_VALUES 1 FLOAT32_IEEE COLUMN_DIR DIRECT /end RECORD_LAYOUT
/begin COMPU_METHOD CU_CCSIPRACDMAXACCRNTRANGE8GAI0 "Conversion method for CcsIprAcdMaxAcCrntRange8Gain1_C" RAT_FUNC "%10.0" "1" COEFFS 0.000000 1.000000 -0.000000 0.000000 0.000000 1.000000 /end COMPU_METHOD
/* Scalar calibration for DDE 'CcsIprAcdMaxAcCrntRange8Ofst1_C'. */
/begin CHARACTERISTIC CcsIprAcdMaxAcCrntRange8Ofst1_C "Maximuim AC charge current when CP dutycycle is between 96 to 96.5 %" VALUE 0x70017604 RL_CCSIPRACDMAXACCRNTRANGE8OFS0 100.000000 CU_CCSIPRACDMAXACCRNTRANGE8OFS0 0.000000 100.000000 BYTE_ORDER MSB_LAST /end CHARACTERISTIC
/begin RECORD_LAYOUT RL_CCSIPRACDMAXACCRNTRANGE8OFS0 FNC_VALUES 1 FLOAT32_IEEE COLUMN_DIR DIRECT /end RECORD_LAYOUT
/begin COMPU_METHOD CU_CCSIPRACDMAXACCRNTRANGE8OFS0 "Conversion method for CcsIprAcdMaxAcCrntRange8Ofst1_C" RAT_FUNC "%10.0" "A" COEFFS 0.000000 1.000000 -0.000000 0.000000 0.000000 1.000000 /end COMPU_METHOD
/* Scalar calibration for DDE 'CcsIprCpChargingModeOf_C'. */
/begin CHARACTERISTIC CcsIprCpChargingModeOf_C "Enables overriding the enumerated charging mode" VALUE 0x70019777 RL_CCSIPRCPCHARGINGMODEOF_C 1.000000 CU_CCSIPRCPCHARGINGMODEOF_C 0.000000 1.000000 BYTE_ORDER MSB_LAST /end CHARACTERISTIC
/begin RECORD_LAYOUT RL_CCSIPRCPCHARGINGMODEOF_C FNC_VALUES 1 UBYTE COLUMN_DIR DIRECT /end RECORD_LAYOUT
/begin COMPU_METHOD CU_CCSIPRCPCHARGINGMODEOF_C "Conversion method for CcsIprCpChargingModeOf_C" RAT_FUNC "%10.0" "b" COEFFS 0.000000 1.000000 -0.000000 0.000000 0.000000 1.000000 /end COMPU_METHOD
/* Scalar calibration for DDE 'CcsIprCpChargingModeOv_C'. */
/begin CHARACTERISTIC CcsIprCpChargingModeOv_C "Override value for the enumerated charging mode" VALUE 0x700185a4 RL_CCSIPRCPCHARGINGMODEOV_C 4294967295.000000 CU_CCSIPRCPCHARGINGMODEOV_C -2147483648.000000 2147483647.000000 BYTE_ORDER MSB_LAST /end CHARACTERISTIC
/begin RECORD_LAYOUT RL_CCSIPRCPCHARGINGMODEOV_C FNC_VALUES 1 SLONG COLUMN_DIR DIRECT /end RECORD_LAYOUT
/begin COMPU_METHOD CU_CCSIPRCPCHARGINGMODEOV_C "Conversion method for CcsIprCpChargingModeOv_C" TAB_VERB "%12.0" "enum" COMPU_TAB_REF CT_CCSIPRCPCHARGINGMODEOV_C /end COMPU_METHOD
/begin COMPU_VTAB CT_CCSIPRCPCHARGINGMODEOV_C "Conversion method for CcsIprCpChargingModeOv_C" TAB_VERB 4 0 "CHARGINGMODE_UNKNOWN" 1 "CHARGINGMODE_DC" 2 "CHARGINGMODE_AC" 3 "CHARGINGMODE_ERROR" /end COMPU_VTAB
/* Scalar calibration for DDE 'CcsIprCpDutcycAcDbncTime_C'. */
/begin CHARACTERISTIC CcsIprCpDutcycAcDbncTime_C "The debounce time for validating EVSE PILOT dutycycle is in AC charging range" VALUE 0x70017690 RL_CCSIPRCPDUTCYCACDBNCTIME_C 1000.000000 CU_CCSIPRCPDUTCYCACDBNCTIME_C 0.000000 1000.000000 BYTE_ORDER MSB_LAST /end CHARACTERISTIC
/begin RECORD_LAYOUT RL_CCSIPRCPDUTCYCACDBNCTIME_C FNC_VALUES 1 FLOAT32_IEEE COLUMN_DIR DIRECT /end RECORD_LAYOUT
/begin COMPU_METHOD CU_CCSIPRCPDUTCYCACDBNCTIME_C "Conversion method for CcsIprCpDutcycAcDbncTime_C" RAT_FUNC "%10.0" "s" COEFFS 0.000000 1.000000 -0.000000 0.000000 0.000000 1.000000 /end COMPU_METHOD
/* Scalar calibration for DDE 'CcsIprCpDutcycPct5DbncTime_C'. */
/begin CHARACTERISTIC CcsIprCpDutcycPct5DbncTime_C "The debounce time for validating EVSE PILOT duty is 5%." VALUE 0x70017494 RL_CCSIPRCPDUTCYCPCT5DBNCTIME_C 1000.000000 CU_CCSIPRCPDUTCYCPCT5DBNCTIME_C 0.000000 1000.000000 BYTE_ORDER MSB_LAST /end CHARACTERISTIC
/begin RECORD_LAYOUT RL_CCSIPRCPDUTCYCPCT5DBNCTIME_C FNC_VALUES 1 FLOAT32_IEEE COLUMN_DIR DIRECT /end RECORD_LAYOUT
/begin COMPU_METHOD CU_CCSIPRCPDUTCYCPCT5DBNCTIME_C "Conversion method for CcsIprCpDutcycPct5DbncTime_C" RAT_FUNC "%10.0" "s" COEFFS 0.000000 1.000000 -0.000000 0.000000 0.000000 1.000000 /end COMPU_METHOD
/* Scalar calibration for DDE 'CcsIprCpDutyRangeAcLimHi_C'. */
/begin CHARACTERISTIC CcsIprCpDutyRangeAcLimHi_C "The higher range of CP PWM dutycycle to decide the charging mode is AC" VALUE 0x70017500 RL_CCSIPRCPDUTYRANGEACLIMHI_C 100.000000 CU_CCSIPRCPDUTYRANGEACLIMHI_C 0.000000 100.000000 BYTE_ORDER MSB_LAST /end CHARACTERISTIC
/begin RECORD_LAYOUT RL_CCSIPRCPDUTYRANGEACLIMHI_C FNC_VALUES 1 FLOAT32_IEEE COLUMN_DIR DIRECT /end RECORD_LAYOUT
/begin COMPU_METHOD CU_CCSIPRCPDUTYRANGEACLIMHI_C "Conversion method for CcsIprCpDutyRangeAcLimHi_C" RAT_FUNC "%10.0" "%" COEFFS 0.000000 1.000000 -0.000000 0.000000 0.000000 1.000000 /end COMPU_METHOD
/* Scalar calibration for DDE 'CcsIprCpDutyRangeAcLimLo_C'. */
/begin CHARACTERISTIC CcsIprCpDutyRangeAcLimLo_C "The lower range of CP PWM dutycycle to decide the charging mode is AC" VALUE 0x70017660 RL_CCSIPRCPDUTYRANGEACLIMLO_C 100.000000 CU_CCSIPRCPDUTYRANGEACLIMLO_C 0.000000 100.000000 BYTE_ORDER MSB_LAST /end CHARACTERISTIC
/begin RECORD_LAYOUT RL_CCSIPRCPDUTYRANGEACLIMLO_C FNC_VALUES 1 FLOAT32_IEEE COLUMN_DIR DIRECT /end RECORD_LAYOUT
/begin COMPU_METHOD CU_CCSIPRCPDUTYRANGEACLIMLO_C "Conversion method for CcsIprCpDutyRangeAcLimLo_C" RAT_FUNC "%10.0" "%" COEFFS 0.000000 1.000000 -0.000000 0.000000 0.000000 1.000000 /end COMPU_METHOD
/* Scalar calibration for DDE 'CcsIprCpDutyRangeDcLimHi_C'. */
/begin CHARACTERISTIC CcsIprCpDutyRangeDcLimHi_C "The higher range of CP PWM dutycycle to decide it is 5% (DC charging)" VALUE 0x70017624 RL_CCSIPRCPDUTYRANGEDCLIMHI_C 100.000000 CU_CCSIPRCPDUTYRANGEDCLIMHI_C 0.000000 100.000000 BYTE_ORDER MSB_LAST /end CHARACTERISTIC
/begin RECORD_LAYOUT RL_CCSIPRCPDUTYRANGEDCLIMHI_C FNC_VALUES 1 FLOAT32_IEEE COLUMN_DIR DIRECT /end RECORD_LAYOUT
/begin COMPU_METHOD CU_CCSIPRCPDUTYRANGEDCLIMHI_C "Conversion method for CcsIprCpDutyRangeDcLimHi_C" RAT_FUNC "%10.0" "%" COEFFS 0.000000 1.000000 -0.000000 0.000000 0.000000 1.000000 /end COMPU_METHOD
/* Scalar calibration for DDE 'CcsIprCpDutyRangeDcLimLo_C'. */
/begin CHARACTERISTIC CcsIprCpDutyRangeDcLimLo_C "The lower range of CP PWM dutycycle to decide it is 5% (DC charging)" VALUE 0x70017608 RL_CCSIPRCPDUTYRANGEDCLIMLO_C 100.000000 CU_CCSIPRCPDUTYRANGEDCLIMLO_C 0.000000 100.000000 BYTE_ORDER MSB_LAST /end CHARACTERISTIC
/begin RECORD_LAYOUT RL_CCSIPRCPDUTYRANGEDCLIMLO_C FNC_VALUES 1 FLOAT32_IEEE COLUMN_DIR DIRECT /end RECORD_LAYOUT
/begin COMPU_METHOD CU_CCSIPRCPDUTYRANGEDCLIMLO_C "Conversion method for CcsIprCpDutyRangeDcLimLo_C" RAT_FUNC "%10.0" "%" COEFFS 0.000000 1.000000 -0.000000 0.000000 0.000000 1.000000 /end COMPU_METHOD
/* Scalar calibration for DDE 'CcsIprDcChgCrntNearZeroThrsh_C'. */
/begin CHARACTERISTIC CcsIprDcChgCrntNearZeroThrsh_C "Threshold for considering the charge current is near zero" VALUE 0x700176c0 RL_CCSIPRDCCHGCRNTNEARZEROTHRS0 20000.000000 CU_CCSIPRDCCHGCRNTNEARZEROTHRS0 -10000.000000 10000.000000 BYTE_ORDER MSB_LAST /end CHARACTERISTIC
/begin RECORD_LAYOUT RL_CCSIPRDCCHGCRNTNEARZEROTHRS0 FNC_VALUES 1 FLOAT32_IEEE COLUMN_DIR DIRECT /end RECORD_LAYOUT
/begin COMPU_METHOD CU_CCSIPRDCCHGCRNTNEARZEROTHRS0 "Conversion method for CcsIprDcChgCrntNearZeroThrsh_C" RAT_FUNC "%10.0" "A" COEFFS 0.000000 1.000000 -0.000000 0.000000 0.000000 1.000000 /end COMPU_METHOD
/* Scalar calibration for DDE 'CcsIprDcChgInletCrntSafeOf_C'. */
/begin CHARACTERISTIC CcsIprDcChgInletCrntSafeOf_C "Enables overriding Indicator that the current at charge inlet is low and is in a safe level" VALUE 0x700186f5 RL_CCSIPRDCCHGINLETCRNTSAFEOF_C 1.000000 CU_CCSIPRDCCHGINLETCRNTSAFEOF_C 0.000000 1.000000 BYTE_ORDER MSB_LAST /end CHARACTERISTIC
/begin RECORD_LAYOUT RL_CCSIPRDCCHGINLETCRNTSAFEOF_C FNC_VALUES 1 UBYTE COLUMN_DIR DIRECT /end RECORD_LAYOUT
/begin COMPU_METHOD CU_CCSIPRDCCHGINLETCRNTSAFEOF_C "Conversion method for CcsIprDcChgInletCrntSafeOf_C" RAT_FUNC "%10.0" "b" COEFFS 0.000000 1.000000 -0.000000 0.000000 0.000000 1.000000 /end COMPU_METHOD
/* Scalar calibration for DDE 'CcsIprDcChgInletCrntSafeOv_C'. */
/begin CHARACTERISTIC CcsIprDcChgInletCrntSafeOv_C "Override value for  Indicator that the current at charge inlet is low and is in a safe level" VALUE 0x700184e5 RL_CCSIPRDCCHGINLETCRNTSAFEOV_C 1.000000 CU_CCSIPRDCCHGINLETCRNTSAFEOV_C 0.000000 1.000000 BYTE_ORDER MSB_LAST /end CHARACTERISTIC
/begin RECORD_LAYOUT RL_CCSIPRDCCHGINLETCRNTSAFEOV_C FNC_VALUES 1 UBYTE COLUMN_DIR DIRECT /end RECORD_LAYOUT
/begin COMPU_METHOD CU_CCSIPRDCCHGINLETCRNTSAFEOV_C "Conversion method for CcsIprDcChgInletCrntSafeOv_C" RAT_FUNC "%10.0" "b" COEFFS 0.000000 1.000000 -0.000000 0.000000 0.000000 1.000000 /end COMPU_METHOD
/* Scalar calibration for DDE 'CcsIprDcChgInletCrntSafeThrsh_C'. */
/begin CHARACTERISTIC CcsIprDcChgInletCrntSafeThrsh_C "Threshold for approving the Current at the charge inlet is below a safe level" VALUE 0x7001754c RL_CCSIPRDCCHGINLETCRNTSAFETHR0 2000.000000 CU_CCSIPRDCCHGINLETCRNTSAFETHR0 -1000.000000 1000.000000 BYTE_ORDER MSB_LAST /end CHARACTERISTIC
/begin RECORD_LAYOUT RL_CCSIPRDCCHGINLETCRNTSAFETHR0 FNC_VALUES 1 FLOAT32_IEEE COLUMN_DIR DIRECT /end RECORD_LAYOUT
/begin COMPU_METHOD CU_CCSIPRDCCHGINLETCRNTSAFETHR0 "Conversion method for CcsIprDcChgInletCrntSafeThrsh_C" RAT_FUNC "%10.0" "A" COEFFS 0.000000 1.000000 -0.000000 0.000000 0.000000 1.000000 /end COMPU_METHOD
/* Scalar calibration for DDE 'CcsIprDcChgInletVoltSafeOf_C'. */
/begin CHARACTERISTIC CcsIprDcChgInletVoltSafeOf_C "Enables overriding Indicator that the volt at charge inlet is low and is in a safe level" VALUE 0x70019e97 RL_CCSIPRDCCHGINLETVOLTSAFEOF_C 1.000000 CU_CCSIPRDCCHGINLETVOLTSAFEOF_C 0.000000 1.000000 BYTE_ORDER MSB_LAST /end CHARACTERISTIC
/begin RECORD_LAYOUT RL_CCSIPRDCCHGINLETVOLTSAFEOF_C FNC_VALUES 1 UBYTE COLUMN_DIR DIRECT /end RECORD_LAYOUT
/begin COMPU_METHOD CU_CCSIPRDCCHGINLETVOLTSAFEOF_C "Conversion method for CcsIprDcChgInletVoltSafeOf_C" RAT_FUNC "%10.0" "b" COEFFS 0.000000 1.000000 -0.000000 0.000000 0.000000 1.000000 /end COMPU_METHOD
/* Scalar calibration for DDE 'CcsIprDcChgInletVoltSafeOv_C'. */
/begin CHARACTERISTIC CcsIprDcChgInletVoltSafeOv_C "Override value for  Indicator that the volt at charge inlet is low and is in a safe level" VALUE 0x70019641 RL_CCSIPRDCCHGINLETVOLTSAFEOV_C 1.000000 CU_CCSIPRDCCHGINLETVOLTSAFEOV_C 0.000000 1.000000 BYTE_ORDER MSB_LAST /end CHARACTERISTIC
/begin RECORD_LAYOUT RL_CCSIPRDCCHGINLETVOLTSAFEOV_C FNC_VALUES 1 UBYTE COLUMN_DIR DIRECT /end RECORD_LAYOUT
/begin COMPU_METHOD CU_CCSIPRDCCHGINLETVOLTSAFEOV_C "Conversion method for CcsIprDcChgInletVoltSafeOv_C" RAT_FUNC "%10.0" "b" COEFFS 0.000000 1.000000 -0.000000 0.000000 0.000000 1.000000 /end COMPU_METHOD
/* Scalar calibration for DDE 'CcsIprDcChgInletVoltSafeThrsh_C'. */
/begin CHARACTERISTIC CcsIprDcChgInletVoltSafeThrsh_C "Threshold for approving the voltage at the charge inlet is below a safe level" VALUE 0x70017688 RL_CCSIPRDCCHGINLETVOLTSAFETHR0 1000.000000 CU_CCSIPRDCCHGINLETVOLTSAFETHR0 0.000000 1000.000000 BYTE_ORDER MSB_LAST /end CHARACTERISTIC
/begin RECORD_LAYOUT RL_CCSIPRDCCHGINLETVOLTSAFETHR0 FNC_VALUES 1 FLOAT32_IEEE COLUMN_DIR DIRECT /end RECORD_LAYOUT
/begin COMPU_METHOD CU_CCSIPRDCCHGINLETVOLTSAFETHR0 "Conversion method for CcsIprDcChgInletVoltSafeThrsh_C" RAT_FUNC "%10.0" "V" COEFFS 0.000000 1.000000 -0.000000 0.000000 0.000000 1.000000 /end COMPU_METHOD
/* Scalar calibration for DDE 'CcsIprDcPrechgCompleteOf_C'. */
/begin CHARACTERISTIC CcsIprDcPrechgCompleteOf_C "Enables overriding indicator that the precharge is done and RESS voltage is almost equal to Charge Inlet volt" VALUE 0x700197b6 RL_CCSIPRDCPRECHGCOMPLETEOF_C 1.000000 CU_CCSIPRDCPRECHGCOMPLETEOF_C 0.000000 1.000000 BYTE_ORDER MSB_LAST /end CHARACTERISTIC
/begin RECORD_LAYOUT RL_CCSIPRDCPRECHGCOMPLETEOF_C FNC_VALUES 1 UBYTE COLUMN_DIR DIRECT /end RECORD_LAYOUT
/begin COMPU_METHOD CU_CCSIPRDCPRECHGCOMPLETEOF_C "Conversion method for CcsIprDcPrechgCompleteOf_C" RAT_FUNC "%10.0" "b" COEFFS 0.000000 1.000000 -0.000000 0.000000 0.000000 1.000000 /end COMPU_METHOD
/* Scalar calibration for DDE 'CcsIprDcPrechgCompleteOv_C'. */
/begin CHARACTERISTIC CcsIprDcPrechgCompleteOv_C "Override value for indicator that the precharge is done and RESS voltage is almost equal to Charge Inlet volt" VALUE 0x70019e39 RL_CCSIPRDCPRECHGCOMPLETEOV_C 1.000000 CU_CCSIPRDCPRECHGCOMPLETEOV_C 0.000000 1.000000 BYTE_ORDER MSB_LAST /end CHARACTERISTIC
/begin RECORD_LAYOUT RL_CCSIPRDCPRECHGCOMPLETEOV_C FNC_VALUES 1 UBYTE COLUMN_DIR DIRECT /end RECORD_LAYOUT
/begin COMPU_METHOD CU_CCSIPRDCPRECHGCOMPLETEOV_C "Conversion method for CcsIprDcPrechgCompleteOv_C" RAT_FUNC "%10.0" "b" COEFFS 0.000000 1.000000 -0.000000 0.000000 0.000000 1.000000 /end COMPU_METHOD
/* Scalar calibration for DDE 'CcsIprDcPrechgDoneDbncTime_C'. */
/begin CHARACTERISTIC CcsIprDcPrechgDoneDbncTime_C "Debounce time for approving the conditions for HV precharging are met" VALUE 0x70017540 RL_CCSIPRDCPRECHGDONEDBNCTIME_C 10000.000000 CU_CCSIPRDCPRECHGDONEDBNCTIME_C 0.000000 10000.000000 BYTE_ORDER MSB_LAST /end CHARACTERISTIC
/begin RECORD_LAYOUT RL_CCSIPRDCPRECHGDONEDBNCTIME_C FNC_VALUES 1 FLOAT32_IEEE COLUMN_DIR DIRECT /end RECORD_LAYOUT
/begin COMPU_METHOD CU_CCSIPRDCPRECHGDONEDBNCTIME_C "Conversion method for CcsIprDcPrechgDoneDbncTime_C" RAT_FUNC "%10.0" "s" COEFFS 0.000000 1.000000 -0.000000 0.000000 0.000000 1.000000 /end COMPU_METHOD
/* Scalar calibration for DDE 'CcsIprDcPrechgVoltThrsh_C'. */
/begin CHARACTERISTIC CcsIprDcPrechgVoltThrsh_C "Threshold difference voltage between charge Inlet Voltage and battery voltage for precharging" VALUE 0x700176b4 RL_CCSIPRDCPRECHGVOLTTHRSH_C 1000.000000 CU_CCSIPRDCPRECHGVOLTTHRSH_C 0.000000 1000.000000 BYTE_ORDER MSB_LAST /end CHARACTERISTIC
/begin RECORD_LAYOUT RL_CCSIPRDCPRECHGVOLTTHRSH_C FNC_VALUES 1 FLOAT32_IEEE COLUMN_DIR DIRECT /end RECORD_LAYOUT
/begin COMPU_METHOD CU_CCSIPRDCPRECHGVOLTTHRSH_C "Conversion method for CcsIprDcPrechgVoltThrsh_C" RAT_FUNC "%10.0" "V" COEFFS 0.000000 1.000000 -0.000000 0.000000 0.000000 1.000000 /end COMPU_METHOD
/* Scalar calibration for DDE 'CcsIprDisPmaxDefault_C'. */
/begin CHARACTERISTIC CcsIprDisPmaxDefault_C "Pmax discharge schedule clip to use when no schedfule segment is active" VALUE 0x70017588 RL_CCSIPRDISPMAXDEFAULT_C 2000000000.000000 CU_CCSIPRDISPMAXDEFAULT_C -1000000000.000000 1000000000.000000 BYTE_ORDER MSB_LAST /end CHARACTERISTIC
/begin RECORD_LAYOUT RL_CCSIPRDISPMAXDEFAULT_C FNC_VALUES 1 FLOAT32_IEEE COLUMN_DIR DIRECT /end RECORD_LAYOUT
/begin COMPU_METHOD CU_CCSIPRDISPMAXDEFAULT_C "Conversion method for CcsIprDisPmaxDefault_C" RAT_FUNC "%10.0" "W" COEFFS 0.000000 1.000000 -0.000000 0.000000 0.000000 1.000000 /end COMPU_METHOD
/* Scalar calibration for DDE 'CcsIprPmaxDefault_C'. */
/begin CHARACTERISTIC CcsIprPmaxDefault_C "Pmax schedule clip to use when no schedfule segment is active" VALUE 0x70017584 RL_CCSIPRPMAXDEFAULT_C 1000000000.000000 CU_CCSIPRPMAXDEFAULT_C 0.000000 1000000000.000000 BYTE_ORDER MSB_LAST /end CHARACTERISTIC
/begin RECORD_LAYOUT RL_CCSIPRPMAXDEFAULT_C FNC_VALUES 1 FLOAT32_IEEE COLUMN_DIR DIRECT /end RECORD_LAYOUT
/begin COMPU_METHOD CU_CCSIPRPMAXDEFAULT_C "Conversion method for CcsIprPmaxDefault_C" RAT_FUNC "%10.0" "W" COEFFS 0.000000 1.000000 -0.000000 0.000000 0.000000 1.000000 /end COMPU_METHOD
/* Scalar calibration for DDE 'CcsIprPmaxEnable_C'. */
/begin CHARACTERISTIC CcsIprPmaxEnable_C "Configuration to enable use of PMax for each protocol (bit-based, zero-indexed, bit 0 - DIN, bit 1 - ISOv1, bit 2 - ISOv2, set bit to 1 to enable PMax consideration)" VALUE 0x70017580 RL_CCSIPRPMAXENABLE_C 7.000000 CU_CCSIPRPMAXENABLE_C 0.000000 7.000000 BYTE_ORDER MSB_LAST /end CHARACTERISTIC
/begin RECORD_LAYOUT RL_CCSIPRPMAXENABLE_C FNC_VALUES 1 UBYTE COLUMN_DIR DIRECT /end RECORD_LAYOUT
/begin COMPU_METHOD CU_CCSIPRPMAXENABLE_C "Conversion method for CcsIprPmaxEnable_C" RAT_FUNC "%10.0" "(not defined)" COEFFS 0.000000 1.000000 -0.000000 0.000000 0.000000 1.000000 /end COMPU_METHOD
/* Scalar calibration for DDE 'CcsIprPpDbncTime_C'. */
/begin CHARACTERISTIC CcsIprPpDbncTime_C "Debouncing time for the aquired EVSE PP signal. This signal is analog. The analog signal is converted to a three state variable. This calibration sets the debounce time for state transition among these discrete state." VALUE 0x70017684 RL_CCSIPRPPDBNCTIME_C 1000.000000 CU_CCSIPRPPDBNCTIME_C 0.000000 1000.000000 BYTE_ORDER MSB_LAST /end CHARACTERISTIC
/begin RECORD_LAYOUT RL_CCSIPRPPDBNCTIME_C FNC_VALUES 1 FLOAT32_IEEE COLUMN_DIR DIRECT /end RECORD_LAYOUT
/begin COMPU_METHOD CU_CCSIPRPPDBNCTIME_C "Conversion method for CcsIprPpDbncTime_C" RAT_FUNC "%10.0" "s" COEFFS 0.000000 1.000000 -0.000000 0.000000 0.000000 1.000000 /end COMPU_METHOD
/* Scalar calibration for DDE 'CcsIprPpHystLoMid_C'. */
/begin CHARACTERISTIC CcsIprPpHystLoMid_C "Paramter A below. Hysteresis Threshold for determing EVSE PP state from raw input voltage of this signal\nvolt less than A-W then LOW\nvolt between A+W and B-W then MIDDLE\nvolt above B+W then HIGH" VALUE 0x70017638 RL_CCSIPRPPHYSTLOMID_C 15.000000 CU_CCSIPRPPHYSTLOMID_C 0.000000 15.000000 BYTE_ORDER MSB_LAST /end CHARACTERISTIC
/begin RECORD_LAYOUT RL_CCSIPRPPHYSTLOMID_C FNC_VALUES 1 FLOAT32_IEEE COLUMN_DIR DIRECT /end RECORD_LAYOUT
/begin COMPU_METHOD CU_CCSIPRPPHYSTLOMID_C "Conversion method for CcsIprPpHystLoMid_C" RAT_FUNC "%10.0" "V" COEFFS 0.000000 1.000000 -0.000000 0.000000 0.000000 1.000000 /end COMPU_METHOD
/* Scalar calibration for DDE 'CcsIprPpHystMidHi_C'. */
/begin CHARACTERISTIC CcsIprPpHystMidHi_C "Paramter B below. Hysteresis Threshold for determing EVSE PP state from raw input voltage of this signal\nvolt less than A-W then LOW\nvolt between A+W and B-W then MIDDLE\nvolt above B+W then HIGH" VALUE 0x700174f8 RL_CCSIPRPPHYSTMIDHI_C 15.000000 CU_CCSIPRPPHYSTMIDHI_C 0.000000 15.000000 BYTE_ORDER MSB_LAST /end CHARACTERISTIC
/begin RECORD_LAYOUT RL_CCSIPRPPHYSTMIDHI_C FNC_VALUES 1 FLOAT32_IEEE COLUMN_DIR DIRECT /end RECORD_LAYOUT
/begin COMPU_METHOD CU_CCSIPRPPHYSTMIDHI_C "Conversion method for CcsIprPpHystMidHi_C" RAT_FUNC "%10.0" "V" COEFFS 0.000000 1.000000 -0.000000 0.000000 0.000000 1.000000 /end COMPU_METHOD
/* Scalar calibration for DDE 'CcsIprPpHystWidth_C'. */
/begin CHARACTERISTIC CcsIprPpHystWidth_C "Paramter W below. Hysteresis Threshold for determing EVSE PP state from raw input voltage of this signal\nvolt less than A-W then LOW\nvolt between A+W and B-W then MIDDLE\nvolt above B+W then HIGH\n" VALUE 0x7001749c RL_CCSIPRPPHYSTWIDTH_C 15.000000 CU_CCSIPRPPHYSTWIDTH_C 0.000000 15.000000 BYTE_ORDER MSB_LAST /end CHARACTERISTIC
/begin RECORD_LAYOUT RL_CCSIPRPPHYSTWIDTH_C FNC_VALUES 1 FLOAT32_IEEE COLUMN_DIR DIRECT /end RECORD_LAYOUT
/begin COMPU_METHOD CU_CCSIPRPPHYSTWIDTH_C "Conversion method for CcsIprPpHystWidth_C" RAT_FUNC "%10.0" "V" COEFFS 0.000000 1.000000 -0.000000 0.000000 0.000000 1.000000 /end COMPU_METHOD
/* Scalar calibration for DDE 'CcsIprPpPosOf_C'. */
/begin CHARACTERISTIC CcsIprPpPosOf_C "Override flag to enable overriding the processed EVSE PP signal position" VALUE 0x7001867e RL_CCSIPRPPPOSOF_C 1.000000 CU_CCSIPRPPPOSOF_C 0.000000 1.000000 BYTE_ORDER MSB_LAST /end CHARACTERISTIC
/begin RECORD_LAYOUT RL_CCSIPRPPPOSOF_C FNC_VALUES 1 UBYTE COLUMN_DIR DIRECT /end RECORD_LAYOUT
/begin COMPU_METHOD CU_CCSIPRPPPOSOF_C "Conversion method for CcsIprPpPosOf_C" RAT_FUNC "%10.0" "b" COEFFS 0.000000 1.000000 -0.000000 0.000000 0.000000 1.000000 /end COMPU_METHOD
/* Scalar calibration for DDE 'CcsIprPpPosOv_C'. */
/begin CHARACTERISTIC CcsIprPpPosOv_C "Override value of  processed EVSE PP signal position" VALUE 0x700195e4 RL_CCSIPRPPPOSOV_C 2.000000 CU_CCSIPRPPPOSOV_C 0.000000 2.000000 BYTE_ORDER MSB_LAST /end CHARACTERISTIC
/begin RECORD_LAYOUT RL_CCSIPRPPPOSOV_C FNC_VALUES 1 UBYTE COLUMN_DIR DIRECT /end RECORD_LAYOUT
/begin COMPU_METHOD CU_CCSIPRPPPOSOV_C "Conversion method for CcsIprPpPosOv_C" RAT_FUNC "%10.0" "1" COEFFS 0.000000 1.000000 -0.000000 0.000000 0.000000 1.000000 /end COMPU_METHOD
/* Scalar calibration for DDE 'CcsIprPpStOf_C'. */
/begin CHARACTERISTIC CcsIprPpStOf_C "Enables overriding The Enumerated State of Proximity Signal according to SAE J1772" VALUE 0x70019618 RL_CCSIPRPPSTOF_C 1.000000 CU_CCSIPRPPSTOF_C 0.000000 1.000000 BYTE_ORDER MSB_LAST /end CHARACTERISTIC
/begin RECORD_LAYOUT RL_CCSIPRPPSTOF_C FNC_VALUES 1 UBYTE COLUMN_DIR DIRECT /end RECORD_LAYOUT
/begin COMPU_METHOD CU_CCSIPRPPSTOF_C "Conversion method for CcsIprPpStOf_C" RAT_FUNC "%10.0" "b" COEFFS 0.000000 1.000000 -0.000000 0.000000 0.000000 1.000000 /end COMPU_METHOD
/* Scalar calibration for DDE 'CcsIprPpStOv_C'. */
/begin CHARACTERISTIC CcsIprPpStOv_C "Override value for The Enumerated State of Proximity Signal according to SAE J1772" VALUE 0x700196ec RL_CCSIPRPPSTOV_C 4294967295.000000 CU_CCSIPRPPSTOV_C -2147483648.000000 2147483647.000000 BYTE_ORDER MSB_LAST /end CHARACTERISTIC
/begin RECORD_LAYOUT RL_CCSIPRPPSTOV_C FNC_VALUES 1 SLONG COLUMN_DIR DIRECT /end RECORD_LAYOUT
/begin COMPU_METHOD CU_CCSIPRPPSTOV_C "Conversion method for CcsIprPpStOv_C" TAB_VERB "%12.0" "enum" COMPU_TAB_REF CT_CCSIPRPPSTOV_C /end COMPU_METHOD
/begin COMPU_VTAB CT_CCSIPRPPSTOV_C "Conversion method for CcsIprPpStOv_C" TAB_VERB 4 0 "PROX_DISCONNECTED" 1 "PROX_CONNECTED_S3_OPEN" 2 "PROX_CONNECTED_S3_CLOSE" 3 "PROX_INVALID" /end COMPU_VTAB
/* Scalar calibration for DDE 'CcsIprPpSupplyInvalidInitTime_C'. */
/begin CHARACTERISTIC CcsIprPpSupplyInvalidInitTime_C "Delay to protect proximity input from startup transient behavior" VALUE 0x7001752c RL_CCSIPRPPSUPPLYINVALIDINITTI0 2.999000 CU_CCSIPRPPSUPPLYINVALIDINITTI0 0.001000 3.000000 BYTE_ORDER MSB_LAST /end CHARACTERISTIC
/begin RECORD_LAYOUT RL_CCSIPRPPSUPPLYINVALIDINITTI0 FNC_VALUES 1 FLOAT32_IEEE COLUMN_DIR DIRECT /end RECORD_LAYOUT
/begin COMPU_METHOD CU_CCSIPRPPSUPPLYINVALIDINITTI0 "Conversion method for CcsIprPpSupplyInvalidInitTime_C" RAT_FUNC "%10.0" "sec" COEFFS 0.000000 1.000000 -0.000000 0.000000 0.000000 1.000000 /end COMPU_METHOD
/* Scalar calibration for DDE 'CcsIprPrtVehChargingPortStOf_C'. */
/begin CHARACTERISTIC CcsIprPrtVehChargingPortStOf_C "Enables overriding Enumerated state of Charging Inlet to be transmitted as a CAN signal to the vehicle controllers" VALUE 0x70019e3e RL_CCSIPRPRTVEHCHARGINGPORTSTO0 1.000000 CU_CCSIPRPRTVEHCHARGINGPORTSTO0 0.000000 1.000000 BYTE_ORDER MSB_LAST /end CHARACTERISTIC
/begin RECORD_LAYOUT RL_CCSIPRPRTVEHCHARGINGPORTSTO0 FNC_VALUES 1 UBYTE COLUMN_DIR DIRECT /end RECORD_LAYOUT
/begin COMPU_METHOD CU_CCSIPRPRTVEHCHARGINGPORTSTO0 "Conversion method for CcsIprPrtVehChargingPortStOf_C" RAT_FUNC "%10.0" "b" COEFFS 0.000000 1.000000 -0.000000 0.000000 0.000000 1.000000 /end COMPU_METHOD
/* Scalar calibration for DDE 'CcsIprPrtVehChargingPortStOv_C'. */
/begin CHARACTERISTIC CcsIprPrtVehChargingPortStOv_C "Override value for Enumerated state of Charging Inlet to be transmitted as a CAN signal to the vehicle controllers" VALUE 0x70018680 RL_CCSIPRPRTVEHCHARGINGPORTSTO1 4294967295.000000 CU_CCSIPRPRTVEHCHARGINGPORTSTO1 -2147483648.000000 2147483647.000000 BYTE_ORDER MSB_LAST /end CHARACTERISTIC
/begin RECORD_LAYOUT RL_CCSIPRPRTVEHCHARGINGPORTSTO1 FNC_VALUES 1 SLONG COLUMN_DIR DIRECT /end RECORD_LAYOUT
/begin COMPU_METHOD CU_CCSIPRPRTVEHCHARGINGPORTSTO1 "Conversion method for CcsIprPrtVehChargingPortStOv_C" TAB_VERB "%12.0" "enum" COMPU_TAB_REF CT_CCSIPRPRTVEHCHARGINGPORTSTO1 /end COMPU_METHOD
/begin COMPU_VTAB CT_CCSIPRPRTVEHCHARGINGPORTSTO1 "Conversion method for CcsIprPrtVehChargingPortStOv_C" TAB_VERB 4 0 "CHARGER_UNPLUGGED" 1 "CHARGER_PLUGGED_HV_ABSENT" 2 "CHARGER_PLUGGED_HV_PRESENT" 3 "CHARGER_PORT_UNKNOWN" /end COMPU_VTAB
/* Scalar calibration for DDE 'CcsIprPrxEvseCrntMaxOf_C'. */
/begin CHARACTERISTIC CcsIprPrxEvseCrntMaxOf_C "Enables overriding Maximum current the EVSE can deliver" VALUE 0x7001964c RL_CCSIPRPRXEVSECRNTMAXOF_C 1.000000 CU_CCSIPRPRXEVSECRNTMAXOF_C 0.000000 1.000000 BYTE_ORDER MSB_LAST /end CHARACTERISTIC
/begin RECORD_LAYOUT RL_CCSIPRPRXEVSECRNTMAXOF_C FNC_VALUES 1 UBYTE COLUMN_DIR DIRECT /end RECORD_LAYOUT
/begin COMPU_METHOD CU_CCSIPRPRXEVSECRNTMAXOF_C "Conversion method for CcsIprPrxEvseCrntMaxOf_C" RAT_FUNC "%10.0" "b" COEFFS 0.000000 1.000000 -0.000000 0.000000 0.000000 1.000000 /end COMPU_METHOD
/* Scalar calibration for DDE 'CcsIprPrxEvseCrntMaxOv_C'. */
/begin CHARACTERISTIC CcsIprPrxEvseCrntMaxOv_C "Override value for Maximum current the EVSE can deliver" VALUE 0x70018520 RL_CCSIPRPRXEVSECRNTMAXOV_C 196605.000000 CU_CCSIPRPRXEVSECRNTMAXOV_C 0.000000 196605.000000 BYTE_ORDER MSB_LAST /end CHARACTERISTIC
/begin RECORD_LAYOUT RL_CCSIPRPRXEVSECRNTMAXOV_C FNC_VALUES 1 FLOAT32_IEEE COLUMN_DIR DIRECT /end RECORD_LAYOUT
/begin COMPU_METHOD CU_CCSIPRPRXEVSECRNTMAXOV_C "Conversion method for CcsIprPrxEvseCrntMaxOv_C" RAT_FUNC "%10.0" "A" COEFFS 0.000000 1.000000 -0.000000 0.000000 0.000000 1.000000 /end COMPU_METHOD
/* Scalar calibration for DDE 'CcsIprPrxEvseCrntMinOf_C'. */
/begin CHARACTERISTIC CcsIprPrxEvseCrntMinOf_C "Enables overriding Minimum current the EVSE can deliver" VALUE 0x70018514 RL_CCSIPRPRXEVSECRNTMINOF_C 1.000000 CU_CCSIPRPRXEVSECRNTMINOF_C 0.000000 1.000000 BYTE_ORDER MSB_LAST /end CHARACTERISTIC
/begin RECORD_LAYOUT RL_CCSIPRPRXEVSECRNTMINOF_C FNC_VALUES 1 UBYTE COLUMN_DIR DIRECT /end RECORD_LAYOUT
/begin COMPU_METHOD CU_CCSIPRPRXEVSECRNTMINOF_C "Conversion method for CcsIprPrxEvseCrntMinOf_C" RAT_FUNC "%10.0" "b" COEFFS 0.000000 1.000000 -0.000000 0.000000 0.000000 1.000000 /end COMPU_METHOD
/* Scalar calibration for DDE 'CcsIprPrxEvseCrntMinOv_C'. */
/begin CHARACTERISTIC CcsIprPrxEvseCrntMinOv_C "Override value for Minimum current the EVSE can deliver" VALUE 0x700196c0 RL_CCSIPRPRXEVSECRNTMINOV_C 196605.000000 CU_CCSIPRPRXEVSECRNTMINOV_C 0.000000 196605.000000 BYTE_ORDER MSB_LAST /end CHARACTERISTIC
/begin RECORD_LAYOUT RL_CCSIPRPRXEVSECRNTMINOV_C FNC_VALUES 1 FLOAT32_IEEE COLUMN_DIR DIRECT /end RECORD_LAYOUT
/begin COMPU_METHOD CU_CCSIPRPRXEVSECRNTMINOV_C "Conversion method for CcsIprPrxEvseCrntMinOv_C" RAT_FUNC "%10.0" "A" COEFFS 0.000000 1.000000 -0.000000 0.000000 0.000000 1.000000 /end COMPU_METHOD
/* Scalar calibration for DDE 'CcsIprPrxEvseCrntValidTimeout_C'. */
/begin CHARACTERISTIC CcsIprPrxEvseCrntValidTimeout_C "The time duration in which the DC voltage measurement by EVSE at the charge inlet is considered valid. This value is recevied by the last V2G message" VALUE 0x700176bc RL_CCSIPRPRXEVSECRNTVALIDTIMEO0 10.000000 CU_CCSIPRPRXEVSECRNTVALIDTIMEO0 0.000000 10.000000 BYTE_ORDER MSB_LAST /end CHARACTERISTIC
/begin RECORD_LAYOUT RL_CCSIPRPRXEVSECRNTVALIDTIMEO0 FNC_VALUES 1 FLOAT32_IEEE COLUMN_DIR DIRECT /end RECORD_LAYOUT
/begin COMPU_METHOD CU_CCSIPRPRXEVSECRNTVALIDTIMEO0 "Conversion method for CcsIprPrxEvseCrntValidTimeout_C" RAT_FUNC "%10.0" "s" COEFFS 0.000000 1.000000 -0.000000 0.000000 0.000000 1.000000 /end COMPU_METHOD
/* Scalar calibration for DDE 'CcsIprPrxEvseDchgCrntMaxOf_C'. */
/begin CHARACTERISTIC CcsIprPrxEvseDchgCrntMaxOf_C "Enables overriding Maximum discharge current the EVSE can deliver" VALUE 0x70018700 RL_CCSIPRPRXEVSEDCHGCRNTMAXOF_C 1.000000 CU_CCSIPRPRXEVSEDCHGCRNTMAXOF_C 0.000000 1.000000 BYTE_ORDER MSB_LAST /end CHARACTERISTIC
/begin RECORD_LAYOUT RL_CCSIPRPRXEVSEDCHGCRNTMAXOF_C FNC_VALUES 1 UBYTE COLUMN_DIR DIRECT /end RECORD_LAYOUT
/begin COMPU_METHOD CU_CCSIPRPRXEVSEDCHGCRNTMAXOF_C "Conversion method for CcsIprPrxEvseDchgCrntMaxOf_C" RAT_FUNC "%10.0" "b" COEFFS 0.000000 1.000000 -0.000000 0.000000 0.000000 1.000000 /end COMPU_METHOD
/* Scalar calibration for DDE 'CcsIprPrxEvseDchgCrntMaxOv_C'. */
/begin CHARACTERISTIC CcsIprPrxEvseDchgCrntMaxOv_C "Override value for Maximum discharge current the EVSE can deliver" VALUE 0x70019e50 RL_CCSIPRPRXEVSEDCHGCRNTMAXOV_C 196605.000000 CU_CCSIPRPRXEVSEDCHGCRNTMAXOV_C 0.000000 196605.000000 BYTE_ORDER MSB_LAST /end CHARACTERISTIC
/begin RECORD_LAYOUT RL_CCSIPRPRXEVSEDCHGCRNTMAXOV_C FNC_VALUES 1 FLOAT32_IEEE COLUMN_DIR DIRECT /end RECORD_LAYOUT
/begin COMPU_METHOD CU_CCSIPRPRXEVSEDCHGCRNTMAXOV_C "Conversion method for CcsIprPrxEvseDchgCrntMaxOv_C" RAT_FUNC "%10.0" "A" COEFFS 0.000000 1.000000 -0.000000 0.000000 0.000000 1.000000 /end COMPU_METHOD
/* Scalar calibration for DDE 'CcsIprPrxEvseDchgCrntMinOf_C'. */
/begin CHARACTERISTIC CcsIprPrxEvseDchgCrntMinOf_C "Enables overriding Minimum discharge current the EVSE can deliver" VALUE 0x700185c1 RL_CCSIPRPRXEVSEDCHGCRNTMINOF_C 1.000000 CU_CCSIPRPRXEVSEDCHGCRNTMINOF_C 0.000000 1.000000 BYTE_ORDER MSB_LAST /end CHARACTERISTIC
/begin RECORD_LAYOUT RL_CCSIPRPRXEVSEDCHGCRNTMINOF_C FNC_VALUES 1 UBYTE COLUMN_DIR DIRECT /end RECORD_LAYOUT
/begin COMPU_METHOD CU_CCSIPRPRXEVSEDCHGCRNTMINOF_C "Conversion method for CcsIprPrxEvseDchgCrntMinOf_C" RAT_FUNC "%10.0" "b" COEFFS 0.000000 1.000000 -0.000000 0.000000 0.000000 1.000000 /end COMPU_METHOD
/* Scalar calibration for DDE 'CcsIprPrxEvseDchgCrntMinOv_C'. */
/begin CHARACTERISTIC CcsIprPrxEvseDchgCrntMinOv_C "Override value for Minimum discharge current the EVSE can deliver" VALUE 0x70019768 RL_CCSIPRPRXEVSEDCHGCRNTMINOV_C 196605.000000 CU_CCSIPRPRXEVSEDCHGCRNTMINOV_C 0.000000 196605.000000 BYTE_ORDER MSB_LAST /end CHARACTERISTIC
/begin RECORD_LAYOUT RL_CCSIPRPRXEVSEDCHGCRNTMINOV_C FNC_VALUES 1 FLOAT32_IEEE COLUMN_DIR DIRECT /end RECORD_LAYOUT
/begin COMPU_METHOD CU_CCSIPRPRXEVSEDCHGCRNTMINOV_C "Conversion method for CcsIprPrxEvseDchgCrntMinOv_C" RAT_FUNC "%10.0" "A" COEFFS 0.000000 1.000000 -0.000000 0.000000 0.000000 1.000000 /end COMPU_METHOD
/* Scalar calibration for DDE 'CcsIprPrxEvseDchgPwrMaxOf_C'. */
/begin CHARACTERISTIC CcsIprPrxEvseDchgPwrMaxOf_C "Enables overriding Maximum discharge power the EVSE can deliver" VALUE 0x700185b4 RL_CCSIPRPRXEVSEDCHGPWRMAXOF_C 1.000000 CU_CCSIPRPRXEVSEDCHGPWRMAXOF_C 0.000000 1.000000 BYTE_ORDER MSB_LAST /end CHARACTERISTIC
/begin RECORD_LAYOUT RL_CCSIPRPRXEVSEDCHGPWRMAXOF_C FNC_VALUES 1 UBYTE COLUMN_DIR DIRECT /end RECORD_LAYOUT
/begin COMPU_METHOD CU_CCSIPRPRXEVSEDCHGPWRMAXOF_C "Conversion method for CcsIprPrxEvseDchgPwrMaxOf_C" RAT_FUNC "%10.0" "b" COEFFS 0.000000 1.000000 -0.000000 0.000000 0.000000 1.000000 /end COMPU_METHOD
/* Scalar calibration for DDE 'CcsIprPrxEvseDchgPwrMaxOv_C'. */
/begin CHARACTERISTIC CcsIprPrxEvseDchgPwrMaxOv_C "Override value for Maximum discharge power the EVSE can deliver" VALUE 0x7001973c RL_CCSIPRPRXEVSEDCHGPWRMAXOV_C 196605.000000 CU_CCSIPRPRXEVSEDCHGPWRMAXOV_C 0.000000 196605.000000 BYTE_ORDER MSB_LAST /end CHARACTERISTIC
/begin RECORD_LAYOUT RL_CCSIPRPRXEVSEDCHGPWRMAXOV_C FNC_VALUES 1 FLOAT32_IEEE COLUMN_DIR DIRECT /end RECORD_LAYOUT
/begin COMPU_METHOD CU_CCSIPRPRXEVSEDCHGPWRMAXOV_C "Conversion method for CcsIprPrxEvseDchgPwrMaxOv_C" RAT_FUNC "%10.0" "A" COEFFS 0.000000 1.000000 -0.000000 0.000000 0.000000 1.000000 /end COMPU_METHOD
/* Scalar calibration for DDE 'CcsIprPrxEvsePwrMaxOf_C'. */
/begin CHARACTERISTIC CcsIprPrxEvsePwrMaxOf_C "Enables overriding Maximum power that EVSE can deliver" VALUE 0x70019e88 RL_CCSIPRPRXEVSEPWRMAXOF_C 1.000000 CU_CCSIPRPRXEVSEPWRMAXOF_C 0.000000 1.000000 BYTE_ORDER MSB_LAST /end CHARACTERISTIC
/begin RECORD_LAYOUT RL_CCSIPRPRXEVSEPWRMAXOF_C FNC_VALUES 1 UBYTE COLUMN_DIR DIRECT /end RECORD_LAYOUT
/begin COMPU_METHOD CU_CCSIPRPRXEVSEPWRMAXOF_C "Conversion method for CcsIprPrxEvsePwrMaxOf_C" RAT_FUNC "%10.0" "b" COEFFS 0.000000 1.000000 -0.000000 0.000000 0.000000 1.000000 /end COMPU_METHOD
/* Scalar calibration for DDE 'CcsIprPrxEvsePwrMaxOv_C'. */
/begin CHARACTERISTIC CcsIprPrxEvsePwrMaxOv_C "Override value for Maximum power that EVSE can deliver" VALUE 0x70019630 RL_CCSIPRPRXEVSEPWRMAXOV_C 196605.000000 CU_CCSIPRPRXEVSEPWRMAXOV_C 0.000000 196605.000000 BYTE_ORDER MSB_LAST /end CHARACTERISTIC
/begin RECORD_LAYOUT RL_CCSIPRPRXEVSEPWRMAXOV_C FNC_VALUES 1 FLOAT32_IEEE COLUMN_DIR DIRECT /end RECORD_LAYOUT
/begin COMPU_METHOD CU_CCSIPRPRXEVSEPWRMAXOV_C "Conversion method for CcsIprPrxEvsePwrMaxOv_C" RAT_FUNC "%10.0" "W" COEFFS 0.000000 1.000000 -0.000000 0.000000 0.000000 1.000000 /end COMPU_METHOD
/* Scalar calibration for DDE 'CcsIprPrxEvseVoltMaxOf_C'. */
/begin CHARACTERISTIC CcsIprPrxEvseVoltMaxOf_C "Enables overriding Maximum voltage the EVSE can deliver" VALUE 0x700186a2 RL_CCSIPRPRXEVSEVOLTMAXOF_C 1.000000 CU_CCSIPRPRXEVSEVOLTMAXOF_C 0.000000 1.000000 BYTE_ORDER MSB_LAST /end CHARACTERISTIC
/begin RECORD_LAYOUT RL_CCSIPRPRXEVSEVOLTMAXOF_C FNC_VALUES 1 UBYTE COLUMN_DIR DIRECT /end RECORD_LAYOUT
/begin COMPU_METHOD CU_CCSIPRPRXEVSEVOLTMAXOF_C "Conversion method for CcsIprPrxEvseVoltMaxOf_C" RAT_FUNC "%10.0" "b" COEFFS 0.000000 1.000000 -0.000000 0.000000 0.000000 1.000000 /end COMPU_METHOD
/* Scalar calibration for DDE 'CcsIprPrxEvseVoltMaxOv_C'. */
/begin CHARACTERISTIC CcsIprPrxEvseVoltMaxOv_C "Override value for Maximum voltage the EVSE can deliver" VALUE 0x70019d90 RL_CCSIPRPRXEVSEVOLTMAXOV_C 196605.000000 CU_CCSIPRPRXEVSEVOLTMAXOV_C 0.000000 196605.000000 BYTE_ORDER MSB_LAST /end CHARACTERISTIC
/begin RECORD_LAYOUT RL_CCSIPRPRXEVSEVOLTMAXOV_C FNC_VALUES 1 FLOAT32_IEEE COLUMN_DIR DIRECT /end RECORD_LAYOUT
/begin COMPU_METHOD CU_CCSIPRPRXEVSEVOLTMAXOV_C "Conversion method for CcsIprPrxEvseVoltMaxOv_C" RAT_FUNC "%10.0" "V" COEFFS 0.000000 1.000000 -0.000000 0.000000 0.000000 1.000000 /end COMPU_METHOD
/* Scalar calibration for DDE 'CcsIprPrxEvseVoltMinOf_C'. */
/begin CHARACTERISTIC CcsIprPrxEvseVoltMinOf_C "Enables overriding Minimum voltage the EVSE can deliver" VALUE 0x700195f3 RL_CCSIPRPRXEVSEVOLTMINOF_C 1.000000 CU_CCSIPRPRXEVSEVOLTMINOF_C 0.000000 1.000000 BYTE_ORDER MSB_LAST /end CHARACTERISTIC
/begin RECORD_LAYOUT RL_CCSIPRPRXEVSEVOLTMINOF_C FNC_VALUES 1 UBYTE COLUMN_DIR DIRECT /end RECORD_LAYOUT
/begin COMPU_METHOD CU_CCSIPRPRXEVSEVOLTMINOF_C "Conversion method for CcsIprPrxEvseVoltMinOf_C" RAT_FUNC "%10.0" "b" COEFFS 0.000000 1.000000 -0.000000 0.000000 0.000000 1.000000 /end COMPU_METHOD
/* Scalar calibration for DDE 'CcsIprPrxEvseVoltMinOv_C'. */
/begin CHARACTERISTIC CcsIprPrxEvseVoltMinOv_C "Override value for Minimum voltage the EVSE can deliver" VALUE 0x700184c8 RL_CCSIPRPRXEVSEVOLTMINOV_C 196605.000000 CU_CCSIPRPRXEVSEVOLTMINOV_C 0.000000 196605.000000 BYTE_ORDER MSB_LAST /end CHARACTERISTIC
/begin RECORD_LAYOUT RL_CCSIPRPRXEVSEVOLTMINOV_C FNC_VALUES 1 FLOAT32_IEEE COLUMN_DIR DIRECT /end RECORD_LAYOUT
/begin COMPU_METHOD CU_CCSIPRPRXEVSEVOLTMINOV_C "Conversion method for CcsIprPrxEvseVoltMinOv_C" RAT_FUNC "%10.0" "V" COEFFS 0.000000 1.000000 -0.000000 0.000000 0.000000 1.000000 /end COMPU_METHOD
/* Scalar calibration for DDE 'CcsIprPrxEvseVoltValidTimeout_C'. */
/begin CHARACTERISTIC CcsIprPrxEvseVoltValidTimeout_C "The time duration in which the DC voltage measurement by EVSE at the charge inlet is considered valid. This value is recevied by the last V2G message" VALUE 0x70017628 RL_CCSIPRPRXEVSEVOLTVALIDTIMEO0 10.000000 CU_CCSIPRPRXEVSEVOLTVALIDTIMEO0 0.000000 10.000000 BYTE_ORDER MSB_LAST /end CHARACTERISTIC
/begin RECORD_LAYOUT RL_CCSIPRPRXEVSEVOLTVALIDTIMEO0 FNC_VALUES 1 FLOAT32_IEEE COLUMN_DIR DIRECT /end RECORD_LAYOUT
/begin COMPU_METHOD CU_CCSIPRPRXEVSEVOLTVALIDTIMEO0 "Conversion method for CcsIprPrxEvseVoltValidTimeout_C" RAT_FUNC "%10.0" "s" COEFFS 0.000000 1.000000 -0.000000 0.000000 0.000000 1.000000 /end COMPU_METHOD
/* Vector/array calibration for DDE 'CcsOprChgProfileEntryDuration_CA'. */
/begin CHARACTERISTIC CcsOprChgProfileEntryDuration_0 "A vector of values specifying the duration in seconds that the charging profile entry is valid for." VAL_BLK 0x70019db8 RL_CCSOPRCHGPROFILEENTRYDURATI0 429467295.000000 CU_CCSOPRCHGPROFILEENTRYDURATI0 0.000000 429467295.000000 NUMBER 24 BYTE_ORDER MSB_LAST /end CHARACTERISTIC
/begin RECORD_LAYOUT RL_CCSOPRCHGPROFILEENTRYDURATI0 FNC_VALUES 1 FLOAT32_IEEE COLUMN_DIR DIRECT /end RECORD_LAYOUT
/begin COMPU_METHOD CU_CCSOPRCHGPROFILEENTRYDURATI0 "Conversion method for CcsOprChgProfileEntryDuration_CA" RAT_FUNC "%10.0" "sec" COEFFS 0.000000 1.000000 -0.000000 0.000000 0.000000 1.000000 /end COMPU_METHOD
/* Vector/array calibration for DDE 'CcsOprChgProfileEntryMaxPwr_CA'. */
/begin CHARACTERISTIC CcsOprChgProfileEntryMaxPwr_CA "Maximum power in Watts consumed by the vehicle within the current charging profile entry." VAL_BLK 0x70018540 RL_CCSOPRCHGPROFILEENTRYMAXPWR0 65535.000000 CU_CCSOPRCHGPROFILEENTRYMAXPWR0 0.000000 65535.000000 NUMBER 24 BYTE_ORDER MSB_LAST /end CHARACTERISTIC
/begin RECORD_LAYOUT RL_CCSOPRCHGPROFILEENTRYMAXPWR0 FNC_VALUES 1 FLOAT32_IEEE COLUMN_DIR DIRECT /end RECORD_LAYOUT
/begin COMPU_METHOD CU_CCSOPRCHGPROFILEENTRYMAXPWR0 "Conversion method for CcsOprChgProfileEntryMaxPwr_CA" RAT_FUNC "%10.0" "W" COEFFS 0.000000 1.000000 -0.000000 0.000000 0.000000 1.000000 /end COMPU_METHOD
/* Vector/array calibration for DDE 'CcsOprChgProfileEntryStrt_CA'. */
/begin CHARACTERISTIC CcsOprChgProfileEntryStrt_CA "Time when chargingProfileEntry starts to be valid. Offset in seconds from now." VAL_BLK 0x700185ec RL_CCSOPRCHGPROFILEENTRYSTRT_CA 429467295.000000 CU_CCSOPRCHGPROFILEENTRYSTRT_CA 0.000000 429467295.000000 NUMBER 24 BYTE_ORDER MSB_LAST /end CHARACTERISTIC
/begin RECORD_LAYOUT RL_CCSOPRCHGPROFILEENTRYSTRT_CA FNC_VALUES 1 FLOAT32_IEEE COLUMN_DIR DIRECT /end RECORD_LAYOUT
/begin COMPU_METHOD CU_CCSOPRCHGPROFILEENTRYSTRT_CA "Conversion method for CcsOprChgProfileEntryStrt_CA" RAT_FUNC "%10.0" "s" COEFFS 0.000000 1.000000 -0.000000 0.000000 0.000000 1.000000 /end COMPU_METHOD
/* Scalar calibration for DDE 'CcsOprPrechgTargetCrnt_C'. */
/begin CHARACTERISTIC CcsOprPrechgTargetCrnt_C "Target current transmitted in the PreChargeReq message; Non-zero current value during pre-charge preferred by some EVSE" VALUE 0x7001758c RL_CCSOPRPRECHGTARGETCRNT_C 10.000000 CU_CCSOPRPRECHGTARGETCRNT_C 0.000000 10.000000 BYTE_ORDER MSB_LAST /end CHARACTERISTIC
/begin RECORD_LAYOUT RL_CCSOPRPRECHGTARGETCRNT_C FNC_VALUES 1 FLOAT32_IEEE COLUMN_DIR DIRECT /end RECORD_LAYOUT
/begin COMPU_METHOD CU_CCSOPRPRECHGTARGETCRNT_C "Conversion method for CcsOprPrechgTargetCrnt_C" RAT_FUNC "%10.0" "A" COEFFS 0.000000 1.000000 -0.000000 0.000000 0.000000 1.000000 /end COMPU_METHOD
/* Scalar calibration for DDE 'CcsOprSessionCompleteSocThrsh_C'. */
/begin CHARACTERISTIC CcsOprSessionCompleteSocThrsh_C "If actual SOC and target SOC are within this threshold, the charging complete flag is set. If set to -1, the flag does not get set" VALUE 0x700173e8 RL_CCSOPRSESSIONCOMPLETESOCTHR0 11.000000 CU_CCSOPRSESSIONCOMPLETESOCTHR0 -1.000000 10.000000 BYTE_ORDER MSB_LAST /end CHARACTERISTIC
/begin RECORD_LAYOUT RL_CCSOPRSESSIONCOMPLETESOCTHR0 FNC_VALUES 1 FLOAT32_IEEE COLUMN_DIR DIRECT /end RECORD_LAYOUT
/begin COMPU_METHOD CU_CCSOPRSESSIONCOMPLETESOCTHR0 "Conversion method for CcsOprSessionCompleteSocThrsh_C" RAT_FUNC "%10.0" "%" COEFFS 0.000000 1.000000 -0.000000 0.000000 0.000000 1.000000 /end COMPU_METHOD
/* Scalar calibration for DDE 'CcsOprV2gTxEvCabinConditionOf_C'. */
/begin CHARACTERISTIC CcsOprV2gTxEvCabinConditionOf_C "Enables overriding Vehicle Cabin Conditioning, The vehicle is using energy from the DC supply to heat or cool the passenger compartment" VALUE 0x70019e1b RL_CCSOPRV2GTXEVCABINCONDITION2 1.000000 CU_CCSOPRV2GTXEVCABINCONDITION2 0.000000 1.000000 BYTE_ORDER MSB_LAST /end CHARACTERISTIC
/begin RECORD_LAYOUT RL_CCSOPRV2GTXEVCABINCONDITION2 FNC_VALUES 1 UBYTE COLUMN_DIR DIRECT /end RECORD_LAYOUT
/begin COMPU_METHOD CU_CCSOPRV2GTXEVCABINCONDITION2 "Conversion method for CcsOprV2gTxEvCabinConditionOf_C" RAT_FUNC "%10.0" "b" COEFFS 0.000000 1.000000 -0.000000 0.000000 0.000000 1.000000 /end COMPU_METHOD
/* Scalar calibration for DDE 'CcsOprV2gTxEvCabinConditionOv_C'. */
/begin CHARACTERISTIC CcsOprV2gTxEvCabinConditionOv_C "Override value for Vehicle Cabin Conditioning, The vehicle is using energy from the DC supply to heat or cool the passenger compartment" VALUE 0x700195cc RL_CCSOPRV2GTXEVCABINCONDITION0 1.000000 CU_CCSOPRV2GTXEVCABINCONDITION0 0.000000 1.000000 BYTE_ORDER MSB_LAST /end CHARACTERISTIC
/begin RECORD_LAYOUT RL_CCSOPRV2GTXEVCABINCONDITION0 FNC_VALUES 1 UBYTE COLUMN_DIR DIRECT /end RECORD_LAYOUT
/begin COMPU_METHOD CU_CCSOPRV2GTXEVCABINCONDITION0 "Conversion method for CcsOprV2gTxEvCabinConditionOv_C" RAT_FUNC "%10.0" "b" COEFFS 0.000000 1.000000 -0.000000 0.000000 0.000000 1.000000 /end COMPU_METHOD
/* Scalar calibration for DDE 'CcsOprV2gTxReadyToChargeOf_C'. */
/begin CHARACTERISTIC CcsOprV2gTxReadyToChargeOf_C "Enables overriding If set to TRUE, signals that the vehicle is ready for full energy transfer." VALUE 0x700186d9 RL_CCSOPRV2GTXREADYTOCHARGEOF_C 1.000000 CU_CCSOPRV2GTXREADYTOCHARGEOF_C 0.000000 1.000000 BYTE_ORDER MSB_LAST /end CHARACTERISTIC
/begin RECORD_LAYOUT RL_CCSOPRV2GTXREADYTOCHARGEOF_C FNC_VALUES 1 UBYTE COLUMN_DIR DIRECT /end RECORD_LAYOUT
/begin COMPU_METHOD CU_CCSOPRV2GTXREADYTOCHARGEOF_C "Conversion method for CcsOprV2gTxReadyToChargeOf_C" RAT_FUNC "%10.0" "b" COEFFS 0.000000 1.000000 -0.000000 0.000000 0.000000 1.000000 /end COMPU_METHOD
/* Scalar calibration for DDE 'CcsOprV2gTxReadyToChargeOv_C'. */
/begin CHARACTERISTIC CcsOprV2gTxReadyToChargeOv_C "Override value for If set to TRUE, signals that the vehicle is ready for full energy transfer." VALUE 0x70019e20 RL_CCSOPRV2GTXREADYTOCHARGEOV_C 1.000000 CU_CCSOPRV2GTXREADYTOCHARGEOV_C 0.000000 1.000000 BYTE_ORDER MSB_LAST /end CHARACTERISTIC
/begin RECORD_LAYOUT RL_CCSOPRV2GTXREADYTOCHARGEOV_C FNC_VALUES 1 UBYTE COLUMN_DIR DIRECT /end RECORD_LAYOUT
/begin COMPU_METHOD CU_CCSOPRV2GTXREADYTOCHARGEOV_C "Conversion method for CcsOprV2gTxReadyToChargeOv_C" RAT_FUNC "%10.0" "b" COEFFS 0.000000 1.000000 -0.000000 0.000000 0.000000 1.000000 /end COMPU_METHOD
/* Scalar calibration for DDE 'CcsStmChgInletLockEnOf_C'. */
/begin CHARACTERISTIC CcsStmChgInletLockEnOf_C "Enables overriding command for enabling the Charge Connector Lock into the Vehicle Inlet" VALUE 0x700196c4 RL_CCSSTMCHGINLETLOCKENOF_C 1.000000 CU_CCSSTMCHGINLETLOCKENOF_C 0.000000 1.000000 BYTE_ORDER MSB_LAST /end CHARACTERISTIC
/begin RECORD_LAYOUT RL_CCSSTMCHGINLETLOCKENOF_C FNC_VALUES 1 UBYTE COLUMN_DIR DIRECT /end RECORD_LAYOUT
/begin COMPU_METHOD CU_CCSSTMCHGINLETLOCKENOF_C "Conversion method for CcsStmChgInletLockEnOf_C" RAT_FUNC "%10.0" "b" COEFFS 0.000000 1.000000 -0.000000 0.000000 0.000000 1.000000 /end COMPU_METHOD
/* Scalar calibration for DDE 'CcsStmChgInletLockEnOv_C'. */
/begin CHARACTERISTIC CcsStmChgInletLockEnOv_C "Override value command for enabling the Charge Connector Lock into the Vehicle Inlet" VALUE 0x700185c2 RL_CCSSTMCHGINLETLOCKENOV_C 1.000000 CU_CCSSTMCHGINLETLOCKENOV_C 0.000000 1.000000 BYTE_ORDER MSB_LAST /end CHARACTERISTIC
/begin RECORD_LAYOUT RL_CCSSTMCHGINLETLOCKENOV_C FNC_VALUES 1 UBYTE COLUMN_DIR DIRECT /end RECORD_LAYOUT
/begin COMPU_METHOD CU_CCSSTMCHGINLETLOCKENOV_C "Conversion method for CcsStmChgInletLockEnOv_C" RAT_FUNC "%10.0" "b" COEFFS 0.000000 1.000000 -0.000000 0.000000 0.000000 1.000000 /end COMPU_METHOD
/* Scalar calibration for DDE 'CcsStmChgRelayEnOf_C'. */
/begin CHARACTERISTIC CcsStmChgRelayEnOf_C "Enables overriding the Request for enabling (closing) HV Charge relays on the charging path" VALUE 0x70019645 RL_CCSSTMCHGRELAYENOF_C 1.000000 CU_CCSSTMCHGRELAYENOF_C 0.000000 1.000000 BYTE_ORDER MSB_LAST /end CHARACTERISTIC
/begin RECORD_LAYOUT RL_CCSSTMCHGRELAYENOF_C FNC_VALUES 1 UBYTE COLUMN_DIR DIRECT /end RECORD_LAYOUT
/begin COMPU_METHOD CU_CCSSTMCHGRELAYENOF_C "Conversion method for CcsStmChgRelayEnOf_C" RAT_FUNC "%10.0" "b" COEFFS 0.000000 1.000000 -0.000000 0.000000 0.000000 1.000000 /end COMPU_METHOD
/* Scalar calibration for DDE 'CcsStmChgRelayEnOv_C'. */
/begin CHARACTERISTIC CcsStmChgRelayEnOv_C "Override value of Request for enabling (closing) HV Charge relays on the charging path" VALUE 0x70018515 RL_CCSSTMCHGRELAYENOV_C 1.000000 CU_CCSSTMCHGRELAYENOV_C 0.000000 1.000000 BYTE_ORDER MSB_LAST /end CHARACTERISTIC
/begin RECORD_LAYOUT RL_CCSSTMCHGRELAYENOV_C FNC_VALUES 1 UBYTE COLUMN_DIR DIRECT /end RECORD_LAYOUT
/begin COMPU_METHOD CU_CCSSTMCHGRELAYENOV_C "Conversion method for CcsStmChgRelayEnOv_C" RAT_FUNC "%10.0" "b" COEFFS 0.000000 1.000000 -0.000000 0.000000 0.000000 1.000000 /end COMPU_METHOD
/* Scalar calibration for DDE 'CcsStmChgRelayWeldCheckEnOf_C'. */
/begin CHARACTERISTIC CcsStmChgRelayWeldCheckEnOf_C "Enables overriding the Request for enabling the Weld-check logic for the HV relays on charging path" VALUE 0x70019d59 RL_CCSSTMCHGRELAYWELDCHECKENOF0 1.000000 CU_CCSSTMCHGRELAYWELDCHECKENOF0 0.000000 1.000000 BYTE_ORDER MSB_LAST /end CHARACTERISTIC
/begin RECORD_LAYOUT RL_CCSSTMCHGRELAYWELDCHECKENOF0 FNC_VALUES 1 UBYTE COLUMN_DIR DIRECT /end RECORD_LAYOUT
/begin COMPU_METHOD CU_CCSSTMCHGRELAYWELDCHECKENOF0 "Conversion method for CcsStmChgRelayWeldCheckEnOf_C" RAT_FUNC "%10.0" "b" COEFFS 0.000000 1.000000 -0.000000 0.000000 0.000000 1.000000 /end COMPU_METHOD
/* Scalar calibration for DDE 'CcsStmChgRelayWeldCheckEnOv_C'. */
/begin CHARACTERISTIC CcsStmChgRelayWeldCheckEnOv_C "Override value of Request for enabling the Weld-check logic for the HV relays on charging path" VALUE 0x700186d6 RL_CCSSTMCHGRELAYWELDCHECKENOV0 1.000000 CU_CCSSTMCHGRELAYWELDCHECKENOV0 0.000000 1.000000 BYTE_ORDER MSB_LAST /end CHARACTERISTIC
/begin RECORD_LAYOUT RL_CCSSTMCHGRELAYWELDCHECKENOV0 FNC_VALUES 1 UBYTE COLUMN_DIR DIRECT /end RECORD_LAYOUT
/begin COMPU_METHOD CU_CCSSTMCHGRELAYWELDCHECKENOV0 "Conversion method for CcsStmChgRelayWeldCheckEnOv_C" RAT_FUNC "%10.0" "b" COEFFS 0.000000 1.000000 -0.000000 0.000000 0.000000 1.000000 /end COMPU_METHOD
/* Scalar calibration for DDE 'CcsStmCrntSafeLevelTimeout1_C'. */
/begin CHARACTERISTIC CcsStmCrntSafeLevelTimeout1_C "An optional wait time for charge current at the charge inlet port to fall below a safe level threshold" VALUE 0x700176e8 RL_CCSSTMCRNTSAFELEVELTIMEOUT10 1.500000 CU_CCSSTMCRNTSAFELEVELTIMEOUT10 0.000000 1.500000 BYTE_ORDER MSB_LAST /end CHARACTERISTIC
/begin RECORD_LAYOUT RL_CCSSTMCRNTSAFELEVELTIMEOUT10 FNC_VALUES 1 FLOAT32_IEEE COLUMN_DIR DIRECT /end RECORD_LAYOUT
/begin COMPU_METHOD CU_CCSSTMCRNTSAFELEVELTIMEOUT10 "Conversion method for CcsStmCrntSafeLevelTimeout1_C" RAT_FUNC "%10.0" "s" COEFFS 0.000000 1.000000 -0.000000 0.000000 0.000000 1.000000 /end COMPU_METHOD
/* Scalar calibration for DDE 'CcsStmCrntSafeLevelTimeout2_C'. */
/begin CHARACTERISTIC CcsStmCrntSafeLevelTimeout2_C "Optional timeout when waiting for the charging current to go below a safe threshold so charge relays can be opened after that. This timeout is used only in Vehicle Initiated Shutdown stage" VALUE 0x70017578 RL_CCSSTMCRNTSAFELEVELTIMEOUT20 100000.000000 CU_CCSSTMCRNTSAFELEVELTIMEOUT20 0.000000 100000.000000 BYTE_ORDER MSB_LAST /end CHARACTERISTIC
/begin RECORD_LAYOUT RL_CCSSTMCRNTSAFELEVELTIMEOUT20 FNC_VALUES 1 FLOAT32_IEEE COLUMN_DIR DIRECT /end RECORD_LAYOUT
/begin COMPU_METHOD CU_CCSSTMCRNTSAFELEVELTIMEOUT20 "Conversion method for CcsStmCrntSafeLevelTimeout2_C" RAT_FUNC "%10.0" "s" COEFFS 0.000000 1.000000 -0.000000 0.000000 0.000000 1.000000 /end COMPU_METHOD
/* Scalar calibration for DDE 'CcsStmDelayBiDirCtrlReq_C'. */
/begin CHARACTERISTIC CcsStmDelayBiDirCtrlReq_C "The desired delay (interval) time between 2 successive DC_BidirectionalControlRes response messages." VALUE 0x700176d8 RL_CCSSTMDELAYBIDIRCTRLREQ_C 100000.000000 CU_CCSSTMDELAYBIDIRCTRLREQ_C 0.000000 100000.000000 BYTE_ORDER MSB_LAST /end CHARACTERISTIC
/begin RECORD_LAYOUT RL_CCSSTMDELAYBIDIRCTRLREQ_C FNC_VALUES 1 FLOAT32_IEEE COLUMN_DIR DIRECT /end RECORD_LAYOUT
/begin COMPU_METHOD CU_CCSSTMDELAYBIDIRCTRLREQ_C "Conversion method for CcsStmDelayBiDirCtrlReq_C" RAT_FUNC "%10.0" "s" COEFFS 0.000000 1.000000 -0.000000 0.000000 0.000000 1.000000 /end COMPU_METHOD
/* Scalar calibration for DDE 'CcsStmDelayCableCheckReq_C'. */
/begin CHARACTERISTIC CcsStmDelayCableCheckReq_C "The desired delay (interval) time between 2 successive CableCheckReq messages. Note: a number bigger than 59 leads to an EVSE initiated shutdown" VALUE 0x700176d0 RL_CCSSTMDELAYCABLECHECKREQ_C 100000.000000 CU_CCSSTMDELAYCABLECHECKREQ_C 0.000000 100000.000000 BYTE_ORDER MSB_LAST /end CHARACTERISTIC
/begin RECORD_LAYOUT RL_CCSSTMDELAYCABLECHECKREQ_C FNC_VALUES 1 FLOAT32_IEEE COLUMN_DIR DIRECT /end RECORD_LAYOUT
/begin COMPU_METHOD CU_CCSSTMDELAYCABLECHECKREQ_C "Conversion method for CcsStmDelayCableCheckReq_C" RAT_FUNC "%10.0" "s" COEFFS 0.000000 1.000000 -0.000000 0.000000 0.000000 1.000000 /end COMPU_METHOD
/* Scalar calibration for DDE 'CcsStmDelayChgParamDiscovReq_C'. */
/begin CHARACTERISTIC CcsStmDelayChgParamDiscovReq_C "The desired delay (interval) time between 2 successive ChargeParameterDiscoveryReq messages. Note: a number bigger than 59 leads to an EVSE initiated shutdown" VALUE 0x70017558 RL_CCSSTMDELAYCHGPARAMDISCOVRE0 100000.000000 CU_CCSSTMDELAYCHGPARAMDISCOVRE0 0.000000 100000.000000 BYTE_ORDER MSB_LAST /end CHARACTERISTIC
/begin RECORD_LAYOUT RL_CCSSTMDELAYCHGPARAMDISCOVRE0 FNC_VALUES 1 FLOAT32_IEEE COLUMN_DIR DIRECT /end RECORD_LAYOUT
/begin COMPU_METHOD CU_CCSSTMDELAYCHGPARAMDISCOVRE0 "Conversion method for CcsStmDelayChgParamDiscovReq_C" RAT_FUNC "%10.0" "s" COEFFS 0.000000 1.000000 -0.000000 0.000000 0.000000 1.000000 /end COMPU_METHOD
/* Scalar calibration for DDE 'CcsStmDelayContractAuthenReq_C'. */
/begin CHARACTERISTIC CcsStmDelayContractAuthenReq_C "The desired delay (interval) time between 2 successive ContractAuthenticationReq messages. Note: a number bigger than 59 leads to an EVSE initiated shutdown" VALUE 0x70017554 RL_CCSSTMDELAYCONTRACTAUTHENRE0 100000.000000 CU_CCSSTMDELAYCONTRACTAUTHENRE0 0.000000 100000.000000 BYTE_ORDER MSB_LAST /end CHARACTERISTIC
/begin RECORD_LAYOUT RL_CCSSTMDELAYCONTRACTAUTHENRE0 FNC_VALUES 1 FLOAT32_IEEE COLUMN_DIR DIRECT /end RECORD_LAYOUT
/begin COMPU_METHOD CU_CCSSTMDELAYCONTRACTAUTHENRE0 "Conversion method for CcsStmDelayContractAuthenReq_C" RAT_FUNC "%10.0" "s" COEFFS 0.000000 1.000000 -0.000000 0.000000 0.000000 1.000000 /end COMPU_METHOD
/* Scalar calibration for DDE 'CcsStmDelayCrntDemandReq_C'. */
/begin CHARACTERISTIC CcsStmDelayCrntDemandReq_C "The desired delay (interval) time between 2 successive charge demand request messages (7A). Note: a number bigger than 59 leads to an EVSE initiated shutdown" VALUE 0x7001755c RL_CCSSTMDELAYCRNTDEMANDREQ_C 100000.000000 CU_CCSSTMDELAYCRNTDEMANDREQ_C 0.000000 100000.000000 BYTE_ORDER MSB_LAST /end CHARACTERISTIC
/begin RECORD_LAYOUT RL_CCSSTMDELAYCRNTDEMANDREQ_C FNC_VALUES 1 FLOAT32_IEEE COLUMN_DIR DIRECT /end RECORD_LAYOUT
/begin COMPU_METHOD CU_CCSSTMDELAYCRNTDEMANDREQ_C "Conversion method for CcsStmDelayCrntDemandReq_C" RAT_FUNC "%10.0" "s" COEFFS 0.000000 1.000000 -0.000000 0.000000 0.000000 1.000000 /end COMPU_METHOD
/* Scalar calibration for DDE 'CcsStmDelayEvseShutdn2Init_C'. */
/begin CHARACTERISTIC CcsStmDelayEvseShutdn2Init_C "The desired delay to re-establish the charging session after completing an EVSE initiated shutdown sequence" VALUE 0x700176cc RL_CCSSTMDELAYEVSESHUTDN2INIT_C 100000.000000 CU_CCSSTMDELAYEVSESHUTDN2INIT_C 0.000000 100000.000000 BYTE_ORDER MSB_LAST /end CHARACTERISTIC
/begin RECORD_LAYOUT RL_CCSSTMDELAYEVSESHUTDN2INIT_C FNC_VALUES 1 FLOAT32_IEEE COLUMN_DIR DIRECT /end RECORD_LAYOUT
/begin COMPU_METHOD CU_CCSSTMDELAYEVSESHUTDN2INIT_C "Conversion method for CcsStmDelayEvseShutdn2Init_C" RAT_FUNC "%10.0" "s" COEFFS 0.000000 1.000000 -0.000000 0.000000 0.000000 1.000000 /end COMPU_METHOD
/* Scalar calibration for DDE 'CcsStmDelayInit_C'. */
/begin CHARACTERISTIC CcsStmDelayInit_C "An intial optional delay at first state of charging main state-machine to start processing of input signals. Is added to avoid possible frequent state switching" VALUE 0x700176f4 RL_CCSSTMDELAYINIT_C 100000.000000 CU_CCSSTMDELAYINIT_C 0.000000 100000.000000 BYTE_ORDER MSB_LAST /end CHARACTERISTIC
/begin RECORD_LAYOUT RL_CCSSTMDELAYINIT_C FNC_VALUES 1 FLOAT32_IEEE COLUMN_DIR DIRECT /end RECORD_LAYOUT
/begin COMPU_METHOD CU_CCSSTMDELAYINIT_C "Conversion method for CcsStmDelayInit_C" RAT_FUNC "%10.0" "s" COEFFS 0.000000 1.000000 -0.000000 0.000000 0.000000 1.000000 /end COMPU_METHOD
/* Scalar calibration for DDE 'CcsStmDelayMsg10aTx_C'. */
/begin CHARACTERISTIC CcsStmDelayMsg10aTx_C "Time to delay sending message 10a during noncritical shutdown" VALUE 0x700176f0 RL_CCSSTMDELAYMSG10ATX_C 100000.000000 CU_CCSSTMDELAYMSG10ATX_C 0.000000 100000.000000 BYTE_ORDER MSB_LAST /end CHARACTERISTIC
/begin RECORD_LAYOUT RL_CCSSTMDELAYMSG10ATX_C FNC_VALUES 1 FLOAT32_IEEE COLUMN_DIR DIRECT /end RECORD_LAYOUT
/begin COMPU_METHOD CU_CCSSTMDELAYMSG10ATX_C "Conversion method for CcsStmDelayMsg10aTx_C" RAT_FUNC "%10.0" "s" COEFFS 0.000000 1.000000 -0.000000 0.000000 0.000000 1.000000 /end COMPU_METHOD
/* Scalar calibration for DDE 'CcsStmDelayPreChgReq_C'. */
/begin CHARACTERISTIC CcsStmDelayPreChgReq_C "The desired delay (interval) time between 2 successive Pre-Chargerequest messages. Note: a number bigger than 59 leads to an EVSE initiated shutdown" VALUE 0x700176dc RL_CCSSTMDELAYPRECHGREQ_C 100000.000000 CU_CCSSTMDELAYPRECHGREQ_C 0.000000 100000.000000 BYTE_ORDER MSB_LAST /end CHARACTERISTIC
/begin RECORD_LAYOUT RL_CCSSTMDELAYPRECHGREQ_C FNC_VALUES 1 FLOAT32_IEEE COLUMN_DIR DIRECT /end RECORD_LAYOUT
/begin COMPU_METHOD CU_CCSSTMDELAYPRECHGREQ_C "Conversion method for CcsStmDelayPreChgReq_C" RAT_FUNC "%10.0" "s" COEFFS 0.000000 1.000000 -0.000000 0.000000 0.000000 1.000000 /end COMPU_METHOD
/* Scalar calibration for DDE 'CcsStmDelayPwrDelivReq_C'. */
/begin CHARACTERISTIC CcsStmDelayPwrDelivReq_C "The desired delay (interval) time between 2 successive Power delivery request messages. Note: a number bigger than 59 leads to an EVSE initiated shutdown" VALUE 0x70017560 RL_CCSSTMDELAYPWRDELIVREQ_C 5.000000 CU_CCSSTMDELAYPWRDELIVREQ_C 0.000000 5.000000 BYTE_ORDER MSB_LAST /end CHARACTERISTIC
/begin RECORD_LAYOUT RL_CCSSTMDELAYPWRDELIVREQ_C FNC_VALUES 1 FLOAT32_IEEE COLUMN_DIR DIRECT /end RECORD_LAYOUT
/begin COMPU_METHOD CU_CCSSTMDELAYPWRDELIVREQ_C "Conversion method for CcsStmDelayPwrDelivReq_C" RAT_FUNC "%10.0" "s" COEFFS 0.000000 1.000000 -0.000000 0.000000 0.000000 1.000000 /end COMPU_METHOD
/* Scalar calibration for DDE 'CcsStmDelayQcaStartup_C'. */
/begin CHARACTERISTIC CcsStmDelayQcaStartup_C "A delay time after enabling the V2G QCA chip. This delay allows the QCA chip to load its software and be ready to accept commands" VALUE 0x700175e8 RL_CCSSTMDELAYQCASTARTUP_C 100000.000000 CU_CCSSTMDELAYQCASTARTUP_C 0.000000 100000.000000 BYTE_ORDER MSB_LAST /end CHARACTERISTIC
/begin RECORD_LAYOUT RL_CCSSTMDELAYQCASTARTUP_C FNC_VALUES 1 FLOAT32_IEEE COLUMN_DIR DIRECT /end RECORD_LAYOUT
/begin COMPU_METHOD CU_CCSSTMDELAYQCASTARTUP_C "Conversion method for CcsStmDelayQcaStartup_C" RAT_FUNC "%10.0" "s" COEFFS 0.000000 1.000000 -0.000000 0.000000 0.000000 1.000000 /end COMPU_METHOD
/* Scalar calibration for DDE 'CcsStmDelaySvcDetailReq_C'. */
/begin CHARACTERISTIC CcsStmDelaySvcDetailReq_C "The desired delay (interval) time between 2 successive ServiceDetail request messages. Note: a number bigger than 59 leads to an EVSE initiated shutdown" VALUE 0x70017564 RL_CCSSTMDELAYSVCDETAILREQ_C 100000.000000 CU_CCSSTMDELAYSVCDETAILREQ_C 0.000000 100000.000000 BYTE_ORDER MSB_LAST /end CHARACTERISTIC
/begin RECORD_LAYOUT RL_CCSSTMDELAYSVCDETAILREQ_C FNC_VALUES 1 FLOAT32_IEEE COLUMN_DIR DIRECT /end RECORD_LAYOUT
/begin COMPU_METHOD CU_CCSSTMDELAYSVCDETAILREQ_C "Conversion method for CcsStmDelaySvcDetailReq_C" RAT_FUNC "%10.0" "s" COEFFS 0.000000 1.000000 -0.000000 0.000000 0.000000 1.000000 /end COMPU_METHOD
/* Scalar calibration for DDE 'CcsStmDelayWaitOpenChgRly_C'. */
/begin CHARACTERISTIC CcsStmDelayWaitOpenChgRly_C "An optional wait time for HV voltage charge relays to be opened even if status of relays is reported as opened" VALUE 0x7001756c RL_CCSSTMDELAYWAITOPENCHGRLY_C 100000.000000 CU_CCSSTMDELAYWAITOPENCHGRLY_C 0.000000 100000.000000 BYTE_ORDER MSB_LAST /end CHARACTERISTIC
/begin RECORD_LAYOUT RL_CCSSTMDELAYWAITOPENCHGRLY_C FNC_VALUES 1 FLOAT32_IEEE COLUMN_DIR DIRECT /end RECORD_LAYOUT
/begin COMPU_METHOD CU_CCSSTMDELAYWAITOPENCHGRLY_C "Conversion method for CcsStmDelayWaitOpenChgRly_C" RAT_FUNC "%10.0" "s" COEFFS 0.000000 1.000000 -0.000000 0.000000 0.000000 1.000000 /end COMPU_METHOD
/* Scalar calibration for DDE 'CcsStmDelayWaitVoltSafeLevel_C'. */
/begin CHARACTERISTIC CcsStmDelayWaitVoltSafeLevel_C "An optional wait time for charge volt at the charge inlet port to fall below a safe level threshold" VALUE 0x70017574 RL_CCSSTMDELAYWAITVOLTSAFELEVE0 100000.000000 CU_CCSSTMDELAYWAITVOLTSAFELEVE0 0.000000 100000.000000 BYTE_ORDER MSB_LAST /end CHARACTERISTIC
/begin RECORD_LAYOUT RL_CCSSTMDELAYWAITVOLTSAFELEVE0 FNC_VALUES 1 FLOAT32_IEEE COLUMN_DIR DIRECT /end RECORD_LAYOUT
/begin COMPU_METHOD CU_CCSSTMDELAYWAITVOLTSAFELEVE0 "Conversion method for CcsStmDelayWaitVoltSafeLevel_C" RAT_FUNC "%10.0" "s" COEFFS 0.000000 1.000000 -0.000000 0.000000 0.000000 1.000000 /end COMPU_METHOD
/* Scalar calibration for DDE 'CcsStmDelayWeldingDetectReq_C'. */
/begin CHARACTERISTIC CcsStmDelayWeldingDetectReq_C "The desired delay (interval) time between 2 successive WeldingDetectionReq messages. Note: a number bigger than 59 leads to an EVSE initiated shutdown" VALUE 0x700176e4 RL_CCSSTMDELAYWELDINGDETECTREQ0 100000.000000 CU_CCSSTMDELAYWELDINGDETECTREQ0 0.000000 100000.000000 BYTE_ORDER MSB_LAST /end CHARACTERISTIC
/begin RECORD_LAYOUT RL_CCSSTMDELAYWELDINGDETECTREQ0 FNC_VALUES 1 FLOAT32_IEEE COLUMN_DIR DIRECT /end RECORD_LAYOUT
/begin COMPU_METHOD CU_CCSSTMDELAYWELDINGDETECTREQ0 "Conversion method for CcsStmDelayWeldingDetectReq_C" RAT_FUNC "%10.0" "s" COEFFS 0.000000 1.000000 -0.000000 0.000000 0.000000 1.000000 /end COMPU_METHOD
/* Scalar calibration for DDE 'CcsStmEvIsolCheckInhibitOf_C'. */
/begin CHARACTERISTIC CcsStmEvIsolCheckInhibitOf_C "Enables overriding Request for inhibiting HV Isolation Check on EV side" VALUE 0x7001976c RL_CCSSTMEVISOLCHECKINHIBITOF_C 1.000000 CU_CCSSTMEVISOLCHECKINHIBITOF_C 0.000000 1.000000 BYTE_ORDER MSB_LAST /end CHARACTERISTIC
/begin RECORD_LAYOUT RL_CCSSTMEVISOLCHECKINHIBITOF_C FNC_VALUES 1 UBYTE COLUMN_DIR DIRECT /end RECORD_LAYOUT
/begin COMPU_METHOD CU_CCSSTMEVISOLCHECKINHIBITOF_C "Conversion method for CcsStmEvIsolCheckInhibitOf_C" RAT_FUNC "%10.0" "b" COEFFS 0.000000 1.000000 -0.000000 0.000000 0.000000 1.000000 /end COMPU_METHOD
/* Scalar calibration for DDE 'CcsStmEvIsolCheckInhibitOv_C'. */
/begin CHARACTERISTIC CcsStmEvIsolCheckInhibitOv_C "Override value for Request for inhibiting the HV Isolation Check on EV side" VALUE 0x7001866d RL_CCSSTMEVISOLCHECKINHIBITOV_C 1.000000 CU_CCSSTMEVISOLCHECKINHIBITOV_C 0.000000 1.000000 BYTE_ORDER MSB_LAST /end CHARACTERISTIC
/begin RECORD_LAYOUT RL_CCSSTMEVISOLCHECKINHIBITOV_C FNC_VALUES 1 UBYTE COLUMN_DIR DIRECT /end RECORD_LAYOUT
/begin COMPU_METHOD CU_CCSSTMEVISOLCHECKINHIBITOV_C "Conversion method for CcsStmEvIsolCheckInhibitOv_C" RAT_FUNC "%10.0" "b" COEFFS 0.000000 1.000000 -0.000000 0.000000 0.000000 1.000000 /end COMPU_METHOD
/* Scalar calibration for DDE 'CcsStmPrxMsg10bTimeout_C'. */
/begin CHARACTERISTIC CcsStmPrxMsg10bTimeout_C "Timeout for not receiving the expected PLC message 10b from EVSE" VALUE 0x70017570 RL_CCSSTMPRXMSG10BTIMEOUT_C 100000.000000 CU_CCSSTMPRXMSG10BTIMEOUT_C 0.000000 100000.000000 BYTE_ORDER MSB_LAST /end CHARACTERISTIC
/begin RECORD_LAYOUT RL_CCSSTMPRXMSG10BTIMEOUT_C FNC_VALUES 1 FLOAT32_IEEE COLUMN_DIR DIRECT /end RECORD_LAYOUT
/begin COMPU_METHOD CU_CCSSTMPRXMSG10BTIMEOUT_C "Conversion method for CcsStmPrxMsg10bTimeout_C" RAT_FUNC "%10.0" "s" COEFFS 0.000000 1.000000 -0.000000 0.000000 0.000000 1.000000 /end COMPU_METHOD
/* Scalar calibration for DDE 'CcsStmPrxMsg9bTimeout_C'. */
/begin CHARACTERISTIC CcsStmPrxMsg9bTimeout_C "Timeout for not receiving the expected PLC message 9b from EVSE" VALUE 0x70017568 RL_CCSSTMPRXMSG9BTIMEOUT_C 100000.000000 CU_CCSSTMPRXMSG9BTIMEOUT_C 0.000000 100000.000000 BYTE_ORDER MSB_LAST /end CHARACTERISTIC
/begin RECORD_LAYOUT RL_CCSSTMPRXMSG9BTIMEOUT_C FNC_VALUES 1 FLOAT32_IEEE COLUMN_DIR DIRECT /end RECORD_LAYOUT
/begin COMPU_METHOD CU_CCSSTMPRXMSG9BTIMEOUT_C "Conversion method for CcsStmPrxMsg9bTimeout_C" RAT_FUNC "%10.0" "s" COEFFS 0.000000 1.000000 -0.000000 0.000000 0.000000 1.000000 /end COMPU_METHOD
/* Scalar calibration for DDE 'CcsStmSlacTerminateTimeout_C'. */
/begin CHARACTERISTIC CcsStmSlacTerminateTimeout_C "Optional timeout when waiting for SLAC/TCP link with EVSE to be terminated. Set to a big value to disable this timeout" VALUE 0x700176ec RL_CCSSTMSLACTERMINATETIMEOUT_C 100000.000000 CU_CCSSTMSLACTERMINATETIMEOUT_C 0.000000 100000.000000 BYTE_ORDER MSB_LAST /end CHARACTERISTIC
/begin RECORD_LAYOUT RL_CCSSTMSLACTERMINATETIMEOUT_C FNC_VALUES 1 FLOAT32_IEEE COLUMN_DIR DIRECT /end RECORD_LAYOUT
/begin COMPU_METHOD CU_CCSSTMSLACTERMINATETIMEOUT_C "Conversion method for CcsStmSlacTerminateTimeout_C" RAT_FUNC "%10.0" "s" COEFFS 0.000000 1.000000 -0.000000 0.000000 0.000000 1.000000 /end COMPU_METHOD
/* Scalar calibration for DDE 'CcsStmStateOf_C'. */
/begin CHARACTERISTIC CcsStmStateOf_C "Enables overriding The main state of state-machine that controls the timing of charge seesion based on SAE J1772" VALUE 0x70019775 RL_CCSSTMSTATEOF_C 1.000000 CU_CCSSTMSTATEOF_C 0.000000 1.000000 BYTE_ORDER MSB_LAST /end CHARACTERISTIC
/begin RECORD_LAYOUT RL_CCSSTMSTATEOF_C FNC_VALUES 1 UBYTE COLUMN_DIR DIRECT /end RECORD_LAYOUT
/begin COMPU_METHOD CU_CCSSTMSTATEOF_C "Conversion method for CcsStmStateOf_C" RAT_FUNC "%10.0" "b" COEFFS 0.000000 1.000000 -0.000000 0.000000 0.000000 1.000000 /end COMPU_METHOD
/* Scalar calibration for DDE 'CcsStmStateOv_C'. */
/begin CHARACTERISTIC CcsStmStateOv_C "Override value for The enumerated state of state-machine that controls the timing of charge seesion based on SAE J1772" VALUE 0x70018678 RL_CCSSTMSTATEOV_C 4294967295.000000 CU_CCSSTMSTATEOV_C -2147483648.000000 2147483647.000000 BYTE_ORDER MSB_LAST /end CHARACTERISTIC
/begin RECORD_LAYOUT RL_CCSSTMSTATEOV_C FNC_VALUES 1 SLONG COLUMN_DIR DIRECT /end RECORD_LAYOUT
/begin COMPU_METHOD CU_CCSSTMSTATEOV_C "Conversion method for CcsStmStateOv_C" TAB_VERB "%12.0" "enum" COMPU_TAB_REF CT_CCSSTMSTATEOV_C /end COMPU_METHOD
/begin COMPU_VTAB CT_CCSSTMSTATEOV_C "Conversion method for CcsStmStateOv_C" TAB_VERB 45 0 "V2G_CHARGER_DISCON" 31 "V2G_WAITFOR_IDENTIFYING_CHG_MODE" 1 "V2G_ENABLE_QCA" 2 "V2G_INIT_SLAC_ASSOC" 3 "V2G_INIT_APP_PROTOCOL" 4 "V2G_INIT_SESSION_SETUP" 5 "V2G_INIT_SERVICE_DISCOV" 40 "V2G_INIT_SERVICE_DETAIL" 6 "V2G_INIT_PAYMENT_SEL" 7 "V2G_INIT_CONTRACT_AUTHEN" 8 "V2G_INIT_CHG_PARAM_DISCOV" 9 "V2G_INIT_CHG_INLET_LOCK_ENABLE" 10 "V2G_ISOL_EV_STOP_ISOL_MONITOR" 11 "V2G_ISOL_CABLE_CHECK" 12 "V2G_PRECHG_PRECHARGING" 13 "V2G_PRECHG_CLOSE_CHARGE_RELAYS" 14 "V2G_PRECHG_POWERDELIVERY" 15 "V2G_ENGYTRNSF_CRNT_DEMAND" 16 "V2G_NORMSHUTDN_POWERDELIVERY" 17 "V2G_NORMSHUTDN_WAIT_ZEROCURRENT" 18 "V2G_NORMSHUTDN_PILOT_B2" 19 "V2G_NORMSHUTDN_WELD_DETECT" 20 "V2G_NORMSHUTDN_OPEN_CHARGE_RELAYS" 21 "V2G_NORMSHUTDN_SESSION_STOP" 22 "V2G_NORMSHUTDN_TERMINATE_TCP_LINK" 23 "V2G_NORMSHUTDN_INLET_VOLT_SAFELEVEL" 24 "V2G_NORMSHUTDN_CHG_SESSION_COMPLETE" 25 "V2G_VEHSHUTDN_SESSION_STOP" 26 "V2G_VEHSHUTDN_TERMINATE_TCP_LINK" 27 "V2G_VEHSHUTDN_OPEN_CHARGE_RELAYS" 28 "V2G_VEHSHUTDN_COMPLETE" 29 "V2G_EVSESHUTDN_TERMINATE_TCP_LINK" 30 "V2G_EVSESHUTDN_OPEN_CHARGE_RELAYS" 32 "V2G_EVSESHUTDN_COMPLETE" 33 "V2G_AC_VERIFY_PROX_S3_CLOSED" 34 "V2G_AC_CLOSE_PILOT_S2_READY" 35 "V2G_AC_WAIT_EVSE_COTACTOR_CLOSE" 36 "V2G_AC_DRAW_ENERGY" 37 "V2G_AC_SHUTDN_WAIT_CRNT_ZERO" 38 "V2G_AC_SHUTDN_COMPLETE_WAIT_UNPLUG" 39 "V2G_AC_SHUTDN_UNEXPECTED_ERR" 41 "V2G_ENGYTRNSF_BPT" 42 "V2G_POWERDELIVERY_RENEG" 43 "V2G_CHG_PARAM_DISC_RENEG" 44 "V2G_ENGYTRNSF_ZEROCURRENT" /end COMPU_VTAB
/* Scalar calibration for DDE 'CcsStmUseTargetSocForShutdn_C'. */
/begin CHARACTERISTIC CcsStmUseTargetSocForShutdn_C "Calibration to configure if session should be terminated normally if charging is complete, i.e., target SOC reached. Setting to 0 disables SOC based termination, EV normal stop or EVSE can terminate normally." VALUE 0x700176d4 RL_CCSSTMUSETARGETSOCFORSHUTDN0 1.000000 CU_CCSSTMUSETARGETSOCFORSHUTDN0 0.000000 1.000000 BYTE_ORDER MSB_LAST /end CHARACTERISTIC
/begin RECORD_LAYOUT RL_CCSSTMUSETARGETSOCFORSHUTDN0 FNC_VALUES 1 UBYTE COLUMN_DIR DIRECT /end RECORD_LAYOUT
/begin COMPU_METHOD CU_CCSSTMUSETARGETSOCFORSHUTDN0 "Conversion method for CcsStmUseTargetSocForShutdn_C" RAT_FUNC "%10.0" "b" COEFFS 0.000000 1.000000 -0.000000 0.000000 0.000000 1.000000 /end COMPU_METHOD
/* Scalar calibration for DDE 'CcsStmV2gConnectInitOf_C'. */
/begin CHARACTERISTIC CcsStmV2gConnectInitOf_C "Enables overriding command for establishing the communication link with EVSE (EV-EVSE assosiation)." VALUE 0x700186fc RL_CCSSTMV2GCONNECTINITOF_C 1.000000 CU_CCSSTMV2GCONNECTINITOF_C 0.000000 1.000000 BYTE_ORDER MSB_LAST /end CHARACTERISTIC
/begin RECORD_LAYOUT RL_CCSSTMV2GCONNECTINITOF_C FNC_VALUES 1 UBYTE COLUMN_DIR DIRECT /end RECORD_LAYOUT
/begin COMPU_METHOD CU_CCSSTMV2GCONNECTINITOF_C "Conversion method for CcsStmV2gConnectInitOf_C" RAT_FUNC "%10.0" "b" COEFFS 0.000000 1.000000 -0.000000 0.000000 0.000000 1.000000 /end COMPU_METHOD
/* Scalar calibration for DDE 'CcsStmV2gConnectInitOv_C'. */
/begin CHARACTERISTIC CcsStmV2gConnectInitOv_C "Override value for command for establishing the communication link with EVSE (EV-EVSE assosiation)." VALUE 0x70019e44 RL_CCSSTMV2GCONNECTINITOV_C 1.000000 CU_CCSSTMV2GCONNECTINITOV_C 0.000000 1.000000 BYTE_ORDER MSB_LAST /end CHARACTERISTIC
/begin RECORD_LAYOUT RL_CCSSTMV2GCONNECTINITOV_C FNC_VALUES 1 UBYTE COLUMN_DIR DIRECT /end RECORD_LAYOUT
/begin COMPU_METHOD CU_CCSSTMV2GCONNECTINITOV_C "Conversion method for CcsStmV2gConnectInitOv_C" RAT_FUNC "%10.0" "b" COEFFS 0.000000 1.000000 -0.000000 0.000000 0.000000 1.000000 /end COMPU_METHOD
/* Scalar calibration for DDE 'CcsStmV2gConnectTerminateOf_C'. */
/begin CHARACTERISTIC CcsStmV2gConnectTerminateOf_C "Enables overriding command for terminating the communication link with EVSE." VALUE 0x700195ef RL_CCSSTMV2GCONNECTTERMINATEOF0 1.000000 CU_CCSSTMV2GCONNECTTERMINATEOF0 0.000000 1.000000 BYTE_ORDER MSB_LAST /end CHARACTERISTIC
/begin RECORD_LAYOUT RL_CCSSTMV2GCONNECTTERMINATEOF0 FNC_VALUES 1 UBYTE COLUMN_DIR DIRECT /end RECORD_LAYOUT
/begin COMPU_METHOD CU_CCSSTMV2GCONNECTTERMINATEOF0 "Conversion method for CcsStmV2gConnectTerminateOf_C" RAT_FUNC "%10.0" "b" COEFFS 0.000000 1.000000 -0.000000 0.000000 0.000000 1.000000 /end COMPU_METHOD
/* Scalar calibration for DDE 'CcsStmV2gConnectTerminateOv_C'. */
/begin CHARACTERISTIC CcsStmV2gConnectTerminateOv_C "Override value for command for terminating the communication link with EVSE." VALUE 0x700184bf RL_CCSSTMV2GCONNECTTERMINATEOV0 1.000000 CU_CCSSTMV2GCONNECTTERMINATEOV0 0.000000 1.000000 BYTE_ORDER MSB_LAST /end CHARACTERISTIC
/begin RECORD_LAYOUT RL_CCSSTMV2GCONNECTTERMINATEOV0 FNC_VALUES 1 UBYTE COLUMN_DIR DIRECT /end RECORD_LAYOUT
/begin COMPU_METHOD CU_CCSSTMV2GCONNECTTERMINATEOV0 "Conversion method for CcsStmV2gConnectTerminateOv_C" RAT_FUNC "%10.0" "b" COEFFS 0.000000 1.000000 -0.000000 0.000000 0.000000 1.000000 /end COMPU_METHOD
/* Scalar calibration for DDE 'CcsStmV2gPilotPulldownEnOf_C'. */
/begin CHARACTERISTIC CcsStmV2gPilotPulldownEnOf_C "Enables overriding command for enabling the internal digital output for Pilot pulldown (According to SAE J1772 F.1.8 this means entering C or D mode for Piliot signal)" VALUE 0x70019e55 RL_CCSSTMV2GPILOTPULLDOWNENOF_C 1.000000 CU_CCSSTMV2GPILOTPULLDOWNENOF_C 0.000000 1.000000 BYTE_ORDER MSB_LAST /end CHARACTERISTIC
/begin RECORD_LAYOUT RL_CCSSTMV2GPILOTPULLDOWNENOF_C FNC_VALUES 1 UBYTE COLUMN_DIR DIRECT /end RECORD_LAYOUT
/begin COMPU_METHOD CU_CCSSTMV2GPILOTPULLDOWNENOF_C "Conversion method for CcsStmV2gPilotPulldownEnOf_C" RAT_FUNC "%10.0" "b" COEFFS 0.000000 1.000000 -0.000000 0.000000 0.000000 1.000000 /end COMPU_METHOD
/* Scalar calibration for DDE 'CcsStmV2gPilotPulldownEnOv_C'. */
/begin CHARACTERISTIC CcsStmV2gPilotPulldownEnOv_C "Override value command for enabling the internal digital output for Pilot pulldown (According to SAE J1772 F.1.8 this means entering C or D mode for Piliot signal)" VALUE 0x700195f5 RL_CCSSTMV2GPILOTPULLDOWNENOV_C 1.000000 CU_CCSSTMV2GPILOTPULLDOWNENOV_C 0.000000 1.000000 BYTE_ORDER MSB_LAST /end CHARACTERISTIC
/begin RECORD_LAYOUT RL_CCSSTMV2GPILOTPULLDOWNENOV_C FNC_VALUES 1 UBYTE COLUMN_DIR DIRECT /end RECORD_LAYOUT
/begin COMPU_METHOD CU_CCSSTMV2GPILOTPULLDOWNENOV_C "Conversion method for CcsStmV2gPilotPulldownEnOv_C" RAT_FUNC "%10.0" "b" COEFFS 0.000000 1.000000 -0.000000 0.000000 0.000000 1.000000 /end COMPU_METHOD
/* Scalar calibration for DDE 'CcsStmV2gStMsgTxOf_C'. */
/begin CHARACTERISTIC CcsStmV2gStMsgTxOf_C "Enables overriding The enumerated state of state-machine that controls the transmission of PLC messages to the EVSE" VALUE 0x70019e1a RL_CCSSTMV2GSTMSGTXOF_C 1.000000 CU_CCSSTMV2GSTMSGTXOF_C 0.000000 1.000000 BYTE_ORDER MSB_LAST /end CHARACTERISTIC
/begin RECORD_LAYOUT RL_CCSSTMV2GSTMSGTXOF_C FNC_VALUES 1 UBYTE COLUMN_DIR DIRECT /end RECORD_LAYOUT
/begin COMPU_METHOD CU_CCSSTMV2GSTMSGTXOF_C "Conversion method for CcsStmV2gStMsgTxOf_C" RAT_FUNC "%10.0" "b" COEFFS 0.000000 1.000000 -0.000000 0.000000 0.000000 1.000000 /end COMPU_METHOD
/* Scalar calibration for DDE 'CcsStmV2gStMsgTxOv_C'. */
/begin CHARACTERISTIC CcsStmV2gStMsgTxOv_C "Override value for The enumerated state of state-machine that controls the transmission of PLC messages to the EVSE" VALUE 0x700195c8 RL_CCSSTMV2GSTMSGTXOV_C 4294967295.000000 CU_CCSSTMV2GSTMSGTXOV_C -2147483648.000000 2147483647.000000 BYTE_ORDER MSB_LAST /end CHARACTERISTIC
/begin RECORD_LAYOUT RL_CCSSTMV2GSTMSGTXOV_C FNC_VALUES 1 SLONG COLUMN_DIR DIRECT /end RECORD_LAYOUT
/begin COMPU_METHOD CU_CCSSTMV2GSTMSGTXOV_C "Conversion method for CcsStmV2gStMsgTxOv_C" TAB_VERB "%12.0" "enum" COMPU_TAB_REF CT_CCSSTMV2GSTMSGTXOV_C /end COMPU_METHOD
/begin COMPU_VTAB CT_CCSSTMV2GSTMSGTXOV_C "Conversion method for CcsStmV2gStMsgTxOv_C" TAB_VERB 16 0 "V2G_MSGTX_RESEND" 1 "V2G_MSGTX_SEND_SESSETUP" 2 "V2G_MSGTX_SEND_SVCDISCV" 15 "V2G_MSGTX_SEND_SVCDETAIL" 3 "V2G_MSGTX_SEND_PMTSEL" 4 "V2G_MSGTX_SEND_AUTH" 5 "V2G_MSGTX_SEND_CHGPARDISC" 6 "V2G_MSGTX_SEND_CBLCHK" 7 "V2G_MSGTX_SEND_PRECHG" 8 "V2G_MSGTX_SEND_PWRDELIV" 9 "V2G_MSGTX_SEND_CRNTDMD" 10 "V2G_MSGTX_SEND_PWRDELIV_SHUTDN" 11 "V2G_MSGTX_SEND_WELDDET" 12 "V2G_MSGTX_SEND_SESSTOP" 13 "V2G_SEND_SUPPORTEDPROTO" 14 "V2G_SEND_ISO2_BPTCTRL" /end COMPU_VTAB
/* Scalar calibration for DDE 'D3_AinE_FltMax_C'. */
/begin CHARACTERISTIC D3_AinE_FltMax_C "D3 AinE/ChgLck Max Fault Limit Cal" VALUE 0xa0108600 RL_D3_AINE_FLTMAX_C 40.000000 CU_D3_AINE_FLTMAX_C 0.000000 40.000000 BYTE_ORDER MSB_LAST /end CHARACTERISTIC
/begin RECORD_LAYOUT RL_D3_AINE_FLTMAX_C FNC_VALUES 1 FLOAT32_IEEE COLUMN_DIR DIRECT /end RECORD_LAYOUT
/begin COMPU_METHOD CU_D3_AINE_FLTMAX_C "Conversion method for D3_AinE_FltMax_C" RAT_FUNC "%10.3" "V" COEFFS 0.000000 1.000000 -0.000000 0.000000 0.000000 1.000000 /end COMPU_METHOD
/* Scalar calibration for DDE 'D3_AinE_FltMin_C'. */
/begin CHARACTERISTIC D3_AinE_FltMin_C "D3 AinE/ChgLck Min Fault Limit Cal" VALUE 0xa01085fc RL_D3_AINE_FLTMIN_C 40.000000 CU_D3_AINE_FLTMIN_C 0.000000 40.000000 BYTE_ORDER MSB_LAST /end CHARACTERISTIC
/begin RECORD_LAYOUT RL_D3_AINE_FLTMIN_C FNC_VALUES 1 FLOAT32_IEEE COLUMN_DIR DIRECT /end RECORD_LAYOUT
/begin COMPU_METHOD CU_D3_AINE_FLTMIN_C "Conversion method for D3_AinE_FltMin_C" RAT_FUNC "%10.3" "V" COEFFS 0.000000 1.000000 -0.000000 0.000000 0.000000 1.000000 /end COMPU_METHOD
/* Scalar calibration for DDE 'D3_AinE_ScaleFactor_C'. */
/begin CHARACTERISTIC D3_AinE_ScaleFactor_C "D3 AinE/ChgLck Scale value (raw divided by this value to get pin voltage)" VALUE 0xa01085f8 RL_D3_AINE_SCALEFACTOR_C 39.999000 CU_D3_AINE_SCALEFACTOR_C 0.001000 40.000000 BYTE_ORDER MSB_LAST /end CHARACTERISTIC
/begin RECORD_LAYOUT RL_D3_AINE_SCALEFACTOR_C FNC_VALUES 1 FLOAT32_IEEE COLUMN_DIR DIRECT /end RECORD_LAYOUT
/begin COMPU_METHOD CU_D3_AINE_SCALEFACTOR_C "Conversion method for D3_AinE_ScaleFactor_C" RAT_FUNC "%10.3" "(not defined)" COEFFS 0.000000 1.000000 -0.000000 0.000000 0.000000 1.000000 /end COMPU_METHOD
/* Scalar calibration for DDE 'F2_LedA_FltMax_C'. */
/begin CHARACTERISTIC F2_LedA_FltMax_C "F2 LEDA Max Fault Limit Cal" VALUE 0xa01085f4 RL_F2_LEDA_FLTMAX_C 40.000000 CU_F2_LEDA_FLTMAX_C 0.000000 40.000000 BYTE_ORDER MSB_LAST /end CHARACTERISTIC
/begin RECORD_LAYOUT RL_F2_LEDA_FLTMAX_C FNC_VALUES 1 FLOAT32_IEEE COLUMN_DIR DIRECT /end RECORD_LAYOUT
/begin COMPU_METHOD CU_F2_LEDA_FLTMAX_C "Conversion method for F2_LedA_FltMax_C" RAT_FUNC "%10.3" "V" COEFFS 0.000000 1.000000 -0.000000 0.000000 0.000000 1.000000 /end COMPU_METHOD
/* Scalar calibration for DDE 'F2_LedA_FltMin_C'. */
/begin CHARACTERISTIC F2_LedA_FltMin_C "F2 LEDA Min Fault Limit Cal" VALUE 0xa01085f0 RL_F2_LEDA_FLTMIN_C 40.000000 CU_F2_LEDA_FLTMIN_C 0.000000 40.000000 BYTE_ORDER MSB_LAST /end CHARACTERISTIC
/begin RECORD_LAYOUT RL_F2_LEDA_FLTMIN_C FNC_VALUES 1 FLOAT32_IEEE COLUMN_DIR DIRECT /end RECORD_LAYOUT
/begin COMPU_METHOD CU_F2_LEDA_FLTMIN_C "Conversion method for F2_LedA_FltMin_C" RAT_FUNC "%10.3" "V" COEFFS 0.000000 1.000000 -0.000000 0.000000 0.000000 1.000000 /end COMPU_METHOD
/* Scalar calibration for DDE 'F2_LedA_ScaleFactor_C'. */
/begin CHARACTERISTIC F2_LedA_ScaleFactor_C "F2 LEDA Scale value (raw divided by this value to get pin voltage)" VALUE 0xa01085ec RL_F2_LEDA_SCALEFACTOR_C 39.999000 CU_F2_LEDA_SCALEFACTOR_C 0.001000 40.000000 BYTE_ORDER MSB_LAST /end CHARACTERISTIC
/begin RECORD_LAYOUT RL_F2_LEDA_SCALEFACTOR_C FNC_VALUES 1 FLOAT32_IEEE COLUMN_DIR DIRECT /end RECORD_LAYOUT
/begin COMPU_METHOD CU_F2_LEDA_SCALEFACTOR_C "Conversion method for F2_LedA_ScaleFactor_C" RAT_FUNC "%10.3" "(not defined)" COEFFS 0.000000 1.000000 -0.000000 0.000000 0.000000 1.000000 /end COMPU_METHOD
/* Scalar calibration for DDE 'F3_LedB_FltMax_C'. */
/begin CHARACTERISTIC F3_LedB_FltMax_C "F3 LEDB Max Fault Limit Cal" VALUE 0xa01085e8 RL_F3_LEDB_FLTMAX_C 40.000000 CU_F3_LEDB_FLTMAX_C 0.000000 40.000000 BYTE_ORDER MSB_LAST /end CHARACTERISTIC
/begin RECORD_LAYOUT RL_F3_LEDB_FLTMAX_C FNC_VALUES 1 FLOAT32_IEEE COLUMN_DIR DIRECT /end RECORD_LAYOUT
/begin COMPU_METHOD CU_F3_LEDB_FLTMAX_C "Conversion method for F3_LedB_FltMax_C" RAT_FUNC "%10.3" "V" COEFFS 0.000000 1.000000 -0.000000 0.000000 0.000000 1.000000 /end COMPU_METHOD
/* Scalar calibration for DDE 'F3_LedB_FltMin_C'. */
/begin CHARACTERISTIC F3_LedB_FltMin_C "F3 LEDB Min Fault Limit Cal" VALUE 0xa01085e4 RL_F3_LEDB_FLTMIN_C 40.000000 CU_F3_LEDB_FLTMIN_C 0.000000 40.000000 BYTE_ORDER MSB_LAST /end CHARACTERISTIC
/begin RECORD_LAYOUT RL_F3_LEDB_FLTMIN_C FNC_VALUES 1 FLOAT32_IEEE COLUMN_DIR DIRECT /end RECORD_LAYOUT
/begin COMPU_METHOD CU_F3_LEDB_FLTMIN_C "Conversion method for F3_LedB_FltMin_C" RAT_FUNC "%10.3" "V" COEFFS 0.000000 1.000000 -0.000000 0.000000 0.000000 1.000000 /end COMPU_METHOD
/* Scalar calibration for DDE 'F3_LedB_ScaleFactor_C'. */
/begin CHARACTERISTIC F3_LedB_ScaleFactor_C "F3 LEDB Scale value (raw divided by this value to get pin voltage)" VALUE 0xa01085e0 RL_F3_LEDB_SCALEFACTOR_C 39.999000 CU_F3_LEDB_SCALEFACTOR_C 0.001000 40.000000 BYTE_ORDER MSB_LAST /end CHARACTERISTIC
/begin RECORD_LAYOUT RL_F3_LEDB_SCALEFACTOR_C FNC_VALUES 1 FLOAT32_IEEE COLUMN_DIR DIRECT /end RECORD_LAYOUT
/begin COMPU_METHOD CU_F3_LEDB_SCALEFACTOR_C "Conversion method for F3_LedB_ScaleFactor_C" RAT_FUNC "%10.3" "(not defined)" COEFFS 0.000000 1.000000 -0.000000 0.000000 0.000000 1.000000 /end COMPU_METHOD
/* Scalar calibration for DDE 'F4_LedC_FltMax_C'. */
/begin CHARACTERISTIC F4_LedC_FltMax_C "F4 LEDC Max Fault Limit Cal" VALUE 0xa01085dc RL_F4_LEDC_FLTMAX_C 40.000000 CU_F4_LEDC_FLTMAX_C 0.000000 40.000000 BYTE_ORDER MSB_LAST /end CHARACTERISTIC
/begin RECORD_LAYOUT RL_F4_LEDC_FLTMAX_C FNC_VALUES 1 FLOAT32_IEEE COLUMN_DIR DIRECT /end RECORD_LAYOUT
/begin COMPU_METHOD CU_F4_LEDC_FLTMAX_C "Conversion method for F4_LedC_FltMax_C" RAT_FUNC "%10.3" "V" COEFFS 0.000000 1.000000 -0.000000 0.000000 0.000000 1.000000 /end COMPU_METHOD
/* Scalar calibration for DDE 'F4_LedC_FltMin_C'. */
/begin CHARACTERISTIC F4_LedC_FltMin_C "F4 LEDC Min Fault Limit Cal" VALUE 0xa01085d8 RL_F4_LEDC_FLTMIN_C 40.000000 CU_F4_LEDC_FLTMIN_C 0.000000 40.000000 BYTE_ORDER MSB_LAST /end CHARACTERISTIC
/begin RECORD_LAYOUT RL_F4_LEDC_FLTMIN_C FNC_VALUES 1 FLOAT32_IEEE COLUMN_DIR DIRECT /end RECORD_LAYOUT
/begin COMPU_METHOD CU_F4_LEDC_FLTMIN_C "Conversion method for F4_LedC_FltMin_C" RAT_FUNC "%10.3" "V" COEFFS 0.000000 1.000000 -0.000000 0.000000 0.000000 1.000000 /end COMPU_METHOD
/* Scalar calibration for DDE 'F4_LedC_ScaleFactor_C'. */
/begin CHARACTERISTIC F4_LedC_ScaleFactor_C "F4 LEDC Scale value (raw divided by this value to get pin voltage)" VALUE 0xa01085d4 RL_F4_LEDC_SCALEFACTOR_C 39.999000 CU_F4_LEDC_SCALEFACTOR_C 0.001000 40.000000 BYTE_ORDER MSB_LAST /end CHARACTERISTIC
/begin RECORD_LAYOUT RL_F4_LEDC_SCALEFACTOR_C FNC_VALUES 1 FLOAT32_IEEE COLUMN_DIR DIRECT /end RECORD_LAYOUT
/begin COMPU_METHOD CU_F4_LEDC_SCALEFACTOR_C "Conversion method for F4_LedC_ScaleFactor_C" RAT_FUNC "%10.3" "(not defined)" COEFFS 0.000000 1.000000 -0.000000 0.000000 0.000000 1.000000 /end COMPU_METHOD
/* Scalar calibration for DDE 'HostAcCrntPresAtPortEnOf_C'. */
/begin CHARACTERISTIC HostAcCrntPresAtPortEnOf_C "Enables overriding" VALUE 0x700185b7 RL_HOSTACCRNTPRESATPORTENOF_C 1.000000 CU_HOSTACCRNTPRESATPORTENOF_C 0.000000 1.000000 BYTE_ORDER MSB_LAST /end CHARACTERISTIC
/begin RECORD_LAYOUT RL_HOSTACCRNTPRESATPORTENOF_C FNC_VALUES 1 UBYTE COLUMN_DIR DIRECT /end RECORD_LAYOUT
/begin COMPU_METHOD CU_HOSTACCRNTPRESATPORTENOF_C "Conversion method for HostAcCrntPresAtPortEnOf_C" RAT_FUNC "%10.0" "b" COEFFS 0.000000 1.000000 -0.000000 0.000000 0.000000 1.000000 /end COMPU_METHOD
/* Scalar calibration for DDE 'HostAcCrntPresAtPortEnOv_C'. */
/begin CHARACTERISTIC HostAcCrntPresAtPortEnOv_C "Override value" VALUE 0x70019643 RL_HOSTACCRNTPRESATPORTENOV_C 1.000000 CU_HOSTACCRNTPRESATPORTENOV_C 0.000000 1.000000 BYTE_ORDER MSB_LAST /end CHARACTERISTIC
/begin RECORD_LAYOUT RL_HOSTACCRNTPRESATPORTENOV_C FNC_VALUES 1 UBYTE COLUMN_DIR DIRECT /end RECORD_LAYOUT
/begin COMPU_METHOD CU_HOSTACCRNTPRESATPORTENOV_C "Conversion method for HostAcCrntPresAtPortEnOv_C" RAT_FUNC "%10.0" "b" COEFFS 0.000000 1.000000 -0.000000 0.000000 0.000000 1.000000 /end COMPU_METHOD
/* Scalar calibration for DDE 'HostAcCrntPresentAtPortOf_C'. */
/begin CHARACTERISTIC HostAcCrntPresentAtPortOf_C "Enables overriding Instantaneous current  at port" VALUE 0x70019daf RL_HOSTACCRNTPRESENTATPORTOF_C 1.000000 CU_HOSTACCRNTPRESENTATPORTOF_C 0.000000 1.000000 BYTE_ORDER MSB_LAST /end CHARACTERISTIC
/begin RECORD_LAYOUT RL_HOSTACCRNTPRESENTATPORTOF_C FNC_VALUES 1 UBYTE COLUMN_DIR DIRECT /end RECORD_LAYOUT
/begin COMPU_METHOD CU_HOSTACCRNTPRESENTATPORTOF_C "Conversion method for HostAcCrntPresentAtPortOf_C" RAT_FUNC "%10.0" "b" COEFFS 0.000000 1.000000 -0.000000 0.000000 0.000000 1.000000 /end COMPU_METHOD
/* Scalar calibration for DDE 'HostAcCrntPresentAtPortOv_C'. */
/begin CHARACTERISTIC HostAcCrntPresentAtPortOv_C "Override value for Instantaneous current  at port" VALUE 0x70019e96 RL_HOSTACCRNTPRESENTATPORTOV_C 1.000000 CU_HOSTACCRNTPRESENTATPORTOV_C 0.000000 1.000000 BYTE_ORDER MSB_LAST /end CHARACTERISTIC
/begin RECORD_LAYOUT RL_HOSTACCRNTPRESENTATPORTOV_C FNC_VALUES 1 UBYTE COLUMN_DIR DIRECT /end RECORD_LAYOUT
/begin COMPU_METHOD CU_HOSTACCRNTPRESENTATPORTOV_C "Conversion method for HostAcCrntPresentAtPortOv_C" RAT_FUNC "%10.0" "b" COEFFS 0.000000 1.000000 -0.000000 0.000000 0.000000 1.000000 /end COMPU_METHOD
/* Scalar calibration for DDE 'HostAcVltPresAtPortEnOf_C'. */
/begin CHARACTERISTIC HostAcVltPresAtPortEnOf_C "Enables overriding" VALUE 0x700195e5 RL_HOSTACVLTPRESATPORTENOF_C 1.000000 CU_HOSTACVLTPRESATPORTENOF_C 0.000000 1.000000 BYTE_ORDER MSB_LAST /end CHARACTERISTIC
/begin RECORD_LAYOUT RL_HOSTACVLTPRESATPORTENOF_C FNC_VALUES 1 UBYTE COLUMN_DIR DIRECT /end RECORD_LAYOUT
/begin COMPU_METHOD CU_HOSTACVLTPRESATPORTENOF_C "Conversion method for HostAcVltPresAtPortEnOf_C" RAT_FUNC "%10.0" "b" COEFFS 0.000000 1.000000 -0.000000 0.000000 0.000000 1.000000 /end COMPU_METHOD
/* Scalar calibration for DDE 'HostAcVltPresAtPortEnOv_C'. */
/begin CHARACTERISTIC HostAcVltPresAtPortEnOv_C "Override value" VALUE 0x700185be RL_HOSTACVLTPRESATPORTENOV_C 1.000000 CU_HOSTACVLTPRESATPORTENOV_C 0.000000 1.000000 BYTE_ORDER MSB_LAST /end CHARACTERISTIC
/begin RECORD_LAYOUT RL_HOSTACVLTPRESATPORTENOV_C FNC_VALUES 1 UBYTE COLUMN_DIR DIRECT /end RECORD_LAYOUT
/begin COMPU_METHOD CU_HOSTACVLTPRESATPORTENOV_C "Conversion method for HostAcVltPresAtPortEnOv_C" RAT_FUNC "%10.0" "b" COEFFS 0.000000 1.000000 -0.000000 0.000000 0.000000 1.000000 /end COMPU_METHOD
/* Scalar calibration for DDE 'HostAcVoltPresentAtPortOf_C'. */
/begin CHARACTERISTIC HostAcVoltPresentAtPortOf_C "Enables overriding Port AC voltage is present" VALUE 0x70019e3a RL_HOSTACVOLTPRESENTATPORTOF_C 1.000000 CU_HOSTACVOLTPRESENTATPORTOF_C 0.000000 1.000000 BYTE_ORDER MSB_LAST /end CHARACTERISTIC
/begin RECORD_LAYOUT RL_HOSTACVOLTPRESENTATPORTOF_C FNC_VALUES 1 UBYTE COLUMN_DIR DIRECT /end RECORD_LAYOUT
/begin COMPU_METHOD CU_HOSTACVOLTPRESENTATPORTOF_C "Conversion method for HostAcVoltPresentAtPortOf_C" RAT_FUNC "%10.0" "b" COEFFS 0.000000 1.000000 -0.000000 0.000000 0.000000 1.000000 /end COMPU_METHOD
/* Scalar calibration for DDE 'HostAcVoltPresentAtPortOv_C'. */
/begin CHARACTERISTIC HostAcVoltPresentAtPortOv_C "Override value for Port AC voltage is present" VALUE 0x70019781 RL_HOSTACVOLTPRESENTATPORTOV_C 1.000000 CU_HOSTACVOLTPRESENTATPORTOV_C 0.000000 1.000000 BYTE_ORDER MSB_LAST /end CHARACTERISTIC
/begin RECORD_LAYOUT RL_HOSTACVOLTPRESENTATPORTOV_C FNC_VALUES 1 UBYTE COLUMN_DIR DIRECT /end RECORD_LAYOUT
/begin COMPU_METHOD CU_HOSTACVOLTPRESENTATPORTOV_C "Conversion method for HostAcVoltPresentAtPortOv_C" RAT_FUNC "%10.0" "b" COEFFS 0.000000 1.000000 -0.000000 0.000000 0.000000 1.000000 /end COMPU_METHOD
/* Scalar calibration for DDE 'HostAinEvsePilotVoltPeakRawOf_C'. */
/begin CHARACTERISTIC HostAinEvsePilotVoltPeakRawOf_C "Enables overriding Raw Peak voltage value of charging interface Pilot signal" VALUE 0x70017534 RL_HOSTAINEVSEPILOTVOLTPEAKRAW1 1.000000 CU_HOSTAINEVSEPILOTVOLTPEAKRAW1 0.000000 1.000000 BYTE_ORDER MSB_LAST /end CHARACTERISTIC
/begin RECORD_LAYOUT RL_HOSTAINEVSEPILOTVOLTPEAKRAW1 FNC_VALUES 1 UBYTE COLUMN_DIR DIRECT /end RECORD_LAYOUT
/begin COMPU_METHOD CU_HOSTAINEVSEPILOTVOLTPEAKRAW1 "Conversion method for HostAinEvsePilotVoltPeakRawOf_C" RAT_FUNC "%10.0" "b" COEFFS 0.000000 1.000000 -0.000000 0.000000 0.000000 1.000000 /end COMPU_METHOD
/* Scalar calibration for DDE 'HostAinEvsePilotVoltPeakRawOv_C'. */
/begin CHARACTERISTIC HostAinEvsePilotVoltPeakRawOv_C "Override value for Raw Peak voltage value of charging interface Pilot signal" VALUE 0x7001759c RL_HOSTAINEVSEPILOTVOLTPEAKRAW2 150.000000 CU_HOSTAINEVSEPILOTVOLTPEAKRAW2 -50.000000 100.000000 BYTE_ORDER MSB_LAST /end CHARACTERISTIC
/begin RECORD_LAYOUT RL_HOSTAINEVSEPILOTVOLTPEAKRAW2 FNC_VALUES 1 FLOAT32_IEEE COLUMN_DIR DIRECT /end RECORD_LAYOUT
/begin COMPU_METHOD CU_HOSTAINEVSEPILOTVOLTPEAKRAW2 "Conversion method for HostAinEvsePilotVoltPeakRawOv_C" RAT_FUNC "%10.0" "V" COEFFS 0.000000 1.000000 -0.000000 0.000000 0.000000 1.000000 /end COMPU_METHOD
/* Scalar calibration for DDE 'HostAinEvsePilotVoltRawOf_C'. */
/begin CHARACTERISTIC HostAinEvsePilotVoltRawOf_C "Enables overriding Raw voltage value of charging interface Pilot signal" VALUE 0x700176af RL_HOSTAINEVSEPILOTVOLTRAWOF_C 1.000000 CU_HOSTAINEVSEPILOTVOLTRAWOF_C 0.000000 1.000000 BYTE_ORDER MSB_LAST /end CHARACTERISTIC
/begin RECORD_LAYOUT RL_HOSTAINEVSEPILOTVOLTRAWOF_C FNC_VALUES 1 UBYTE COLUMN_DIR DIRECT /end RECORD_LAYOUT
/begin COMPU_METHOD CU_HOSTAINEVSEPILOTVOLTRAWOF_C "Conversion method for HostAinEvsePilotVoltRawOf_C" RAT_FUNC "%10.0" "b" COEFFS 0.000000 1.000000 -0.000000 0.000000 0.000000 1.000000 /end COMPU_METHOD
/* Scalar calibration for DDE 'HostAinEvsePilotVoltRawOv_C'. */
/begin CHARACTERISTIC HostAinEvsePilotVoltRawOv_C "Override value for Raw voltage value of charging interface Pilot signal" VALUE 0x700176b0 RL_HOSTAINEVSEPILOTVOLTRAWOV_C 150.000000 CU_HOSTAINEVSEPILOTVOLTRAWOV_C -50.000000 100.000000 BYTE_ORDER MSB_LAST /end CHARACTERISTIC
/begin RECORD_LAYOUT RL_HOSTAINEVSEPILOTVOLTRAWOV_C FNC_VALUES 1 FLOAT32_IEEE COLUMN_DIR DIRECT /end RECORD_LAYOUT
/begin COMPU_METHOD CU_HOSTAINEVSEPILOTVOLTRAWOV_C "Conversion method for HostAinEvsePilotVoltRawOv_C" RAT_FUNC "%10.0" "V" COEFFS 0.000000 1.000000 -0.000000 0.000000 0.000000 1.000000 /end COMPU_METHOD
/* Scalar calibration for DDE 'HostAinEvseProximityVoltRawOf_C'. */
/begin CHARACTERISTIC HostAinEvseProximityVoltRawOf_C "Enables overriding Raw voltage value of charging interface Proximity signal" VALUE 0x70017695 RL_HOSTAINEVSEPROXIMITYVOLTRAW2 1.000000 CU_HOSTAINEVSEPROXIMITYVOLTRAW2 0.000000 1.000000 BYTE_ORDER MSB_LAST /end CHARACTERISTIC
/begin RECORD_LAYOUT RL_HOSTAINEVSEPROXIMITYVOLTRAW2 FNC_VALUES 1 UBYTE COLUMN_DIR DIRECT /end RECORD_LAYOUT
/begin COMPU_METHOD CU_HOSTAINEVSEPROXIMITYVOLTRAW2 "Conversion method for HostAinEvseProximityVoltRawOf_C" RAT_FUNC "%10.0" "b" COEFFS 0.000000 1.000000 -0.000000 0.000000 0.000000 1.000000 /end COMPU_METHOD
/* Scalar calibration for DDE 'HostAinEvseProximityVoltRawOv_C'. */
/begin CHARACTERISTIC HostAinEvseProximityVoltRawOv_C "Override value for Raw voltage value of charging interface Proximity signal" VALUE 0x7001769c RL_HOSTAINEVSEPROXIMITYVOLTRAW0 150.000000 CU_HOSTAINEVSEPROXIMITYVOLTRAW0 -50.000000 100.000000 BYTE_ORDER MSB_LAST /end CHARACTERISTIC
/begin RECORD_LAYOUT RL_HOSTAINEVSEPROXIMITYVOLTRAW0 FNC_VALUES 1 FLOAT32_IEEE COLUMN_DIR DIRECT /end RECORD_LAYOUT
/begin COMPU_METHOD CU_HOSTAINEVSEPROXIMITYVOLTRAW0 "Conversion method for HostAinEvseProximityVoltRawOv_C" RAT_FUNC "%10.0" "V" COEFFS 0.000000 1.000000 -0.000000 0.000000 0.000000 1.000000 /end COMPU_METHOD
/* Scalar calibration for DDE 'HostAinProximitySupplyFdbkOf_C'. */
/begin CHARACTERISTIC HostAinProximitySupplyFdbkOf_C "Enables overriding Raw internal feedback form the 5V supply voltage output used for powring up the proximity  signal circuit in an EV-EVSE interface" VALUE 0x700175ae RL_HOSTAINPROXIMITYSUPPLYFDBKO1 1.000000 CU_HOSTAINPROXIMITYSUPPLYFDBKO1 0.000000 1.000000 BYTE_ORDER MSB_LAST /end CHARACTERISTIC
/begin RECORD_LAYOUT RL_HOSTAINPROXIMITYSUPPLYFDBKO1 FNC_VALUES 1 UBYTE COLUMN_DIR DIRECT /end RECORD_LAYOUT
/begin COMPU_METHOD CU_HOSTAINPROXIMITYSUPPLYFDBKO1 "Conversion method for HostAinProximitySupplyFdbkOf_C" RAT_FUNC "%10.0" "b" COEFFS 0.000000 1.000000 -0.000000 0.000000 0.000000 1.000000 /end COMPU_METHOD
/* Scalar calibration for DDE 'HostAinProximitySupplyFdbkOv_C'. */
/begin CHARACTERISTIC HostAinProximitySupplyFdbkOv_C "Override value for Raw  internal feedback form the 5V supply voltage output used for powring up the proximity  signal circuit in an EV-EVSE interface" VALUE 0x7001742c RL_HOSTAINPROXIMITYSUPPLYFDBKO0 150.000000 CU_HOSTAINPROXIMITYSUPPLYFDBKO0 -50.000000 100.000000 BYTE_ORDER MSB_LAST /end CHARACTERISTIC
/begin RECORD_LAYOUT RL_HOSTAINPROXIMITYSUPPLYFDBKO0 FNC_VALUES 1 FLOAT32_IEEE COLUMN_DIR DIRECT /end RECORD_LAYOUT
/begin COMPU_METHOD CU_HOSTAINPROXIMITYSUPPLYFDBKO0 "Conversion method for HostAinProximitySupplyFdbkOv_C" RAT_FUNC "%10.0" "V" COEFFS 0.000000 1.000000 -0.000000 0.000000 0.000000 1.000000 /end COMPU_METHOD
/* Scalar calibration for DDE 'HostAllChargeRelaysClosedDelay_C'. */
/begin CHARACTERISTIC HostAllChargeRelaysClosedDelay0 "(not defined)" VALUE 0x70017404 RL_HOSTALLCHARGERELAYSCLOSEDDE0 100000.000000 CU_HOSTALLCHARGERELAYSCLOSEDDE0 0.000000 100000.000000 BYTE_ORDER MSB_LAST /end CHARACTERISTIC
/begin RECORD_LAYOUT RL_HOSTALLCHARGERELAYSCLOSEDDE0 FNC_VALUES 1 FLOAT32_IEEE COLUMN_DIR DIRECT /end RECORD_LAYOUT
/begin COMPU_METHOD CU_HOSTALLCHARGERELAYSCLOSEDDE0 "Conversion method for HostAllChargeRelaysClosedDelay_C" RAT_FUNC "%10.0" "s" COEFFS 0.000000 1.000000 -0.000000 0.000000 0.000000 1.000000 /end COMPU_METHOD
/* Scalar calibration for DDE 'HostAllChgRelaysClosedOf_C'. */
/begin CHARACTERISTIC HostAllChgRelaysClosedOf_C "Enavbles overriding" VALUE 0x700186c4 RL_HOSTALLCHGRELAYSCLOSEDOF_C 1.000000 CU_HOSTALLCHGRELAYSCLOSEDOF_C 0.000000 1.000000 BYTE_ORDER MSB_LAST /end CHARACTERISTIC
/begin RECORD_LAYOUT RL_HOSTALLCHGRELAYSCLOSEDOF_C FNC_VALUES 1 UBYTE COLUMN_DIR DIRECT /end RECORD_LAYOUT
/begin COMPU_METHOD CU_HOSTALLCHGRELAYSCLOSEDOF_C "Conversion method for HostAllChgRelaysClosedOf_C" RAT_FUNC "%10.0" "b" COEFFS 0.000000 1.000000 -0.000000 0.000000 0.000000 1.000000 /end COMPU_METHOD
/* Scalar calibration for DDE 'HostAllChgRelaysClosedOv_C'. */
/begin CHARACTERISTIC HostAllChgRelaysClosedOv_C "Override value" VALUE 0x70018504 RL_HOSTALLCHGRELAYSCLOSEDOV_C 1.000000 CU_HOSTALLCHGRELAYSCLOSEDOV_C 0.000000 1.000000 BYTE_ORDER MSB_LAST /end CHARACTERISTIC
/begin RECORD_LAYOUT RL_HOSTALLCHGRELAYSCLOSEDOV_C FNC_VALUES 1 UBYTE COLUMN_DIR DIRECT /end RECORD_LAYOUT
/begin COMPU_METHOD CU_HOSTALLCHGRELAYSCLOSEDOV_C "Conversion method for HostAllChgRelaysClosedOv_C" RAT_FUNC "%10.0" "b" COEFFS 0.000000 1.000000 -0.000000 0.000000 0.000000 1.000000 /end COMPU_METHOD
/* Scalar calibration for DDE 'HostBptModePriorityOf_C'. */
/begin CHARACTERISTIC HostBptModePriorityOf_C "Enables overriding" VALUE 0x7001868c RL_HOSTBPTMODEPRIORITYOF_C 1.000000 CU_HOSTBPTMODEPRIORITYOF_C 0.000000 1.000000 BYTE_ORDER MSB_LAST /end CHARACTERISTIC
/begin RECORD_LAYOUT RL_HOSTBPTMODEPRIORITYOF_C FNC_VALUES 1 UBYTE COLUMN_DIR DIRECT /end RECORD_LAYOUT
/begin COMPU_METHOD CU_HOSTBPTMODEPRIORITYOF_C "Conversion method for HostBptModePriorityOf_C" RAT_FUNC "%10.0" "b" COEFFS 0.000000 1.000000 -0.000000 0.000000 0.000000 1.000000 /end COMPU_METHOD
/* Scalar calibration for DDE 'HostBptModePriorityOv_C'. */
/begin CHARACTERISTIC HostBptModePriorityOv_C "Override value" VALUE 0x70019642 RL_HOSTBPTMODEPRIORITYOV_C 255.000000 CU_HOSTBPTMODEPRIORITYOV_C 0.000000 255.000000 BYTE_ORDER MSB_LAST /end CHARACTERISTIC
/begin RECORD_LAYOUT RL_HOSTBPTMODEPRIORITYOV_C FNC_VALUES 1 UBYTE COLUMN_DIR DIRECT /end RECORD_LAYOUT
/begin COMPU_METHOD CU_HOSTBPTMODEPRIORITYOV_C "Conversion method for HostBptModePriorityOv_C" RAT_FUNC "%10.0" "e" COEFFS 0.000000 1.000000 -0.000000 0.000000 0.000000 1.000000 /end COMPU_METHOD
/* Scalar calibration for DDE 'HostBptModePriority_C'. */
/begin CHARACTERISTIC HostBptModePriority_C "Disabled (3), Preferred (1), Fallback (2), Reserved (0)" VALUE 0x700175c4 RL_HOSTBPTMODEPRIORITY_C 255.000000 CU_HOSTBPTMODEPRIORITY_C 0.000000 255.000000 BYTE_ORDER MSB_LAST /end CHARACTERISTIC
/begin RECORD_LAYOUT RL_HOSTBPTMODEPRIORITY_C FNC_VALUES 1 UBYTE COLUMN_DIR DIRECT /end RECORD_LAYOUT
/begin COMPU_METHOD CU_HOSTBPTMODEPRIORITY_C "Conversion method for HostBptModePriority_C" RAT_FUNC "%10.0" "1" COEFFS 0.000000 1.000000 -0.000000 0.000000 0.000000 1.000000 /end COMPU_METHOD
/* Scalar calibration for DDE 'HostChargeEmergStop_C'. */
/begin CHARACTERISTIC HostChargeEmergStop_C "(not defined)" VALUE 0x700195f6 RL_HOSTCHARGEEMERGSTOP_C 1.000000 CU_HOSTCHARGEEMERGSTOP_C 0.000000 1.000000 BYTE_ORDER MSB_LAST /end CHARACTERISTIC
/begin RECORD_LAYOUT RL_HOSTCHARGEEMERGSTOP_C FNC_VALUES 1 UBYTE COLUMN_DIR DIRECT /end RECORD_LAYOUT
/begin COMPU_METHOD CU_HOSTCHARGEEMERGSTOP_C "Conversion method for HostChargeEmergStop_C" RAT_FUNC "%10.0" "b" COEFFS 0.000000 1.000000 -0.000000 0.000000 0.000000 1.000000 /end COMPU_METHOD
/* Scalar calibration for DDE 'HostChargeEmergencyStopOf_C'. */
/begin CHARACTERISTIC HostChargeEmergencyStopOf_C "Enavbles overriding" VALUE 0x700184ff RL_HOSTCHARGEEMERGENCYSTOPOF_C 1.000000 CU_HOSTCHARGEEMERGENCYSTOPOF_C 0.000000 1.000000 BYTE_ORDER MSB_LAST /end CHARACTERISTIC
/begin RECORD_LAYOUT RL_HOSTCHARGEEMERGENCYSTOPOF_C FNC_VALUES 1 UBYTE COLUMN_DIR DIRECT /end RECORD_LAYOUT
/begin COMPU_METHOD CU_HOSTCHARGEEMERGENCYSTOPOF_C "Conversion method for HostChargeEmergencyStopOf_C" RAT_FUNC "%10.0" "b" COEFFS 0.000000 1.000000 -0.000000 0.000000 0.000000 1.000000 /end COMPU_METHOD
/* Scalar calibration for DDE 'HostChargeEmergencyStopOv_C'. */
/begin CHARACTERISTIC HostChargeEmergencyStopOv_C "Override value" VALUE 0x70019dae RL_HOSTCHARGEEMERGENCYSTOPOV_C 1.000000 CU_HOSTCHARGEEMERGENCYSTOPOV_C 0.000000 1.000000 BYTE_ORDER MSB_LAST /end CHARACTERISTIC
/begin RECORD_LAYOUT RL_HOSTCHARGEEMERGENCYSTOPOV_C FNC_VALUES 1 UBYTE COLUMN_DIR DIRECT /end RECORD_LAYOUT
/begin COMPU_METHOD CU_HOSTCHARGEEMERGENCYSTOPOV_C "Conversion method for HostChargeEmergencyStopOv_C" RAT_FUNC "%10.0" "b" COEFFS 0.000000 1.000000 -0.000000 0.000000 0.000000 1.000000 /end COMPU_METHOD
/* Scalar calibration for DDE 'HostChargeInletLockStatusDelay_C'. */
/begin CHARACTERISTIC HostChargeInletLockStatusDelay0 "(not defined)" VALUE 0x700175f0 RL_HOSTCHARGEINLETLOCKSTATUSDE0 100000.000000 CU_HOSTCHARGEINLETLOCKSTATUSDE0 0.000000 100000.000000 BYTE_ORDER MSB_LAST /end CHARACTERISTIC
/begin RECORD_LAYOUT RL_HOSTCHARGEINLETLOCKSTATUSDE0 FNC_VALUES 1 FLOAT32_IEEE COLUMN_DIR DIRECT /end RECORD_LAYOUT
/begin COMPU_METHOD CU_HOSTCHARGEINLETLOCKSTATUSDE0 "Conversion method for HostChargeInletLockStatusDelay_C" RAT_FUNC "%10.0" "s" COEFFS 0.000000 1.000000 -0.000000 0.000000 0.000000 1.000000 /end COMPU_METHOD
/* Scalar calibration for DDE 'HostChargeNormalStopOf_C'. */
/begin CHARACTERISTIC HostChargeNormalStopOf_C "Enavbles overriding" VALUE 0x700195f7 RL_HOSTCHARGENORMALSTOPOF_C 1.000000 CU_HOSTCHARGENORMALSTOPOF_C 0.000000 1.000000 BYTE_ORDER MSB_LAST /end CHARACTERISTIC
/begin RECORD_LAYOUT RL_HOSTCHARGENORMALSTOPOF_C FNC_VALUES 1 UBYTE COLUMN_DIR DIRECT /end RECORD_LAYOUT
/begin COMPU_METHOD CU_HOSTCHARGENORMALSTOPOF_C "Conversion method for HostChargeNormalStopOf_C" RAT_FUNC "%10.0" "b" COEFFS 0.000000 1.000000 -0.000000 0.000000 0.000000 1.000000 /end COMPU_METHOD
/* Scalar calibration for DDE 'HostChargeNormalStopOv_C'. */
/begin CHARACTERISTIC HostChargeNormalStopOv_C "Override value" VALUE 0x7001864c RL_HOSTCHARGENORMALSTOPOV_C 1.000000 CU_HOSTCHARGENORMALSTOPOV_C 0.000000 1.000000 BYTE_ORDER MSB_LAST /end CHARACTERISTIC
/begin RECORD_LAYOUT RL_HOSTCHARGENORMALSTOPOV_C FNC_VALUES 1 UBYTE COLUMN_DIR DIRECT /end RECORD_LAYOUT
/begin COMPU_METHOD CU_HOSTCHARGENORMALSTOPOV_C "Conversion method for HostChargeNormalStopOv_C" RAT_FUNC "%10.0" "b" COEFFS 0.000000 1.000000 -0.000000 0.000000 0.000000 1.000000 /end COMPU_METHOD
/* Scalar calibration for DDE 'HostChargeNormalStop_C'. */
/begin CHARACTERISTIC HostChargeNormalStop_C "(not defined)" VALUE 0x7001767c RL_HOSTCHARGENORMALSTOP_C 1.000000 CU_HOSTCHARGENORMALSTOP_C 0.000000 1.000000 BYTE_ORDER MSB_LAST /end CHARACTERISTIC
/begin RECORD_LAYOUT RL_HOSTCHARGENORMALSTOP_C FNC_VALUES 1 UBYTE COLUMN_DIR DIRECT /end RECORD_LAYOUT
/begin COMPU_METHOD CU_HOSTCHARGENORMALSTOP_C "Conversion method for HostChargeNormalStop_C" RAT_FUNC "%10.0" "b" COEFFS 0.000000 1.000000 -0.000000 0.000000 0.000000 1.000000 /end COMPU_METHOD
/* Scalar calibration for DDE 'HostChgInletLockStatusOf_C'. */
/begin CHARACTERISTIC HostChgInletLockStatusOf_C "Enavbles overriding" VALUE 0x700195c5 RL_HOSTCHGINLETLOCKSTATUSOF_C 1.000000 CU_HOSTCHGINLETLOCKSTATUSOF_C 0.000000 1.000000 BYTE_ORDER MSB_LAST /end CHARACTERISTIC
/begin RECORD_LAYOUT RL_HOSTCHGINLETLOCKSTATUSOF_C FNC_VALUES 1 UBYTE COLUMN_DIR DIRECT /end RECORD_LAYOUT
/begin COMPU_METHOD CU_HOSTCHGINLETLOCKSTATUSOF_C "Conversion method for HostChgInletLockStatusOf_C" RAT_FUNC "%10.0" "b" COEFFS 0.000000 1.000000 -0.000000 0.000000 0.000000 1.000000 /end COMPU_METHOD
/* Scalar calibration for DDE 'HostChgInletLockStatusOv_C'. */
/begin CHARACTERISTIC HostChgInletLockStatusOv_C "Override value" VALUE 0x70019e69 RL_HOSTCHGINLETLOCKSTATUSOV_C 1.000000 CU_HOSTCHGINLETLOCKSTATUSOV_C 0.000000 1.000000 BYTE_ORDER MSB_LAST /end CHARACTERISTIC
/begin RECORD_LAYOUT RL_HOSTCHGINLETLOCKSTATUSOV_C FNC_VALUES 1 UBYTE COLUMN_DIR DIRECT /end RECORD_LAYOUT
/begin COMPU_METHOD CU_HOSTCHGINLETLOCKSTATUSOV_C "Conversion method for HostChgInletLockStatusOv_C" RAT_FUNC "%10.0" "b" COEFFS 0.000000 1.000000 -0.000000 0.000000 0.000000 1.000000 /end COMPU_METHOD
/* Scalar calibration for DDE 'HostChgPortCrntAcEn_C'. */
/begin CHARACTERISTIC HostChgPortCrntAcEn_C "(not defined)" VALUE 0x7001961c RL_HOSTCHGPORTCRNTACEN_C 1.000000 CU_HOSTCHGPORTCRNTACEN_C 0.000000 1.000000 BYTE_ORDER MSB_LAST /end CHARACTERISTIC
/begin RECORD_LAYOUT RL_HOSTCHGPORTCRNTACEN_C FNC_VALUES 1 UBYTE COLUMN_DIR DIRECT /end RECORD_LAYOUT
/begin COMPU_METHOD CU_HOSTCHGPORTCRNTACEN_C "Conversion method for HostChgPortCrntAcEn_C" RAT_FUNC "%10.0" "b" COEFFS 0.000000 1.000000 -0.000000 0.000000 0.000000 1.000000 /end COMPU_METHOD
/* Scalar calibration for DDE 'HostChgPortCrntAc_C'. */
/begin CHARACTERISTIC HostChgPortCrntAc_C "(not defined)" VALUE 0x70019638 RL_HOSTCHGPORTCRNTAC_C 200000000.000000 CU_HOSTCHGPORTCRNTAC_C -100000000.000000 100000000.000000 BYTE_ORDER MSB_LAST /end CHARACTERISTIC
/begin RECORD_LAYOUT RL_HOSTCHGPORTCRNTAC_C FNC_VALUES 1 FLOAT32_IEEE COLUMN_DIR DIRECT /end RECORD_LAYOUT
/begin COMPU_METHOD CU_HOSTCHGPORTCRNTAC_C "Conversion method for HostChgPortCrntAc_C" RAT_FUNC "%10.0" "A" COEFFS 0.000000 1.000000 -0.000000 0.000000 0.000000 1.000000 /end COMPU_METHOD
/* Scalar calibration for DDE 'HostChgPortCrntDcOf_C'. */
/begin CHARACTERISTIC HostChgPortCrntDcOf_C "Enables overriding Instantaneous current  at port" VALUE 0x700186e9 RL_HOSTCHGPORTCRNTDCOF_C 1.000000 CU_HOSTCHGPORTCRNTDCOF_C 0.000000 1.000000 BYTE_ORDER MSB_LAST /end CHARACTERISTIC
/begin RECORD_LAYOUT RL_HOSTCHGPORTCRNTDCOF_C FNC_VALUES 1 UBYTE COLUMN_DIR DIRECT /end RECORD_LAYOUT
/begin COMPU_METHOD CU_HOSTCHGPORTCRNTDCOF_C "Conversion method for HostChgPortCrntDcOf_C" RAT_FUNC "%10.0" "b" COEFFS 0.000000 1.000000 -0.000000 0.000000 0.000000 1.000000 /end COMPU_METHOD
/* Scalar calibration for DDE 'HostChgPortCrntDcOv_C'. */
/begin CHARACTERISTIC HostChgPortCrntDcOv_C "Override value for Instantaneous current  at port" VALUE 0x700186e4 RL_HOSTCHGPORTCRNTDCOV_C 196605.000000 CU_HOSTCHGPORTCRNTDCOV_C 0.000000 196605.000000 BYTE_ORDER MSB_LAST /end CHARACTERISTIC
/begin RECORD_LAYOUT RL_HOSTCHGPORTCRNTDCOV_C FNC_VALUES 1 FLOAT32_IEEE COLUMN_DIR DIRECT /end RECORD_LAYOUT
/begin COMPU_METHOD CU_HOSTCHGPORTCRNTDCOV_C "Conversion method for HostChgPortCrntDcOv_C" RAT_FUNC "%10.0" "A" COEFFS 0.000000 1.000000 -0.000000 0.000000 0.000000 1.000000 /end COMPU_METHOD
/* Scalar calibration for DDE 'HostChgPortCrntDcValidOf_C'. */
/begin CHARACTERISTIC HostChgPortCrntDcValidOf_C "Enavbles overriding" VALUE 0x7001977a RL_HOSTCHGPORTCRNTDCVALIDOF_C 1.000000 CU_HOSTCHGPORTCRNTDCVALIDOF_C 0.000000 1.000000 BYTE_ORDER MSB_LAST /end CHARACTERISTIC
/begin RECORD_LAYOUT RL_HOSTCHGPORTCRNTDCVALIDOF_C FNC_VALUES 1 UBYTE COLUMN_DIR DIRECT /end RECORD_LAYOUT
/begin COMPU_METHOD CU_HOSTCHGPORTCRNTDCVALIDOF_C "Conversion method for HostChgPortCrntDcValidOf_C" RAT_FUNC "%10.0" "b" COEFFS 0.000000 1.000000 -0.000000 0.000000 0.000000 1.000000 /end COMPU_METHOD
/* Scalar calibration for DDE 'HostChgPortCrntDcValidOv_C'. */
/begin CHARACTERISTIC HostChgPortCrntDcValidOv_C "Override value" VALUE 0x70019779 RL_HOSTCHGPORTCRNTDCVALIDOV_C 1.000000 CU_HOSTCHGPORTCRNTDCVALIDOV_C 0.000000 1.000000 BYTE_ORDER MSB_LAST /end CHARACTERISTIC
/begin RECORD_LAYOUT RL_HOSTCHGPORTCRNTDCVALIDOV_C FNC_VALUES 1 UBYTE COLUMN_DIR DIRECT /end RECORD_LAYOUT
/begin COMPU_METHOD CU_HOSTCHGPORTCRNTDCVALIDOV_C "Conversion method for HostChgPortCrntDcValidOv_C" RAT_FUNC "%10.0" "b" COEFFS 0.000000 1.000000 -0.000000 0.000000 0.000000 1.000000 /end COMPU_METHOD
/* Scalar calibration for DDE 'HostChgPortCrntDcValid_C'. */
/begin CHARACTERISTIC HostChgPortCrntDcValid_C "(not defined)" VALUE 0x700186e1 RL_HOSTCHGPORTCRNTDCVALID_C 1.000000 CU_HOSTCHGPORTCRNTDCVALID_C 0.000000 1.000000 BYTE_ORDER MSB_LAST /end CHARACTERISTIC
/begin RECORD_LAYOUT RL_HOSTCHGPORTCRNTDCVALID_C FNC_VALUES 1 UBYTE COLUMN_DIR DIRECT /end RECORD_LAYOUT
/begin COMPU_METHOD CU_HOSTCHGPORTCRNTDCVALID_C "Conversion method for HostChgPortCrntDcValid_C" RAT_FUNC "%10.0" "b" COEFFS 0.000000 1.000000 -0.000000 0.000000 0.000000 1.000000 /end COMPU_METHOD
/* Scalar calibration for DDE 'HostChgPortCrntDc_C'. */
/begin CHARACTERISTIC HostChgPortCrntDc_C "(not defined)" VALUE 0x70019e8c RL_HOSTCHGPORTCRNTDC_C 200000000.000000 CU_HOSTCHGPORTCRNTDC_C -100000000.000000 100000000.000000 BYTE_ORDER MSB_LAST /end CHARACTERISTIC
/begin RECORD_LAYOUT RL_HOSTCHGPORTCRNTDC_C FNC_VALUES 1 FLOAT32_IEEE COLUMN_DIR DIRECT /end RECORD_LAYOUT
/begin COMPU_METHOD CU_HOSTCHGPORTCRNTDC_C "Conversion method for HostChgPortCrntDc_C" RAT_FUNC "%10.0" "A" COEFFS 0.000000 1.000000 -0.000000 0.000000 0.000000 1.000000 /end COMPU_METHOD
/* Scalar calibration for DDE 'HostChgPortVoltAcEn_C'. */
/begin CHARACTERISTIC HostChgPortVoltAcEn_C "(not defined)" VALUE 0x70019e18 RL_HOSTCHGPORTVOLTACEN_C 1.000000 CU_HOSTCHGPORTVOLTACEN_C 0.000000 1.000000 BYTE_ORDER MSB_LAST /end CHARACTERISTIC
/begin RECORD_LAYOUT RL_HOSTCHGPORTVOLTACEN_C FNC_VALUES 1 UBYTE COLUMN_DIR DIRECT /end RECORD_LAYOUT
/begin COMPU_METHOD CU_HOSTCHGPORTVOLTACEN_C "Conversion method for HostChgPortVoltAcEn_C" RAT_FUNC "%10.0" "b" COEFFS 0.000000 1.000000 -0.000000 0.000000 0.000000 1.000000 /end COMPU_METHOD
/* Scalar calibration for DDE 'HostChgPortVoltAc_C'. */
/begin CHARACTERISTIC HostChgPortVoltAc_C "(not defined)" VALUE 0x70019e64 RL_HOSTCHGPORTVOLTAC_C 200000000.000000 CU_HOSTCHGPORTVOLTAC_C -100000000.000000 100000000.000000 BYTE_ORDER MSB_LAST /end CHARACTERISTIC
/begin RECORD_LAYOUT RL_HOSTCHGPORTVOLTAC_C FNC_VALUES 1 FLOAT32_IEEE COLUMN_DIR DIRECT /end RECORD_LAYOUT
/begin COMPU_METHOD CU_HOSTCHGPORTVOLTAC_C "Conversion method for HostChgPortVoltAc_C" RAT_FUNC "%10.0" "V" COEFFS 0.000000 1.000000 -0.000000 0.000000 0.000000 1.000000 /end COMPU_METHOD
/* Scalar calibration for DDE 'HostChgPortVoltDcOf_C'. */
/begin CHARACTERISTIC HostChgPortVoltDcOf_C "Enables overriding Port voltage" VALUE 0x70019dac RL_HOSTCHGPORTVOLTDCOF_C 1.000000 CU_HOSTCHGPORTVOLTDCOF_C 0.000000 1.000000 BYTE_ORDER MSB_LAST /end CHARACTERISTIC
/begin RECORD_LAYOUT RL_HOSTCHGPORTVOLTDCOF_C FNC_VALUES 1 UBYTE COLUMN_DIR DIRECT /end RECORD_LAYOUT
/begin COMPU_METHOD CU_HOSTCHGPORTVOLTDCOF_C "Conversion method for HostChgPortVoltDcOf_C" RAT_FUNC "%10.0" "b" COEFFS 0.000000 1.000000 -0.000000 0.000000 0.000000 1.000000 /end COMPU_METHOD
/* Scalar calibration for DDE 'HostChgPortVoltDcOv_C'. */
/begin CHARACTERISTIC HostChgPortVoltDcOv_C "Override value for Port voltage" VALUE 0x70018658 RL_HOSTCHGPORTVOLTDCOV_C 196605.000000 CU_HOSTCHGPORTVOLTDCOV_C 0.000000 196605.000000 BYTE_ORDER MSB_LAST /end CHARACTERISTIC
/begin RECORD_LAYOUT RL_HOSTCHGPORTVOLTDCOV_C FNC_VALUES 1 FLOAT32_IEEE COLUMN_DIR DIRECT /end RECORD_LAYOUT
/begin COMPU_METHOD CU_HOSTCHGPORTVOLTDCOV_C "Conversion method for HostChgPortVoltDcOv_C" RAT_FUNC "%10.0" "V" COEFFS 0.000000 1.000000 -0.000000 0.000000 0.000000 1.000000 /end COMPU_METHOD
/* Scalar calibration for DDE 'HostChgPortVoltDcValidOf_C'. */
/begin CHARACTERISTIC HostChgPortVoltDcValidOf_C "Enavbles overriding" VALUE 0x700196b2 RL_HOSTCHGPORTVOLTDCVALIDOF_C 1.000000 CU_HOSTCHGPORTVOLTDCVALIDOF_C 0.000000 1.000000 BYTE_ORDER MSB_LAST /end CHARACTERISTIC
/begin RECORD_LAYOUT RL_HOSTCHGPORTVOLTDCVALIDOF_C FNC_VALUES 1 UBYTE COLUMN_DIR DIRECT /end RECORD_LAYOUT
/begin COMPU_METHOD CU_HOSTCHGPORTVOLTDCVALIDOF_C "Conversion method for HostChgPortVoltDcValidOf_C" RAT_FUNC "%10.0" "b" COEFFS 0.000000 1.000000 -0.000000 0.000000 0.000000 1.000000 /end COMPU_METHOD
/* Scalar calibration for DDE 'HostChgPortVoltDcValidOv_C'. */
/begin CHARACTERISTIC HostChgPortVoltDcValidOv_C "Override value" VALUE 0x70019d6d RL_HOSTCHGPORTVOLTDCVALIDOV_C 1.000000 CU_HOSTCHGPORTVOLTDCVALIDOV_C 0.000000 1.000000 BYTE_ORDER MSB_LAST /end CHARACTERISTIC
/begin RECORD_LAYOUT RL_HOSTCHGPORTVOLTDCVALIDOV_C FNC_VALUES 1 UBYTE COLUMN_DIR DIRECT /end RECORD_LAYOUT
/begin COMPU_METHOD CU_HOSTCHGPORTVOLTDCVALIDOV_C "Conversion method for HostChgPortVoltDcValidOv_C" RAT_FUNC "%10.0" "b" COEFFS 0.000000 1.000000 -0.000000 0.000000 0.000000 1.000000 /end COMPU_METHOD
/* Scalar calibration for DDE 'HostChgPortVoltDcValid_C'. */
/begin CHARACTERISTIC HostChgPortVoltDcValid_C "(not defined)" VALUE 0x700185d1 RL_HOSTCHGPORTVOLTDCVALID_C 1.000000 CU_HOSTCHGPORTVOLTDCVALID_C 0.000000 1.000000 BYTE_ORDER MSB_LAST /end CHARACTERISTIC
/begin RECORD_LAYOUT RL_HOSTCHGPORTVOLTDCVALID_C FNC_VALUES 1 UBYTE COLUMN_DIR DIRECT /end RECORD_LAYOUT
/begin COMPU_METHOD CU_HOSTCHGPORTVOLTDCVALID_C "Conversion method for HostChgPortVoltDcValid_C" RAT_FUNC "%10.0" "b" COEFFS 0.000000 1.000000 -0.000000 0.000000 0.000000 1.000000 /end COMPU_METHOD
/* Scalar calibration for DDE 'HostChgPortVoltDc_C'. */
/begin CHARACTERISTIC HostChgPortVoltDc_C "(not defined)" VALUE 0x700196b4 RL_HOSTCHGPORTVOLTDC_C 200000000.000000 CU_HOSTCHGPORTVOLTDC_C -100000000.000000 100000000.000000 BYTE_ORDER MSB_LAST /end CHARACTERISTIC
/begin RECORD_LAYOUT RL_HOSTCHGPORTVOLTDC_C FNC_VALUES 1 FLOAT32_IEEE COLUMN_DIR DIRECT /end RECORD_LAYOUT
/begin COMPU_METHOD CU_HOSTCHGPORTVOLTDC_C "Conversion method for HostChgPortVoltDc_C" RAT_FUNC "%10.0" "V" COEFFS 0.000000 1.000000 -0.000000 0.000000 0.000000 1.000000 /end COMPU_METHOD
/* Scalar calibration for DDE 'HostChgRlyWeldCheckDoneDelay_C'. */
/begin CHARACTERISTIC HostChgRlyWeldCheckDoneDelay_C "(not defined)" VALUE 0x70017650 RL_HOSTCHGRLYWELDCHECKDONEDELA0 100000.000000 CU_HOSTCHGRLYWELDCHECKDONEDELA0 0.000000 100000.000000 BYTE_ORDER MSB_LAST /end CHARACTERISTIC
/begin RECORD_LAYOUT RL_HOSTCHGRLYWELDCHECKDONEDELA0 FNC_VALUES 1 FLOAT32_IEEE COLUMN_DIR DIRECT /end RECORD_LAYOUT
/begin COMPU_METHOD CU_HOSTCHGRLYWELDCHECKDONEDELA0 "Conversion method for HostChgRlyWeldCheckDoneDelay_C" RAT_FUNC "%10.0" "s" COEFFS 0.000000 1.000000 -0.000000 0.000000 0.000000 1.000000 /end COMPU_METHOD
/* Scalar calibration for DDE 'HostChgRlyWeldCheckDoneOf_C'. */
/begin CHARACTERISTIC HostChgRlyWeldCheckDoneOf_C "Enavbles overriding" VALUE 0x70019d6e RL_HOSTCHGRLYWELDCHECKDONEOF_C 1.000000 CU_HOSTCHGRLYWELDCHECKDONEOF_C 0.000000 1.000000 BYTE_ORDER MSB_LAST /end CHARACTERISTIC
/begin RECORD_LAYOUT RL_HOSTCHGRLYWELDCHECKDONEOF_C FNC_VALUES 1 UBYTE COLUMN_DIR DIRECT /end RECORD_LAYOUT
/begin COMPU_METHOD CU_HOSTCHGRLYWELDCHECKDONEOF_C "Conversion method for HostChgRlyWeldCheckDoneOf_C" RAT_FUNC "%10.0" "b" COEFFS 0.000000 1.000000 -0.000000 0.000000 0.000000 1.000000 /end COMPU_METHOD
/* Scalar calibration for DDE 'HostChgRlyWeldCheckDoneOv_C'. */
/begin CHARACTERISTIC HostChgRlyWeldCheckDoneOv_C "Override value" VALUE 0x70019644 RL_HOSTCHGRLYWELDCHECKDONEOV_C 1.000000 CU_HOSTCHGRLYWELDCHECKDONEOV_C 0.000000 1.000000 BYTE_ORDER MSB_LAST /end CHARACTERISTIC
/begin RECORD_LAYOUT RL_HOSTCHGRLYWELDCHECKDONEOV_C FNC_VALUES 1 UBYTE COLUMN_DIR DIRECT /end RECORD_LAYOUT
/begin COMPU_METHOD CU_HOSTCHGRLYWELDCHECKDONEOV_C "Conversion method for HostChgRlyWeldCheckDoneOv_C" RAT_FUNC "%10.0" "b" COEFFS 0.000000 1.000000 -0.000000 0.000000 0.000000 1.000000 /end COMPU_METHOD
/* Scalar calibration for DDE 'HostDepartureTimeOf_C'. */
/begin CHARACTERISTIC HostDepartureTimeOf_C "Enables overriding departure time provided by the host" VALUE 0x70019d80 RL_HOSTDEPARTURETIMEOF_C 1.000000 CU_HOSTDEPARTURETIMEOF_C 0.000000 1.000000 BYTE_ORDER MSB_LAST /end CHARACTERISTIC
/begin RECORD_LAYOUT RL_HOSTDEPARTURETIMEOF_C FNC_VALUES 1 UBYTE COLUMN_DIR DIRECT /end RECORD_LAYOUT
/begin COMPU_METHOD CU_HOSTDEPARTURETIMEOF_C "Conversion method for HostDepartureTimeOf_C" RAT_FUNC "%10.0" "b" COEFFS 0.000000 1.000000 -0.000000 0.000000 0.000000 1.000000 /end COMPU_METHOD
/* Scalar calibration for DDE 'HostDepartureTimeOv_C'. */
/begin CHARACTERISTIC HostDepartureTimeOv_C "Override value for departure time provided by the host" VALUE 0x700186f8 RL_HOSTDEPARTURETIMEOV_C 4294967295.000000 CU_HOSTDEPARTURETIMEOV_C 0.000000 4294967295.000000 BYTE_ORDER MSB_LAST /end CHARACTERISTIC
/begin RECORD_LAYOUT RL_HOSTDEPARTURETIMEOV_C FNC_VALUES 1 FLOAT32_IEEE COLUMN_DIR DIRECT /end RECORD_LAYOUT
/begin COMPU_METHOD CU_HOSTDEPARTURETIMEOV_C "Conversion method for HostDepartureTimeOv_C" RAT_FUNC "%10.0" "s" COEFFS 0.000000 1.000000 -0.000000 0.000000 0.000000 1.000000 /end COMPU_METHOD
/* Scalar calibration for DDE 'HostDepartureTime_C'. */
/begin CHARACTERISTIC HostDepartureTime_C "(not defined)" VALUE 0x70019e40 RL_HOSTDEPARTURETIME_C 4294967295.000000 CU_HOSTDEPARTURETIME_C 0.000000 4294967295.000000 BYTE_ORDER MSB_LAST /end CHARACTERISTIC
/begin RECORD_LAYOUT RL_HOSTDEPARTURETIME_C FNC_VALUES 1 ULONG COLUMN_DIR DIRECT /end RECORD_LAYOUT
/begin COMPU_METHOD CU_HOSTDEPARTURETIME_C "Conversion method for HostDepartureTime_C" RAT_FUNC "%10.0" "s" COEFFS 0.000000 1.000000 -0.000000 0.000000 0.000000 1.000000 /end COMPU_METHOD
/* Scalar calibration for DDE 'HostDesiredEgyTransferMode_C'. */
/begin CHARACTERISTIC HostDesiredEgyTransferMode_C "0: AC single phase core, 1: AC three phase core, 2: DC core, 3: DC extended, 4: DC combo core, 5: DC unique" VALUE 0x7001740c RL_HOSTDESIREDEGYTRANSFERMODE_C 255.000000 CU_HOSTDESIREDEGYTRANSFERMODE_C 0.000000 255.000000 BYTE_ORDER MSB_LAST /end CHARACTERISTIC
/begin RECORD_LAYOUT RL_HOSTDESIREDEGYTRANSFERMODE_C FNC_VALUES 1 UBYTE COLUMN_DIR DIRECT /end RECORD_LAYOUT
/begin COMPU_METHOD CU_HOSTDESIREDEGYTRANSFERMODE_C "Conversion method for HostDesiredEgyTransferMode_C" RAT_FUNC "%10.0" "1" COEFFS 0.000000 1.000000 -0.000000 0.000000 0.000000 1.000000 /end COMPU_METHOD
/* Scalar calibration for DDE 'HostDesiredEgyTrnsfrMdeOf_C'. */
/begin CHARACTERISTIC HostDesiredEgyTrnsfrMdeOf_C "Enables overriding" VALUE 0x700195d6 RL_HOSTDESIREDEGYTRNSFRMDEOF_C 1.000000 CU_HOSTDESIREDEGYTRNSFRMDEOF_C 0.000000 1.000000 BYTE_ORDER MSB_LAST /end CHARACTERISTIC
/begin RECORD_LAYOUT RL_HOSTDESIREDEGYTRNSFRMDEOF_C FNC_VALUES 1 UBYTE COLUMN_DIR DIRECT /end RECORD_LAYOUT
/begin COMPU_METHOD CU_HOSTDESIREDEGYTRNSFRMDEOF_C "Conversion method for HostDesiredEgyTrnsfrMdeOf_C" RAT_FUNC "%10.0" "b" COEFFS 0.000000 1.000000 -0.000000 0.000000 0.000000 1.000000 /end COMPU_METHOD
/* Scalar calibration for DDE 'HostDesiredEgyTrnsfrMdeOv_C'. */
/begin CHARACTERISTIC HostDesiredEgyTrnsfrMdeOv_C "Override value" VALUE 0x700185c0 RL_HOSTDESIREDEGYTRNSFRMDEOV_C 255.000000 CU_HOSTDESIREDEGYTRNSFRMDEOV_C 0.000000 255.000000 BYTE_ORDER MSB_LAST /end CHARACTERISTIC
/begin RECORD_LAYOUT RL_HOSTDESIREDEGYTRNSFRMDEOV_C FNC_VALUES 1 UBYTE COLUMN_DIR DIRECT /end RECORD_LAYOUT
/begin COMPU_METHOD CU_HOSTDESIREDEGYTRNSFRMDEOV_C "Conversion method for HostDesiredEgyTrnsfrMdeOv_C" RAT_FUNC "%10.0" "e" COEFFS 0.000000 1.000000 -0.000000 0.000000 0.000000 1.000000 /end COMPU_METHOD
/* Scalar calibration for DDE 'HostDinProtocolEnable_C'. */
/begin CHARACTERISTIC HostDinProtocolEnable_C "Set to 1 if the EV wants to use the DIN protocol and send it as part of the supportedAppProtocolRequest message." VALUE 0x700186d5 RL_HOSTDINPROTOCOLENABLE_C 1.000000 CU_HOSTDINPROTOCOLENABLE_C 0.000000 1.000000 BYTE_ORDER MSB_LAST /end CHARACTERISTIC
/begin RECORD_LAYOUT RL_HOSTDINPROTOCOLENABLE_C FNC_VALUES 1 UBYTE COLUMN_DIR DIRECT /end RECORD_LAYOUT
/begin COMPU_METHOD CU_HOSTDINPROTOCOLENABLE_C "Conversion method for HostDinProtocolEnable_C" RAT_FUNC "%10.0" "b" COEFFS 0.000000 1.000000 -0.000000 0.000000 0.000000 1.000000 /end COMPU_METHOD
/* Scalar calibration for DDE 'HostDinProtocolPriority_C'. */
/begin CHARACTERISTIC HostDinProtocolPriority_C "Set to 1 if the EV wants to use the DIN protocol and send it as part of the supportedAppProtocolRequest message." VALUE 0x70017618 RL_HOSTDINPROTOCOLPRIORITY_C 255.000000 CU_HOSTDINPROTOCOLPRIORITY_C 0.000000 255.000000 BYTE_ORDER MSB_LAST /end CHARACTERISTIC
/begin RECORD_LAYOUT RL_HOSTDINPROTOCOLPRIORITY_C FNC_VALUES 1 UBYTE COLUMN_DIR DIRECT /end RECORD_LAYOUT
/begin COMPU_METHOD CU_HOSTDINPROTOCOLPRIORITY_C "Conversion method for HostDinProtocolPriority_C" RAT_FUNC "%10.0" "(not defined)" COEFFS 0.000000 1.000000 -0.000000 0.000000 0.000000 1.000000 /end COMPU_METHOD
/* Scalar calibration for DDE 'HostDynamicModePriorityOf_C'. */
/begin CHARACTERISTIC HostDynamicModePriorityOf_C "Enables overriding" VALUE 0x7001965c RL_HOSTDYNAMICMODEPRIORITYOF_C 1.000000 CU_HOSTDYNAMICMODEPRIORITYOF_C 0.000000 1.000000 BYTE_ORDER MSB_LAST /end CHARACTERISTIC
/begin RECORD_LAYOUT RL_HOSTDYNAMICMODEPRIORITYOF_C FNC_VALUES 1 UBYTE COLUMN_DIR DIRECT /end RECORD_LAYOUT
/begin COMPU_METHOD CU_HOSTDYNAMICMODEPRIORITYOF_C "Conversion method for HostDynamicModePriorityOf_C" RAT_FUNC "%10.0" "b" COEFFS 0.000000 1.000000 -0.000000 0.000000 0.000000 1.000000 /end COMPU_METHOD
/* Scalar calibration for DDE 'HostDynamicModePriorityOv_C'. */
/begin CHARACTERISTIC HostDynamicModePriorityOv_C "Override value" VALUE 0x700184fe RL_HOSTDYNAMICMODEPRIORITYOV_C 255.000000 CU_HOSTDYNAMICMODEPRIORITYOV_C 0.000000 255.000000 BYTE_ORDER MSB_LAST /end CHARACTERISTIC
/begin RECORD_LAYOUT RL_HOSTDYNAMICMODEPRIORITYOV_C FNC_VALUES 1 UBYTE COLUMN_DIR DIRECT /end RECORD_LAYOUT
/begin COMPU_METHOD CU_HOSTDYNAMICMODEPRIORITYOV_C "Conversion method for HostDynamicModePriorityOv_C" RAT_FUNC "%10.0" "e" COEFFS 0.000000 1.000000 -0.000000 0.000000 0.000000 1.000000 /end COMPU_METHOD
/* Scalar calibration for DDE 'HostDynamicModePriority_C'. */
/begin CHARACTERISTIC HostDynamicModePriority_C "Disabled (3), Preferred (1), Fallback (2), Reserved (0)" VALUE 0x700176a4 RL_HOSTDYNAMICMODEPRIORITY_C 255.000000 CU_HOSTDYNAMICMODEPRIORITY_C 0.000000 255.000000 BYTE_ORDER MSB_LAST /end CHARACTERISTIC
/begin RECORD_LAYOUT RL_HOSTDYNAMICMODEPRIORITY_C FNC_VALUES 1 UBYTE COLUMN_DIR DIRECT /end RECORD_LAYOUT
/begin COMPU_METHOD CU_HOSTDYNAMICMODEPRIORITY_C "Conversion method for HostDynamicModePriority_C" RAT_FUNC "%10.0" "1" COEFFS 0.000000 1.000000 -0.000000 0.000000 0.000000 1.000000 /end COMPU_METHOD
/* Scalar calibration for DDE 'HostEvCrntMaxLim_C'. */
/begin CHARACTERISTIC HostEvCrntMaxLim_C "(not defined)" VALUE 0x70017544 RL_HOSTEVCRNTMAXLIM_C 200000000.000000 CU_HOSTEVCRNTMAXLIM_C -100000000.000000 100000000.000000 BYTE_ORDER MSB_LAST /end CHARACTERISTIC
/begin RECORD_LAYOUT RL_HOSTEVCRNTMAXLIM_C FNC_VALUES 1 FLOAT32_IEEE COLUMN_DIR DIRECT /end RECORD_LAYOUT
/begin COMPU_METHOD CU_HOSTEVCRNTMAXLIM_C "Conversion method for HostEvCrntMaxLim_C" RAT_FUNC "%10.0" "A" COEFFS 0.000000 1.000000 -0.000000 0.000000 0.000000 1.000000 /end COMPU_METHOD
/* Scalar calibration for DDE 'HostEvCrntMinLim_C'. */
/begin CHARACTERISTIC HostEvCrntMinLim_C "(not defined)" VALUE 0x70017548 RL_HOSTEVCRNTMINLIM_C 200000000.000000 CU_HOSTEVCRNTMINLIM_C -100000000.000000 100000000.000000 BYTE_ORDER MSB_LAST /end CHARACTERISTIC
/begin RECORD_LAYOUT RL_HOSTEVCRNTMINLIM_C FNC_VALUES 1 FLOAT32_IEEE COLUMN_DIR DIRECT /end RECORD_LAYOUT
/begin COMPU_METHOD CU_HOSTEVCRNTMINLIM_C "Conversion method for HostEvCrntMinLim_C" RAT_FUNC "%10.0" "A" COEFFS 0.000000 1.000000 -0.000000 0.000000 0.000000 1.000000 /end COMPU_METHOD
/* Scalar calibration for DDE 'HostEvCurrMaxLimOf_C'. */
/begin CHARACTERISTIC HostEvCurrMaxLimOf_C "Enables overriding Maximum current supported by the vehicle." VALUE 0x70019e92 RL_HOSTEVCURRMAXLIMOF_C 1.000000 CU_HOSTEVCURRMAXLIMOF_C 0.000000 1.000000 BYTE_ORDER MSB_LAST /end CHARACTERISTIC
/begin RECORD_LAYOUT RL_HOSTEVCURRMAXLIMOF_C FNC_VALUES 1 UBYTE COLUMN_DIR DIRECT /end RECORD_LAYOUT
/begin COMPU_METHOD CU_HOSTEVCURRMAXLIMOF_C "Conversion method for HostEvCurrMaxLimOf_C" RAT_FUNC "%10.0" "b" COEFFS 0.000000 1.000000 -0.000000 0.000000 0.000000 1.000000 /end COMPU_METHOD
/* Scalar calibration for DDE 'HostEvCurrMaxLimOv_C'. */
/begin CHARACTERISTIC HostEvCurrMaxLimOv_C "Override value for Maximum current supported by the vehicle." VALUE 0x700196ac RL_HOSTEVCURRMAXLIMOV_C 196605.000000 CU_HOSTEVCURRMAXLIMOV_C 0.000000 196605.000000 BYTE_ORDER MSB_LAST /end CHARACTERISTIC
/begin RECORD_LAYOUT RL_HOSTEVCURRMAXLIMOV_C FNC_VALUES 1 FLOAT32_IEEE COLUMN_DIR DIRECT /end RECORD_LAYOUT
/begin COMPU_METHOD CU_HOSTEVCURRMAXLIMOV_C "Conversion method for HostEvCurrMaxLimOv_C" RAT_FUNC "%10.0" "A" COEFFS 0.000000 1.000000 -0.000000 0.000000 0.000000 1.000000 /end COMPU_METHOD
/* Scalar calibration for DDE 'HostEvCurrMinLimOf_C'. */
/begin CHARACTERISTIC HostEvCurrMinLimOf_C "Enables overriding Minimum current supported by the vehicle." VALUE 0x700196bb RL_HOSTEVCURRMINLIMOF_C 1.000000 CU_HOSTEVCURRMINLIMOF_C 0.000000 1.000000 BYTE_ORDER MSB_LAST /end CHARACTERISTIC
/begin RECORD_LAYOUT RL_HOSTEVCURRMINLIMOF_C FNC_VALUES 1 UBYTE COLUMN_DIR DIRECT /end RECORD_LAYOUT
/begin COMPU_METHOD CU_HOSTEVCURRMINLIMOF_C "Conversion method for HostEvCurrMinLimOf_C" RAT_FUNC "%10.0" "b" COEFFS 0.000000 1.000000 -0.000000 0.000000 0.000000 1.000000 /end COMPU_METHOD
/* Scalar calibration for DDE 'HostEvCurrMinLimOv_C'. */
/begin CHARACTERISTIC HostEvCurrMinLimOv_C "Override value for Minimum current supported by the vehicle." VALUE 0x70018690 RL_HOSTEVCURRMINLIMOV_C 196605.000000 CU_HOSTEVCURRMINLIMOV_C 0.000000 196605.000000 BYTE_ORDER MSB_LAST /end CHARACTERISTIC
/begin RECORD_LAYOUT RL_HOSTEVCURRMINLIMOV_C FNC_VALUES 1 FLOAT32_IEEE COLUMN_DIR DIRECT /end RECORD_LAYOUT
/begin COMPU_METHOD CU_HOSTEVCURRMINLIMOV_C "Conversion method for HostEvCurrMinLimOv_C" RAT_FUNC "%10.0" "A" COEFFS 0.000000 1.000000 -0.000000 0.000000 0.000000 1.000000 /end COMPU_METHOD
/* Scalar calibration for DDE 'HostEvDchgCrntMaxLim_C'. */
/begin CHARACTERISTIC HostEvDchgCrntMaxLim_C "(not defined)" VALUE 0x700175a4 RL_HOSTEVDCHGCRNTMAXLIM_C 200000000.000000 CU_HOSTEVDCHGCRNTMAXLIM_C -100000000.000000 100000000.000000 BYTE_ORDER MSB_LAST /end CHARACTERISTIC
/begin RECORD_LAYOUT RL_HOSTEVDCHGCRNTMAXLIM_C FNC_VALUES 1 FLOAT32_IEEE COLUMN_DIR DIRECT /end RECORD_LAYOUT
/begin COMPU_METHOD CU_HOSTEVDCHGCRNTMAXLIM_C "Conversion method for HostEvDchgCrntMaxLim_C" RAT_FUNC "%10.0" "A" COEFFS 0.000000 1.000000 -0.000000 0.000000 0.000000 1.000000 /end COMPU_METHOD
/* Scalar calibration for DDE 'HostEvDchgCrntMinLim_C'. */
/begin CHARACTERISTIC HostEvDchgCrntMinLim_C "(not defined)" VALUE 0x700176c8 RL_HOSTEVDCHGCRNTMINLIM_C 200000000.000000 CU_HOSTEVDCHGCRNTMINLIM_C -100000000.000000 100000000.000000 BYTE_ORDER MSB_LAST /end CHARACTERISTIC
/begin RECORD_LAYOUT RL_HOSTEVDCHGCRNTMINLIM_C FNC_VALUES 1 FLOAT32_IEEE COLUMN_DIR DIRECT /end RECORD_LAYOUT
/begin COMPU_METHOD CU_HOSTEVDCHGCRNTMINLIM_C "Conversion method for HostEvDchgCrntMinLim_C" RAT_FUNC "%10.0" "A" COEFFS 0.000000 1.000000 -0.000000 0.000000 0.000000 1.000000 /end COMPU_METHOD
/* Scalar calibration for DDE 'HostEvDchgPwrMaxLim_C'. */
/begin CHARACTERISTIC HostEvDchgPwrMaxLim_C "(not defined)" VALUE 0x700176fc RL_HOSTEVDCHGPWRMAXLIM_C 200000000.000000 CU_HOSTEVDCHGPWRMAXLIM_C -100000000.000000 100000000.000000 BYTE_ORDER MSB_LAST /end CHARACTERISTIC
/begin RECORD_LAYOUT RL_HOSTEVDCHGPWRMAXLIM_C FNC_VALUES 1 FLOAT32_IEEE COLUMN_DIR DIRECT /end RECORD_LAYOUT
/begin COMPU_METHOD CU_HOSTEVDCHGPWRMAXLIM_C "Conversion method for HostEvDchgPwrMaxLim_C" RAT_FUNC "%10.0" "W" COEFFS 0.000000 1.000000 -0.000000 0.000000 0.000000 1.000000 /end COMPU_METHOD
/* Scalar calibration for DDE 'HostEvDchgPwrMinLim_C'. */
/begin CHARACTERISTIC HostEvDchgPwrMinLim_C "(not defined)" VALUE 0x70017414 RL_HOSTEVDCHGPWRMINLIM_C 200000000.000000 CU_HOSTEVDCHGPWRMINLIM_C -100000000.000000 100000000.000000 BYTE_ORDER MSB_LAST /end CHARACTERISTIC
/begin RECORD_LAYOUT RL_HOSTEVDCHGPWRMINLIM_C FNC_VALUES 1 FLOAT32_IEEE COLUMN_DIR DIRECT /end RECORD_LAYOUT
/begin COMPU_METHOD CU_HOSTEVDCHGPWRMINLIM_C "Conversion method for HostEvDchgPwrMinLim_C" RAT_FUNC "%10.0" "W" COEFFS 0.000000 1.000000 -0.000000 0.000000 0.000000 1.000000 /end COMPU_METHOD
/* Scalar calibration for DDE 'HostEvDisChgCurrMaxLimOf_C'. */
/begin CHARACTERISTIC HostEvDisChgCurrMaxLimOf_C "Enables overriding Maximum discharge current supported by the vehicle." VALUE 0x700195c4 RL_HOSTEVDISCHGCURRMAXLIMOF_C 1.000000 CU_HOSTEVDISCHGCURRMAXLIMOF_C 0.000000 1.000000 BYTE_ORDER MSB_LAST /end CHARACTERISTIC
/begin RECORD_LAYOUT RL_HOSTEVDISCHGCURRMAXLIMOF_C FNC_VALUES 1 UBYTE COLUMN_DIR DIRECT /end RECORD_LAYOUT
/begin COMPU_METHOD CU_HOSTEVDISCHGCURRMAXLIMOF_C "Conversion method for HostEvDisChgCurrMaxLimOf_C" RAT_FUNC "%10.0" "b" COEFFS 0.000000 1.000000 -0.000000 0.000000 0.000000 1.000000 /end COMPU_METHOD
/* Scalar calibration for DDE 'HostEvDisChgCurrMaxLimOv_C'. */
/begin CHARACTERISTIC HostEvDisChgCurrMaxLimOv_C "Override value for Maximum discharge current supported by the vehicle." VALUE 0x700186ec RL_HOSTEVDISCHGCURRMAXLIMOV_C 196605.000000 CU_HOSTEVDISCHGCURRMAXLIMOV_C 0.000000 196605.000000 BYTE_ORDER MSB_LAST /end CHARACTERISTIC
/begin RECORD_LAYOUT RL_HOSTEVDISCHGCURRMAXLIMOV_C FNC_VALUES 1 FLOAT32_IEEE COLUMN_DIR DIRECT /end RECORD_LAYOUT
/begin COMPU_METHOD CU_HOSTEVDISCHGCURRMAXLIMOV_C "Conversion method for HostEvDisChgCurrMaxLimOv_C" RAT_FUNC "%10.0" "Wh" COEFFS 0.000000 1.000000 -0.000000 0.000000 0.000000 1.000000 /end COMPU_METHOD
/* Scalar calibration for DDE 'HostEvDisChgCurrMinLimOf_C'. */
/begin CHARACTERISTIC HostEvDisChgCurrMinLimOf_C "Enables overriding Minimum discharge current supported by the vehicle." VALUE 0x700197b7 RL_HOSTEVDISCHGCURRMINLIMOF_C 1.000000 CU_HOSTEVDISCHGCURRMINLIMOF_C 0.000000 1.000000 BYTE_ORDER MSB_LAST /end CHARACTERISTIC
/begin RECORD_LAYOUT RL_HOSTEVDISCHGCURRMINLIMOF_C FNC_VALUES 1 UBYTE COLUMN_DIR DIRECT /end RECORD_LAYOUT
/begin COMPU_METHOD CU_HOSTEVDISCHGCURRMINLIMOF_C "Conversion method for HostEvDisChgCurrMinLimOf_C" RAT_FUNC "%10.0" "b" COEFFS 0.000000 1.000000 -0.000000 0.000000 0.000000 1.000000 /end COMPU_METHOD
/* Scalar calibration for DDE 'HostEvDisChgCurrMinLimOv_C'. */
/begin CHARACTERISTIC HostEvDisChgCurrMinLimOv_C "Override value for Minimum discharge current supported by the vehicle." VALUE 0x7001977c RL_HOSTEVDISCHGCURRMINLIMOV_C 196605.000000 CU_HOSTEVDISCHGCURRMINLIMOV_C 0.000000 196605.000000 BYTE_ORDER MSB_LAST /end CHARACTERISTIC
/begin RECORD_LAYOUT RL_HOSTEVDISCHGCURRMINLIMOV_C FNC_VALUES 1 FLOAT32_IEEE COLUMN_DIR DIRECT /end RECORD_LAYOUT
/begin COMPU_METHOD CU_HOSTEVDISCHGCURRMINLIMOV_C "Conversion method for HostEvDisChgCurrMinLimOv_C" RAT_FUNC "%10.0" "Wh" COEFFS 0.000000 1.000000 -0.000000 0.000000 0.000000 1.000000 /end COMPU_METHOD
/* Scalar calibration for DDE 'HostEvDisChgPwrMaxLimOf_C'. */
/begin CHARACTERISTIC HostEvDisChgPwrMaxLimOf_C "Enables overriding Maximum discharge power supported by the vehicle." VALUE 0x700184f4 RL_HOSTEVDISCHGPWRMAXLIMOF_C 1.000000 CU_HOSTEVDISCHGPWRMAXLIMOF_C 0.000000 1.000000 BYTE_ORDER MSB_LAST /end CHARACTERISTIC
/begin RECORD_LAYOUT RL_HOSTEVDISCHGPWRMAXLIMOF_C FNC_VALUES 1 UBYTE COLUMN_DIR DIRECT /end RECORD_LAYOUT
/begin COMPU_METHOD CU_HOSTEVDISCHGPWRMAXLIMOF_C "Conversion method for HostEvDisChgPwrMaxLimOf_C" RAT_FUNC "%10.0" "b" COEFFS 0.000000 1.000000 -0.000000 0.000000 0.000000 1.000000 /end COMPU_METHOD
/* Scalar calibration for DDE 'HostEvDisChgPwrMaxLimOv_C'. */
/begin CHARACTERISTIC HostEvDisChgPwrMaxLimOv_C "Override value for Maximum discharge power supported by the vehicle." VALUE 0x7001967c RL_HOSTEVDISCHGPWRMAXLIMOV_C 196605.000000 CU_HOSTEVDISCHGPWRMAXLIMOV_C 0.000000 196605.000000 BYTE_ORDER MSB_LAST /end CHARACTERISTIC
/begin RECORD_LAYOUT RL_HOSTEVDISCHGPWRMAXLIMOV_C FNC_VALUES 1 FLOAT32_IEEE COLUMN_DIR DIRECT /end RECORD_LAYOUT
/begin COMPU_METHOD CU_HOSTEVDISCHGPWRMAXLIMOV_C "Conversion method for HostEvDisChgPwrMaxLimOv_C" RAT_FUNC "%10.0" "Wh" COEFFS 0.000000 1.000000 -0.000000 0.000000 0.000000 1.000000 /end COMPU_METHOD
/* Scalar calibration for DDE 'HostEvDisChgPwrMinLimOf_C'. */
/begin CHARACTERISTIC HostEvDisChgPwrMinLimOf_C "Enables overriding Minimum discharge power supported by the vehicle." VALUE 0x70019d70 RL_HOSTEVDISCHGPWRMINLIMOF_C 1.000000 CU_HOSTEVDISCHGPWRMINLIMOF_C 0.000000 1.000000 BYTE_ORDER MSB_LAST /end CHARACTERISTIC
/begin RECORD_LAYOUT RL_HOSTEVDISCHGPWRMINLIMOF_C FNC_VALUES 1 UBYTE COLUMN_DIR DIRECT /end RECORD_LAYOUT
/begin COMPU_METHOD CU_HOSTEVDISCHGPWRMINLIMOF_C "Conversion method for HostEvDisChgPwrMinLimOf_C" RAT_FUNC "%10.0" "b" COEFFS 0.000000 1.000000 -0.000000 0.000000 0.000000 1.000000 /end COMPU_METHOD
/* Scalar calibration for DDE 'HostEvDisChgPwrMinLimOv_C'. */
/begin CHARACTERISTIC HostEvDisChgPwrMinLimOv_C "Override value for Minimum discharge power supported by the vehicle." VALUE 0x70019620 RL_HOSTEVDISCHGPWRMINLIMOV_C 196605.000000 CU_HOSTEVDISCHGPWRMINLIMOV_C 0.000000 196605.000000 BYTE_ORDER MSB_LAST /end CHARACTERISTIC
/begin RECORD_LAYOUT RL_HOSTEVDISCHGPWRMINLIMOV_C FNC_VALUES 1 FLOAT32_IEEE COLUMN_DIR DIRECT /end RECORD_LAYOUT
/begin COMPU_METHOD CU_HOSTEVDISCHGPWRMINLIMOV_C "Conversion method for HostEvDisChgPwrMinLimOv_C" RAT_FUNC "%10.0" "Wh" COEFFS 0.000000 1.000000 -0.000000 0.000000 0.000000 1.000000 /end COMPU_METHOD
/* Scalar calibration for DDE 'HostEvEgyCapacityOf_C'. */
/begin CHARACTERISTIC HostEvEgyCapacityOf_C "Enables overriding Maximum energy capacity supported by the vehicle" VALUE 0x70019738 RL_HOSTEVEGYCAPACITYOF_C 1.000000 CU_HOSTEVEGYCAPACITYOF_C 0.000000 1.000000 BYTE_ORDER MSB_LAST /end CHARACTERISTIC
/begin RECORD_LAYOUT RL_HOSTEVEGYCAPACITYOF_C FNC_VALUES 1 UBYTE COLUMN_DIR DIRECT /end RECORD_LAYOUT
/begin COMPU_METHOD CU_HOSTEVEGYCAPACITYOF_C "Conversion method for HostEvEgyCapacityOf_C" RAT_FUNC "%10.0" "b" COEFFS 0.000000 1.000000 -0.000000 0.000000 0.000000 1.000000 /end COMPU_METHOD
/* Scalar calibration for DDE 'HostEvEgyCapacityOv_C'. */
/begin CHARACTERISTIC HostEvEgyCapacityOv_C "Override value for Maximum energy capacity supported by the vehicle" VALUE 0x700185dc RL_HOSTEVEGYCAPACITYOV_C 196605.000000 CU_HOSTEVEGYCAPACITYOV_C 0.000000 196605.000000 BYTE_ORDER MSB_LAST /end CHARACTERISTIC
/begin RECORD_LAYOUT RL_HOSTEVEGYCAPACITYOV_C FNC_VALUES 1 FLOAT32_IEEE COLUMN_DIR DIRECT /end RECORD_LAYOUT
/begin COMPU_METHOD CU_HOSTEVEGYCAPACITYOV_C "Conversion method for HostEvEgyCapacityOv_C" RAT_FUNC "%10.0" "Wh" COEFFS 0.000000 1.000000 -0.000000 0.000000 0.000000 1.000000 /end COMPU_METHOD
/* Scalar calibration for DDE 'HostEvEgyCapacity_C'. */
/begin CHARACTERISTIC HostEvEgyCapacity_C "(not defined)" VALUE 0x700173cc RL_HOSTEVEGYCAPACITY_C 200000000.000000 CU_HOSTEVEGYCAPACITY_C -100000000.000000 100000000.000000 BYTE_ORDER MSB_LAST /end CHARACTERISTIC
/begin RECORD_LAYOUT RL_HOSTEVEGYCAPACITY_C FNC_VALUES 1 FLOAT32_IEEE COLUMN_DIR DIRECT /end RECORD_LAYOUT
/begin COMPU_METHOD CU_HOSTEVEGYCAPACITY_C "Conversion method for HostEvEgyCapacity_C" RAT_FUNC "%10.0" "W*h" COEFFS 0.000000 1.000000 -0.000000 0.000000 0.000000 1.000000 /end COMPU_METHOD
/* Scalar calibration for DDE 'HostEvEgyMax_C'. */
/begin CHARACTERISTIC HostEvEgyMax_C "(not defined)" VALUE 0x700175b8 RL_HOSTEVEGYMAX_C 200000000.000000 CU_HOSTEVEGYMAX_C -100000000.000000 100000000.000000 BYTE_ORDER MSB_LAST /end CHARACTERISTIC
/begin RECORD_LAYOUT RL_HOSTEVEGYMAX_C FNC_VALUES 1 FLOAT32_IEEE COLUMN_DIR DIRECT /end RECORD_LAYOUT
/begin COMPU_METHOD CU_HOSTEVEGYMAX_C "Conversion method for HostEvEgyMax_C" RAT_FUNC "%10.0" "W*h" COEFFS 0.000000 1.000000 -0.000000 0.000000 0.000000 1.000000 /end COMPU_METHOD
/* Scalar calibration for DDE 'HostEvEgyMin_C'. */
/begin CHARACTERISTIC HostEvEgyMin_C "(not defined)" VALUE 0x70017598 RL_HOSTEVEGYMIN_C 200000000.000000 CU_HOSTEVEGYMIN_C -100000000.000000 100000000.000000 BYTE_ORDER MSB_LAST /end CHARACTERISTIC
/begin RECORD_LAYOUT RL_HOSTEVEGYMIN_C FNC_VALUES 1 FLOAT32_IEEE COLUMN_DIR DIRECT /end RECORD_LAYOUT
/begin COMPU_METHOD CU_HOSTEVEGYMIN_C "Conversion method for HostEvEgyMin_C" RAT_FUNC "%10.0" "W*h" COEFFS 0.000000 1.000000 -0.000000 0.000000 0.000000 1.000000 /end COMPU_METHOD
/* Scalar calibration for DDE 'HostEvEgyReqAmountOf_C'. */
/begin CHARACTERISTIC HostEvEgyReqAmountOf_C "Enables overriding Amount of energy requested by the vehicle" VALUE 0x70019646 RL_HOSTEVEGYREQAMOUNTOF_C 1.000000 CU_HOSTEVEGYREQAMOUNTOF_C 0.000000 1.000000 BYTE_ORDER MSB_LAST /end CHARACTERISTIC
/begin RECORD_LAYOUT RL_HOSTEVEGYREQAMOUNTOF_C FNC_VALUES 1 UBYTE COLUMN_DIR DIRECT /end RECORD_LAYOUT
/begin COMPU_METHOD CU_HOSTEVEGYREQAMOUNTOF_C "Conversion method for HostEvEgyReqAmountOf_C" RAT_FUNC "%10.0" "b" COEFFS 0.000000 1.000000 -0.000000 0.000000 0.000000 1.000000 /end COMPU_METHOD
/* Scalar calibration for DDE 'HostEvEgyReqAmountOv_C'. */
/begin CHARACTERISTIC HostEvEgyReqAmountOv_C "Override value for Amount of energy requested by the vehicle" VALUE 0x70018518 RL_HOSTEVEGYREQAMOUNTOV_C 196605.000000 CU_HOSTEVEGYREQAMOUNTOV_C 0.000000 196605.000000 BYTE_ORDER MSB_LAST /end CHARACTERISTIC
/begin RECORD_LAYOUT RL_HOSTEVEGYREQAMOUNTOV_C FNC_VALUES 1 FLOAT32_IEEE COLUMN_DIR DIRECT /end RECORD_LAYOUT
/begin COMPU_METHOD CU_HOSTEVEGYREQAMOUNTOV_C "Conversion method for HostEvEgyReqAmountOv_C" RAT_FUNC "%10.0" "Wh" COEFFS 0.000000 1.000000 -0.000000 0.000000 0.000000 1.000000 /end COMPU_METHOD
/* Scalar calibration for DDE 'HostEvEgyReqAmount_C'. */
/begin CHARACTERISTIC HostEvEgyReqAmount_C "(not defined)" VALUE 0x700173f4 RL_HOSTEVEGYREQAMOUNT_C 200000000.000000 CU_HOSTEVEGYREQAMOUNT_C -100000000.000000 100000000.000000 BYTE_ORDER MSB_LAST /end CHARACTERISTIC
/begin RECORD_LAYOUT RL_HOSTEVEGYREQAMOUNT_C FNC_VALUES 1 FLOAT32_IEEE COLUMN_DIR DIRECT /end RECORD_LAYOUT
/begin COMPU_METHOD CU_HOSTEVEGYREQAMOUNT_C "Conversion method for HostEvEgyReqAmount_C" RAT_FUNC "%10.0" "W*h" COEFFS 0.000000 1.000000 -0.000000 0.000000 0.000000 1.000000 /end COMPU_METHOD
/* Scalar calibration for DDE 'HostEvIsolCheckDisabledDelay_C'. */
/begin CHARACTERISTIC HostEvIsolCheckDisabledDelay_C "(not defined)" VALUE 0x7001763c RL_HOSTEVISOLCHECKDISABLEDDELA0 100000.000000 CU_HOSTEVISOLCHECKDISABLEDDELA0 0.000000 100000.000000 BYTE_ORDER MSB_LAST /end CHARACTERISTIC
/begin RECORD_LAYOUT RL_HOSTEVISOLCHECKDISABLEDDELA0 FNC_VALUES 1 FLOAT32_IEEE COLUMN_DIR DIRECT /end RECORD_LAYOUT
/begin COMPU_METHOD CU_HOSTEVISOLCHECKDISABLEDDELA0 "Conversion method for HostEvIsolCheckDisabledDelay_C" RAT_FUNC "%10.0" "s" COEFFS 0.000000 1.000000 -0.000000 0.000000 0.000000 1.000000 /end COMPU_METHOD
/* Scalar calibration for DDE 'HostEvIsolCheckDisabledOf_C'. */
/begin CHARACTERISTIC HostEvIsolCheckDisabledOf_C "Enavbles overriding" VALUE 0x70019636 RL_HOSTEVISOLCHECKDISABLEDOF_C 1.000000 CU_HOSTEVISOLCHECKDISABLEDOF_C 0.000000 1.000000 BYTE_ORDER MSB_LAST /end CHARACTERISTIC
/begin RECORD_LAYOUT RL_HOSTEVISOLCHECKDISABLEDOF_C FNC_VALUES 1 UBYTE COLUMN_DIR DIRECT /end RECORD_LAYOUT
/begin COMPU_METHOD CU_HOSTEVISOLCHECKDISABLEDOF_C "Conversion method for HostEvIsolCheckDisabledOf_C" RAT_FUNC "%10.0" "b" COEFFS 0.000000 1.000000 -0.000000 0.000000 0.000000 1.000000 /end COMPU_METHOD
/* Scalar calibration for DDE 'HostEvIsolCheckDisabledOv_C'. */
/begin CHARACTERISTIC HostEvIsolCheckDisabledOv_C "Override value" VALUE 0x700184e4 RL_HOSTEVISOLCHECKDISABLEDOV_C 1.000000 CU_HOSTEVISOLCHECKDISABLEDOV_C 0.000000 1.000000 BYTE_ORDER MSB_LAST /end CHARACTERISTIC
/begin RECORD_LAYOUT RL_HOSTEVISOLCHECKDISABLEDOV_C FNC_VALUES 1 UBYTE COLUMN_DIR DIRECT /end RECORD_LAYOUT
/begin COMPU_METHOD CU_HOSTEVISOLCHECKDISABLEDOV_C "Conversion method for HostEvIsolCheckDisabledOv_C" RAT_FUNC "%10.0" "b" COEFFS 0.000000 1.000000 -0.000000 0.000000 0.000000 1.000000 /end COMPU_METHOD
/* Scalar calibration for DDE 'HostEvMaxEgyOf_C'. */
/begin CHARACTERISTIC HostEvMaxEgyOf_C "Enables overriding Maximum level of energy accepted by the EV" VALUE 0x700184e9 RL_HOSTEVMAXEGYOF_C 1.000000 CU_HOSTEVMAXEGYOF_C 0.000000 1.000000 BYTE_ORDER MSB_LAST /end CHARACTERISTIC
/begin RECORD_LAYOUT RL_HOSTEVMAXEGYOF_C FNC_VALUES 1 UBYTE COLUMN_DIR DIRECT /end RECORD_LAYOUT
/begin COMPU_METHOD CU_HOSTEVMAXEGYOF_C "Conversion method for HostEvMaxEgyOf_C" RAT_FUNC "%10.0" "b" COEFFS 0.000000 1.000000 -0.000000 0.000000 0.000000 1.000000 /end COMPU_METHOD
/* Scalar calibration for DDE 'HostEvMaxEgyOv_C'. */
/begin CHARACTERISTIC HostEvMaxEgyOv_C "Override value for Maximum level of energy accepted by the EV" VALUE 0x70019674 RL_HOSTEVMAXEGYOV_C 196605.000000 CU_HOSTEVMAXEGYOV_C 0.000000 196605.000000 BYTE_ORDER MSB_LAST /end CHARACTERISTIC
/begin RECORD_LAYOUT RL_HOSTEVMAXEGYOV_C FNC_VALUES 1 FLOAT32_IEEE COLUMN_DIR DIRECT /end RECORD_LAYOUT
/begin COMPU_METHOD CU_HOSTEVMAXEGYOV_C "Conversion method for HostEvMaxEgyOv_C" RAT_FUNC "%10.0" "Wh" COEFFS 0.000000 1.000000 -0.000000 0.000000 0.000000 1.000000 /end COMPU_METHOD
/* Scalar calibration for DDE 'HostEvMinEgyOf_C'. */
/begin CHARACTERISTIC HostEvMinEgyOf_C "Enables overriding Minimum level of energy requested by the EV as soon as possible" VALUE 0x70019678 RL_HOSTEVMINEGYOF_C 1.000000 CU_HOSTEVMINEGYOF_C 0.000000 1.000000 BYTE_ORDER MSB_LAST /end CHARACTERISTIC
/begin RECORD_LAYOUT RL_HOSTEVMINEGYOF_C FNC_VALUES 1 UBYTE COLUMN_DIR DIRECT /end RECORD_LAYOUT
/begin COMPU_METHOD CU_HOSTEVMINEGYOF_C "Conversion method for HostEvMinEgyOf_C" RAT_FUNC "%10.0" "b" COEFFS 0.000000 1.000000 -0.000000 0.000000 0.000000 1.000000 /end COMPU_METHOD
/* Scalar calibration for DDE 'HostEvMinEgyOv_C'. */
/begin CHARACTERISTIC HostEvMinEgyOv_C "Override value for Minimum level of energy requested by the EV as soon as possible" VALUE 0x700185ac RL_HOSTEVMINEGYOV_C 196605.000000 CU_HOSTEVMINEGYOV_C 0.000000 196605.000000 BYTE_ORDER MSB_LAST /end CHARACTERISTIC
/begin RECORD_LAYOUT RL_HOSTEVMINEGYOV_C FNC_VALUES 1 FLOAT32_IEEE COLUMN_DIR DIRECT /end RECORD_LAYOUT
/begin COMPU_METHOD CU_HOSTEVMINEGYOV_C "Conversion method for HostEvMinEgyOv_C" RAT_FUNC "%10.0" "Wh" COEFFS 0.000000 1.000000 -0.000000 0.000000 0.000000 1.000000 /end COMPU_METHOD
/* Scalar calibration for DDE 'HostEvPwrMaxLimOf_C'. */
/begin CHARACTERISTIC HostEvPwrMaxLimOf_C "Enables overriding Maximum power supported by the vehicle." VALUE 0x70019e28 RL_HOSTEVPWRMAXLIMOF_C 1.000000 CU_HOSTEVPWRMAXLIMOF_C 0.000000 1.000000 BYTE_ORDER MSB_LAST /end CHARACTERISTIC
/begin RECORD_LAYOUT RL_HOSTEVPWRMAXLIMOF_C FNC_VALUES 1 UBYTE COLUMN_DIR DIRECT /end RECORD_LAYOUT
/begin COMPU_METHOD CU_HOSTEVPWRMAXLIMOF_C "Conversion method for HostEvPwrMaxLimOf_C" RAT_FUNC "%10.0" "b" COEFFS 0.000000 1.000000 -0.000000 0.000000 0.000000 1.000000 /end COMPU_METHOD
/* Scalar calibration for DDE 'HostEvPwrMaxLimOv_C'. */
/begin CHARACTERISTIC HostEvPwrMaxLimOv_C "Override value for Maximum power supported by the vehicle." VALUE 0x700195d0 RL_HOSTEVPWRMAXLIMOV_C 196605.000000 CU_HOSTEVPWRMAXLIMOV_C 0.000000 196605.000000 BYTE_ORDER MSB_LAST /end CHARACTERISTIC
/begin RECORD_LAYOUT RL_HOSTEVPWRMAXLIMOV_C FNC_VALUES 1 FLOAT32_IEEE COLUMN_DIR DIRECT /end RECORD_LAYOUT
/begin COMPU_METHOD CU_HOSTEVPWRMAXLIMOV_C "Conversion method for HostEvPwrMaxLimOv_C" RAT_FUNC "%10.0" "W" COEFFS 0.000000 1.000000 -0.000000 0.000000 0.000000 1.000000 /end COMPU_METHOD
/* Scalar calibration for DDE 'HostEvPwrMaxLim_C'. */
/begin CHARACTERISTIC HostEvPwrMaxLim_C "(not defined)" VALUE 0x700176f8 RL_HOSTEVPWRMAXLIM_C 200000000.000000 CU_HOSTEVPWRMAXLIM_C -100000000.000000 100000000.000000 BYTE_ORDER MSB_LAST /end CHARACTERISTIC
/begin RECORD_LAYOUT RL_HOSTEVPWRMAXLIM_C FNC_VALUES 1 FLOAT32_IEEE COLUMN_DIR DIRECT /end RECORD_LAYOUT
/begin COMPU_METHOD CU_HOSTEVPWRMAXLIM_C "Conversion method for HostEvPwrMaxLim_C" RAT_FUNC "%10.0" "W" COEFFS 0.000000 1.000000 -0.000000 0.000000 0.000000 1.000000 /end COMPU_METHOD
/* Scalar calibration for DDE 'HostEvPwrMinLimOf_C'. */
/begin CHARACTERISTIC HostEvPwrMinLimOf_C "Enables overriding Minimum power supported by the vehicle." VALUE 0x70018708 RL_HOSTEVPWRMINLIMOF_C 1.000000 CU_HOSTEVPWRMINLIMOF_C 0.000000 1.000000 BYTE_ORDER MSB_LAST /end CHARACTERISTIC
/begin RECORD_LAYOUT RL_HOSTEVPWRMINLIMOF_C FNC_VALUES 1 UBYTE COLUMN_DIR DIRECT /end RECORD_LAYOUT
/begin COMPU_METHOD CU_HOSTEVPWRMINLIMOF_C "Conversion method for HostEvPwrMinLimOf_C" RAT_FUNC "%10.0" "b" COEFFS 0.000000 1.000000 -0.000000 0.000000 0.000000 1.000000 /end COMPU_METHOD
/* Scalar calibration for DDE 'HostEvPwrMinLimOv_C'. */
/begin CHARACTERISTIC HostEvPwrMinLimOv_C "Override value for Minimum power supported by the vehicle." VALUE 0x700184d0 RL_HOSTEVPWRMINLIMOV_C 196605.000000 CU_HOSTEVPWRMINLIMOV_C 0.000000 196605.000000 BYTE_ORDER MSB_LAST /end CHARACTERISTIC
/begin RECORD_LAYOUT RL_HOSTEVPWRMINLIMOV_C FNC_VALUES 1 FLOAT32_IEEE COLUMN_DIR DIRECT /end RECORD_LAYOUT
/begin COMPU_METHOD CU_HOSTEVPWRMINLIMOV_C "Conversion method for HostEvPwrMinLimOv_C" RAT_FUNC "%10.0" "W" COEFFS 0.000000 1.000000 -0.000000 0.000000 0.000000 1.000000 /end COMPU_METHOD
/* Scalar calibration for DDE 'HostEvPwrMinLim_C'. */
/begin CHARACTERISTIC HostEvPwrMinLim_C "(not defined)" VALUE 0x70017600 RL_HOSTEVPWRMINLIM_C 200000000.000000 CU_HOSTEVPWRMINLIM_C -100000000.000000 100000000.000000 BYTE_ORDER MSB_LAST /end CHARACTERISTIC
/begin RECORD_LAYOUT RL_HOSTEVPWRMINLIM_C FNC_VALUES 1 FLOAT32_IEEE COLUMN_DIR DIRECT /end RECORD_LAYOUT
/begin COMPU_METHOD CU_HOSTEVPWRMINLIM_C "Conversion method for HostEvPwrMinLim_C" RAT_FUNC "%10.0" "W" COEFFS 0.000000 1.000000 -0.000000 0.000000 0.000000 1.000000 /end COMPU_METHOD
/* Scalar calibration for DDE 'HostEvTargetCrntOf_C'. */
/begin CHARACTERISTIC HostEvTargetCrntOf_C "Enables overriding Instantaneous current requested by the vehicle" VALUE 0x70019d65 RL_HOSTEVTARGETCRNTOF_C 1.000000 CU_HOSTEVTARGETCRNTOF_C 0.000000 1.000000 BYTE_ORDER MSB_LAST /end CHARACTERISTIC
/begin RECORD_LAYOUT RL_HOSTEVTARGETCRNTOF_C FNC_VALUES 1 UBYTE COLUMN_DIR DIRECT /end RECORD_LAYOUT
/begin COMPU_METHOD CU_HOSTEVTARGETCRNTOF_C "Conversion method for HostEvTargetCrntOf_C" RAT_FUNC "%10.0" "b" COEFFS 0.000000 1.000000 -0.000000 0.000000 0.000000 1.000000 /end COMPU_METHOD
/* Scalar calibration for DDE 'HostEvTargetCrntOv_C'. */
/begin CHARACTERISTIC HostEvTargetCrntOv_C "Override value for Instantaneous current requested by the vehicle" VALUE 0x700186dc RL_HOSTEVTARGETCRNTOV_C 196605.000000 CU_HOSTEVTARGETCRNTOV_C 0.000000 196605.000000 BYTE_ORDER MSB_LAST /end CHARACTERISTIC
/begin RECORD_LAYOUT RL_HOSTEVTARGETCRNTOV_C FNC_VALUES 1 FLOAT32_IEEE COLUMN_DIR DIRECT /end RECORD_LAYOUT
/begin COMPU_METHOD CU_HOSTEVTARGETCRNTOV_C "Conversion method for HostEvTargetCrntOv_C" RAT_FUNC "%10.0" "A" COEFFS 0.000000 1.000000 -0.000000 0.000000 0.000000 1.000000 /end COMPU_METHOD
/* Scalar calibration for DDE 'HostEvTargetCrnt_C'. */
/begin CHARACTERISTIC HostEvTargetCrnt_C "(not defined)" VALUE 0x7001757c RL_HOSTEVTARGETCRNT_C 200000000.000000 CU_HOSTEVTARGETCRNT_C -100000000.000000 100000000.000000 BYTE_ORDER MSB_LAST /end CHARACTERISTIC
/begin RECORD_LAYOUT RL_HOSTEVTARGETCRNT_C FNC_VALUES 1 FLOAT32_IEEE COLUMN_DIR DIRECT /end RECORD_LAYOUT
/begin COMPU_METHOD CU_HOSTEVTARGETCRNT_C "Conversion method for HostEvTargetCrnt_C" RAT_FUNC "%10.0" "A" COEFFS 0.000000 1.000000 -0.000000 0.000000 0.000000 1.000000 /end COMPU_METHOD
/* Scalar calibration for DDE 'HostEvTargetVoltOf_C'. */
/begin CHARACTERISTIC HostEvTargetVoltOf_C "Enables overriding Target Voltage requested by EV" VALUE 0x700185e4 RL_HOSTEVTARGETVOLTOF_C 1.000000 CU_HOSTEVTARGETVOLTOF_C 0.000000 1.000000 BYTE_ORDER MSB_LAST /end CHARACTERISTIC
/begin RECORD_LAYOUT RL_HOSTEVTARGETVOLTOF_C FNC_VALUES 1 UBYTE COLUMN_DIR DIRECT /end RECORD_LAYOUT
/begin COMPU_METHOD CU_HOSTEVTARGETVOLTOF_C "Conversion method for HostEvTargetVoltOf_C" RAT_FUNC "%10.0" "b" COEFFS 0.000000 1.000000 -0.000000 0.000000 0.000000 1.000000 /end COMPU_METHOD
/* Scalar calibration for DDE 'HostEvTargetVoltOv_C'. */
/begin CHARACTERISTIC HostEvTargetVoltOv_C "Override value for Target Voltage requested by EV" VALUE 0x70019794 RL_HOSTEVTARGETVOLTOV_C 196605.000000 CU_HOSTEVTARGETVOLTOV_C 0.000000 196605.000000 BYTE_ORDER MSB_LAST /end CHARACTERISTIC
/begin RECORD_LAYOUT RL_HOSTEVTARGETVOLTOV_C FNC_VALUES 1 FLOAT32_IEEE COLUMN_DIR DIRECT /end RECORD_LAYOUT
/begin COMPU_METHOD CU_HOSTEVTARGETVOLTOV_C "Conversion method for HostEvTargetVoltOv_C" RAT_FUNC "%10.0" "V" COEFFS 0.000000 1.000000 -0.000000 0.000000 0.000000 1.000000 /end COMPU_METHOD
/* Scalar calibration for DDE 'HostEvTargetVolt_C'. */
/begin CHARACTERISTIC HostEvTargetVolt_C "(not defined)" VALUE 0x70017700 RL_HOSTEVTARGETVOLT_C 200000000.000000 CU_HOSTEVTARGETVOLT_C -100000000.000000 100000000.000000 BYTE_ORDER MSB_LAST /end CHARACTERISTIC
/begin RECORD_LAYOUT RL_HOSTEVTARGETVOLT_C FNC_VALUES 1 FLOAT32_IEEE COLUMN_DIR DIRECT /end RECORD_LAYOUT
/begin COMPU_METHOD CU_HOSTEVTARGETVOLT_C "Conversion method for HostEvTargetVolt_C" RAT_FUNC "%10.0" "V" COEFFS 0.000000 1.000000 -0.000000 0.000000 0.000000 1.000000 /end COMPU_METHOD
/* Scalar calibration for DDE 'HostEvVoltMaxLimOf_C'. */
/begin CHARACTERISTIC HostEvVoltMaxLimOf_C "Enables overriding Maximum voltage supported by the vehicle." VALUE 0x70019780 RL_HOSTEVVOLTMAXLIMOF_C 1.000000 CU_HOSTEVVOLTMAXLIMOF_C 0.000000 1.000000 BYTE_ORDER MSB_LAST /end CHARACTERISTIC
/begin RECORD_LAYOUT RL_HOSTEVVOLTMAXLIMOF_C FNC_VALUES 1 UBYTE COLUMN_DIR DIRECT /end RECORD_LAYOUT
/begin COMPU_METHOD CU_HOSTEVVOLTMAXLIMOF_C "Conversion method for HostEvVoltMaxLimOf_C" RAT_FUNC "%10.0" "b" COEFFS 0.000000 1.000000 -0.000000 0.000000 0.000000 1.000000 /end COMPU_METHOD
/* Scalar calibration for DDE 'HostEvVoltMaxLimOv_C'. */
/begin CHARACTERISTIC HostEvVoltMaxLimOv_C "Override value for Maximum voltage supported by the vehicle." VALUE 0x70019658 RL_HOSTEVVOLTMAXLIMOV_C 196605.000000 CU_HOSTEVVOLTMAXLIMOV_C 0.000000 196605.000000 BYTE_ORDER MSB_LAST /end CHARACTERISTIC
/begin RECORD_LAYOUT RL_HOSTEVVOLTMAXLIMOV_C FNC_VALUES 1 FLOAT32_IEEE COLUMN_DIR DIRECT /end RECORD_LAYOUT
/begin COMPU_METHOD CU_HOSTEVVOLTMAXLIMOV_C "Conversion method for HostEvVoltMaxLimOv_C" RAT_FUNC "%10.0" "V" COEFFS 0.000000 1.000000 -0.000000 0.000000 0.000000 1.000000 /end COMPU_METHOD
/* Scalar calibration for DDE 'HostEvVoltMaxLim_C'. */
/begin CHARACTERISTIC HostEvVoltMaxLim_C "(not defined)" VALUE 0x70017528 RL_HOSTEVVOLTMAXLIM_C 200000000.000000 CU_HOSTEVVOLTMAXLIM_C -100000000.000000 100000000.000000 BYTE_ORDER MSB_LAST /end CHARACTERISTIC
/begin RECORD_LAYOUT RL_HOSTEVVOLTMAXLIM_C FNC_VALUES 1 FLOAT32_IEEE COLUMN_DIR DIRECT /end RECORD_LAYOUT
/begin COMPU_METHOD CU_HOSTEVVOLTMAXLIM_C "Conversion method for HostEvVoltMaxLim_C" RAT_FUNC "%10.0" "V" COEFFS 0.000000 1.000000 -0.000000 0.000000 0.000000 1.000000 /end COMPU_METHOD
/* Scalar calibration for DDE 'HostEvVoltMinLimOf_C'. */
/begin CHARACTERISTIC HostEvVoltMinLimOf_C "Enables overriding Minimum voltage supported by the vehicle." VALUE 0x700185cd RL_HOSTEVVOLTMINLIMOF_C 1.000000 CU_HOSTEVVOLTMINLIMOF_C 0.000000 1.000000 BYTE_ORDER MSB_LAST /end CHARACTERISTIC
/begin RECORD_LAYOUT RL_HOSTEVVOLTMINLIMOF_C FNC_VALUES 1 UBYTE COLUMN_DIR DIRECT /end RECORD_LAYOUT
/begin COMPU_METHOD CU_HOSTEVVOLTMINLIMOF_C "Conversion method for HostEvVoltMinLimOf_C" RAT_FUNC "%10.0" "b" COEFFS 0.000000 1.000000 -0.000000 0.000000 0.000000 1.000000 /end COMPU_METHOD
/* Scalar calibration for DDE 'HostEvVoltMinLimOv_C'. */
/begin CHARACTERISTIC HostEvVoltMinLimOv_C "Override value for Minimum voltage supported by the vehicle." VALUE 0x70019668 RL_HOSTEVVOLTMINLIMOV_C 196605.000000 CU_HOSTEVVOLTMINLIMOV_C 0.000000 196605.000000 BYTE_ORDER MSB_LAST /end CHARACTERISTIC
/begin RECORD_LAYOUT RL_HOSTEVVOLTMINLIMOV_C FNC_VALUES 1 FLOAT32_IEEE COLUMN_DIR DIRECT /end RECORD_LAYOUT
/begin COMPU_METHOD CU_HOSTEVVOLTMINLIMOV_C "Conversion method for HostEvVoltMinLimOv_C" RAT_FUNC "%10.0" "V" COEFFS 0.000000 1.000000 -0.000000 0.000000 0.000000 1.000000 /end COMPU_METHOD
/* Scalar calibration for DDE 'HostEvVoltMinLim_C'. */
/begin CHARACTERISTIC HostEvVoltMinLim_C "(not defined)" VALUE 0x700176a0 RL_HOSTEVVOLTMINLIM_C 200000000.000000 CU_HOSTEVVOLTMINLIM_C -100000000.000000 100000000.000000 BYTE_ORDER MSB_LAST /end CHARACTERISTIC
/begin RECORD_LAYOUT RL_HOSTEVVOLTMINLIM_C FNC_VALUES 1 FLOAT32_IEEE COLUMN_DIR DIRECT /end RECORD_LAYOUT
/begin COMPU_METHOD CU_HOSTEVVOLTMINLIM_C "Conversion method for HostEvVoltMinLim_C" RAT_FUNC "%10.0" "V" COEFFS 0.000000 1.000000 -0.000000 0.000000 0.000000 1.000000 /end COMPU_METHOD
/* Scalar calibration for DDE 'HostIgnoreIsolWarningOf_C'. */
/begin CHARACTERISTIC HostIgnoreIsolWarningOf_C "Enavbles overriding" VALUE 0x7001963c RL_HOSTIGNOREISOLWARNINGOF_C 1.000000 CU_HOSTIGNOREISOLWARNINGOF_C 0.000000 1.000000 BYTE_ORDER MSB_LAST /end CHARACTERISTIC
/begin RECORD_LAYOUT RL_HOSTIGNOREISOLWARNINGOF_C FNC_VALUES 1 UBYTE COLUMN_DIR DIRECT /end RECORD_LAYOUT
/begin COMPU_METHOD CU_HOSTIGNOREISOLWARNINGOF_C "Conversion method for HostIgnoreIsolWarningOf_C" RAT_FUNC "%10.0" "b" COEFFS 0.000000 1.000000 -0.000000 0.000000 0.000000 1.000000 /end COMPU_METHOD
/* Scalar calibration for DDE 'HostIgnoreIsolWarningOv_C'. */
/begin CHARACTERISTIC HostIgnoreIsolWarningOv_C "Override value" VALUE 0x70019778 RL_HOSTIGNOREISOLWARNINGOV_C 1.000000 CU_HOSTIGNOREISOLWARNINGOV_C 0.000000 1.000000 BYTE_ORDER MSB_LAST /end CHARACTERISTIC
/begin RECORD_LAYOUT RL_HOSTIGNOREISOLWARNINGOV_C FNC_VALUES 1 UBYTE COLUMN_DIR DIRECT /end RECORD_LAYOUT
/begin COMPU_METHOD CU_HOSTIGNOREISOLWARNINGOV_C "Conversion method for HostIgnoreIsolWarningOv_C" RAT_FUNC "%10.0" "b" COEFFS 0.000000 1.000000 -0.000000 0.000000 0.000000 1.000000 /end COMPU_METHOD
/* Scalar calibration for DDE 'HostIgnoreIsolWarning_C'. */
/begin CHARACTERISTIC HostIgnoreIsolWarning_C "(not defined)" VALUE 0x70017518 RL_HOSTIGNOREISOLWARNING_C 1.000000 CU_HOSTIGNOREISOLWARNING_C 0.000000 1.000000 BYTE_ORDER MSB_LAST /end CHARACTERISTIC
/begin RECORD_LAYOUT RL_HOSTIGNOREISOLWARNING_C FNC_VALUES 1 UBYTE COLUMN_DIR DIRECT /end RECORD_LAYOUT
/begin COMPU_METHOD CU_HOSTIGNOREISOLWARNING_C "Conversion method for HostIgnoreIsolWarning_C" RAT_FUNC "%10.0" "b" COEFFS 0.000000 1.000000 -0.000000 0.000000 0.000000 1.000000 /end COMPU_METHOD
/* Scalar calibration for DDE 'HostIso1ProtocolEnable_C'. */
/begin CHARACTERISTIC HostIso1ProtocolEnable_C "Set to 1 if the EV wants to use the ISO15118 ED2 protocol and send it as part of the supportedAppProtocolRequest message." VALUE 0x70017438 RL_HOSTISO1PROTOCOLENABLE_C 1.000000 CU_HOSTISO1PROTOCOLENABLE_C 0.000000 1.000000 BYTE_ORDER MSB_LAST /end CHARACTERISTIC
/begin RECORD_LAYOUT RL_HOSTISO1PROTOCOLENABLE_C FNC_VALUES 1 UBYTE COLUMN_DIR DIRECT /end RECORD_LAYOUT
/begin COMPU_METHOD CU_HOSTISO1PROTOCOLENABLE_C "Conversion method for HostIso1ProtocolEnable_C" RAT_FUNC "%10.0" "b" COEFFS 0.000000 1.000000 -0.000000 0.000000 0.000000 1.000000 /end COMPU_METHOD
/* Scalar calibration for DDE 'HostIso1ProtocolPriority_C'. */
/begin CHARACTERISTIC HostIso1ProtocolPriority_C "Set to 1 if the EV wants to use the DIN protocol and send it as part of the supportedAppProtocolRequest message." VALUE 0x7001743a RL_HOSTISO1PROTOCOLPRIORITY_C 255.000000 CU_HOSTISO1PROTOCOLPRIORITY_C 0.000000 255.000000 BYTE_ORDER MSB_LAST /end CHARACTERISTIC
/begin RECORD_LAYOUT RL_HOSTISO1PROTOCOLPRIORITY_C FNC_VALUES 1 UBYTE COLUMN_DIR DIRECT /end RECORD_LAYOUT
/begin COMPU_METHOD CU_HOSTISO1PROTOCOLPRIORITY_C "Conversion method for HostIso1ProtocolPriority_C" RAT_FUNC "%10.0" "(not defined)" COEFFS 0.000000 1.000000 -0.000000 0.000000 0.000000 1.000000 /end COMPU_METHOD
/* Scalar calibration for DDE 'HostIso2ProtocolEnable_C'. */
/begin CHARACTERISTIC HostIso2ProtocolEnable_C "Set to 1 if the EV wants to use the ISO15118 ED2 protocol and send it as part of the supportedAppProtocolRequest message." VALUE 0x700184e7 RL_HOSTISO2PROTOCOLENABLE_C 1.000000 CU_HOSTISO2PROTOCOLENABLE_C 0.000000 1.000000 BYTE_ORDER MSB_LAST /end CHARACTERISTIC
/begin RECORD_LAYOUT RL_HOSTISO2PROTOCOLENABLE_C FNC_VALUES 1 UBYTE COLUMN_DIR DIRECT /end RECORD_LAYOUT
/begin COMPU_METHOD CU_HOSTISO2PROTOCOLENABLE_C "Conversion method for HostIso2ProtocolEnable_C" RAT_FUNC "%10.0" "b" COEFFS 0.000000 1.000000 -0.000000 0.000000 0.000000 1.000000 /end COMPU_METHOD
/* Scalar calibration for DDE 'HostIso2ProtocolPriority_C'. */
/begin CHARACTERISTIC HostIso2ProtocolPriority_C "Set to 1 if the EV wants to use the DIN protocol and send it as part of the supportedAppProtocolRequest message." VALUE 0x70017620 RL_HOSTISO2PROTOCOLPRIORITY_C 255.000000 CU_HOSTISO2PROTOCOLPRIORITY_C 0.000000 255.000000 BYTE_ORDER MSB_LAST /end CHARACTERISTIC
/begin RECORD_LAYOUT RL_HOSTISO2PROTOCOLPRIORITY_C FNC_VALUES 1 UBYTE COLUMN_DIR DIRECT /end RECORD_LAYOUT
/begin COMPU_METHOD CU_HOSTISO2PROTOCOLPRIORITY_C "Conversion method for HostIso2ProtocolPriority_C" RAT_FUNC "%10.0" "(not defined)" COEFFS 0.000000 1.000000 -0.000000 0.000000 0.000000 1.000000 /end COMPU_METHOD
/* Scalar calibration for DDE 'HostPriorityDinOf_C'. */
/begin CHARACTERISTIC HostPriorityDinOf_C "Enables overriding" VALUE 0x7001966c RL_HOSTPRIORITYDINOF_C 1.000000 CU_HOSTPRIORITYDINOF_C 0.000000 1.000000 BYTE_ORDER MSB_LAST /end CHARACTERISTIC
/begin RECORD_LAYOUT RL_HOSTPRIORITYDINOF_C FNC_VALUES 1 UBYTE COLUMN_DIR DIRECT /end RECORD_LAYOUT
/begin COMPU_METHOD CU_HOSTPRIORITYDINOF_C "Conversion method for HostPriorityDinOf_C" RAT_FUNC "%10.0" "b" COEFFS 0.000000 1.000000 -0.000000 0.000000 0.000000 1.000000 /end COMPU_METHOD
/* Scalar calibration for DDE 'HostPriorityDinOv_C'. */
/begin CHARACTERISTIC HostPriorityDinOv_C "Override value" VALUE 0x700185a8 RL_HOSTPRIORITYDINOV_C 255.000000 CU_HOSTPRIORITYDINOV_C 0.000000 255.000000 BYTE_ORDER MSB_LAST /end CHARACTERISTIC
/begin RECORD_LAYOUT RL_HOSTPRIORITYDINOV_C FNC_VALUES 1 UBYTE COLUMN_DIR DIRECT /end RECORD_LAYOUT
/begin COMPU_METHOD CU_HOSTPRIORITYDINOV_C "Conversion method for HostPriorityDinOv_C" RAT_FUNC "%10.0" "e" COEFFS 0.000000 1.000000 -0.000000 0.000000 0.000000 1.000000 /end COMPU_METHOD
/* Scalar calibration for DDE 'HostPriorityIsoV1Of_C'. */
/begin CHARACTERISTIC HostPriorityIsoV1Of_C "Enables overriding" VALUE 0x7001972c RL_HOSTPRIORITYISOV1OF_C 1.000000 CU_HOSTPRIORITYISOV1OF_C 0.000000 1.000000 BYTE_ORDER MSB_LAST /end CHARACTERISTIC
/begin RECORD_LAYOUT RL_HOSTPRIORITYISOV1OF_C FNC_VALUES 1 UBYTE COLUMN_DIR DIRECT /end RECORD_LAYOUT
/begin COMPU_METHOD CU_HOSTPRIORITYISOV1OF_C "Conversion method for HostPriorityIsoV1Of_C" RAT_FUNC "%10.0" "b" COEFFS 0.000000 1.000000 -0.000000 0.000000 0.000000 1.000000 /end COMPU_METHOD
/* Scalar calibration for DDE 'HostPriorityIsoV1Ov_C'. */
/begin CHARACTERISTIC HostPriorityIsoV1Ov_C "Override value" VALUE 0x700185d8 RL_HOSTPRIORITYISOV1OV_C 255.000000 CU_HOSTPRIORITYISOV1OV_C 0.000000 255.000000 BYTE_ORDER MSB_LAST /end CHARACTERISTIC
/begin RECORD_LAYOUT RL_HOSTPRIORITYISOV1OV_C FNC_VALUES 1 UBYTE COLUMN_DIR DIRECT /end RECORD_LAYOUT
/begin COMPU_METHOD CU_HOSTPRIORITYISOV1OV_C "Conversion method for HostPriorityIsoV1Ov_C" RAT_FUNC "%10.0" "e" COEFFS 0.000000 1.000000 -0.000000 0.000000 0.000000 1.000000 /end COMPU_METHOD
/* Scalar calibration for DDE 'HostPriorityIsoV2Of_C'. */
/begin CHARACTERISTIC HostPriorityIsoV2Of_C "Enables overriding" VALUE 0x70019785 RL_HOSTPRIORITYISOV2OF_C 1.000000 CU_HOSTPRIORITYISOV2OF_C 0.000000 1.000000 BYTE_ORDER MSB_LAST /end CHARACTERISTIC
/begin RECORD_LAYOUT RL_HOSTPRIORITYISOV2OF_C FNC_VALUES 1 UBYTE COLUMN_DIR DIRECT /end RECORD_LAYOUT
/begin COMPU_METHOD CU_HOSTPRIORITYISOV2OF_C "Conversion method for HostPriorityIsoV2Of_C" RAT_FUNC "%10.0" "b" COEFFS 0.000000 1.000000 -0.000000 0.000000 0.000000 1.000000 /end COMPU_METHOD
/* Scalar calibration for DDE 'HostPriorityIsoV2Ov_C'. */
/begin CHARACTERISTIC HostPriorityIsoV2Ov_C "Override value" VALUE 0x70018698 RL_HOSTPRIORITYISOV2OV_C 255.000000 CU_HOSTPRIORITYISOV2OV_C 0.000000 255.000000 BYTE_ORDER MSB_LAST /end CHARACTERISTIC
/begin RECORD_LAYOUT RL_HOSTPRIORITYISOV2OV_C FNC_VALUES 1 UBYTE COLUMN_DIR DIRECT /end RECORD_LAYOUT
/begin COMPU_METHOD CU_HOSTPRIORITYISOV2OV_C "Conversion method for HostPriorityIsoV2Ov_C" RAT_FUNC "%10.0" "e" COEFFS 0.000000 1.000000 -0.000000 0.000000 0.000000 1.000000 /end COMPU_METHOD
/* Scalar calibration for DDE 'HostProtocolDinEnblOf_C'. */
/begin CHARACTERISTIC HostProtocolDinEnblOf_C "Enables overriding" VALUE 0x7001866c RL_HOSTPROTOCOLDINENBLOF_C 1.000000 CU_HOSTPROTOCOLDINENBLOF_C 0.000000 1.000000 BYTE_ORDER MSB_LAST /end CHARACTERISTIC
/begin RECORD_LAYOUT RL_HOSTPROTOCOLDINENBLOF_C FNC_VALUES 1 UBYTE COLUMN_DIR DIRECT /end RECORD_LAYOUT
/begin COMPU_METHOD CU_HOSTPROTOCOLDINENBLOF_C "Conversion method for HostProtocolDinEnblOf_C" RAT_FUNC "%10.0" "b" COEFFS 0.000000 1.000000 -0.000000 0.000000 0.000000 1.000000 /end COMPU_METHOD
/* Scalar calibration for DDE 'HostProtocolDinEnblOv_C'. */
/begin CHARACTERISTIC HostProtocolDinEnblOv_C "Override value" VALUE 0x70019d58 RL_HOSTPROTOCOLDINENBLOV_C 1.000000 CU_HOSTPROTOCOLDINENBLOV_C 0.000000 1.000000 BYTE_ORDER MSB_LAST /end CHARACTERISTIC
/begin RECORD_LAYOUT RL_HOSTPROTOCOLDINENBLOV_C FNC_VALUES 1 UBYTE COLUMN_DIR DIRECT /end RECORD_LAYOUT
/begin COMPU_METHOD CU_HOSTPROTOCOLDINENBLOV_C "Conversion method for HostProtocolDinEnblOv_C" RAT_FUNC "%10.0" "b" COEFFS 0.000000 1.000000 -0.000000 0.000000 0.000000 1.000000 /end COMPU_METHOD
/* Scalar calibration for DDE 'HostProtocolIsoV1EnblOf_C'. */
/begin CHARACTERISTIC HostProtocolIsoV1EnblOf_C "Enables overriding" VALUE 0x70019e19 RL_HOSTPROTOCOLISOV1ENBLOF_C 1.000000 CU_HOSTPROTOCOLISOV1ENBLOF_C 0.000000 1.000000 BYTE_ORDER MSB_LAST /end CHARACTERISTIC
/begin RECORD_LAYOUT RL_HOSTPROTOCOLISOV1ENBLOF_C FNC_VALUES 1 UBYTE COLUMN_DIR DIRECT /end RECORD_LAYOUT
/begin COMPU_METHOD CU_HOSTPROTOCOLISOV1ENBLOF_C "Conversion method for HostProtocolIsoV1EnblOf_C" RAT_FUNC "%10.0" "b" COEFFS 0.000000 1.000000 -0.000000 0.000000 0.000000 1.000000 /end COMPU_METHOD
/* Scalar calibration for DDE 'HostProtocolIsoV1EnblOv_C'. */
/begin CHARACTERISTIC HostProtocolIsoV1EnblOv_C "Override value" VALUE 0x700195c6 RL_HOSTPROTOCOLISOV1ENBLOV_C 1.000000 CU_HOSTPROTOCOLISOV1ENBLOV_C 0.000000 1.000000 BYTE_ORDER MSB_LAST /end CHARACTERISTIC
/begin RECORD_LAYOUT RL_HOSTPROTOCOLISOV1ENBLOV_C FNC_VALUES 1 UBYTE COLUMN_DIR DIRECT /end RECORD_LAYOUT
/begin COMPU_METHOD CU_HOSTPROTOCOLISOV1ENBLOV_C "Conversion method for HostProtocolIsoV1EnblOv_C" RAT_FUNC "%10.0" "b" COEFFS 0.000000 1.000000 -0.000000 0.000000 0.000000 1.000000 /end COMPU_METHOD
/* Scalar calibration for DDE 'HostProtocolIsoV2EnblOf_C'. */
/begin CHARACTERISTIC HostProtocolIsoV2EnblOf_C "Enables overriding" VALUE 0x70019e70 RL_HOSTPROTOCOLISOV2ENBLOF_C 1.000000 CU_HOSTPROTOCOLISOV2ENBLOF_C 0.000000 1.000000 BYTE_ORDER MSB_LAST /end CHARACTERISTIC
/begin RECORD_LAYOUT RL_HOSTPROTOCOLISOV2ENBLOF_C FNC_VALUES 1 UBYTE COLUMN_DIR DIRECT /end RECORD_LAYOUT
/begin COMPU_METHOD CU_HOSTPROTOCOLISOV2ENBLOF_C "Conversion method for HostProtocolIsoV2EnblOf_C" RAT_FUNC "%10.0" "b" COEFFS 0.000000 1.000000 -0.000000 0.000000 0.000000 1.000000 /end COMPU_METHOD
/* Scalar calibration for DDE 'HostProtocolIsoV2EnblOv_C'. */
/begin CHARACTERISTIC HostProtocolIsoV2EnblOv_C "Override value" VALUE 0x7001962a RL_HOSTPROTOCOLISOV2ENBLOV_C 1.000000 CU_HOSTPROTOCOLISOV2ENBLOV_C 0.000000 1.000000 BYTE_ORDER MSB_LAST /end CHARACTERISTIC
/begin RECORD_LAYOUT RL_HOSTPROTOCOLISOV2ENBLOV_C FNC_VALUES 1 UBYTE COLUMN_DIR DIRECT /end RECORD_LAYOUT
/begin COMPU_METHOD CU_HOSTPROTOCOLISOV2ENBLOV_C "Conversion method for HostProtocolIsoV2EnblOv_C" RAT_FUNC "%10.0" "b" COEFFS 0.000000 1.000000 -0.000000 0.000000 0.000000 1.000000 /end COMPU_METHOD
/* Scalar calibration for DDE 'HostPwminEvsePilotDutcycOf_C'. */
/begin CHARACTERISTIC HostPwminEvsePilotDutcycOf_C "Enables overriding duty_cycle percent feature for PWM Input of EVSE Pilot." VALUE 0x700174f0 RL_HOSTPWMINEVSEPILOTDUTCYCOF_C 1.000000 CU_HOSTPWMINEVSEPILOTDUTCYCOF_C 0.000000 1.000000 BYTE_ORDER MSB_LAST /end CHARACTERISTIC
/begin RECORD_LAYOUT RL_HOSTPWMINEVSEPILOTDUTCYCOF_C FNC_VALUES 1 UBYTE COLUMN_DIR DIRECT /end RECORD_LAYOUT
/begin COMPU_METHOD CU_HOSTPWMINEVSEPILOTDUTCYCOF_C "Conversion method for HostPwminEvsePilotDutcycOf_C" RAT_FUNC "%10.0" "b" COEFFS 0.000000 1.000000 -0.000000 0.000000 0.000000 1.000000 /end COMPU_METHOD
/* Scalar calibration for DDE 'HostPwminEvsePilotDutcycOv_C'. */
/begin CHARACTERISTIC HostPwminEvsePilotDutcycOv_C "Override value for duty_cycle percent feature for PWM Input of EVSE Pilot." VALUE 0x70017514 RL_HOSTPWMINEVSEPILOTDUTCYCOV_C 100.000000 CU_HOSTPWMINEVSEPILOTDUTCYCOV_C 0.000000 100.000000 BYTE_ORDER MSB_LAST /end CHARACTERISTIC
/begin RECORD_LAYOUT RL_HOSTPWMINEVSEPILOTDUTCYCOV_C FNC_VALUES 1 FLOAT32_IEEE COLUMN_DIR DIRECT /end RECORD_LAYOUT
/begin COMPU_METHOD CU_HOSTPWMINEVSEPILOTDUTCYCOV_C "Conversion method for HostPwminEvsePilotDutcycOv_C" RAT_FUNC "%10.0" "%" COEFFS 0.000000 1.000000 -0.000000 0.000000 0.000000 1.000000 /end COMPU_METHOD
/* Scalar calibration for DDE 'HostPwminEvsePilotFreqOf_C'. */
/begin CHARACTERISTIC HostPwminEvsePilotFreqOf_C "Enables overriding Frequency of the last measured period for the PWM Input of EVSE Pilot" VALUE 0x700176ae RL_HOSTPWMINEVSEPILOTFREQOF_C 1.000000 CU_HOSTPWMINEVSEPILOTFREQOF_C 0.000000 1.000000 BYTE_ORDER MSB_LAST /end CHARACTERISTIC
/begin RECORD_LAYOUT RL_HOSTPWMINEVSEPILOTFREQOF_C FNC_VALUES 1 UBYTE COLUMN_DIR DIRECT /end RECORD_LAYOUT
/begin COMPU_METHOD CU_HOSTPWMINEVSEPILOTFREQOF_C "Conversion method for HostPwminEvsePilotFreqOf_C" RAT_FUNC "%10.0" "b" COEFFS 0.000000 1.000000 -0.000000 0.000000 0.000000 1.000000 /end COMPU_METHOD
/* Scalar calibration for DDE 'HostPwminEvsePilotFreqOv_C'. */
/begin CHARACTERISTIC HostPwminEvsePilotFreqOv_C "Override value for Frequency of the last measured period for the PWM Input of EVSE Pilot" VALUE 0x70017408 RL_HOSTPWMINEVSEPILOTFREQOV_C 10000000.000000 CU_HOSTPWMINEVSEPILOTFREQOV_C 0.000000 10000000.000000 BYTE_ORDER MSB_LAST /end CHARACTERISTIC
/begin RECORD_LAYOUT RL_HOSTPWMINEVSEPILOTFREQOV_C FNC_VALUES 1 FLOAT32_IEEE COLUMN_DIR DIRECT /end RECORD_LAYOUT
/begin COMPU_METHOD CU_HOSTPWMINEVSEPILOTFREQOV_C "Conversion method for HostPwminEvsePilotFreqOv_C" RAT_FUNC "%10.0" "Hz" COEFFS 0.000000 1.000000 -0.000000 0.000000 0.000000 1.000000 /end COMPU_METHOD
/* Scalar calibration for DDE 'HostPwminEvsePilotTimeoutOf_C'. */
/begin CHARACTERISTIC HostPwminEvsePilotTimeoutOf_C "Enables overriding Timeout feature for PWM Input of EVSE Pilot (True if a complete period has not been measured for the timeout given by the mask parameter Time out, zero otherwise)." VALUE 0x7001762c RL_HOSTPWMINEVSEPILOTTIMEOUTOF0 1.000000 CU_HOSTPWMINEVSEPILOTTIMEOUTOF0 0.000000 1.000000 BYTE_ORDER MSB_LAST /end CHARACTERISTIC
/begin RECORD_LAYOUT RL_HOSTPWMINEVSEPILOTTIMEOUTOF0 FNC_VALUES 1 UBYTE COLUMN_DIR DIRECT /end RECORD_LAYOUT
/begin COMPU_METHOD CU_HOSTPWMINEVSEPILOTTIMEOUTOF0 "Conversion method for HostPwminEvsePilotTimeoutOf_C" RAT_FUNC "%10.0" "b" COEFFS 0.000000 1.000000 -0.000000 0.000000 0.000000 1.000000 /end COMPU_METHOD
/* Scalar calibration for DDE 'HostPwminEvsePilotTimeoutOv_C'. */
/begin CHARACTERISTIC HostPwminEvsePilotTimeoutOv_C "Override value for Timeout feature for PWM Input of EVSE Pilot (True if a complete period has not been measured for the timeout given by the mask parameter Time out, zero otherwise)." VALUE 0x700196ea RL_HOSTPWMINEVSEPILOTTIMEOUTOV0 1.000000 CU_HOSTPWMINEVSEPILOTTIMEOUTOV0 0.000000 1.000000 BYTE_ORDER MSB_LAST /end CHARACTERISTIC
/begin RECORD_LAYOUT RL_HOSTPWMINEVSEPILOTTIMEOUTOV0 FNC_VALUES 1 UBYTE COLUMN_DIR DIRECT /end RECORD_LAYOUT
/begin COMPU_METHOD CU_HOSTPWMINEVSEPILOTTIMEOUTOV0 "Conversion method for HostPwminEvsePilotTimeoutOv_C" RAT_FUNC "%10.0" "b" COEFFS 0.000000 1.000000 -0.000000 0.000000 0.000000 1.000000 /end COMPU_METHOD
/* Scalar calibration for DDE 'HostRelayWeldCheckEn_C'. */
/begin CHARACTERISTIC HostRelayWeldCheckEn_C "(not defined)" VALUE 0x70019d6b RL_HOSTRELAYWELDCHECKEN_C 1.000000 CU_HOSTRELAYWELDCHECKEN_C 0.000000 1.000000 BYTE_ORDER MSB_LAST /end CHARACTERISTIC
/begin RECORD_LAYOUT RL_HOSTRELAYWELDCHECKEN_C FNC_VALUES 1 UBYTE COLUMN_DIR DIRECT /end RECORD_LAYOUT
/begin COMPU_METHOD CU_HOSTRELAYWELDCHECKEN_C "Conversion method for HostRelayWeldCheckEn_C" RAT_FUNC "%10.0" "b" COEFFS 0.000000 1.000000 -0.000000 0.000000 0.000000 1.000000 /end COMPU_METHOD
/* Scalar calibration for DDE 'HostRelayWeldCheckEnableOf_C'. */
/begin CHARACTERISTIC HostRelayWeldCheckEnableOf_C "Enavbles overriding" VALUE 0x70019764 RL_HOSTRELAYWELDCHECKENABLEOF_C 1.000000 CU_HOSTRELAYWELDCHECKENABLEOF_C 0.000000 1.000000 BYTE_ORDER MSB_LAST /end CHARACTERISTIC
/begin RECORD_LAYOUT RL_HOSTRELAYWELDCHECKENABLEOF_C FNC_VALUES 1 UBYTE COLUMN_DIR DIRECT /end RECORD_LAYOUT
/begin COMPU_METHOD CU_HOSTRELAYWELDCHECKENABLEOF_C "Conversion method for HostRelayWeldCheckEnableOf_C" RAT_FUNC "%10.0" "b" COEFFS 0.000000 1.000000 -0.000000 0.000000 0.000000 1.000000 /end COMPU_METHOD
/* Scalar calibration for DDE 'HostRelayWeldCheckEnableOv_C'. */
/begin CHARACTERISTIC HostRelayWeldCheckEnableOv_C "Override value" VALUE 0x70019e5c RL_HOSTRELAYWELDCHECKENABLEOV_C 1.000000 CU_HOSTRELAYWELDCHECKENABLEOV_C 0.000000 1.000000 BYTE_ORDER MSB_LAST /end CHARACTERISTIC
/begin RECORD_LAYOUT RL_HOSTRELAYWELDCHECKENABLEOV_C FNC_VALUES 1 UBYTE COLUMN_DIR DIRECT /end RECORD_LAYOUT
/begin COMPU_METHOD CU_HOSTRELAYWELDCHECKENABLEOV_C "Conversion method for HostRelayWeldCheckEnableOv_C" RAT_FUNC "%10.0" "b" COEFFS 0.000000 1.000000 -0.000000 0.000000 0.000000 1.000000 /end COMPU_METHOD
/* Scalar calibration for DDE 'HostRemainTimeToBulkSoc_C'. */
/begin CHARACTERISTIC HostRemainTimeToBulkSoc_C "(not defined)" VALUE 0x700175c8 RL_HOSTREMAINTIMETOBULKSOC_C 200000000.000000 CU_HOSTREMAINTIMETOBULKSOC_C -100000000.000000 100000000.000000 BYTE_ORDER MSB_LAST /end CHARACTERISTIC
/begin RECORD_LAYOUT RL_HOSTREMAINTIMETOBULKSOC_C FNC_VALUES 1 FLOAT32_IEEE COLUMN_DIR DIRECT /end RECORD_LAYOUT
/begin COMPU_METHOD CU_HOSTREMAINTIMETOBULKSOC_C "Conversion method for HostRemainTimeToBulkSoc_C" RAT_FUNC "%10.0" "s" COEFFS 0.000000 1.000000 -0.000000 0.000000 0.000000 1.000000 /end COMPU_METHOD
/* Scalar calibration for DDE 'HostRemainTimeToFullSocOf_C'. */
/begin CHARACTERISTIC HostRemainTimeToFullSocOf_C "Enables overriding Estimated or calculated time until full charge is complete." VALUE 0x700185d9 RL_HOSTREMAINTIMETOFULLSOCOF_C 1.000000 CU_HOSTREMAINTIMETOFULLSOCOF_C 0.000000 1.000000 BYTE_ORDER MSB_LAST /end CHARACTERISTIC
/begin RECORD_LAYOUT RL_HOSTREMAINTIMETOFULLSOCOF_C FNC_VALUES 1 UBYTE COLUMN_DIR DIRECT /end RECORD_LAYOUT
/begin COMPU_METHOD CU_HOSTREMAINTIMETOFULLSOCOF_C "Conversion method for HostRemainTimeToFullSocOf_C" RAT_FUNC "%10.0" "b" COEFFS 0.000000 1.000000 -0.000000 0.000000 0.000000 1.000000 /end COMPU_METHOD
/* Scalar calibration for DDE 'HostRemainTimeToFullSocOv_C'. */
/begin CHARACTERISTIC HostRemainTimeToFullSocOv_C "Override value for Estimated or calculated time until full charge is complete." VALUE 0x70019788 RL_HOSTREMAINTIMETOFULLSOCOV_C 196605.000000 CU_HOSTREMAINTIMETOFULLSOCOV_C 0.000000 196605.000000 BYTE_ORDER MSB_LAST /end CHARACTERISTIC
/begin RECORD_LAYOUT RL_HOSTREMAINTIMETOFULLSOCOV_C FNC_VALUES 1 FLOAT32_IEEE COLUMN_DIR DIRECT /end RECORD_LAYOUT
/begin COMPU_METHOD CU_HOSTREMAINTIMETOFULLSOCOV_C "Conversion method for HostRemainTimeToFullSocOv_C" RAT_FUNC "%10.0" "s" COEFFS 0.000000 1.000000 -0.000000 0.000000 0.000000 1.000000 /end COMPU_METHOD
/* Scalar calibration for DDE 'HostRemainTimeToFullSoc_C'. */
/begin CHARACTERISTIC HostRemainTimeToFullSoc_C "(not defined)" VALUE 0x700173fc RL_HOSTREMAINTIMETOFULLSOC_C 200000000.000000 CU_HOSTREMAINTIMETOFULLSOC_C -100000000.000000 100000000.000000 BYTE_ORDER MSB_LAST /end CHARACTERISTIC
/begin RECORD_LAYOUT RL_HOSTREMAINTIMETOFULLSOC_C FNC_VALUES 1 FLOAT32_IEEE COLUMN_DIR DIRECT /end RECORD_LAYOUT
/begin COMPU_METHOD CU_HOSTREMAINTIMETOFULLSOC_C "Conversion method for HostRemainTimeToFullSoc_C" RAT_FUNC "%10.0" "s" COEFFS 0.000000 1.000000 -0.000000 0.000000 0.000000 1.000000 /end COMPU_METHOD
/* Scalar calibration for DDE 'HostRemainTimetoBulkSocOf_C'. */
/begin CHARACTERISTIC HostRemainTimetoBulkSocOf_C "Enables overriding Estimated or calculated time until bulk charge is complete." VALUE 0x700184e8 RL_HOSTREMAINTIMETOBULKSOCOF_C 1.000000 CU_HOSTREMAINTIMETOBULKSOCOF_C 0.000000 1.000000 BYTE_ORDER MSB_LAST /end CHARACTERISTIC
/begin RECORD_LAYOUT RL_HOSTREMAINTIMETOBULKSOCOF_C FNC_VALUES 1 UBYTE COLUMN_DIR DIRECT /end RECORD_LAYOUT
/begin COMPU_METHOD CU_HOSTREMAINTIMETOBULKSOCOF_C "Conversion method for HostRemainTimetoBulkSocOf_C" RAT_FUNC "%10.0" "b" COEFFS 0.000000 1.000000 -0.000000 0.000000 0.000000 1.000000 /end COMPU_METHOD
/* Scalar calibration for DDE 'HostRemainTimetoBulkSocOv_C'. */
/begin CHARACTERISTIC HostRemainTimetoBulkSocOv_C "Override value for Estimated or calculated time until bulk charge is complete." VALUE 0x70019670 RL_HOSTREMAINTIMETOBULKSOCOV_C 196605.000000 CU_HOSTREMAINTIMETOBULKSOCOV_C 0.000000 196605.000000 BYTE_ORDER MSB_LAST /end CHARACTERISTIC
/begin RECORD_LAYOUT RL_HOSTREMAINTIMETOBULKSOCOV_C FNC_VALUES 1 FLOAT32_IEEE COLUMN_DIR DIRECT /end RECORD_LAYOUT
/begin COMPU_METHOD CU_HOSTREMAINTIMETOBULKSOCOV_C "Conversion method for HostRemainTimetoBulkSocOv_C" RAT_FUNC "%10.0" "s" COEFFS 0.000000 1.000000 -0.000000 0.000000 0.000000 1.000000 /end COMPU_METHOD
/* Scalar calibration for DDE 'HostRessBulkSocOf_C'. */
/begin CHARACTERISTIC HostRessBulkSocOf_C "Enavbles overriding" VALUE 0x70019790 RL_HOSTRESSBULKSOCOF_C 1.000000 CU_HOSTRESSBULKSOCOF_C 0.000000 1.000000 BYTE_ORDER MSB_LAST /end CHARACTERISTIC
/begin RECORD_LAYOUT RL_HOSTRESSBULKSOCOF_C FNC_VALUES 1 UBYTE COLUMN_DIR DIRECT /end RECORD_LAYOUT
/begin COMPU_METHOD CU_HOSTRESSBULKSOCOF_C "Conversion method for HostRessBulkSocOf_C" RAT_FUNC "%10.0" "b" COEFFS 0.000000 1.000000 -0.000000 0.000000 0.000000 1.000000 /end COMPU_METHOD
/* Scalar calibration for DDE 'HostRessBulkSocOv_C'. */
/begin CHARACTERISTIC HostRessBulkSocOv_C "Override value" VALUE 0x7001869c RL_HOSTRESSBULKSOCOV_C 100.000000 CU_HOSTRESSBULKSOCOV_C 0.000000 100.000000 BYTE_ORDER MSB_LAST /end CHARACTERISTIC
/begin RECORD_LAYOUT RL_HOSTRESSBULKSOCOV_C FNC_VALUES 1 FLOAT32_IEEE COLUMN_DIR DIRECT /end RECORD_LAYOUT
/begin COMPU_METHOD CU_HOSTRESSBULKSOCOV_C "Conversion method for HostRessBulkSocOv_C" RAT_FUNC "%10.0" "%" COEFFS 0.000000 1.000000 -0.000000 0.000000 0.000000 1.000000 /end COMPU_METHOD
/* Scalar calibration for DDE 'HostRessBulkSoc_C'. */
/begin CHARACTERISTIC HostRessBulkSoc_C "(not defined)" VALUE 0x700175b0 RL_HOSTRESSBULKSOC_C 200000000.000000 CU_HOSTRESSBULKSOC_C -100000000.000000 100000000.000000 BYTE_ORDER MSB_LAST /end CHARACTERISTIC
/begin RECORD_LAYOUT RL_HOSTRESSBULKSOC_C FNC_VALUES 1 FLOAT32_IEEE COLUMN_DIR DIRECT /end RECORD_LAYOUT
/begin COMPU_METHOD CU_HOSTRESSBULKSOC_C "Conversion method for HostRessBulkSoc_C" RAT_FUNC "%10.0" "%" COEFFS 0.000000 1.000000 -0.000000 0.000000 0.000000 1.000000 /end COMPU_METHOD
/* Scalar calibration for DDE 'HostRessFullSoc_C'. */
/begin CHARACTERISTIC HostRessFullSoc_C "(not defined)" VALUE 0x70017590 RL_HOSTRESSFULLSOC_C 200000000.000000 CU_HOSTRESSFULLSOC_C -100000000.000000 100000000.000000 BYTE_ORDER MSB_LAST /end CHARACTERISTIC
/begin RECORD_LAYOUT RL_HOSTRESSFULLSOC_C FNC_VALUES 1 FLOAT32_IEEE COLUMN_DIR DIRECT /end RECORD_LAYOUT
/begin COMPU_METHOD CU_HOSTRESSFULLSOC_C "Conversion method for HostRessFullSoc_C" RAT_FUNC "%10.0" "%" COEFFS 0.000000 1.000000 -0.000000 0.000000 0.000000 1.000000 /end COMPU_METHOD
/* Scalar calibration for DDE 'HostRessSocOf_C'. */
/begin CHARACTERISTIC HostRessSocOf_C "Enavbles overriding" VALUE 0x700195cd RL_HOSTRESSSOCOF_C 1.000000 CU_HOSTRESSSOCOF_C 0.000000 1.000000 BYTE_ORDER MSB_LAST /end CHARACTERISTIC
/begin RECORD_LAYOUT RL_HOSTRESSSOCOF_C FNC_VALUES 1 UBYTE COLUMN_DIR DIRECT /end RECORD_LAYOUT
/begin COMPU_METHOD CU_HOSTRESSSOCOF_C "Conversion method for HostRessSocOf_C" RAT_FUNC "%10.0" "b" COEFFS 0.000000 1.000000 -0.000000 0.000000 0.000000 1.000000 /end COMPU_METHOD
/* Scalar calibration for DDE 'HostRessSocOv_C'. */
/begin CHARACTERISTIC HostRessSocOv_C "Override value" VALUE 0x70019e7c RL_HOSTRESSSOCOV_C 100.000000 CU_HOSTRESSSOCOV_C 0.000000 100.000000 BYTE_ORDER MSB_LAST /end CHARACTERISTIC
/begin RECORD_LAYOUT RL_HOSTRESSSOCOV_C FNC_VALUES 1 FLOAT32_IEEE COLUMN_DIR DIRECT /end RECORD_LAYOUT
/begin COMPU_METHOD CU_HOSTRESSSOCOV_C "Conversion method for HostRessSocOv_C" RAT_FUNC "%10.0" "%" COEFFS 0.000000 1.000000 -0.000000 0.000000 0.000000 1.000000 /end COMPU_METHOD
/* Scalar calibration for DDE 'HostRessTargetSocOf_C'. */
/begin CHARACTERISTIC HostRessTargetSocOf_C "Enables overriding The state of charge desired by the EV" VALUE 0x7001962c RL_HOSTRESSTARGETSOCOF_C 1.000000 CU_HOSTRESSTARGETSOCOF_C 0.000000 1.000000 BYTE_ORDER MSB_LAST /end CHARACTERISTIC
/begin RECORD_LAYOUT RL_HOSTRESSTARGETSOCOF_C FNC_VALUES 1 UBYTE COLUMN_DIR DIRECT /end RECORD_LAYOUT
/begin COMPU_METHOD CU_HOSTRESSTARGETSOCOF_C "Conversion method for HostRessTargetSocOf_C" RAT_FUNC "%10.0" "b" COEFFS 0.000000 1.000000 -0.000000 0.000000 0.000000 1.000000 /end COMPU_METHOD
/* Scalar calibration for DDE 'HostRessTargetSocOv_C'. */
/begin CHARACTERISTIC HostRessTargetSocOv_C "Override value for The state of charge desired by the EV" VALUE 0x700184ec RL_HOSTRESSTARGETSOCOV_C 196605.000000 CU_HOSTRESSTARGETSOCOV_C 0.000000 196605.000000 BYTE_ORDER MSB_LAST /end CHARACTERISTIC
/begin RECORD_LAYOUT RL_HOSTRESSTARGETSOCOV_C FNC_VALUES 1 FLOAT32_IEEE COLUMN_DIR DIRECT /end RECORD_LAYOUT
/begin COMPU_METHOD CU_HOSTRESSTARGETSOCOV_C "Conversion method for HostRessTargetSocOv_C" RAT_FUNC "%10.0" "Wh" COEFFS 0.000000 1.000000 -0.000000 0.000000 0.000000 1.000000 /end COMPU_METHOD
/* Scalar calibration for DDE 'HostRessVoltOf_C'. */
/begin CHARACTERISTIC HostRessVoltOf_C "Enables overriding Battery voltage" VALUE 0x70019664 RL_HOSTRESSVOLTOF_C 1.000000 CU_HOSTRESSVOLTOF_C 0.000000 1.000000 BYTE_ORDER MSB_LAST /end CHARACTERISTIC
/begin RECORD_LAYOUT RL_HOSTRESSVOLTOF_C FNC_VALUES 1 UBYTE COLUMN_DIR DIRECT /end RECORD_LAYOUT
/begin COMPU_METHOD CU_HOSTRESSVOLTOF_C "Conversion method for HostRessVoltOf_C" RAT_FUNC "%10.0" "b" COEFFS 0.000000 1.000000 -0.000000 0.000000 0.000000 1.000000 /end COMPU_METHOD
/* Scalar calibration for DDE 'HostRessVoltOv_C'. */
/begin CHARACTERISTIC HostRessVoltOv_C "Override value for Battery voltage" VALUE 0x70019e2c RL_HOSTRESSVOLTOV_C 196605.000000 CU_HOSTRESSVOLTOV_C 0.000000 196605.000000 BYTE_ORDER MSB_LAST /end CHARACTERISTIC
/begin RECORD_LAYOUT RL_HOSTRESSVOLTOV_C FNC_VALUES 1 FLOAT32_IEEE COLUMN_DIR DIRECT /end RECORD_LAYOUT
/begin COMPU_METHOD CU_HOSTRESSVOLTOV_C "Conversion method for HostRessVoltOv_C" RAT_FUNC "%10.0" "V" COEFFS 0.000000 1.000000 -0.000000 0.000000 0.000000 1.000000 /end COMPU_METHOD
/* Scalar calibration for DDE 'K3_ignition_FltMax_C'. */
/begin CHARACTERISTIC K3_ignition_FltMax_C "K3 Ignition Max Fault Limit Cal" VALUE 0xa01085d0 RL_K3_IGNITION_FLTMAX_C 40.000000 CU_K3_IGNITION_FLTMAX_C 0.000000 40.000000 BYTE_ORDER MSB_LAST /end CHARACTERISTIC
/begin RECORD_LAYOUT RL_K3_IGNITION_FLTMAX_C FNC_VALUES 1 FLOAT32_IEEE COLUMN_DIR DIRECT /end RECORD_LAYOUT
/begin COMPU_METHOD CU_K3_IGNITION_FLTMAX_C "Conversion method for K3_ignition_FltMax_C" RAT_FUNC "%10.3" "V" COEFFS 0.000000 1.000000 -0.000000 0.000000 0.000000 1.000000 /end COMPU_METHOD
/* Scalar calibration for DDE 'K3_ignition_FltMin_C'. */
/begin CHARACTERISTIC K3_ignition_FltMin_C "K3 Ignition Min Fault Limit Cal" VALUE 0xa01085cc RL_K3_IGNITION_FLTMIN_C 40.000000 CU_K3_IGNITION_FLTMIN_C 0.000000 40.000000 BYTE_ORDER MSB_LAST /end CHARACTERISTIC
/begin RECORD_LAYOUT RL_K3_IGNITION_FLTMIN_C FNC_VALUES 1 FLOAT32_IEEE COLUMN_DIR DIRECT /end RECORD_LAYOUT
/begin COMPU_METHOD CU_K3_IGNITION_FLTMIN_C "Conversion method for K3_ignition_FltMin_C" RAT_FUNC "%10.3" "V" COEFFS 0.000000 1.000000 -0.000000 0.000000 0.000000 1.000000 /end COMPU_METHOD
/* Scalar calibration for DDE 'K3_ignition_ScaleFactor_C'. */
/begin CHARACTERISTIC K3_ignition_ScaleFactor_C "K3 Ignition Scale value (raw divided by this value to get pin voltage)" VALUE 0xa01085c8 RL_K3_IGNITION_SCALEFACTOR_C 39.999000 CU_K3_IGNITION_SCALEFACTOR_C 0.001000 40.000000 BYTE_ORDER MSB_LAST /end CHARACTERISTIC
/begin RECORD_LAYOUT RL_K3_IGNITION_SCALEFACTOR_C FNC_VALUES 1 FLOAT32_IEEE COLUMN_DIR DIRECT /end RECORD_LAYOUT
/begin COMPU_METHOD CU_K3_IGNITION_SCALEFACTOR_C "Conversion method for K3_ignition_ScaleFactor_C" RAT_FUNC "%10.3" "(not defined)" COEFFS 0.000000 1.000000 -0.000000 0.000000 0.000000 1.000000 /end COMPU_METHOD
/* Scalar calibration for DDE 'M2_HbrNVmon_FltMax_C'. */
/begin CHARACTERISTIC M2_HbrNVmon_FltMax_C "M2 HbrN vmon Max Fault Limit Cal" VALUE 0xa01085c4 RL_M2_HBRNVMON_FLTMAX_C 40.000000 CU_M2_HBRNVMON_FLTMAX_C 0.000000 40.000000 BYTE_ORDER MSB_LAST /end CHARACTERISTIC
/begin RECORD_LAYOUT RL_M2_HBRNVMON_FLTMAX_C FNC_VALUES 1 FLOAT32_IEEE COLUMN_DIR DIRECT /end RECORD_LAYOUT
/begin COMPU_METHOD CU_M2_HBRNVMON_FLTMAX_C "Conversion method for M2_HbrNVmon_FltMax_C" RAT_FUNC "%10.3" "V" COEFFS 0.000000 1.000000 -0.000000 0.000000 0.000000 1.000000 /end COMPU_METHOD
/* Scalar calibration for DDE 'M2_HbrNVmon_FltMin_C'. */
/begin CHARACTERISTIC M2_HbrNVmon_FltMin_C "M2 HbrN vmon Min Fault Limit Cal" VALUE 0xa01085c0 RL_M2_HBRNVMON_FLTMIN_C 40.000000 CU_M2_HBRNVMON_FLTMIN_C 0.000000 40.000000 BYTE_ORDER MSB_LAST /end CHARACTERISTIC
/begin RECORD_LAYOUT RL_M2_HBRNVMON_FLTMIN_C FNC_VALUES 1 FLOAT32_IEEE COLUMN_DIR DIRECT /end RECORD_LAYOUT
/begin COMPU_METHOD CU_M2_HBRNVMON_FLTMIN_C "Conversion method for M2_HbrNVmon_FltMin_C" RAT_FUNC "%10.3" "V" COEFFS 0.000000 1.000000 -0.000000 0.000000 0.000000 1.000000 /end COMPU_METHOD
/* Scalar calibration for DDE 'M2_HbrNVmon_ScaleFactor_C'. */
/begin CHARACTERISTIC M2_HbrNVmon_ScaleFactor_C "M2 HbrN vmon Scale value (raw divided by this value to get pin voltage)" VALUE 0xa01085bc RL_M2_HBRNVMON_SCALEFACTOR_C 39.999000 CU_M2_HBRNVMON_SCALEFACTOR_C 0.001000 40.000000 BYTE_ORDER MSB_LAST /end CHARACTERISTIC
/begin RECORD_LAYOUT RL_M2_HBRNVMON_SCALEFACTOR_C FNC_VALUES 1 FLOAT32_IEEE COLUMN_DIR DIRECT /end RECORD_LAYOUT
/begin COMPU_METHOD CU_M2_HBRNVMON_SCALEFACTOR_C "Conversion method for M2_HbrNVmon_ScaleFactor_C" RAT_FUNC "%10.3" "(not defined)" COEFFS 0.000000 1.000000 -0.000000 0.000000 0.000000 1.000000 /end COMPU_METHOD
/* Scalar calibration for DDE 'M3_HbrPVmon_FltMax_C'. */
/begin CHARACTERISTIC M3_HbrPVmon_FltMax_C "M3 HbrP vmon Max Fault Limit Cal" VALUE 0xa01085b8 RL_M3_HBRPVMON_FLTMAX_C 40.000000 CU_M3_HBRPVMON_FLTMAX_C 0.000000 40.000000 BYTE_ORDER MSB_LAST /end CHARACTERISTIC
/begin RECORD_LAYOUT RL_M3_HBRPVMON_FLTMAX_C FNC_VALUES 1 FLOAT32_IEEE COLUMN_DIR DIRECT /end RECORD_LAYOUT
/begin COMPU_METHOD CU_M3_HBRPVMON_FLTMAX_C "Conversion method for M3_HbrPVmon_FltMax_C" RAT_FUNC "%10.3" "V" COEFFS 0.000000 1.000000 -0.000000 0.000000 0.000000 1.000000 /end COMPU_METHOD
/* Scalar calibration for DDE 'M3_HbrPVmon_FltMin_C'. */
/begin CHARACTERISTIC M3_HbrPVmon_FltMin_C "M3 HbrP vmon Min Fault Limit Cal" VALUE 0xa01085b4 RL_M3_HBRPVMON_FLTMIN_C 40.000000 CU_M3_HBRPVMON_FLTMIN_C 0.000000 40.000000 BYTE_ORDER MSB_LAST /end CHARACTERISTIC
/begin RECORD_LAYOUT RL_M3_HBRPVMON_FLTMIN_C FNC_VALUES 1 FLOAT32_IEEE COLUMN_DIR DIRECT /end RECORD_LAYOUT
/begin COMPU_METHOD CU_M3_HBRPVMON_FLTMIN_C "Conversion method for M3_HbrPVmon_FltMin_C" RAT_FUNC "%10.3" "V" COEFFS 0.000000 1.000000 -0.000000 0.000000 0.000000 1.000000 /end COMPU_METHOD
/* Scalar calibration for DDE 'M3_HbrPVmon_ScaleFactor_C'. */
/begin CHARACTERISTIC M3_HbrPVmon_ScaleFactor_C "M3 HbrP vmon Scale value (raw divided by this value to get pin voltage)" VALUE 0xa01085b0 RL_M3_HBRPVMON_SCALEFACTOR_C 39.999000 CU_M3_HBRPVMON_SCALEFACTOR_C 0.001000 40.000000 BYTE_ORDER MSB_LAST /end CHARACTERISTIC
/begin RECORD_LAYOUT RL_M3_HBRPVMON_SCALEFACTOR_C FNC_VALUES 1 FLOAT32_IEEE COLUMN_DIR DIRECT /end RECORD_LAYOUT
/begin COMPU_METHOD CU_M3_HBRPVMON_SCALEFACTOR_C "Conversion method for M3_HbrPVmon_ScaleFactor_C" RAT_FUNC "%10.3" "(not defined)" COEFFS 0.000000 1.000000 -0.000000 0.000000 0.000000 1.000000 /end COMPU_METHOD
/* Scalar calibration for DDE 'SimRessCapacity_C'. */
/begin CHARACTERISTIC SimRessCapacity_C "Desired Bulk SOC value of Renewable Energy Source System" VALUE 0x70017610 RL_SIMRESSCAPACITY_C 10000000.000000 CU_SIMRESSCAPACITY_C 0.000000 10000000.000000 BYTE_ORDER MSB_LAST /end CHARACTERISTIC
/begin RECORD_LAYOUT RL_SIMRESSCAPACITY_C FNC_VALUES 1 FLOAT32_IEEE COLUMN_DIR DIRECT /end RECORD_LAYOUT
/begin COMPU_METHOD CU_SIMRESSCAPACITY_C "Conversion method for SimRessCapacity_C" RAT_FUNC "%10.0" "A*s" COEFFS 0.000000 1.000000 -0.000000 0.000000 0.000000 1.000000 /end COMPU_METHOD
/* Scalar calibration for DDE 'SimRessChgCrntMax_C'. */
/begin CHARACTERISTIC SimRessChgCrntMax_C "Calibration for setting the maximum charge curretn of HV battery pack. The battery might report its own max current. The smaller value of these two will be considered as battery max chagrge current" VALUE 0x700189cc RL_SIMRESSCHGCRNTMAX_C 20000.000000 CU_SIMRESSCHGCRNTMAX_C -10000.000000 10000.000000 BYTE_ORDER MSB_LAST /end CHARACTERISTIC
/begin RECORD_LAYOUT RL_SIMRESSCHGCRNTMAX_C FNC_VALUES 1 FLOAT32_IEEE COLUMN_DIR DIRECT /end RECORD_LAYOUT
/begin COMPU_METHOD CU_SIMRESSCHGCRNTMAX_C "Conversion method for SimRessChgCrntMax_C" RAT_FUNC "%10.0" "A" COEFFS 0.000000 1.000000 -0.000000 0.000000 0.000000 1.000000 /end COMPU_METHOD
/* Scalar calibration for DDE 'SimRessChgVoltMax_C'. */
/begin CHARACTERISTIC SimRessChgVoltMax_C "Calibration for setting the maximum voltage of HV battery pack (offboard DC charger will be prohibited to source a voltage above this value)" VALUE 0x70017674 RL_SIMRESSCHGVOLTMAX_C 1510.000000 CU_SIMRESSCHGVOLTMAX_C -10.000000 1500.000000 BYTE_ORDER MSB_LAST /end CHARACTERISTIC
/begin RECORD_LAYOUT RL_SIMRESSCHGVOLTMAX_C FNC_VALUES 1 FLOAT32_IEEE COLUMN_DIR DIRECT /end RECORD_LAYOUT
/begin COMPU_METHOD CU_SIMRESSCHGVOLTMAX_C "Conversion method for SimRessChgVoltMax_C" RAT_FUNC "%10.0" "V" COEFFS 0.000000 1.000000 -0.000000 0.000000 0.000000 1.000000 /end COMPU_METHOD
/* Scalar calibration for DDE 'SimRessFullSoc_C'. */
/begin CHARACTERISTIC SimRessFullSoc_C "Desired Full SOC value of Renewable Energy Source System" VALUE 0x7001751c RL_SIMRESSFULLSOC_C 100.000000 CU_SIMRESSFULLSOC_C 0.000000 100.000000 BYTE_ORDER MSB_LAST /end CHARACTERISTIC
/begin RECORD_LAYOUT RL_SIMRESSFULLSOC_C FNC_VALUES 1 FLOAT32_IEEE COLUMN_DIR DIRECT /end RECORD_LAYOUT
/begin COMPU_METHOD CU_SIMRESSFULLSOC_C "Conversion method for SimRessFullSoc_C" RAT_FUNC "%10.0" "%" COEFFS 0.000000 1.000000 -0.000000 0.000000 0.000000 1.000000 /end COMPU_METHOD
/* Scalar calibration for DDE 'SimRessInitSoc_C'. */
/begin CHARACTERISTIC SimRessInitSoc_C "Desired Bulk SOC value of Renewable Energy Source System" VALUE 0x700175bc RL_SIMRESSINITSOC_C 100.000000 CU_SIMRESSINITSOC_C 0.000000 100.000000 BYTE_ORDER MSB_LAST /end CHARACTERISTIC
/begin RECORD_LAYOUT RL_SIMRESSINITSOC_C FNC_VALUES 1 FLOAT32_IEEE COLUMN_DIR DIRECT /end RECORD_LAYOUT
/begin COMPU_METHOD CU_SIMRESSINITSOC_C "Conversion method for SimRessInitSoc_C" RAT_FUNC "%10.0" "%" COEFFS 0.000000 1.000000 -0.000000 0.000000 0.000000 1.000000 /end COMPU_METHOD
/end MODULE
/end PROJECT
