ASAP2_VERSION 1 31
/begin PROJECT LaForge_CCU_TestApp "Test Application for LaForge TC367"
/begin HEADER "Dana" VERSION "0_3_1" /end HEADER
/begin MODULE OpenECU_TC367_001 ""
/* Scalar calibration for DDE 'A2_vproxim_FltMax_C'. */
/begin CHARACTERISTIC A2_vproxim_FltMax_C "A2 Proximity Max Fault Limit Cal" VALUE 0xa0108684 RL_A2_VPROXIM_FLTMAX_C 40.000000 CU_A2_VPROXIM_FLTMAX_C 0.000000 40.000000 BYTE_ORDER MSB_LAST /end CHARACTERISTIC
/begin RECORD_LAYOUT RL_A2_VPROXIM_FLTMAX_C FNC_VALUES 1 FLOAT32_IEEE COLUMN_DIR DIRECT /end RECORD_LAYOUT
/begin COMPU_METHOD CU_A2_VPROXIM_FLTMAX_C "Conversion method for A2_vproxim_FltMax_C" RAT_FUNC "%10.3" "V" COEFFS 0.000000 1.000000 -0.000000 0.000000 0.000000 1.000000 /end COMPU_METHOD
/* Scalar calibration for DDE 'A2_vproxim_FltMin_C'. */
/begin CHARACTERISTIC A2_vproxim_FltMin_C "A2 Proximity Min Fault Limit Cal" VALUE 0xa0108680 RL_A2_VPROXIM_FLTMIN_C 40.000000 CU_A2_VPROXIM_FLTMIN_C 0.000000 40.000000 BYTE_ORDER MSB_LAST /end CHARACTERISTIC
/begin RECORD_LAYOUT RL_A2_VPROXIM_FLTMIN_C FNC_VALUES 1 FLOAT32_IEEE COLUMN_DIR DIRECT /end RECORD_LAYOUT
/begin COMPU_METHOD CU_A2_VPROXIM_FLTMIN_C "Conversion method for A2_vproxim_FltMin_C" RAT_FUNC "%10.3" "V" COEFFS 0.000000 1.000000 -0.000000 0.000000 0.000000 1.000000 /end COMPU_METHOD
/* Scalar calibration for DDE 'A2_vproxim_ScaleFactor_C'. */
/begin CHARACTERISTIC A2_vproxim_ScaleFactor_C "A2 Proximity Scale value (raw divided by this value to get pin voltage)" VALUE 0xa010867c RL_A2_VPROXIM_SCALEFACTOR_C 39.999000 CU_A2_VPROXIM_SCALEFACTOR_C 0.001000 40.000000 BYTE_ORDER MSB_LAST /end CHARACTERISTIC
/begin RECORD_LAYOUT RL_A2_VPROXIM_SCALEFACTOR_C FNC_VALUES 1 FLOAT32_IEEE COLUMN_DIR DIRECT /end RECORD_LAYOUT
/begin COMPU_METHOD CU_A2_VPROXIM_SCALEFACTOR_C "Conversion method for A2_vproxim_ScaleFactor_C" RAT_FUNC "%10.3" "(not defined)" COEFFS 0.000000 1.000000 -0.000000 0.000000 0.000000 1.000000 /end COMPU_METHOD
/* Scalar calibration for DDE 'A3_vpilot_FltMax_C'. */
/begin CHARACTERISTIC A3_vpilot_FltMax_C "A3 Pilot Max Fault Limit Cal" VALUE 0xa0108678 RL_A3_VPILOT_FLTMAX_C 40.000000 CU_A3_VPILOT_FLTMAX_C 0.000000 40.000000 BYTE_ORDER MSB_LAST /end CHARACTERISTIC
/begin RECORD_LAYOUT RL_A3_VPILOT_FLTMAX_C FNC_VALUES 1 FLOAT32_IEEE COLUMN_DIR DIRECT /end RECORD_LAYOUT
/begin COMPU_METHOD CU_A3_VPILOT_FLTMAX_C "Conversion method for A3_vpilot_FltMax_C" RAT_FUNC "%10.3" "V" COEFFS 0.000000 1.000000 -0.000000 0.000000 0.000000 1.000000 /end COMPU_METHOD
/* Scalar calibration for DDE 'A3_vpilot_FltMin_C'. */
/begin CHARACTERISTIC A3_vpilot_FltMin_C "A3 Pilot Min Fault Limit Cal" VALUE 0xa0108674 RL_A3_VPILOT_FLTMIN_C 40.000000 CU_A3_VPILOT_FLTMIN_C 0.000000 40.000000 BYTE_ORDER MSB_LAST /end CHARACTERISTIC
/begin RECORD_LAYOUT RL_A3_VPILOT_FLTMIN_C FNC_VALUES 1 FLOAT32_IEEE COLUMN_DIR DIRECT /end RECORD_LAYOUT
/begin COMPU_METHOD CU_A3_VPILOT_FLTMIN_C "Conversion method for A3_vpilot_FltMin_C" RAT_FUNC "%10.3" "V" COEFFS 0.000000 1.000000 -0.000000 0.000000 0.000000 1.000000 /end COMPU_METHOD
/* Scalar calibration for DDE 'A3_vpilot_Offset_C'. */
/begin CHARACTERISTIC A3_vpilot_Offset_C "A3 Pilot offset value (raw value is subtracted by this value to get pin voltage)" VALUE 0xa0108670 RL_A3_VPILOT_OFFSET_C 40.000000 CU_A3_VPILOT_OFFSET_C 0.000000 40.000000 BYTE_ORDER MSB_LAST /end CHARACTERISTIC
/begin RECORD_LAYOUT RL_A3_VPILOT_OFFSET_C FNC_VALUES 1 FLOAT32_IEEE COLUMN_DIR DIRECT /end RECORD_LAYOUT
/begin COMPU_METHOD CU_A3_VPILOT_OFFSET_C "Conversion method for A3_vpilot_Offset_C" RAT_FUNC "%10.3" "(not defined)" COEFFS 0.000000 1.000000 -0.000000 0.000000 0.000000 1.000000 /end COMPU_METHOD
/* Scalar calibration for DDE 'A3_vpilot_ScaleFactor_C'. */
/begin CHARACTERISTIC A3_vpilot_ScaleFactor_C "A3 Pilot Scale value (raw divided by this value to get pin voltage)" VALUE 0xa010866c RL_A3_VPILOT_SCALEFACTOR_C 39.999000 CU_A3_VPILOT_SCALEFACTOR_C 0.001000 40.000000 BYTE_ORDER MSB_LAST /end CHARACTERISTIC
/begin RECORD_LAYOUT RL_A3_VPILOT_SCALEFACTOR_C FNC_VALUES 1 FLOAT32_IEEE COLUMN_DIR DIRECT /end RECORD_LAYOUT
/begin COMPU_METHOD CU_A3_VPILOT_SCALEFACTOR_C "Conversion method for A3_vpilot_ScaleFactor_C" RAT_FUNC "%10.4" "(not defined)" COEFFS 0.000000 1.000000 -0.000000 0.000000 0.000000 1.000000 /end COMPU_METHOD
/* Scalar calibration for DDE 'A3_vpilpeak_FltMax_C'. */
/begin CHARACTERISTIC A3_vpilpeak_FltMax_C "A3 Pilot Peak Max Fault Limit Cal" VALUE 0xa0108668 RL_A3_VPILPEAK_FLTMAX_C 40.000000 CU_A3_VPILPEAK_FLTMAX_C 0.000000 40.000000 BYTE_ORDER MSB_LAST /end CHARACTERISTIC
/begin RECORD_LAYOUT RL_A3_VPILPEAK_FLTMAX_C FNC_VALUES 1 FLOAT32_IEEE COLUMN_DIR DIRECT /end RECORD_LAYOUT
/begin COMPU_METHOD CU_A3_VPILPEAK_FLTMAX_C "Conversion method for A3_vpilpeak_FltMax_C" RAT_FUNC "%10.3" "V" COEFFS 0.000000 1.000000 -0.000000 0.000000 0.000000 1.000000 /end COMPU_METHOD
/* Scalar calibration for DDE 'A3_vpilpeak_FltMin_C'. */
/begin CHARACTERISTIC A3_vpilpeak_FltMin_C "A3 Pilot Peak Min Fault Limit Cal" VALUE 0xa0108664 RL_A3_VPILPEAK_FLTMIN_C 40.000000 CU_A3_VPILPEAK_FLTMIN_C 0.000000 40.000000 BYTE_ORDER MSB_LAST /end CHARACTERISTIC
/begin RECORD_LAYOUT RL_A3_VPILPEAK_FLTMIN_C FNC_VALUES 1 FLOAT32_IEEE COLUMN_DIR DIRECT /end RECORD_LAYOUT
/begin COMPU_METHOD CU_A3_VPILPEAK_FLTMIN_C "Conversion method for A3_vpilpeak_FltMin_C" RAT_FUNC "%10.3" "V" COEFFS 0.000000 1.000000 -0.000000 0.000000 0.000000 1.000000 /end COMPU_METHOD
/* Scalar calibration for DDE 'A3_vpilpeak_Offset_C'. */
/begin CHARACTERISTIC A3_vpilpeak_Offset_C "A3 Pilot Peak offset value (raw value is subtracted by this value to get pin voltage)" VALUE 0xa0108660 RL_A3_VPILPEAK_OFFSET_C 40.000000 CU_A3_VPILPEAK_OFFSET_C 0.000000 40.000000 BYTE_ORDER MSB_LAST /end CHARACTERISTIC
/begin RECORD_LAYOUT RL_A3_VPILPEAK_OFFSET_C FNC_VALUES 1 FLOAT32_IEEE COLUMN_DIR DIRECT /end RECORD_LAYOUT
/begin COMPU_METHOD CU_A3_VPILPEAK_OFFSET_C "Conversion method for A3_vpilpeak_Offset_C" RAT_FUNC "%10.3" "(not defined)" COEFFS 0.000000 1.000000 -0.000000 0.000000 0.000000 1.000000 /end COMPU_METHOD
/* Scalar calibration for DDE 'A3_vpilpeak_ScaleFactor_C'. */
/begin CHARACTERISTIC A3_vpilpeak_ScaleFactor_C "A3 Pilot Peak Scale value (raw divided by this value to get pin voltage)" VALUE 0xa010865c RL_A3_VPILPEAK_SCALEFACTOR_C 39.999000 CU_A3_VPILPEAK_SCALEFACTOR_C 0.001000 40.000000 BYTE_ORDER MSB_LAST /end CHARACTERISTIC
/begin RECORD_LAYOUT RL_A3_VPILPEAK_SCALEFACTOR_C FNC_VALUES 1 FLOAT32_IEEE COLUMN_DIR DIRECT /end RECORD_LAYOUT
/begin COMPU_METHOD CU_A3_VPILPEAK_SCALEFACTOR_C "Conversion method for A3_vpilpeak_ScaleFactor_C" RAT_FUNC "%10.4" "(not defined)" COEFFS 0.000000 1.000000 -0.000000 0.000000 0.000000 1.000000 /end COMPU_METHOD
/* Scalar calibration for DDE 'B4_vtempc_FltMax_C'. */
/begin CHARACTERISTIC B4_vtempc_FltMax_C "B4 Max Fault Limit Cal" VALUE 0xa0108658 RL_B4_VTEMPC_FLTMAX_C 40.000000 CU_B4_VTEMPC_FLTMAX_C 0.000000 40.000000 BYTE_ORDER MSB_LAST /end CHARACTERISTIC
/begin RECORD_LAYOUT RL_B4_VTEMPC_FLTMAX_C FNC_VALUES 1 FLOAT32_IEEE COLUMN_DIR DIRECT /end RECORD_LAYOUT
/begin COMPU_METHOD CU_B4_VTEMPC_FLTMAX_C "Conversion method for B4_vtempc_FltMax_C" RAT_FUNC "%10.3" "V" COEFFS 0.000000 1.000000 -0.000000 0.000000 0.000000 1.000000 /end COMPU_METHOD
/* Scalar calibration for DDE 'B4_vtempc_FltMin_C'. */
/begin CHARACTERISTIC B4_vtempc_FltMin_C "B4 Min Fault Limit Cal" VALUE 0xa0108654 RL_B4_VTEMPC_FLTMIN_C 40.000000 CU_B4_VTEMPC_FLTMIN_C 0.000000 40.000000 BYTE_ORDER MSB_LAST /end CHARACTERISTIC
/begin RECORD_LAYOUT RL_B4_VTEMPC_FLTMIN_C FNC_VALUES 1 FLOAT32_IEEE COLUMN_DIR DIRECT /end RECORD_LAYOUT
/begin COMPU_METHOD CU_B4_VTEMPC_FLTMIN_C "Conversion method for B4_vtempc_FltMin_C" RAT_FUNC "%10.3" "V" COEFFS 0.000000 1.000000 -0.000000 0.000000 0.000000 1.000000 /end COMPU_METHOD
/* Scalar calibration for DDE 'C2_vtempd_FltMax_C'. */
/begin CHARACTERISTIC C2_vtempd_FltMax_C "C2 Max Fault Limit Cal" VALUE 0xa0108650 RL_C2_VTEMPD_FLTMAX_C 40.000000 CU_C2_VTEMPD_FLTMAX_C 0.000000 40.000000 BYTE_ORDER MSB_LAST /end CHARACTERISTIC
/begin RECORD_LAYOUT RL_C2_VTEMPD_FLTMAX_C FNC_VALUES 1 FLOAT32_IEEE COLUMN_DIR DIRECT /end RECORD_LAYOUT
/begin COMPU_METHOD CU_C2_VTEMPD_FLTMAX_C "Conversion method for C2_vtempd_FltMax_C" RAT_FUNC "%10.3" "V" COEFFS 0.000000 1.000000 -0.000000 0.000000 0.000000 1.000000 /end COMPU_METHOD
/* Scalar calibration for DDE 'C2_vtempd_FltMin_C'. */
/begin CHARACTERISTIC C2_vtempd_FltMin_C "C2 Min Fault Limit Cal" VALUE 0xa010864c RL_C2_VTEMPD_FLTMIN_C 40.000000 CU_C2_VTEMPD_FLTMIN_C 0.000000 40.000000 BYTE_ORDER MSB_LAST /end CHARACTERISTIC
/begin RECORD_LAYOUT RL_C2_VTEMPD_FLTMIN_C FNC_VALUES 1 FLOAT32_IEEE COLUMN_DIR DIRECT /end RECORD_LAYOUT
/begin COMPU_METHOD CU_C2_VTEMPD_FLTMIN_C "Conversion method for C2_vtempd_FltMin_C" RAT_FUNC "%10.3" "V" COEFFS 0.000000 1.000000 -0.000000 0.000000 0.000000 1.000000 /end COMPU_METHOD
/* Vector/array calibration for DDE 'CANFDData_C'. */
/begin CHARACTERISTIC CANFDData_C "(not defined)" VAL_BLK 0xa0108641 RL_CANFDDATA_C 255.000000 CU_CANFDDATA_C 0.000000 255.000000 NUMBER 8 BYTE_ORDER MSB_LAST /end CHARACTERISTIC
/begin RECORD_LAYOUT RL_CANFDDATA_C FNC_VALUES 1 UBYTE COLUMN_DIR DIRECT /end RECORD_LAYOUT
/begin COMPU_METHOD CU_CANFDDATA_C "Conversion method for CANFDData_C" RAT_FUNC "%10.0" "(not defined)" COEFFS 0.000000 1.000000 -0.000000 0.000000 0.000000 1.000000 /end COMPU_METHOD
/* Scalar calibration for DDE 'CANFDData_override_C'. */
/begin CHARACTERISTIC CANFDData_override_C "(not defined)" VALUE 0xa0108640 RL_CANFDDATA_OVERRIDE_C 255.000000 CU_CANFDDATA_OVERRIDE_C 0.000000 255.000000 BYTE_ORDER MSB_LAST /end CHARACTERISTIC
/begin RECORD_LAYOUT RL_CANFDDATA_OVERRIDE_C FNC_VALUES 1 UBYTE COLUMN_DIR DIRECT /end RECORD_LAYOUT
/begin COMPU_METHOD CU_CANFDDATA_OVERRIDE_C "Conversion method for CANFDData_override_C" RAT_FUNC "%10.0" "(not defined)" COEFFS 0.000000 1.000000 -0.000000 0.000000 0.000000 1.000000 /end COMPU_METHOD
/* Scalar calibration for DDE 'CANFDIncrement_C'. */
/begin CHARACTERISTIC CANFDIncrement_C "(not defined)" VALUE 0xa010863c RL_CANFDINCREMENT_C 4294967295.000000 CU_CANFDINCREMENT_C 0.000000 4294967295.000000 BYTE_ORDER MSB_LAST /end CHARACTERISTIC
/begin RECORD_LAYOUT RL_CANFDINCREMENT_C FNC_VALUES 1 ULONG COLUMN_DIR DIRECT /end RECORD_LAYOUT
/begin COMPU_METHOD CU_CANFDINCREMENT_C "Conversion method for CANFDIncrement_C" RAT_FUNC "%10.0" "(not defined)" COEFFS 0.000000 1.000000 -0.000000 0.000000 0.000000 1.000000 /end COMPU_METHOD
/* Scalar calibration for DDE 'CANFDInitCount_C'. */
/begin CHARACTERISTIC CANFDInitCount_C "(not defined)" VALUE 0xa0108638 RL_CANFDINITCOUNT_C 4294967295.000000 CU_CANFDINITCOUNT_C 0.000000 4294967295.000000 BYTE_ORDER MSB_LAST /end CHARACTERISTIC
/begin RECORD_LAYOUT RL_CANFDINITCOUNT_C FNC_VALUES 1 ULONG COLUMN_DIR DIRECT /end RECORD_LAYOUT
/begin COMPU_METHOD CU_CANFDINITCOUNT_C "Conversion method for CANFDInitCount_C" RAT_FUNC "%10.0" "(not defined)" COEFFS 0.000000 1.000000 -0.000000 0.000000 0.000000 1.000000 /end COMPU_METHOD
/* Scalar calibration for DDE 'CANFDResetCounter_C'. */
/begin CHARACTERISTIC CANFDResetCounter_C "(not defined)" VALUE 0xa0108636 RL_CANFDRESETCOUNTER_C 255.000000 CU_CANFDRESETCOUNTER_C 0.000000 255.000000 BYTE_ORDER MSB_LAST /end CHARACTERISTIC
/begin RECORD_LAYOUT RL_CANFDRESETCOUNTER_C FNC_VALUES 1 UBYTE COLUMN_DIR DIRECT /end RECORD_LAYOUT
/begin COMPU_METHOD CU_CANFDRESETCOUNTER_C "Conversion method for CANFDResetCounter_C" RAT_FUNC "%10.0" "(not defined)" COEFFS 0.000000 1.000000 -0.000000 0.000000 0.000000 1.000000 /end COMPU_METHOD
/* Scalar calibration for DDE 'CANFDTrig_C'. */
/begin CHARACTERISTIC CANFDTrig_C "(not defined)" VALUE 0xa0108635 RL_CANFDTRIG_C 255.000000 CU_CANFDTRIG_C 0.000000 255.000000 BYTE_ORDER MSB_LAST /end CHARACTERISTIC
/begin RECORD_LAYOUT RL_CANFDTRIG_C FNC_VALUES 1 UBYTE COLUMN_DIR DIRECT /end RECORD_LAYOUT
/begin COMPU_METHOD CU_CANFDTRIG_C "Conversion method for CANFDTrig_C" RAT_FUNC "%10.0" "(not defined)" COEFFS 0.000000 1.000000 -0.000000 0.000000 0.000000 1.000000 /end COMPU_METHOD
/* Scalar calibration for DDE 'CANFDTrig_override_C'. */
/begin CHARACTERISTIC CANFDTrig_override_C "(not defined)" VALUE 0xa0108634 RL_CANFDTRIG_OVERRIDE_C 255.000000 CU_CANFDTRIG_OVERRIDE_C 0.000000 255.000000 BYTE_ORDER MSB_LAST /end CHARACTERISTIC
/begin RECORD_LAYOUT RL_CANFDTRIG_OVERRIDE_C FNC_VALUES 1 UBYTE COLUMN_DIR DIRECT /end RECORD_LAYOUT
/begin COMPU_METHOD CU_CANFDTRIG_OVERRIDE_C "Conversion method for CANFDTrig_override_C" RAT_FUNC "%10.0" "(not defined)" COEFFS 0.000000 1.000000 -0.000000 0.000000 0.000000 1.000000 /end COMPU_METHOD
/* Scalar calibration for DDE 'CANFDTxTimeoutDur_C'. */
/begin CHARACTERISTIC CANFDTxTimeoutDur_C "Timeout duration" VALUE 0xa0108630 RL_CANFDTXTIMEOUTDUR_C 10.000000 CU_CANFDTXTIMEOUTDUR_C 0.000000 10.000000 BYTE_ORDER MSB_LAST /end CHARACTERISTIC
/begin RECORD_LAYOUT RL_CANFDTXTIMEOUTDUR_C FNC_VALUES 1 FLOAT32_IEEE COLUMN_DIR DIRECT /end RECORD_LAYOUT
/begin COMPU_METHOD CU_CANFDTXTIMEOUTDUR_C "Conversion method for CANFDTxTimeoutDur_C" RAT_FUNC "%10.3" "s" COEFFS 0.000000 1.000000 -0.000000 0.000000 0.000000 1.000000 /end COMPU_METHOD
/* Scalar calibration for DDE 'CANLoad10_C'. */
/begin CHARACTERISTIC CANLoad10_C "(not defined)" VALUE 0xa010862f RL_CANLOAD10_C 1.000000 CU_CANLOAD10_C 0.000000 1.000000 BYTE_ORDER MSB_LAST /end CHARACTERISTIC
/begin RECORD_LAYOUT RL_CANLOAD10_C FNC_VALUES 1 UBYTE COLUMN_DIR DIRECT /end RECORD_LAYOUT
/begin COMPU_METHOD CU_CANLOAD10_C "Conversion method for CANLoad10_C" RAT_FUNC "%10.0" "b" COEFFS 0.000000 1.000000 -0.000000 0.000000 0.000000 1.000000 /end COMPU_METHOD
/* Scalar calibration for DDE 'CANLoad11_C'. */
/begin CHARACTERISTIC CANLoad11_C "(not defined)" VALUE 0xa010862e RL_CANLOAD11_C 1.000000 CU_CANLOAD11_C 0.000000 1.000000 BYTE_ORDER MSB_LAST /end CHARACTERISTIC
/begin RECORD_LAYOUT RL_CANLOAD11_C FNC_VALUES 1 UBYTE COLUMN_DIR DIRECT /end RECORD_LAYOUT
/begin COMPU_METHOD CU_CANLOAD11_C "Conversion method for CANLoad11_C" RAT_FUNC "%10.0" "b" COEFFS 0.000000 1.000000 -0.000000 0.000000 0.000000 1.000000 /end COMPU_METHOD
/* Scalar calibration for DDE 'CANLoad12_C'. */
/begin CHARACTERISTIC CANLoad12_C "(not defined)" VALUE 0xa010862d RL_CANLOAD12_C 1.000000 CU_CANLOAD12_C 0.000000 1.000000 BYTE_ORDER MSB_LAST /end CHARACTERISTIC
/begin RECORD_LAYOUT RL_CANLOAD12_C FNC_VALUES 1 UBYTE COLUMN_DIR DIRECT /end RECORD_LAYOUT
/begin COMPU_METHOD CU_CANLOAD12_C "Conversion method for CANLoad12_C" RAT_FUNC "%10.0" "b" COEFFS 0.000000 1.000000 -0.000000 0.000000 0.000000 1.000000 /end COMPU_METHOD
/* Scalar calibration for DDE 'CANLoad13_C'. */
/begin CHARACTERISTIC CANLoad13_C "(not defined)" VALUE 0xa010862c RL_CANLOAD13_C 1.000000 CU_CANLOAD13_C 0.000000 1.000000 BYTE_ORDER MSB_LAST /end CHARACTERISTIC
/begin RECORD_LAYOUT RL_CANLOAD13_C FNC_VALUES 1 UBYTE COLUMN_DIR DIRECT /end RECORD_LAYOUT
/begin COMPU_METHOD CU_CANLOAD13_C "Conversion method for CANLoad13_C" RAT_FUNC "%10.0" "b" COEFFS 0.000000 1.000000 -0.000000 0.000000 0.000000 1.000000 /end COMPU_METHOD
/* Scalar calibration for DDE 'CANLoad14_C'. */
/begin CHARACTERISTIC CANLoad14_C "(not defined)" VALUE 0xa010862b RL_CANLOAD14_C 1.000000 CU_CANLOAD14_C 0.000000 1.000000 BYTE_ORDER MSB_LAST /end CHARACTERISTIC
/begin RECORD_LAYOUT RL_CANLOAD14_C FNC_VALUES 1 UBYTE COLUMN_DIR DIRECT /end RECORD_LAYOUT
/begin COMPU_METHOD CU_CANLOAD14_C "Conversion method for CANLoad14_C" RAT_FUNC "%10.0" "b" COEFFS 0.000000 1.000000 -0.000000 0.000000 0.000000 1.000000 /end COMPU_METHOD
/* Scalar calibration for DDE 'CANLoad15_C'. */
/begin CHARACTERISTIC CANLoad15_C "(not defined)" VALUE 0xa010862a RL_CANLOAD15_C 1.000000 CU_CANLOAD15_C 0.000000 1.000000 BYTE_ORDER MSB_LAST /end CHARACTERISTIC
/begin RECORD_LAYOUT RL_CANLOAD15_C FNC_VALUES 1 UBYTE COLUMN_DIR DIRECT /end RECORD_LAYOUT
/begin COMPU_METHOD CU_CANLOAD15_C "Conversion method for CANLoad15_C" RAT_FUNC "%10.0" "b" COEFFS 0.000000 1.000000 -0.000000 0.000000 0.000000 1.000000 /end COMPU_METHOD
/* Scalar calibration for DDE 'CANLoad16_C'. */
/begin CHARACTERISTIC CANLoad16_C "(not defined)" VALUE 0xa0108629 RL_CANLOAD16_C 1.000000 CU_CANLOAD16_C 0.000000 1.000000 BYTE_ORDER MSB_LAST /end CHARACTERISTIC
/begin RECORD_LAYOUT RL_CANLOAD16_C FNC_VALUES 1 UBYTE COLUMN_DIR DIRECT /end RECORD_LAYOUT
/begin COMPU_METHOD CU_CANLOAD16_C "Conversion method for CANLoad16_C" RAT_FUNC "%10.0" "b" COEFFS 0.000000 1.000000 -0.000000 0.000000 0.000000 1.000000 /end COMPU_METHOD
/* Scalar calibration for DDE 'CANLoad17_C'. */
/begin CHARACTERISTIC CANLoad17_C "(not defined)" VALUE 0xa0108628 RL_CANLOAD17_C 1.000000 CU_CANLOAD17_C 0.000000 1.000000 BYTE_ORDER MSB_LAST /end CHARACTERISTIC
/begin RECORD_LAYOUT RL_CANLOAD17_C FNC_VALUES 1 UBYTE COLUMN_DIR DIRECT /end RECORD_LAYOUT
/begin COMPU_METHOD CU_CANLOAD17_C "Conversion method for CANLoad17_C" RAT_FUNC "%10.0" "b" COEFFS 0.000000 1.000000 -0.000000 0.000000 0.000000 1.000000 /end COMPU_METHOD
/* Scalar calibration for DDE 'CANLoad18_C'. */
/begin CHARACTERISTIC CANLoad18_C "(not defined)" VALUE 0xa0108627 RL_CANLOAD18_C 1.000000 CU_CANLOAD18_C 0.000000 1.000000 BYTE_ORDER MSB_LAST /end CHARACTERISTIC
/begin RECORD_LAYOUT RL_CANLOAD18_C FNC_VALUES 1 UBYTE COLUMN_DIR DIRECT /end RECORD_LAYOUT
/begin COMPU_METHOD CU_CANLOAD18_C "Conversion method for CANLoad18_C" RAT_FUNC "%10.0" "b" COEFFS 0.000000 1.000000 -0.000000 0.000000 0.000000 1.000000 /end COMPU_METHOD
/* Scalar calibration for DDE 'CANLoad19_C'. */
/begin CHARACTERISTIC CANLoad19_C "(not defined)" VALUE 0xa0108626 RL_CANLOAD19_C 1.000000 CU_CANLOAD19_C 0.000000 1.000000 BYTE_ORDER MSB_LAST /end CHARACTERISTIC
/begin RECORD_LAYOUT RL_CANLOAD19_C FNC_VALUES 1 UBYTE COLUMN_DIR DIRECT /end RECORD_LAYOUT
/begin COMPU_METHOD CU_CANLOAD19_C "Conversion method for CANLoad19_C" RAT_FUNC "%10.0" "b" COEFFS 0.000000 1.000000 -0.000000 0.000000 0.000000 1.000000 /end COMPU_METHOD
/* Scalar calibration for DDE 'CANLoad1_C'. */
/begin CHARACTERISTIC CANLoad1_C "(not defined)" VALUE 0xa0108625 RL_CANLOAD1_C 1.000000 CU_CANLOAD1_C 0.000000 1.000000 BYTE_ORDER MSB_LAST /end CHARACTERISTIC
/begin RECORD_LAYOUT RL_CANLOAD1_C FNC_VALUES 1 UBYTE COLUMN_DIR DIRECT /end RECORD_LAYOUT
/begin COMPU_METHOD CU_CANLOAD1_C "Conversion method for CANLoad1_C" RAT_FUNC "%10.0" "b" COEFFS 0.000000 1.000000 -0.000000 0.000000 0.000000 1.000000 /end COMPU_METHOD
/* Scalar calibration for DDE 'CANLoad20_C'. */
/begin CHARACTERISTIC CANLoad20_C "(not defined)" VALUE 0xa0108624 RL_CANLOAD20_C 1.000000 CU_CANLOAD20_C 0.000000 1.000000 BYTE_ORDER MSB_LAST /end CHARACTERISTIC
/begin RECORD_LAYOUT RL_CANLOAD20_C FNC_VALUES 1 UBYTE COLUMN_DIR DIRECT /end RECORD_LAYOUT
/begin COMPU_METHOD CU_CANLOAD20_C "Conversion method for CANLoad20_C" RAT_FUNC "%10.0" "b" COEFFS 0.000000 1.000000 -0.000000 0.000000 0.000000 1.000000 /end COMPU_METHOD
/* Scalar calibration for DDE 'CANLoad21_C'. */
/begin CHARACTERISTIC CANLoad21_C "(not defined)" VALUE 0xa0108623 RL_CANLOAD21_C 1.000000 CU_CANLOAD21_C 0.000000 1.000000 BYTE_ORDER MSB_LAST /end CHARACTERISTIC
/begin RECORD_LAYOUT RL_CANLOAD21_C FNC_VALUES 1 UBYTE COLUMN_DIR DIRECT /end RECORD_LAYOUT
/begin COMPU_METHOD CU_CANLOAD21_C "Conversion method for CANLoad21_C" RAT_FUNC "%10.0" "b" COEFFS 0.000000 1.000000 -0.000000 0.000000 0.000000 1.000000 /end COMPU_METHOD
/* Scalar calibration for DDE 'CANLoad22_C'. */
/begin CHARACTERISTIC CANLoad22_C "(not defined)" VALUE 0xa0108622 RL_CANLOAD22_C 1.000000 CU_CANLOAD22_C 0.000000 1.000000 BYTE_ORDER MSB_LAST /end CHARACTERISTIC
/begin RECORD_LAYOUT RL_CANLOAD22_C FNC_VALUES 1 UBYTE COLUMN_DIR DIRECT /end RECORD_LAYOUT
/begin COMPU_METHOD CU_CANLOAD22_C "Conversion method for CANLoad22_C" RAT_FUNC "%10.0" "b" COEFFS 0.000000 1.000000 -0.000000 0.000000 0.000000 1.000000 /end COMPU_METHOD
/* Scalar calibration for DDE 'CANLoad23_C'. */
/begin CHARACTERISTIC CANLoad23_C "(not defined)" VALUE 0xa0108621 RL_CANLOAD23_C 1.000000 CU_CANLOAD23_C 0.000000 1.000000 BYTE_ORDER MSB_LAST /end CHARACTERISTIC
/begin RECORD_LAYOUT RL_CANLOAD23_C FNC_VALUES 1 UBYTE COLUMN_DIR DIRECT /end RECORD_LAYOUT
/begin COMPU_METHOD CU_CANLOAD23_C "Conversion method for CANLoad23_C" RAT_FUNC "%10.0" "b" COEFFS 0.000000 1.000000 -0.000000 0.000000 0.000000 1.000000 /end COMPU_METHOD
/* Scalar calibration for DDE 'CANLoad24_C'. */
/begin CHARACTERISTIC CANLoad24_C "(not defined)" VALUE 0xa0108620 RL_CANLOAD24_C 1.000000 CU_CANLOAD24_C 0.000000 1.000000 BYTE_ORDER MSB_LAST /end CHARACTERISTIC
/begin RECORD_LAYOUT RL_CANLOAD24_C FNC_VALUES 1 UBYTE COLUMN_DIR DIRECT /end RECORD_LAYOUT
/begin COMPU_METHOD CU_CANLOAD24_C "Conversion method for CANLoad24_C" RAT_FUNC "%10.0" "b" COEFFS 0.000000 1.000000 -0.000000 0.000000 0.000000 1.000000 /end COMPU_METHOD
/* Scalar calibration for DDE 'CANLoad25_C'. */
/begin CHARACTERISTIC CANLoad25_C "(not defined)" VALUE 0xa010861f RL_CANLOAD25_C 1.000000 CU_CANLOAD25_C 0.000000 1.000000 BYTE_ORDER MSB_LAST /end CHARACTERISTIC
/begin RECORD_LAYOUT RL_CANLOAD25_C FNC_VALUES 1 UBYTE COLUMN_DIR DIRECT /end RECORD_LAYOUT
/begin COMPU_METHOD CU_CANLOAD25_C "Conversion method for CANLoad25_C" RAT_FUNC "%10.0" "b" COEFFS 0.000000 1.000000 -0.000000 0.000000 0.000000 1.000000 /end COMPU_METHOD
/* Scalar calibration for DDE 'CANLoad26_C'. */
/begin CHARACTERISTIC CANLoad26_C "(not defined)" VALUE 0xa010861e RL_CANLOAD26_C 1.000000 CU_CANLOAD26_C 0.000000 1.000000 BYTE_ORDER MSB_LAST /end CHARACTERISTIC
/begin RECORD_LAYOUT RL_CANLOAD26_C FNC_VALUES 1 UBYTE COLUMN_DIR DIRECT /end RECORD_LAYOUT
/begin COMPU_METHOD CU_CANLOAD26_C "Conversion method for CANLoad26_C" RAT_FUNC "%10.0" "b" COEFFS 0.000000 1.000000 -0.000000 0.000000 0.000000 1.000000 /end COMPU_METHOD
/* Scalar calibration for DDE 'CANLoad27_C'. */
/begin CHARACTERISTIC CANLoad27_C "(not defined)" VALUE 0xa010861d RL_CANLOAD27_C 1.000000 CU_CANLOAD27_C 0.000000 1.000000 BYTE_ORDER MSB_LAST /end CHARACTERISTIC
/begin RECORD_LAYOUT RL_CANLOAD27_C FNC_VALUES 1 UBYTE COLUMN_DIR DIRECT /end RECORD_LAYOUT
/begin COMPU_METHOD CU_CANLOAD27_C "Conversion method for CANLoad27_C" RAT_FUNC "%10.0" "b" COEFFS 0.000000 1.000000 -0.000000 0.000000 0.000000 1.000000 /end COMPU_METHOD
/* Scalar calibration for DDE 'CANLoad28_C'. */
/begin CHARACTERISTIC CANLoad28_C "(not defined)" VALUE 0xa010861c RL_CANLOAD28_C 1.000000 CU_CANLOAD28_C 0.000000 1.000000 BYTE_ORDER MSB_LAST /end CHARACTERISTIC
/begin RECORD_LAYOUT RL_CANLOAD28_C FNC_VALUES 1 UBYTE COLUMN_DIR DIRECT /end RECORD_LAYOUT
/begin COMPU_METHOD CU_CANLOAD28_C "Conversion method for CANLoad28_C" RAT_FUNC "%10.0" "b" COEFFS 0.000000 1.000000 -0.000000 0.000000 0.000000 1.000000 /end COMPU_METHOD
/* Scalar calibration for DDE 'CANLoad29_C'. */
/begin CHARACTERISTIC CANLoad29_C "(not defined)" VALUE 0xa010861b RL_CANLOAD29_C 1.000000 CU_CANLOAD29_C 0.000000 1.000000 BYTE_ORDER MSB_LAST /end CHARACTERISTIC
/begin RECORD_LAYOUT RL_CANLOAD29_C FNC_VALUES 1 UBYTE COLUMN_DIR DIRECT /end RECORD_LAYOUT
/begin COMPU_METHOD CU_CANLOAD29_C "Conversion method for CANLoad29_C" RAT_FUNC "%10.0" "b" COEFFS 0.000000 1.000000 -0.000000 0.000000 0.000000 1.000000 /end COMPU_METHOD
/* Scalar calibration for DDE 'CANLoad2_C'. */
/begin CHARACTERISTIC CANLoad2_C "(not defined)" VALUE 0xa010861a RL_CANLOAD2_C 1.000000 CU_CANLOAD2_C 0.000000 1.000000 BYTE_ORDER MSB_LAST /end CHARACTERISTIC
/begin RECORD_LAYOUT RL_CANLOAD2_C FNC_VALUES 1 UBYTE COLUMN_DIR DIRECT /end RECORD_LAYOUT
/begin COMPU_METHOD CU_CANLOAD2_C "Conversion method for CANLoad2_C" RAT_FUNC "%10.0" "b" COEFFS 0.000000 1.000000 -0.000000 0.000000 0.000000 1.000000 /end COMPU_METHOD
/* Scalar calibration for DDE 'CANLoad30_C'. */
/begin CHARACTERISTIC CANLoad30_C "(not defined)" VALUE 0xa0108619 RL_CANLOAD30_C 1.000000 CU_CANLOAD30_C 0.000000 1.000000 BYTE_ORDER MSB_LAST /end CHARACTERISTIC
/begin RECORD_LAYOUT RL_CANLOAD30_C FNC_VALUES 1 UBYTE COLUMN_DIR DIRECT /end RECORD_LAYOUT
/begin COMPU_METHOD CU_CANLOAD30_C "Conversion method for CANLoad30_C" RAT_FUNC "%10.0" "b" COEFFS 0.000000 1.000000 -0.000000 0.000000 0.000000 1.000000 /end COMPU_METHOD
/* Scalar calibration for DDE 'CANLoad31_C'. */
/begin CHARACTERISTIC CANLoad31_C "(not defined)" VALUE 0xa0108618 RL_CANLOAD31_C 1.000000 CU_CANLOAD31_C 0.000000 1.000000 BYTE_ORDER MSB_LAST /end CHARACTERISTIC
/begin RECORD_LAYOUT RL_CANLOAD31_C FNC_VALUES 1 UBYTE COLUMN_DIR DIRECT /end RECORD_LAYOUT
/begin COMPU_METHOD CU_CANLOAD31_C "Conversion method for CANLoad31_C" RAT_FUNC "%10.0" "b" COEFFS 0.000000 1.000000 -0.000000 0.000000 0.000000 1.000000 /end COMPU_METHOD
/* Scalar calibration for DDE 'CANLoad32_C'. */
/begin CHARACTERISTIC CANLoad32_C "(not defined)" VALUE 0xa0108617 RL_CANLOAD32_C 1.000000 CU_CANLOAD32_C 0.000000 1.000000 BYTE_ORDER MSB_LAST /end CHARACTERISTIC
/begin RECORD_LAYOUT RL_CANLOAD32_C FNC_VALUES 1 UBYTE COLUMN_DIR DIRECT /end RECORD_LAYOUT
/begin COMPU_METHOD CU_CANLOAD32_C "Conversion method for CANLoad32_C" RAT_FUNC "%10.0" "b" COEFFS 0.000000 1.000000 -0.000000 0.000000 0.000000 1.000000 /end COMPU_METHOD
/* Scalar calibration for DDE 'CANLoad33_C'. */
/begin CHARACTERISTIC CANLoad33_C "(not defined)" VALUE 0xa0108616 RL_CANLOAD33_C 1.000000 CU_CANLOAD33_C 0.000000 1.000000 BYTE_ORDER MSB_LAST /end CHARACTERISTIC
/begin RECORD_LAYOUT RL_CANLOAD33_C FNC_VALUES 1 UBYTE COLUMN_DIR DIRECT /end RECORD_LAYOUT
/begin COMPU_METHOD CU_CANLOAD33_C "Conversion method for CANLoad33_C" RAT_FUNC "%10.0" "b" COEFFS 0.000000 1.000000 -0.000000 0.000000 0.000000 1.000000 /end COMPU_METHOD
/* Scalar calibration for DDE 'CANLoad34_C'. */
/begin CHARACTERISTIC CANLoad34_C "(not defined)" VALUE 0xa0108615 RL_CANLOAD34_C 1.000000 CU_CANLOAD34_C 0.000000 1.000000 BYTE_ORDER MSB_LAST /end CHARACTERISTIC
/begin RECORD_LAYOUT RL_CANLOAD34_C FNC_VALUES 1 UBYTE COLUMN_DIR DIRECT /end RECORD_LAYOUT
/begin COMPU_METHOD CU_CANLOAD34_C "Conversion method for CANLoad34_C" RAT_FUNC "%10.0" "b" COEFFS 0.000000 1.000000 -0.000000 0.000000 0.000000 1.000000 /end COMPU_METHOD
/* Scalar calibration for DDE 'CANLoad35_C'. */
/begin CHARACTERISTIC CANLoad35_C "(not defined)" VALUE 0xa0108614 RL_CANLOAD35_C 1.000000 CU_CANLOAD35_C 0.000000 1.000000 BYTE_ORDER MSB_LAST /end CHARACTERISTIC
/begin RECORD_LAYOUT RL_CANLOAD35_C FNC_VALUES 1 UBYTE COLUMN_DIR DIRECT /end RECORD_LAYOUT
/begin COMPU_METHOD CU_CANLOAD35_C "Conversion method for CANLoad35_C" RAT_FUNC "%10.0" "b" COEFFS 0.000000 1.000000 -0.000000 0.000000 0.000000 1.000000 /end COMPU_METHOD
/* Scalar calibration for DDE 'CANLoad36_C'. */
/begin CHARACTERISTIC CANLoad36_C "(not defined)" VALUE 0xa0108613 RL_CANLOAD36_C 1.000000 CU_CANLOAD36_C 0.000000 1.000000 BYTE_ORDER MSB_LAST /end CHARACTERISTIC
/begin RECORD_LAYOUT RL_CANLOAD36_C FNC_VALUES 1 UBYTE COLUMN_DIR DIRECT /end RECORD_LAYOUT
/begin COMPU_METHOD CU_CANLOAD36_C "Conversion method for CANLoad36_C" RAT_FUNC "%10.0" "b" COEFFS 0.000000 1.000000 -0.000000 0.000000 0.000000 1.000000 /end COMPU_METHOD
/* Scalar calibration for DDE 'CANLoad37_C'. */
/begin CHARACTERISTIC CANLoad37_C "(not defined)" VALUE 0xa0108612 RL_CANLOAD37_C 1.000000 CU_CANLOAD37_C 0.000000 1.000000 BYTE_ORDER MSB_LAST /end CHARACTERISTIC
/begin RECORD_LAYOUT RL_CANLOAD37_C FNC_VALUES 1 UBYTE COLUMN_DIR DIRECT /end RECORD_LAYOUT
/begin COMPU_METHOD CU_CANLOAD37_C "Conversion method for CANLoad37_C" RAT_FUNC "%10.0" "b" COEFFS 0.000000 1.000000 -0.000000 0.000000 0.000000 1.000000 /end COMPU_METHOD
/* Scalar calibration for DDE 'CANLoad38_C'. */
/begin CHARACTERISTIC CANLoad38_C "(not defined)" VALUE 0xa0108611 RL_CANLOAD38_C 1.000000 CU_CANLOAD38_C 0.000000 1.000000 BYTE_ORDER MSB_LAST /end CHARACTERISTIC
/begin RECORD_LAYOUT RL_CANLOAD38_C FNC_VALUES 1 UBYTE COLUMN_DIR DIRECT /end RECORD_LAYOUT
/begin COMPU_METHOD CU_CANLOAD38_C "Conversion method for CANLoad38_C" RAT_FUNC "%10.0" "b" COEFFS 0.000000 1.000000 -0.000000 0.000000 0.000000 1.000000 /end COMPU_METHOD
/* Scalar calibration for DDE 'CANLoad39_C'. */
/begin CHARACTERISTIC CANLoad39_C "(not defined)" VALUE 0xa0108610 RL_CANLOAD39_C 1.000000 CU_CANLOAD39_C 0.000000 1.000000 BYTE_ORDER MSB_LAST /end CHARACTERISTIC
/begin RECORD_LAYOUT RL_CANLOAD39_C FNC_VALUES 1 UBYTE COLUMN_DIR DIRECT /end RECORD_LAYOUT
/begin COMPU_METHOD CU_CANLOAD39_C "Conversion method for CANLoad39_C" RAT_FUNC "%10.0" "b" COEFFS 0.000000 1.000000 -0.000000 0.000000 0.000000 1.000000 /end COMPU_METHOD
/* Scalar calibration for DDE 'CANLoad3_C'. */
/begin CHARACTERISTIC CANLoad3_C "(not defined)" VALUE 0xa010860f RL_CANLOAD3_C 1.000000 CU_CANLOAD3_C 0.000000 1.000000 BYTE_ORDER MSB_LAST /end CHARACTERISTIC
/begin RECORD_LAYOUT RL_CANLOAD3_C FNC_VALUES 1 UBYTE COLUMN_DIR DIRECT /end RECORD_LAYOUT
/begin COMPU_METHOD CU_CANLOAD3_C "Conversion method for CANLoad3_C" RAT_FUNC "%10.0" "b" COEFFS 0.000000 1.000000 -0.000000 0.000000 0.000000 1.000000 /end COMPU_METHOD
/* Scalar calibration for DDE 'CANLoad40_C'. */
/begin CHARACTERISTIC CANLoad40_C "(not defined)" VALUE 0xa010860e RL_CANLOAD40_C 1.000000 CU_CANLOAD40_C 0.000000 1.000000 BYTE_ORDER MSB_LAST /end CHARACTERISTIC
/begin RECORD_LAYOUT RL_CANLOAD40_C FNC_VALUES 1 UBYTE COLUMN_DIR DIRECT /end RECORD_LAYOUT
/begin COMPU_METHOD CU_CANLOAD40_C "Conversion method for CANLoad40_C" RAT_FUNC "%10.0" "b" COEFFS 0.000000 1.000000 -0.000000 0.000000 0.000000 1.000000 /end COMPU_METHOD
/* Scalar calibration for DDE 'CANLoad41_C'. */
/begin CHARACTERISTIC CANLoad41_C "(not defined)" VALUE 0xa010860d RL_CANLOAD41_C 1.000000 CU_CANLOAD41_C 0.000000 1.000000 BYTE_ORDER MSB_LAST /end CHARACTERISTIC
/begin RECORD_LAYOUT RL_CANLOAD41_C FNC_VALUES 1 UBYTE COLUMN_DIR DIRECT /end RECORD_LAYOUT
/begin COMPU_METHOD CU_CANLOAD41_C "Conversion method for CANLoad41_C" RAT_FUNC "%10.0" "b" COEFFS 0.000000 1.000000 -0.000000 0.000000 0.000000 1.000000 /end COMPU_METHOD
/* Scalar calibration for DDE 'CANLoad42_C'. */
/begin CHARACTERISTIC CANLoad42_C "(not defined)" VALUE 0xa010860c RL_CANLOAD42_C 1.000000 CU_CANLOAD42_C 0.000000 1.000000 BYTE_ORDER MSB_LAST /end CHARACTERISTIC
/begin RECORD_LAYOUT RL_CANLOAD42_C FNC_VALUES 1 UBYTE COLUMN_DIR DIRECT /end RECORD_LAYOUT
/begin COMPU_METHOD CU_CANLOAD42_C "Conversion method for CANLoad42_C" RAT_FUNC "%10.0" "b" COEFFS 0.000000 1.000000 -0.000000 0.000000 0.000000 1.000000 /end COMPU_METHOD
/* Scalar calibration for DDE 'CANLoad43_C'. */
/begin CHARACTERISTIC CANLoad43_C "(not defined)" VALUE 0xa010860b RL_CANLOAD43_C 1.000000 CU_CANLOAD43_C 0.000000 1.000000 BYTE_ORDER MSB_LAST /end CHARACTERISTIC
/begin RECORD_LAYOUT RL_CANLOAD43_C FNC_VALUES 1 UBYTE COLUMN_DIR DIRECT /end RECORD_LAYOUT
/begin COMPU_METHOD CU_CANLOAD43_C "Conversion method for CANLoad43_C" RAT_FUNC "%10.0" "b" COEFFS 0.000000 1.000000 -0.000000 0.000000 0.000000 1.000000 /end COMPU_METHOD
/* Scalar calibration for DDE 'CANLoad44_C'. */
/begin CHARACTERISTIC CANLoad44_C "(not defined)" VALUE 0xa010860a RL_CANLOAD44_C 1.000000 CU_CANLOAD44_C 0.000000 1.000000 BYTE_ORDER MSB_LAST /end CHARACTERISTIC
/begin RECORD_LAYOUT RL_CANLOAD44_C FNC_VALUES 1 UBYTE COLUMN_DIR DIRECT /end RECORD_LAYOUT
/begin COMPU_METHOD CU_CANLOAD44_C "Conversion method for CANLoad44_C" RAT_FUNC "%10.0" "b" COEFFS 0.000000 1.000000 -0.000000 0.000000 0.000000 1.000000 /end COMPU_METHOD
/* Scalar calibration for DDE 'CANLoad4_C'. */
/begin CHARACTERISTIC CANLoad4_C "(not defined)" VALUE 0xa0108609 RL_CANLOAD4_C 1.000000 CU_CANLOAD4_C 0.000000 1.000000 BYTE_ORDER MSB_LAST /end CHARACTERISTIC
/begin RECORD_LAYOUT RL_CANLOAD4_C FNC_VALUES 1 UBYTE COLUMN_DIR DIRECT /end RECORD_LAYOUT
/begin COMPU_METHOD CU_CANLOAD4_C "Conversion method for CANLoad4_C" RAT_FUNC "%10.0" "b" COEFFS 0.000000 1.000000 -0.000000 0.000000 0.000000 1.000000 /end COMPU_METHOD
/* Scalar calibration for DDE 'CANLoad5_C'. */
/begin CHARACTERISTIC CANLoad5_C "(not defined)" VALUE 0xa0108608 RL_CANLOAD5_C 1.000000 CU_CANLOAD5_C 0.000000 1.000000 BYTE_ORDER MSB_LAST /end CHARACTERISTIC
/begin RECORD_LAYOUT RL_CANLOAD5_C FNC_VALUES 1 UBYTE COLUMN_DIR DIRECT /end RECORD_LAYOUT
/begin COMPU_METHOD CU_CANLOAD5_C "Conversion method for CANLoad5_C" RAT_FUNC "%10.0" "b" COEFFS 0.000000 1.000000 -0.000000 0.000000 0.000000 1.000000 /end COMPU_METHOD
/* Scalar calibration for DDE 'CANLoad6_C'. */
/begin CHARACTERISTIC CANLoad6_C "(not defined)" VALUE 0xa0108607 RL_CANLOAD6_C 1.000000 CU_CANLOAD6_C 0.000000 1.000000 BYTE_ORDER MSB_LAST /end CHARACTERISTIC
/begin RECORD_LAYOUT RL_CANLOAD6_C FNC_VALUES 1 UBYTE COLUMN_DIR DIRECT /end RECORD_LAYOUT
/begin COMPU_METHOD CU_CANLOAD6_C "Conversion method for CANLoad6_C" RAT_FUNC "%10.0" "b" COEFFS 0.000000 1.000000 -0.000000 0.000000 0.000000 1.000000 /end COMPU_METHOD
/* Scalar calibration for DDE 'CANLoad7_C'. */
/begin CHARACTERISTIC CANLoad7_C "(not defined)" VALUE 0xa0108606 RL_CANLOAD7_C 1.000000 CU_CANLOAD7_C 0.000000 1.000000 BYTE_ORDER MSB_LAST /end CHARACTERISTIC
/begin RECORD_LAYOUT RL_CANLOAD7_C FNC_VALUES 1 UBYTE COLUMN_DIR DIRECT /end RECORD_LAYOUT
/begin COMPU_METHOD CU_CANLOAD7_C "Conversion method for CANLoad7_C" RAT_FUNC "%10.0" "b" COEFFS 0.000000 1.000000 -0.000000 0.000000 0.000000 1.000000 /end COMPU_METHOD
/* Scalar calibration for DDE 'CANLoad8_C'. */
/begin CHARACTERISTIC CANLoad8_C "(not defined)" VALUE 0xa0108605 RL_CANLOAD8_C 1.000000 CU_CANLOAD8_C 0.000000 1.000000 BYTE_ORDER MSB_LAST /end CHARACTERISTIC
/begin RECORD_LAYOUT RL_CANLOAD8_C FNC_VALUES 1 UBYTE COLUMN_DIR DIRECT /end RECORD_LAYOUT
/begin COMPU_METHOD CU_CANLOAD8_C "Conversion method for CANLoad8_C" RAT_FUNC "%10.0" "b" COEFFS 0.000000 1.000000 -0.000000 0.000000 0.000000 1.000000 /end COMPU_METHOD
/* Scalar calibration for DDE 'CANLoad9_C'. */
/begin CHARACTERISTIC CANLoad9_C "(not defined)" VALUE 0xa0108604 RL_CANLOAD9_C 1.000000 CU_CANLOAD9_C 0.000000 1.000000 BYTE_ORDER MSB_LAST /end CHARACTERISTIC
/begin RECORD_LAYOUT RL_CANLOAD9_C FNC_VALUES 1 UBYTE COLUMN_DIR DIRECT /end RECORD_LAYOUT
/begin COMPU_METHOD CU_CANLOAD9_C "Conversion method for CANLoad9_C" RAT_FUNC "%10.0" "b" COEFFS 0.000000 1.000000 -0.000000 0.000000 0.000000 1.000000 /end COMPU_METHOD
/* Vector/array calibration for DDE 'CANLoadBytes_V'. */
/begin CHARACTERISTIC CANLoadBytes_V "CAN loading message payload" VAL_BLK 0x8013640c RL_CANLOADBYTES_V 255.000000 CU_CANLOADBYTES_V 0.000000 255.000000 NUMBER 8 BYTE_ORDER MSB_LAST /end CHARACTERISTIC
/begin RECORD_LAYOUT RL_CANLOADBYTES_V FNC_VALUES 1 UBYTE COLUMN_DIR DIRECT /end RECORD_LAYOUT
/begin COMPU_METHOD CU_CANLOADBYTES_V "Conversion method for CANLoadBytes_V" RAT_FUNC "%10.0" "(not defined)" COEFFS 0.000000 1.000000 -0.000000 0.000000 0.000000 1.000000 /end COMPU_METHOD
/* Scalar calibration for DDE 'CcsCtlAuthSetupEnable_C'. */
/begin CHARACTERISTIC CcsCtlAuthSetupEnable_C "Enable the alternate control path through AuthorizationSetupReq and AuthorizationReq prior to ServiceDiscoveryReq" VALUE 0x700176e0 RL_CCSCTLAUTHSETUPENABLE_C 1.000000 CU_CCSCTLAUTHSETUPENABLE_C 0.000000 1.000000 BYTE_ORDER MSB_LAST /end CHARACTERISTIC
/begin RECORD_LAYOUT RL_CCSCTLAUTHSETUPENABLE_C FNC_VALUES 1 UBYTE COLUMN_DIR DIRECT /end RECORD_LAYOUT
/begin COMPU_METHOD CU_CCSCTLAUTHSETUPENABLE_C "Conversion method for CcsCtlAuthSetupEnable_C" RAT_FUNC "%10.0" "b" COEFFS 0.000000 1.000000 -0.000000 0.000000 0.000000 1.000000 /end COMPU_METHOD
/* Scalar calibration for DDE 'CcsCtlEcuHoldQcaPwrReqTime_C'. */
/begin CHARACTERISTIC CcsCtlEcuHoldQcaPwrReqTime_C "Hold time for which QCA enable flag is held true (1)" VALUE 0x700173d4 RL_CCSCTLECUHOLDQCAPWRREQTIME_C 30.000000 CU_CCSCTLECUHOLDQCAPWRREQTIME_C 0.000000 30.000000 BYTE_ORDER MSB_LAST /end CHARACTERISTIC
/begin RECORD_LAYOUT RL_CCSCTLECUHOLDQCAPWRREQTIME_C FNC_VALUES 1 FLOAT32_IEEE COLUMN_DIR DIRECT /end RECORD_LAYOUT
/begin COMPU_METHOD CU_CCSCTLECUHOLDQCAPWRREQTIME_C "Conversion method for CcsCtlEcuHoldQcaPwrReqTime_C" RAT_FUNC "%10.0" "s" COEFFS 0.000000 1.000000 -0.000000 0.000000 0.000000 1.000000 /end COMPU_METHOD
/* Scalar calibration for DDE 'CcsCtlEcuHoldQcaPwrReq_C'. */
/begin CHARACTERISTIC CcsCtlEcuHoldQcaPwrReq_C "TRUE value enables the the QCA chip (PLC modem)" VALUE 0x70018702 RL_CCSCTLECUHOLDQCAPWRREQ_C 1.000000 CU_CCSCTLECUHOLDQCAPWRREQ_C 0.000000 1.000000 BYTE_ORDER MSB_LAST /end CHARACTERISTIC
/begin RECORD_LAYOUT RL_CCSCTLECUHOLDQCAPWRREQ_C FNC_VALUES 1 UBYTE COLUMN_DIR DIRECT /end RECORD_LAYOUT
/begin COMPU_METHOD CU_CCSCTLECUHOLDQCAPWRREQ_C "Conversion method for CcsCtlEcuHoldQcaPwrReq_C" RAT_FUNC "%10.0" "b" COEFFS 0.000000 1.000000 -0.000000 0.000000 0.000000 1.000000 /end COMPU_METHOD
/* Scalar calibration for DDE 'CcsCtlStopCpEStopMask_C'. */
/begin CHARACTERISTIC CcsCtlStopCpEStopMask_C "Bitmask to define which bits of CcsFltCpWrd will initiate an emergency shutdown" VALUE 0x700173c8 RL_CCSCTLSTOPCPESTOPMASK_C 255.000000 CU_CCSCTLSTOPCPESTOPMASK_C 0.000000 255.000000 BYTE_ORDER MSB_LAST /end CHARACTERISTIC
/begin RECORD_LAYOUT RL_CCSCTLSTOPCPESTOPMASK_C FNC_VALUES 1 UBYTE COLUMN_DIR DIRECT /end RECORD_LAYOUT
/begin COMPU_METHOD CU_CCSCTLSTOPCPESTOPMASK_C "Conversion method for CcsCtlStopCpEStopMask_C" RAT_FUNC "%10.0" "1" COEFFS 0.000000 1.000000 -0.000000 0.000000 0.000000 1.000000 /end COMPU_METHOD
/* Scalar calibration for DDE 'CcsCtlStopCpNStopMask_C'. */
/begin CHARACTERISTIC CcsCtlStopCpNStopMask_C "Bitmask to define which bits of CcsFltCpWrd will initiate a normal shutdown" VALUE 0x700196eb RL_CCSCTLSTOPCPNSTOPMASK_C 255.000000 CU_CCSCTLSTOPCPNSTOPMASK_C 0.000000 255.000000 BYTE_ORDER MSB_LAST /end CHARACTERISTIC
/begin RECORD_LAYOUT RL_CCSCTLSTOPCPNSTOPMASK_C FNC_VALUES 1 UBYTE COLUMN_DIR DIRECT /end RECORD_LAYOUT
/begin COMPU_METHOD CU_CCSCTLSTOPCPNSTOPMASK_C "Conversion method for CcsCtlStopCpNStopMask_C" RAT_FUNC "%10.0" "1" COEFFS 0.000000 1.000000 -0.000000 0.000000 0.000000 1.000000 /end COMPU_METHOD
/* Scalar calibration for DDE 'CcsCtlStopCpRStopMask_C'. */
/begin CHARACTERISTIC CcsCtlStopCpRStopMask_C "Bitmask to define which bits of CcsFltCpWrd will initiate a normal shutdown" VALUE 0x70019656 RL_CCSCTLSTOPCPRSTOPMASK_C 255.000000 CU_CCSCTLSTOPCPRSTOPMASK_C 0.000000 255.000000 BYTE_ORDER MSB_LAST /end CHARACTERISTIC
/begin RECORD_LAYOUT RL_CCSCTLSTOPCPRSTOPMASK_C FNC_VALUES 1 UBYTE COLUMN_DIR DIRECT /end RECORD_LAYOUT
/begin COMPU_METHOD CU_CCSCTLSTOPCPRSTOPMASK_C "Conversion method for CcsCtlStopCpRStopMask_C" RAT_FUNC "%10.0" "1" COEFFS 0.000000 1.000000 -0.000000 0.000000 0.000000 1.000000 /end COMPU_METHOD
/* Scalar calibration for DDE 'CcsCtlStopIntFltEStopMask_C'. */
/begin CHARACTERISTIC CcsCtlStopIntFltEStopMask_C "Bitmask to define which bits of CcsFltInternalFaultsWrd will initiate an emergency shutdown" VALUE 0x700184dc RL_CCSCTLSTOPINTFLTESTOPMASK_C 255.000000 CU_CCSCTLSTOPINTFLTESTOPMASK_C 0.000000 255.000000 BYTE_ORDER MSB_LAST /end CHARACTERISTIC
/begin RECORD_LAYOUT RL_CCSCTLSTOPINTFLTESTOPMASK_C FNC_VALUES 1 UBYTE COLUMN_DIR DIRECT /end RECORD_LAYOUT
/begin COMPU_METHOD CU_CCSCTLSTOPINTFLTESTOPMASK_C "Conversion method for CcsCtlStopIntFltEStopMask_C" RAT_FUNC "%10.0" "1" COEFFS 0.000000 1.000000 -0.000000 0.000000 0.000000 1.000000 /end COMPU_METHOD
/* Scalar calibration for DDE 'CcsCtlStopIntFltNStopMask_C'. */
/begin CHARACTERISTIC CcsCtlStopIntFltNStopMask_C "Bitmask to define which bits of CcsFltInternalFaultsWrd will initiate a normal shutdown" VALUE 0x70019635 RL_CCSCTLSTOPINTFLTNSTOPMASK_C 255.000000 CU_CCSCTLSTOPINTFLTNSTOPMASK_C 0.000000 255.000000 BYTE_ORDER MSB_LAST /end CHARACTERISTIC
/begin RECORD_LAYOUT RL_CCSCTLSTOPINTFLTNSTOPMASK_C FNC_VALUES 1 UBYTE COLUMN_DIR DIRECT /end RECORD_LAYOUT
/begin COMPU_METHOD CU_CCSCTLSTOPINTFLTNSTOPMASK_C "Conversion method for CcsCtlStopIntFltNStopMask_C" RAT_FUNC "%10.0" "1" COEFFS 0.000000 1.000000 -0.000000 0.000000 0.000000 1.000000 /end COMPU_METHOD
/* Scalar calibration for DDE 'CcsCtlStopIntFltRStopMask_C'. */
/begin CHARACTERISTIC CcsCtlStopIntFltRStopMask_C "Bitmask to define which bits of CcsFltInternalFaultsWrd will initiate a rapid shutdown" VALUE 0x700174f1 RL_CCSCTLSTOPINTFLTRSTOPMASK_C 255.000000 CU_CCSCTLSTOPINTFLTRSTOPMASK_C 0.000000 255.000000 BYTE_ORDER MSB_LAST /end CHARACTERISTIC
/begin RECORD_LAYOUT RL_CCSCTLSTOPINTFLTRSTOPMASK_C FNC_VALUES 1 UBYTE COLUMN_DIR DIRECT /end RECORD_LAYOUT
/begin COMPU_METHOD CU_CCSCTLSTOPINTFLTRSTOPMASK_C "Conversion method for CcsCtlStopIntFltRStopMask_C" RAT_FUNC "%10.0" "1" COEFFS 0.000000 1.000000 -0.000000 0.000000 0.000000 1.000000 /end COMPU_METHOD
/* Scalar calibration for DDE 'CcsCtlStopPpEStopMask_C'. */
/begin CHARACTERISTIC CcsCtlStopPpEStopMask_C "Bitmask to define which bits of CcsFltPpWrd will initiate an emergency shutdown" VALUE 0x700173d0 RL_CCSCTLSTOPPPESTOPMASK_C 255.000000 CU_CCSCTLSTOPPPESTOPMASK_C 0.000000 255.000000 BYTE_ORDER MSB_LAST /end CHARACTERISTIC
/begin RECORD_LAYOUT RL_CCSCTLSTOPPPESTOPMASK_C FNC_VALUES 1 UBYTE COLUMN_DIR DIRECT /end RECORD_LAYOUT
/begin COMPU_METHOD CU_CCSCTLSTOPPPESTOPMASK_C "Conversion method for CcsCtlStopPpEStopMask_C" RAT_FUNC "%10.0" "1" COEFFS 0.000000 1.000000 -0.000000 0.000000 0.000000 1.000000 /end COMPU_METHOD
/* Scalar calibration for DDE 'CcsCtlStopPpNStopMask_C'. */
/begin CHARACTERISTIC CcsCtlStopPpNStopMask_C "Bitmask to define which bits of CcsFltPpWrd will initiate a normal shutdown" VALUE 0x700185cf RL_CCSCTLSTOPPPNSTOPMASK_C 255.000000 CU_CCSCTLSTOPPPNSTOPMASK_C 0.000000 255.000000 BYTE_ORDER MSB_LAST /end CHARACTERISTIC
/begin RECORD_LAYOUT RL_CCSCTLSTOPPPNSTOPMASK_C FNC_VALUES 1 UBYTE COLUMN_DIR DIRECT /end RECORD_LAYOUT
/begin COMPU_METHOD CU_CCSCTLSTOPPPNSTOPMASK_C "Conversion method for CcsCtlStopPpNStopMask_C" RAT_FUNC "%10.0" "1" COEFFS 0.000000 1.000000 -0.000000 0.000000 0.000000 1.000000 /end COMPU_METHOD
/* Scalar calibration for DDE 'CcsCtlStopPpRStopMask_C'. */
/begin CHARACTERISTIC CcsCtlStopPpRStopMask_C "Bitmask to define which bits of CcsFltPpWrd will initiate a normal shutdown" VALUE 0x700184e6 RL_CCSCTLSTOPPPRSTOPMASK_C 255.000000 CU_CCSCTLSTOPPPRSTOPMASK_C 0.000000 255.000000 BYTE_ORDER MSB_LAST /end CHARACTERISTIC
/begin RECORD_LAYOUT RL_CCSCTLSTOPPPRSTOPMASK_C FNC_VALUES 1 UBYTE COLUMN_DIR DIRECT /end RECORD_LAYOUT
/begin COMPU_METHOD CU_CCSCTLSTOPPPRSTOPMASK_C "Conversion method for CcsCtlStopPpRStopMask_C" RAT_FUNC "%10.0" "1" COEFFS 0.000000 1.000000 -0.000000 0.000000 0.000000 1.000000 /end COMPU_METHOD
/* Scalar calibration for DDE 'CcsCtlStopRxEgyTypeEStopMask_C'. */
/begin CHARACTERISTIC CcsCtlStopRxEgyTypeEStopMask_C "Bitmask to define which bits of CcsFltRxEgyTrnsTypeWrd will initiate an emergency shutdown" VALUE 0x70019e9c RL_CCSCTLSTOPRXEGYTYPEESTOPMAS0 255.000000 CU_CCSCTLSTOPRXEGYTYPEESTOPMAS0 0.000000 255.000000 BYTE_ORDER MSB_LAST /end CHARACTERISTIC
/begin RECORD_LAYOUT RL_CCSCTLSTOPRXEGYTYPEESTOPMAS0 FNC_VALUES 1 UBYTE COLUMN_DIR DIRECT /end RECORD_LAYOUT
/begin COMPU_METHOD CU_CCSCTLSTOPRXEGYTYPEESTOPMAS0 "Conversion method for CcsCtlStopRxEgyTypeEStopMask_C" RAT_FUNC "%10.0" "1" COEFFS 0.000000 1.000000 -0.000000 0.000000 0.000000 1.000000 /end COMPU_METHOD
/* Scalar calibration for DDE 'CcsCtlStopRxEgyTypeNStopMask_C'. */
/begin CHARACTERISTIC CcsCtlStopRxEgyTypeNStopMask_C "Bitmask to define which bits of CcsFltRxEgyTrnsTypeWrd will initiate a normal shutdown" VALUE 0x7001867c RL_CCSCTLSTOPRXEGYTYPENSTOPMAS0 255.000000 CU_CCSCTLSTOPRXEGYTYPENSTOPMAS0 0.000000 255.000000 BYTE_ORDER MSB_LAST /end CHARACTERISTIC
/begin RECORD_LAYOUT RL_CCSCTLSTOPRXEGYTYPENSTOPMAS0 FNC_VALUES 1 UBYTE COLUMN_DIR DIRECT /end RECORD_LAYOUT
/begin COMPU_METHOD CU_CCSCTLSTOPRXEGYTYPENSTOPMAS0 "Conversion method for CcsCtlStopRxEgyTypeNStopMask_C" RAT_FUNC "%10.0" "1" COEFFS 0.000000 1.000000 -0.000000 0.000000 0.000000 1.000000 /end COMPU_METHOD
/* Scalar calibration for DDE 'CcsCtlStopRxEgyTypeRStopMask_C'. */
/begin CHARACTERISTIC CcsCtlStopRxEgyTypeRStopMask_C "Bitmask to define which bits of CcsFltRxEgyTrnsTypeWrd will initiate a rapid shutdown" VALUE 0x70017644 RL_CCSCTLSTOPRXEGYTYPERSTOPMAS0 255.000000 CU_CCSCTLSTOPRXEGYTYPERSTOPMAS0 0.000000 255.000000 BYTE_ORDER MSB_LAST /end CHARACTERISTIC
/begin RECORD_LAYOUT RL_CCSCTLSTOPRXEGYTYPERSTOPMAS0 FNC_VALUES 1 UBYTE COLUMN_DIR DIRECT /end RECORD_LAYOUT
/begin COMPU_METHOD CU_CCSCTLSTOPRXEGYTYPERSTOPMAS0 "Conversion method for CcsCtlStopRxEgyTypeRStopMask_C" RAT_FUNC "%10.0" "1" COEFFS 0.000000 1.000000 -0.000000 0.000000 0.000000 1.000000 /end COMPU_METHOD
/* Scalar calibration for DDE 'CcsCtlStopRxEvVoltEStopMask_C'. */
/begin CHARACTERISTIC CcsCtlStopRxEvVoltEStopMask_C "Bitmask to define which bits of CcsFltRxEvVoltWrd will initiate an emergency shutdown" VALUE 0x700185ce RL_CCSCTLSTOPRXEVVOLTESTOPMASK0 255.000000 CU_CCSCTLSTOPRXEVVOLTESTOPMASK0 0.000000 255.000000 BYTE_ORDER MSB_LAST /end CHARACTERISTIC
/begin RECORD_LAYOUT RL_CCSCTLSTOPRXEVVOLTESTOPMASK0 FNC_VALUES 1 UBYTE COLUMN_DIR DIRECT /end RECORD_LAYOUT
/begin COMPU_METHOD CU_CCSCTLSTOPRXEVVOLTESTOPMASK0 "Conversion method for CcsCtlStopRxEvVoltEStopMask_C" RAT_FUNC "%10.0" "1" COEFFS 0.000000 1.000000 -0.000000 0.000000 0.000000 1.000000 /end COMPU_METHOD
/* Scalar calibration for DDE 'CcsCtlStopRxEvVoltNStopMask_C'. */
/begin CHARACTERISTIC CcsCtlStopRxEvVoltNStopMask_C "Bitmask to define which bits of CcsFltRxEvVoltWrd will initiate a normal shutdown" VALUE 0x700195d4 RL_CCSCTLSTOPRXEVVOLTNSTOPMASK0 255.000000 CU_CCSCTLSTOPRXEVVOLTNSTOPMASK0 0.000000 255.000000 BYTE_ORDER MSB_LAST /end CHARACTERISTIC
/begin RECORD_LAYOUT RL_CCSCTLSTOPRXEVVOLTNSTOPMASK0 FNC_VALUES 1 UBYTE COLUMN_DIR DIRECT /end RECORD_LAYOUT
/begin COMPU_METHOD CU_CCSCTLSTOPRXEVVOLTNSTOPMASK0 "Conversion method for CcsCtlStopRxEvVoltNStopMask_C" RAT_FUNC "%10.0" "1" COEFFS 0.000000 1.000000 -0.000000 0.000000 0.000000 1.000000 /end COMPU_METHOD
/* Scalar calibration for DDE 'CcsCtlStopRxEvVoltRStopMask_C'. */
/begin CHARACTERISTIC CcsCtlStopRxEvVoltRStopMask_C "Bitmask to define which bits of CcsFltRxEvVoltWrd will initiate a rapid shutdown" VALUE 0x700174ac RL_CCSCTLSTOPRXEVVOLTRSTOPMASK0 255.000000 CU_CCSCTLSTOPRXEVVOLTRSTOPMASK0 0.000000 255.000000 BYTE_ORDER MSB_LAST /end CHARACTERISTIC
/begin RECORD_LAYOUT RL_CCSCTLSTOPRXEVVOLTRSTOPMASK0 FNC_VALUES 1 UBYTE COLUMN_DIR DIRECT /end RECORD_LAYOUT
/begin COMPU_METHOD CU_CCSCTLSTOPRXEVVOLTRSTOPMASK0 "Conversion method for CcsCtlStopRxEvVoltRStopMask_C" RAT_FUNC "%10.0" "1" COEFFS 0.000000 1.000000 -0.000000 0.000000 0.000000 1.000000 /end COMPU_METHOD
/* Scalar calibration for DDE 'CcsCtlStopRxEvseCrntEStopMask_C'. */
/begin CHARACTERISTIC CcsCtlStopRxEvseCrntEStopMask_C "Bitmask to define which bits of CcsFltRxEvseCrntWrd will initiate an emergency shutdown" VALUE 0x700173f1 RL_CCSCTLSTOPRXEVSECRNTESTOPMA0 255.000000 CU_CCSCTLSTOPRXEVSECRNTESTOPMA0 0.000000 255.000000 BYTE_ORDER MSB_LAST /end CHARACTERISTIC
/begin RECORD_LAYOUT RL_CCSCTLSTOPRXEVSECRNTESTOPMA0 FNC_VALUES 1 UBYTE COLUMN_DIR DIRECT /end RECORD_LAYOUT
/begin COMPU_METHOD CU_CCSCTLSTOPRXEVSECRNTESTOPMA0 "Conversion method for CcsCtlStopRxEvseCrntEStopMask_C" RAT_FUNC "%10.0" "1" COEFFS 0.000000 1.000000 -0.000000 0.000000 0.000000 1.000000 /end COMPU_METHOD
/* Scalar calibration for DDE 'CcsCtlStopRxEvseCrntNStopMask_C'. */
/begin CHARACTERISTIC CcsCtlStopRxEvseCrntNStopMask_C "Bitmask to define which bits of CcsFltRxEvseCrntWrd will initiate a normal shutdown" VALUE 0x700186e0 RL_CCSCTLSTOPRXEVSECRNTNSTOPMA0 255.000000 CU_CCSCTLSTOPRXEVSECRNTNSTOPMA0 0.000000 255.000000 BYTE_ORDER MSB_LAST /end CHARACTERISTIC
/begin RECORD_LAYOUT RL_CCSCTLSTOPRXEVSECRNTNSTOPMA0 FNC_VALUES 1 UBYTE COLUMN_DIR DIRECT /end RECORD_LAYOUT
/begin COMPU_METHOD CU_CCSCTLSTOPRXEVSECRNTNSTOPMA0 "Conversion method for CcsCtlStopRxEvseCrntNStopMask_C" RAT_FUNC "%10.0" "1" COEFFS 0.000000 1.000000 -0.000000 0.000000 0.000000 1.000000 /end COMPU_METHOD
/* Scalar calibration for DDE 'CcsCtlStopRxEvseCrntRStopMask_C'. */
/begin CHARACTERISTIC CcsCtlStopRxEvseCrntRStopMask_C "Bitmask to define which bits of CcsFltRxEvseCrntWrd will initiate a normal shutdown" VALUE 0x7001764d RL_CCSCTLSTOPRXEVSECRNTRSTOPMA0 255.000000 CU_CCSCTLSTOPRXEVSECRNTRSTOPMA0 0.000000 255.000000 BYTE_ORDER MSB_LAST /end CHARACTERISTIC
/begin RECORD_LAYOUT RL_CCSCTLSTOPRXEVSECRNTRSTOPMA0 FNC_VALUES 1 UBYTE COLUMN_DIR DIRECT /end RECORD_LAYOUT
/begin COMPU_METHOD CU_CCSCTLSTOPRXEVSECRNTRSTOPMA0 "Conversion method for CcsCtlStopRxEvseCrntRStopMask_C" RAT_FUNC "%10.0" "1" COEFFS 0.000000 1.000000 -0.000000 0.000000 0.000000 1.000000 /end COMPU_METHOD
/* Scalar calibration for DDE 'CcsCtlStopRxEvseIsolEStopMask_C'. */
/begin CHARACTERISTIC CcsCtlStopRxEvseIsolEStopMask_C "Bitmask to define which bits of CcsFltRxEvseIsolWrd will initiate an emergency shutdown" VALUE 0x700185b9 RL_CCSCTLSTOPRXEVSEISOLESTOPMA0 255.000000 CU_CCSCTLSTOPRXEVSEISOLESTOPMA0 0.000000 255.000000 BYTE_ORDER MSB_LAST /end CHARACTERISTIC
/begin RECORD_LAYOUT RL_CCSCTLSTOPRXEVSEISOLESTOPMA0 FNC_VALUES 1 UBYTE COLUMN_DIR DIRECT /end RECORD_LAYOUT
/begin COMPU_METHOD CU_CCSCTLSTOPRXEVSEISOLESTOPMA0 "Conversion method for CcsCtlStopRxEvseIsolEStopMask_C" RAT_FUNC "%10.0" "1" COEFFS 0.000000 1.000000 -0.000000 0.000000 0.000000 1.000000 /end COMPU_METHOD
/* Scalar calibration for DDE 'CcsCtlStopRxEvseIsolNStopMask_C'. */
/begin CHARACTERISTIC CcsCtlStopRxEvseIsolNStopMask_C "Bitmask to define which bits of CcsFltRxEvseIsolWrd will initiate a normal shutdown" VALUE 0x70019776 RL_CCSCTLSTOPRXEVSEISOLNSTOPMA0 255.000000 CU_CCSCTLSTOPRXEVSEISOLNSTOPMA0 0.000000 255.000000 BYTE_ORDER MSB_LAST /end CHARACTERISTIC
/begin RECORD_LAYOUT RL_CCSCTLSTOPRXEVSEISOLNSTOPMA0 FNC_VALUES 1 UBYTE COLUMN_DIR DIRECT /end RECORD_LAYOUT
/begin COMPU_METHOD CU_CCSCTLSTOPRXEVSEISOLNSTOPMA0 "Conversion method for CcsCtlStopRxEvseIsolNStopMask_C" RAT_FUNC "%10.0" "1" COEFFS 0.000000 1.000000 -0.000000 0.000000 0.000000 1.000000 /end COMPU_METHOD
/* Scalar calibration for DDE 'CcsCtlStopRxEvseIsolRStopMask_C'. */
/begin CHARACTERISTIC CcsCtlStopRxEvseIsolRStopMask_C "Bitmask to define which bits of CcsFltRxEvseIsolWrd will initiate a normal shutdown" VALUE 0x70017448 RL_CCSCTLSTOPRXEVSEISOLRSTOPMA0 255.000000 CU_CCSCTLSTOPRXEVSEISOLRSTOPMA0 0.000000 255.000000 BYTE_ORDER MSB_LAST /end CHARACTERISTIC
/begin RECORD_LAYOUT RL_CCSCTLSTOPRXEVSEISOLRSTOPMA0 FNC_VALUES 1 UBYTE COLUMN_DIR DIRECT /end RECORD_LAYOUT
/begin COMPU_METHOD CU_CCSCTLSTOPRXEVSEISOLRSTOPMA0 "Conversion method for CcsCtlStopRxEvseIsolRStopMask_C" RAT_FUNC "%10.0" "1" COEFFS 0.000000 1.000000 -0.000000 0.000000 0.000000 1.000000 /end COMPU_METHOD
/* Scalar calibration for DDE 'CcsCtlStopRxEvseProcEStopMask_C'. */
/begin CHARACTERISTIC CcsCtlStopRxEvseProcEStopMask_C "Bitmask to define which bits of CcsFltRxEvseProcStWrd will initiate an emergency shutdown" VALUE 0x70017694 RL_CCSCTLSTOPRXEVSEPROCESTOPMA0 255.000000 CU_CCSCTLSTOPRXEVSEPROCESTOPMA0 0.000000 255.000000 BYTE_ORDER MSB_LAST /end CHARACTERISTIC
/begin RECORD_LAYOUT RL_CCSCTLSTOPRXEVSEPROCESTOPMA0 FNC_VALUES 1 UBYTE COLUMN_DIR DIRECT /end RECORD_LAYOUT
/begin COMPU_METHOD CU_CCSCTLSTOPRXEVSEPROCESTOPMA0 "Conversion method for CcsCtlStopRxEvseProcEStopMask_C" RAT_FUNC "%10.0" "1" COEFFS 0.000000 1.000000 -0.000000 0.000000 0.000000 1.000000 /end COMPU_METHOD
/* Scalar calibration for DDE 'CcsCtlStopRxEvseProcNStopMask_C'. */
/begin CHARACTERISTIC CcsCtlStopRxEvseProcNStopMask_C "Bitmask to define which bits of CcsFltRxEvseProcStWrd will initiate a normal shutdown" VALUE 0x700185cc RL_CCSCTLSTOPRXEVSEPROCNSTOPMA0 255.000000 CU_CCSCTLSTOPRXEVSEPROCNSTOPMA0 0.000000 255.000000 BYTE_ORDER MSB_LAST /end CHARACTERISTIC
/begin RECORD_LAYOUT RL_CCSCTLSTOPRXEVSEPROCNSTOPMA0 FNC_VALUES 1 UBYTE COLUMN_DIR DIRECT /end RECORD_LAYOUT
/begin COMPU_METHOD CU_CCSCTLSTOPRXEVSEPROCNSTOPMA0 "Conversion method for CcsCtlStopRxEvseProcNStopMask_C" RAT_FUNC "%10.0" "1" COEFFS 0.000000 1.000000 -0.000000 0.000000 0.000000 1.000000 /end COMPU_METHOD
/* Scalar calibration for DDE 'CcsCtlStopRxEvseProcRStopMask_C'. */
/begin CHARACTERISTIC CcsCtlStopRxEvseProcRStopMask_C "Bitmask to define which bits of CcsFltRxEvseProcStWrd will initiate a normal shutdown" VALUE 0x70018664 RL_CCSCTLSTOPRXEVSEPROCRSTOPMA0 255.000000 CU_CCSCTLSTOPRXEVSEPROCRSTOPMA0 0.000000 255.000000 BYTE_ORDER MSB_LAST /end CHARACTERISTIC
/begin RECORD_LAYOUT RL_CCSCTLSTOPRXEVSEPROCRSTOPMA0 FNC_VALUES 1 UBYTE COLUMN_DIR DIRECT /end RECORD_LAYOUT
/begin COMPU_METHOD CU_CCSCTLSTOPRXEVSEPROCRSTOPMA0 "Conversion method for CcsCtlStopRxEvseProcRStopMask_C" RAT_FUNC "%10.0" "1" COEFFS 0.000000 1.000000 -0.000000 0.000000 0.000000 1.000000 /end COMPU_METHOD
/* Scalar calibration for DDE 'CcsCtlStopRxEvsePwrEStopMask_C'. */
/begin CHARACTERISTIC CcsCtlStopRxEvsePwrEStopMask_C "Bitmask to define which bits of CcsFltRxEvsePwrWrd will initiate an emergency shutdown" VALUE 0x700196ba RL_CCSCTLSTOPRXEVSEPWRESTOPMAS0 255.000000 CU_CCSCTLSTOPRXEVSEPWRESTOPMAS0 0.000000 255.000000 BYTE_ORDER MSB_LAST /end CHARACTERISTIC
/begin RECORD_LAYOUT RL_CCSCTLSTOPRXEVSEPWRESTOPMAS0 FNC_VALUES 1 UBYTE COLUMN_DIR DIRECT /end RECORD_LAYOUT
/begin COMPU_METHOD CU_CCSCTLSTOPRXEVSEPWRESTOPMAS0 "Conversion method for CcsCtlStopRxEvsePwrEStopMask_C" RAT_FUNC "%10.0" "1" COEFFS 0.000000 1.000000 -0.000000 0.000000 0.000000 1.000000 /end COMPU_METHOD
/* Scalar calibration for DDE 'CcsCtlStopRxEvsePwrNStopMask_C'. */
/begin CHARACTERISTIC CcsCtlStopRxEvsePwrNStopMask_C "Bitmask to define which bits of CcsFltRxEvsePwrWrd will initiate a normal shutdown" VALUE 0x70019e8a RL_CCSCTLSTOPRXEVSEPWRNSTOPMAS0 255.000000 CU_CCSCTLSTOPRXEVSEPWRNSTOPMAS0 0.000000 255.000000 BYTE_ORDER MSB_LAST /end CHARACTERISTIC
/begin RECORD_LAYOUT RL_CCSCTLSTOPRXEVSEPWRNSTOPMAS0 FNC_VALUES 1 UBYTE COLUMN_DIR DIRECT /end RECORD_LAYOUT
/begin COMPU_METHOD CU_CCSCTLSTOPRXEVSEPWRNSTOPMAS0 "Conversion method for CcsCtlStopRxEvsePwrNStopMask_C" RAT_FUNC "%10.0" "1" COEFFS 0.000000 1.000000 -0.000000 0.000000 0.000000 1.000000 /end COMPU_METHOD
/* Scalar calibration for DDE 'CcsCtlStopRxEvsePwrRStopMask_C'. */
/begin CHARACTERISTIC CcsCtlStopRxEvsePwrRStopMask_C "Bitmask to define which bits of CcsFltRxEvsePwrWrd will initiate a rapid shutdown" VALUE 0x70017668 RL_CCSCTLSTOPRXEVSEPWRRSTOPMAS0 255.000000 CU_CCSCTLSTOPRXEVSEPWRRSTOPMAS0 0.000000 255.000000 BYTE_ORDER MSB_LAST /end CHARACTERISTIC
/begin RECORD_LAYOUT RL_CCSCTLSTOPRXEVSEPWRRSTOPMAS0 FNC_VALUES 1 UBYTE COLUMN_DIR DIRECT /end RECORD_LAYOUT
/begin COMPU_METHOD CU_CCSCTLSTOPRXEVSEPWRRSTOPMAS0 "Conversion method for CcsCtlStopRxEvsePwrRStopMask_C" RAT_FUNC "%10.0" "1" COEFFS 0.000000 1.000000 -0.000000 0.000000 0.000000 1.000000 /end COMPU_METHOD
/* Scalar calibration for DDE 'CcsCtlStopRxEvseStEStopMask_C'. */
/begin CHARACTERISTIC CcsCtlStopRxEvseStEStopMask_C "Bitmask to define which bits of CcsFltRxEvseStCodeWrd will initiate an emergency shutdown" VALUE 0x700186a9 RL_CCSCTLSTOPRXEVSESTESTOPMASK0 255.000000 CU_CCSCTLSTOPRXEVSESTESTOPMASK0 0.000000 255.000000 BYTE_ORDER MSB_LAST /end CHARACTERISTIC
/begin RECORD_LAYOUT RL_CCSCTLSTOPRXEVSESTESTOPMASK0 FNC_VALUES 1 UBYTE COLUMN_DIR DIRECT /end RECORD_LAYOUT
/begin COMPU_METHOD CU_CCSCTLSTOPRXEVSESTESTOPMASK0 "Conversion method for CcsCtlStopRxEvseStEStopMask_C" RAT_FUNC "%10.0" "1" COEFFS 0.000000 1.000000 -0.000000 0.000000 0.000000 1.000000 /end COMPU_METHOD
/* Scalar calibration for DDE 'CcsCtlStopRxEvseStNStopMask_C'. */
/begin CHARACTERISTIC CcsCtlStopRxEvseStNStopMask_C "Bitmask to define which bits of CcsFltRxEvseStCodeWrd will initiate a normal shutdown" VALUE 0x70017551 RL_CCSCTLSTOPRXEVSESTNSTOPMASK0 255.000000 CU_CCSCTLSTOPRXEVSESTNSTOPMASK0 0.000000 255.000000 BYTE_ORDER MSB_LAST /end CHARACTERISTIC
/begin RECORD_LAYOUT RL_CCSCTLSTOPRXEVSESTNSTOPMASK0 FNC_VALUES 1 UBYTE COLUMN_DIR DIRECT /end RECORD_LAYOUT
/begin COMPU_METHOD CU_CCSCTLSTOPRXEVSESTNSTOPMASK0 "Conversion method for CcsCtlStopRxEvseStNStopMask_C" RAT_FUNC "%10.0" "1" COEFFS 0.000000 1.000000 -0.000000 0.000000 0.000000 1.000000 /end COMPU_METHOD
/* Scalar calibration for DDE 'CcsCtlStopRxEvseStRStopMask_C'. */
/begin CHARACTERISTIC CcsCtlStopRxEvseStRStopMask_C "Bitmask to define which bits of CcsFltRxEvseStCodeWrd will initiate a normal shutdown" VALUE 0x70017488 RL_CCSCTLSTOPRXEVSESTRSTOPMASK0 255.000000 CU_CCSCTLSTOPRXEVSESTRSTOPMASK0 0.000000 255.000000 BYTE_ORDER MSB_LAST /end CHARACTERISTIC
/begin RECORD_LAYOUT RL_CCSCTLSTOPRXEVSESTRSTOPMASK0 FNC_VALUES 1 UBYTE COLUMN_DIR DIRECT /end RECORD_LAYOUT
/begin COMPU_METHOD CU_CCSCTLSTOPRXEVSESTRSTOPMASK0 "Conversion method for CcsCtlStopRxEvseStRStopMask_C" RAT_FUNC "%10.0" "1" COEFFS 0.000000 1.000000 -0.000000 0.000000 0.000000 1.000000 /end COMPU_METHOD
/* Scalar calibration for DDE 'CcsCtlStopRxEvseVoltEStopMask_C'. */
/begin CHARACTERISTIC CcsCtlStopRxEvseVoltEStopMask_C "Bitmask to define which bits of CcsFltRxEvseVoltWrd will initiate an emergency shutdown" VALUE 0x700176b8 RL_CCSCTLSTOPRXEVSEVOLTESTOPMA0 255.000000 CU_CCSCTLSTOPRXEVSEVOLTESTOPMA0 0.000000 255.000000 BYTE_ORDER MSB_LAST /end CHARACTERISTIC
/begin RECORD_LAYOUT RL_CCSCTLSTOPRXEVSEVOLTESTOPMA0 FNC_VALUES 1 UBYTE COLUMN_DIR DIRECT /end RECORD_LAYOUT
/begin COMPU_METHOD CU_CCSCTLSTOPRXEVSEVOLTESTOPMA0 "Conversion method for CcsCtlStopRxEvseVoltEStopMask_C" RAT_FUNC "%10.0" "1" COEFFS 0.000000 1.000000 -0.000000 0.000000 0.000000 1.000000 /end COMPU_METHOD
/* Scalar calibration for DDE 'CcsCtlStopRxEvseVoltNStopMask_C'. */
/begin CHARACTERISTIC CcsCtlStopRxEvseVoltNStopMask_C "Bitmask to define which bits of CcsFltRxEvseVoltWrd will initiate a normal shutdown" VALUE 0x70019d66 RL_CCSCTLSTOPRXEVSEVOLTNSTOPMA0 255.000000 CU_CCSCTLSTOPRXEVSEVOLTNSTOPMA0 0.000000 255.000000 BYTE_ORDER MSB_LAST /end CHARACTERISTIC
/begin RECORD_LAYOUT RL_CCSCTLSTOPRXEVSEVOLTNSTOPMA0 FNC_VALUES 1 UBYTE COLUMN_DIR DIRECT /end RECORD_LAYOUT
/begin COMPU_METHOD CU_CCSCTLSTOPRXEVSEVOLTNSTOPMA0 "Conversion method for CcsCtlStopRxEvseVoltNStopMask_C" RAT_FUNC "%10.0" "1" COEFFS 0.000000 1.000000 -0.000000 0.000000 0.000000 1.000000 /end COMPU_METHOD
/* Scalar calibration for DDE 'CcsCtlStopRxEvseVoltRStopMask_C'. */
/begin CHARACTERISTIC CcsCtlStopRxEvseVoltRStopMask_C "Bitmask to define which bits of CcsFltRxEvseVoltWrd will initiate a normal shutdown" VALUE 0x7001764c RL_CCSCTLSTOPRXEVSEVOLTRSTOPMA0 255.000000 CU_CCSCTLSTOPRXEVSEVOLTRSTOPMA0 0.000000 255.000000 BYTE_ORDER MSB_LAST /end CHARACTERISTIC
/begin RECORD_LAYOUT RL_CCSCTLSTOPRXEVSEVOLTRSTOPMA0 FNC_VALUES 1 UBYTE COLUMN_DIR DIRECT /end RECORD_LAYOUT
/begin COMPU_METHOD CU_CCSCTLSTOPRXEVSEVOLTRSTOPMA0 "Conversion method for CcsCtlStopRxEvseVoltRStopMask_C" RAT_FUNC "%10.0" "1" COEFFS 0.000000 1.000000 -0.000000 0.000000 0.000000 1.000000 /end COMPU_METHOD
/* Scalar calibration for DDE 'CcsCtlStopSeqEStopMask_C'. */
/begin CHARACTERISTIC CcsCtlStopSeqEStopMask_C "Bitmask to define which bits of CcsFltSeqWrd will initiate an emergency shutdown" VALUE 0x70017447 RL_CCSCTLSTOPSEQESTOPMASK_C 255.000000 CU_CCSCTLSTOPSEQESTOPMASK_C 0.000000 255.000000 BYTE_ORDER MSB_LAST /end CHARACTERISTIC
/begin RECORD_LAYOUT RL_CCSCTLSTOPSEQESTOPMASK_C FNC_VALUES 1 UBYTE COLUMN_DIR DIRECT /end RECORD_LAYOUT
/begin COMPU_METHOD CU_CCSCTLSTOPSEQESTOPMASK_C "Conversion method for CcsCtlStopSeqEStopMask_C" RAT_FUNC "%10.0" "1" COEFFS 0.000000 1.000000 -0.000000 0.000000 0.000000 1.000000 /end COMPU_METHOD
/* Scalar calibration for DDE 'CcsCtlStopSeqNStopMask_C'. */
/begin CHARACTERISTIC CcsCtlStopSeqNStopMask_C "Bitmask to define which bits of CcsFltSeqWrd will initiate a normal shutdown" VALUE 0x700185d7 RL_CCSCTLSTOPSEQNSTOPMASK_C 255.000000 CU_CCSCTLSTOPSEQNSTOPMASK_C 0.000000 255.000000 BYTE_ORDER MSB_LAST /end CHARACTERISTIC
/begin RECORD_LAYOUT RL_CCSCTLSTOPSEQNSTOPMASK_C FNC_VALUES 1 UBYTE COLUMN_DIR DIRECT /end RECORD_LAYOUT
/begin COMPU_METHOD CU_CCSCTLSTOPSEQNSTOPMASK_C "Conversion method for CcsCtlStopSeqNStopMask_C" RAT_FUNC "%10.0" "1" COEFFS 0.000000 1.000000 -0.000000 0.000000 0.000000 1.000000 /end COMPU_METHOD
/* Scalar calibration for DDE 'CcsCtlStopSeqRStopMask_C'. */
/begin CHARACTERISTIC CcsCtlStopSeqRStopMask_C "Bitmask to define which bits of CcsFltSeqWrd will initiate a rapid shutdown" VALUE 0x70017444 RL_CCSCTLSTOPSEQRSTOPMASK_C 255.000000 CU_CCSCTLSTOPSEQRSTOPMASK_C 0.000000 255.000000 BYTE_ORDER MSB_LAST /end CHARACTERISTIC
/begin RECORD_LAYOUT RL_CCSCTLSTOPSEQRSTOPMASK_C FNC_VALUES 1 UBYTE COLUMN_DIR DIRECT /end RECORD_LAYOUT
/begin COMPU_METHOD CU_CCSCTLSTOPSEQRSTOPMASK_C "Conversion method for CcsCtlStopSeqRStopMask_C" RAT_FUNC "%10.0" "1" COEFFS 0.000000 1.000000 -0.000000 0.000000 0.000000 1.000000 /end COMPU_METHOD
/* Scalar calibration for DDE 'CcsCtlStopSupPrtclEStopMask_C'. */
/begin CHARACTERISTIC CcsCtlStopSupPrtclEStopMask_C "Bitmask to define which bits of CcsFltEvseSupPrtclWrd will initiate an emergency shutdown" VALUE 0x70019640 RL_CCSCTLSTOPSUPPRTCLESTOPMASK0 255.000000 CU_CCSCTLSTOPSUPPRTCLESTOPMASK0 0.000000 255.000000 BYTE_ORDER MSB_LAST /end CHARACTERISTIC
/begin RECORD_LAYOUT RL_CCSCTLSTOPSUPPRTCLESTOPMASK0 FNC_VALUES 1 UBYTE COLUMN_DIR DIRECT /end RECORD_LAYOUT
/begin COMPU_METHOD CU_CCSCTLSTOPSUPPRTCLESTOPMASK0 "Conversion method for CcsCtlStopSupPrtclEStopMask_C" RAT_FUNC "%10.0" "1" COEFFS 0.000000 1.000000 -0.000000 0.000000 0.000000 1.000000 /end COMPU_METHOD
/* Scalar calibration for DDE 'CcsCtlStopSupPrtclNStopMask_C'. */
/begin CHARACTERISTIC CcsCtlStopSupPrtclNStopMask_C "Bitmask to define which bits of CcsFltEvseSupPrtclWrd will initiate a normal shutdown" VALUE 0x70019e29 RL_CCSCTLSTOPSUPPRTCLNSTOPMASK0 255.000000 CU_CCSCTLSTOPSUPPRTCLNSTOPMASK0 0.000000 255.000000 BYTE_ORDER MSB_LAST /end CHARACTERISTIC
/begin RECORD_LAYOUT RL_CCSCTLSTOPSUPPRTCLNSTOPMASK0 FNC_VALUES 1 UBYTE COLUMN_DIR DIRECT /end RECORD_LAYOUT
/begin COMPU_METHOD CU_CCSCTLSTOPSUPPRTCLNSTOPMASK0 "Conversion method for CcsCtlStopSupPrtclNStopMask_C" RAT_FUNC "%10.0" "1" COEFFS 0.000000 1.000000 -0.000000 0.000000 0.000000 1.000000 /end COMPU_METHOD
/* Scalar calibration for DDE 'CcsCtlStopSupPrtclRStopMask_C'. */
/begin CHARACTERISTIC CcsCtlStopSupPrtclRStopMask_C "Bitmask to define which bits of CcsFltSupPrtclWrd will initiate a rapid shutdown" VALUE 0x700174a4 RL_CCSCTLSTOPSUPPRTCLRSTOPMASK0 255.000000 CU_CCSCTLSTOPSUPPRTCLRSTOPMASK0 0.000000 255.000000 BYTE_ORDER MSB_LAST /end CHARACTERISTIC
/begin RECORD_LAYOUT RL_CCSCTLSTOPSUPPRTCLRSTOPMASK0 FNC_VALUES 1 UBYTE COLUMN_DIR DIRECT /end RECORD_LAYOUT
/begin COMPU_METHOD CU_CCSCTLSTOPSUPPRTCLRSTOPMASK0 "Conversion method for CcsCtlStopSupPrtclRStopMask_C" RAT_FUNC "%10.0" "1" COEFFS 0.000000 1.000000 -0.000000 0.000000 0.000000 1.000000 /end COMPU_METHOD
/* Scalar calibration for DDE 'CcsCtlStopV2gMsgEStopMask_C'. */
/begin CHARACTERISTIC CcsCtlStopV2gMsgEStopMask_C "Bitmask to define which bits of CcsFltV2gMsgWrd will initiate an emergency shutdown" VALUE 0x70017505 RL_CCSCTLSTOPV2GMSGESTOPMASK_C 255.000000 CU_CCSCTLSTOPV2GMSGESTOPMASK_C 0.000000 255.000000 BYTE_ORDER MSB_LAST /end CHARACTERISTIC
/begin RECORD_LAYOUT RL_CCSCTLSTOPV2GMSGESTOPMASK_C FNC_VALUES 1 UBYTE COLUMN_DIR DIRECT /end RECORD_LAYOUT
/begin COMPU_METHOD CU_CCSCTLSTOPV2GMSGESTOPMASK_C "Conversion method for CcsCtlStopV2gMsgEStopMask_C" RAT_FUNC "%10.0" "1" COEFFS 0.000000 1.000000 -0.000000 0.000000 0.000000 1.000000 /end COMPU_METHOD
/* Scalar calibration for DDE 'CcsCtlStopV2gMsgNStopMask_C'. */
/begin CHARACTERISTIC CcsCtlStopV2gMsgNStopMask_C "Bitmask to define which bits of CcsFltV2gMsgWrd will initiate a normal shutdown" VALUE 0x70019d6c RL_CCSCTLSTOPV2GMSGNSTOPMASK_C 255.000000 CU_CCSCTLSTOPV2GMSGNSTOPMASK_C 0.000000 255.000000 BYTE_ORDER MSB_LAST /end CHARACTERISTIC
/begin RECORD_LAYOUT RL_CCSCTLSTOPV2GMSGNSTOPMASK_C FNC_VALUES 1 UBYTE COLUMN_DIR DIRECT /end RECORD_LAYOUT
/begin COMPU_METHOD CU_CCSCTLSTOPV2GMSGNSTOPMASK_C "Conversion method for CcsCtlStopV2gMsgNStopMask_C" RAT_FUNC "%10.0" "1" COEFFS 0.000000 1.000000 -0.000000 0.000000 0.000000 1.000000 /end COMPU_METHOD
/* Scalar calibration for DDE 'CcsCtlStopV2gMsgRStopMask_C'. */
/begin CHARACTERISTIC CcsCtlStopV2gMsgRStopMask_C "Bitmask to define which bits of CcsFltV2gMsgWrd will initiate a rapid shutdown" VALUE 0x70017446 RL_CCSCTLSTOPV2GMSGRSTOPMASK_C 255.000000 CU_CCSCTLSTOPV2GMSGRSTOPMASK_C 0.000000 255.000000 BYTE_ORDER MSB_LAST /end CHARACTERISTIC
/begin RECORD_LAYOUT RL_CCSCTLSTOPV2GMSGRSTOPMASK_C FNC_VALUES 1 UBYTE COLUMN_DIR DIRECT /end RECORD_LAYOUT
/begin COMPU_METHOD CU_CCSCTLSTOPV2GMSGRSTOPMASK_C "Conversion method for CcsCtlStopV2gMsgRStopMask_C" RAT_FUNC "%10.0" "1" COEFFS 0.000000 1.000000 -0.000000 0.000000 0.000000 1.000000 /end COMPU_METHOD
/* Scalar calibration for DDE 'CcsCtlSvcDetailMsgEnable_C'. */
/begin CHARACTERISTIC CcsCtlSvcDetailMsgEnable_C "Calibration set whether or not the EV wants to support the service detail message." VALUE 0x70017550 RL_CCSCTLSVCDETAILMSGENABLE_C 1.000000 CU_CCSCTLSVCDETAILMSGENABLE_C 0.000000 1.000000 BYTE_ORDER MSB_LAST /end CHARACTERISTIC
/begin RECORD_LAYOUT RL_CCSCTLSVCDETAILMSGENABLE_C FNC_VALUES 1 UBYTE COLUMN_DIR DIRECT /end RECORD_LAYOUT
/begin COMPU_METHOD CU_CCSCTLSVCDETAILMSGENABLE_C "Conversion method for CcsCtlSvcDetailMsgEnable_C" RAT_FUNC "%10.0" "b" COEFFS 0.000000 1.000000 -0.000000 0.000000 0.000000 1.000000 /end COMPU_METHOD
/* Scalar calibration for DDE 'CcsFltCpDutcycOorhCmax_C'. */
/begin CHARACTERISTIC CcsFltCpDutcycOorhCmax_C "Leacky Bucket maximum value for counter that sets the fault flag for Control PilotDutycycle OUT OF RANGE HIGH in CcsFltCpWrd" VALUE 0x700173d8 RL_CCSFLTCPDUTCYCOORHCMAX_C 65535.000000 CU_CCSFLTCPDUTCYCOORHCMAX_C 0.000000 65535.000000 BYTE_ORDER MSB_LAST /end CHARACTERISTIC
/begin RECORD_LAYOUT RL_CCSFLTCPDUTCYCOORHCMAX_C FNC_VALUES 1 UWORD COLUMN_DIR DIRECT /end RECORD_LAYOUT
/begin COMPU_METHOD CU_CCSFLTCPDUTCYCOORHCMAX_C "Conversion method for CcsFltCpDutcycOorhCmax_C" RAT_FUNC "%10.0" "1" COEFFS 0.000000 1.000000 -0.000000 0.000000 0.000000 1.000000 /end COMPU_METHOD
/* Scalar calibration for DDE 'CcsFltCpDutcycOorhLim_C'. */
/begin CHARACTERISTIC CcsFltCpDutcycOorhLim_C "Threshold Limit for setting fault flag for Control PilotDutycycle OUT OF RANGE HIGH in CcsFltCpWrd" VALUE 0x70017520 RL_CCSFLTCPDUTCYCOORHLIM_C 2000000.000000 CU_CCSFLTCPDUTCYCOORHLIM_C -1000000.000000 1000000.000000 BYTE_ORDER MSB_LAST /end CHARACTERISTIC
/begin RECORD_LAYOUT RL_CCSFLTCPDUTCYCOORHLIM_C FNC_VALUES 1 FLOAT32_IEEE COLUMN_DIR DIRECT /end RECORD_LAYOUT
/begin COMPU_METHOD CU_CCSFLTCPDUTCYCOORHLIM_C "Conversion method for CcsFltCpDutcycOorhLim_C" RAT_FUNC "%10.0" "%" COEFFS 0.000000 1.000000 -0.000000 0.000000 0.000000 1.000000 /end COMPU_METHOD
/* Scalar calibration for DDE 'CcsFltCpDutcycOorlCmax_C'. */
/begin CHARACTERISTIC CcsFltCpDutcycOorlCmax_C "Leacky Bucket maximum value for counter that sets the fault flag for Control Pilot Dutycycle OUT OF RANGE LOW in CcsFltCpWrd" VALUE 0x70017614 RL_CCSFLTCPDUTCYCOORLCMAX_C 65535.000000 CU_CCSFLTCPDUTCYCOORLCMAX_C 0.000000 65535.000000 BYTE_ORDER MSB_LAST /end CHARACTERISTIC
/begin RECORD_LAYOUT RL_CCSFLTCPDUTCYCOORLCMAX_C FNC_VALUES 1 UWORD COLUMN_DIR DIRECT /end RECORD_LAYOUT
/begin COMPU_METHOD CU_CCSFLTCPDUTCYCOORLCMAX_C "Conversion method for CcsFltCpDutcycOorlCmax_C" RAT_FUNC "%10.0" "1" COEFFS 0.000000 1.000000 -0.000000 0.000000 0.000000 1.000000 /end COMPU_METHOD
/* Scalar calibration for DDE 'CcsFltCpDutcycOorlLim_C'. */
/begin CHARACTERISTIC CcsFltCpDutcycOorlLim_C "Threshold Limit for setting fault flag for Control Pilot Dutycycle OUT OF RANGE LOW in CcsFltCpWrd" VALUE 0x700175d4 RL_CCSFLTCPDUTCYCOORLLIM_C 2000000.000000 CU_CCSFLTCPDUTCYCOORLLIM_C -1000000.000000 1000000.000000 BYTE_ORDER MSB_LAST /end CHARACTERISTIC
/begin RECORD_LAYOUT RL_CCSFLTCPDUTCYCOORLLIM_C FNC_VALUES 1 FLOAT32_IEEE COLUMN_DIR DIRECT /end RECORD_LAYOUT
/begin COMPU_METHOD CU_CCSFLTCPDUTCYCOORLLIM_C "Conversion method for CcsFltCpDutcycOorlLim_C" RAT_FUNC "%10.0" "%" COEFFS 0.000000 1.000000 -0.000000 0.000000 0.000000 1.000000 /end COMPU_METHOD
/* Scalar calibration for DDE 'CcsFltCpEn_C'. */
/begin CHARACTERISTIC CcsFltCpEn_C "Each bit of this parameter, if set to 1, enables diagnostic of associated (with the same bit number) fault flag in CcsFltCpWrd" VALUE 0x700175b4 RL_CCSFLTCPEN_C 255.000000 CU_CCSFLTCPEN_C 0.000000 255.000000 BYTE_ORDER MSB_LAST /end CHARACTERISTIC
/begin RECORD_LAYOUT RL_CCSFLTCPEN_C FNC_VALUES 1 UBYTE COLUMN_DIR DIRECT /end RECORD_LAYOUT
/begin COMPU_METHOD CU_CCSFLTCPEN_C "Conversion method for CcsFltCpEn_C" RAT_FUNC "%10.0" "1" COEFFS 0.000000 1.000000 -0.000000 0.000000 0.000000 1.000000 /end COMPU_METHOD
/* Scalar calibration for DDE 'CcsFltCpErrStOorCmax_C'. */
/begin CHARACTERISTIC CcsFltCpErrStOorCmax_C "Leacky Bucket maximum value for counter that sets the fault flag for Control Pilot Dudtycycle Range Error OUT OF RANGE in CcsFltCpWrd" VALUE 0x70017696 RL_CCSFLTCPERRSTOORCMAX_C 65535.000000 CU_CCSFLTCPERRSTOORCMAX_C 0.000000 65535.000000 BYTE_ORDER MSB_LAST /end CHARACTERISTIC
/begin RECORD_LAYOUT RL_CCSFLTCPERRSTOORCMAX_C FNC_VALUES 1 UWORD COLUMN_DIR DIRECT /end RECORD_LAYOUT
/begin COMPU_METHOD CU_CCSFLTCPERRSTOORCMAX_C "Conversion method for CcsFltCpErrStOorCmax_C" RAT_FUNC "%10.0" "1" COEFFS 0.000000 1.000000 -0.000000 0.000000 0.000000 1.000000 /end COMPU_METHOD
/* Scalar calibration for DDE 'CcsFltCpErrStOorhLim_C'. */
/begin CHARACTERISTIC CcsFltCpErrStOorhLim_C "Threshold Limit for setting fault flag for Control Pilot Dudtycycle Range Error OUT OF RANGE in CcsFltCpWrd" VALUE 0x70017508 RL_CCSFLTCPERRSTOORHLIM_C 2000000.000000 CU_CCSFLTCPERRSTOORHLIM_C -1000000.000000 1000000.000000 BYTE_ORDER MSB_LAST /end CHARACTERISTIC
/begin RECORD_LAYOUT RL_CCSFLTCPERRSTOORHLIM_C FNC_VALUES 1 FLOAT32_IEEE COLUMN_DIR DIRECT /end RECORD_LAYOUT
/begin COMPU_METHOD CU_CCSFLTCPERRSTOORHLIM_C "Conversion method for CcsFltCpErrStOorhLim_C" RAT_FUNC "%10.0" "%" COEFFS 0.000000 1.000000 -0.000000 0.000000 0.000000 1.000000 /end COMPU_METHOD
/* Scalar calibration for DDE 'CcsFltCpErrStOorlLim_C'. */
/begin CHARACTERISTIC CcsFltCpErrStOorlLim_C "Threshold Limit for setting fault flag for Control Pilot Dudtycycle Range Error OUT OF RANGE in CcsFltCpWrd" VALUE 0x700174e8 RL_CCSFLTCPERRSTOORLLIM_C 2000000.000000 CU_CCSFLTCPERRSTOORLLIM_C -1000000.000000 1000000.000000 BYTE_ORDER MSB_LAST /end CHARACTERISTIC
/begin RECORD_LAYOUT RL_CCSFLTCPERRSTOORLLIM_C FNC_VALUES 1 FLOAT32_IEEE COLUMN_DIR DIRECT /end RECORD_LAYOUT
/begin COMPU_METHOD CU_CCSFLTCPERRSTOORLLIM_C "Conversion method for CcsFltCpErrStOorlLim_C" RAT_FUNC "%10.0" "%" COEFFS 0.000000 1.000000 -0.000000 0.000000 0.000000 1.000000 /end COMPU_METHOD
/* Scalar calibration for DDE 'CcsFltCpFrqOorCmax_C'. */
/begin CHARACTERISTIC CcsFltCpFrqOorCmax_C "Leacky Bucket maximum value for counter that sets the fault flag for Control Pilot Frequency OUT OF RANGE in CcsFltCpWrd" VALUE 0x70017640 RL_CCSFLTCPFRQOORCMAX_C 65535.000000 CU_CCSFLTCPFRQOORCMAX_C 0.000000 65535.000000 BYTE_ORDER MSB_LAST /end CHARACTERISTIC
/begin RECORD_LAYOUT RL_CCSFLTCPFRQOORCMAX_C FNC_VALUES 1 UWORD COLUMN_DIR DIRECT /end RECORD_LAYOUT
/begin COMPU_METHOD CU_CCSFLTCPFRQOORCMAX_C "Conversion method for CcsFltCpFrqOorCmax_C" RAT_FUNC "%10.0" "1" COEFFS 0.000000 1.000000 -0.000000 0.000000 0.000000 1.000000 /end COMPU_METHOD
/* Scalar calibration for DDE 'CcsFltCpFrqOorhLim_C'. */
/begin CHARACTERISTIC CcsFltCpFrqOorhLim_C "Threshold Limit for setting fault flag for Control Pilot Frequency OUT OF RANGE in CcsFltCpWrd" VALUE 0x700175f8 RL_CCSFLTCPFRQOORHLIM_C 2000000.000000 CU_CCSFLTCPFRQOORHLIM_C -1000000.000000 1000000.000000 BYTE_ORDER MSB_LAST /end CHARACTERISTIC
/begin RECORD_LAYOUT RL_CCSFLTCPFRQOORHLIM_C FNC_VALUES 1 FLOAT32_IEEE COLUMN_DIR DIRECT /end RECORD_LAYOUT
/begin COMPU_METHOD CU_CCSFLTCPFRQOORHLIM_C "Conversion method for CcsFltCpFrqOorhLim_C" RAT_FUNC "%10.0" "Hz" COEFFS 0.000000 1.000000 -0.000000 0.000000 0.000000 1.000000 /end COMPU_METHOD
/* Scalar calibration for DDE 'CcsFltCpFrqOorlLim_C'. */
/begin CHARACTERISTIC CcsFltCpFrqOorlLim_C "Threshold Limit for setting fault flag for Control Pilot Frequency OUT OF RANGE in CcsFltCpWrd" VALUE 0x70017630 RL_CCSFLTCPFRQOORLLIM_C 2000000.000000 CU_CCSFLTCPFRQOORLLIM_C -1000000.000000 1000000.000000 BYTE_ORDER MSB_LAST /end CHARACTERISTIC
/begin RECORD_LAYOUT RL_CCSFLTCPFRQOORLLIM_C FNC_VALUES 1 FLOAT32_IEEE COLUMN_DIR DIRECT /end RECORD_LAYOUT
/begin COMPU_METHOD CU_CCSFLTCPFRQOORLLIM_C "Conversion method for CcsFltCpFrqOorlLim_C" RAT_FUNC "%10.0" "Hz" COEFFS 0.000000 1.000000 -0.000000 0.000000 0.000000 1.000000 /end COMPU_METHOD
/* Scalar calibration for DDE 'CcsFltCpPwmtoCmax_C'. */
/begin CHARACTERISTIC CcsFltCpPwmtoCmax_C "Leacky Bucket maximum value for counter that sets the fault flag for Control Pilot PWM Timeout PWM IN TIMEOUT in CcsFltCpWrd" VALUE 0x70017654 RL_CCSFLTCPPWMTOCMAX_C 65535.000000 CU_CCSFLTCPPWMTOCMAX_C 0.000000 65535.000000 BYTE_ORDER MSB_LAST /end CHARACTERISTIC
/begin RECORD_LAYOUT RL_CCSFLTCPPWMTOCMAX_C FNC_VALUES 1 UWORD COLUMN_DIR DIRECT /end RECORD_LAYOUT
/begin COMPU_METHOD CU_CCSFLTCPPWMTOCMAX_C "Conversion method for CcsFltCpPwmtoCmax_C" RAT_FUNC "%10.0" "1" COEFFS 0.000000 1.000000 -0.000000 0.000000 0.000000 1.000000 /end COMPU_METHOD
/* Scalar calibration for DDE 'CcsFltEvseProcV2GtoLim_C'. */
/begin CHARACTERISTIC CcsFltEvseProcV2GtoLim_C "Threshold Limit for setting fault flag for V2G EVSE Processing V2G Timeout  in CcsFltEvseProcStWrd" VALUE 0x7001768c RL_CCSFLTEVSEPROCV2GTOLIM_C 1000000.000000 CU_CCSFLTEVSEPROCV2GTOLIM_C 0.000000 1000000.000000 BYTE_ORDER MSB_LAST /end CHARACTERISTIC
/begin RECORD_LAYOUT RL_CCSFLTEVSEPROCV2GTOLIM_C FNC_VALUES 1 FLOAT32_IEEE COLUMN_DIR DIRECT /end RECORD_LAYOUT
/begin COMPU_METHOD CU_CCSFLTEVSEPROCV2GTOLIM_C "Conversion method for CcsFltEvseProcV2GtoLim_C" RAT_FUNC "%10.0" "s" COEFFS 0.000000 1.000000 -0.000000 0.000000 0.000000 1.000000 /end COMPU_METHOD
/* Scalar calibration for DDE 'CcsFltInternalFaultsEn_C'. */
/begin CHARACTERISTIC CcsFltInternalFaultsEn_C "Each bit of this parameter, if set to 1, enables diagnostic of associated (with the same bit number) fault flag in CcsFltInternalFaultsWrd" VALUE 0x70017439 RL_CCSFLTINTERNALFAULTSEN_C 255.000000 CU_CCSFLTINTERNALFAULTSEN_C 0.000000 255.000000 BYTE_ORDER MSB_LAST /end CHARACTERISTIC
/begin RECORD_LAYOUT RL_CCSFLTINTERNALFAULTSEN_C FNC_VALUES 1 UBYTE COLUMN_DIR DIRECT /end RECORD_LAYOUT
/begin COMPU_METHOD CU_CCSFLTINTERNALFAULTSEN_C "Conversion method for CcsFltInternalFaultsEn_C" RAT_FUNC "%10.0" "1" COEFFS 0.000000 1.000000 -0.000000 0.000000 0.000000 1.000000 /end COMPU_METHOD
/* Scalar calibration for DDE 'CcsFltLinkEn_C'. */
/begin CHARACTERISTIC CcsFltLinkEn_C "Each bit of this parameter, if set to 1, enables diagnostic of associated (with the same bit number) fault flag in CcsFltLinkWrd" VALUE 0x700175d0 RL_CCSFLTLINKEN_C 255.000000 CU_CCSFLTLINKEN_C 0.000000 255.000000 BYTE_ORDER MSB_LAST /end CHARACTERISTIC
/begin RECORD_LAYOUT RL_CCSFLTLINKEN_C FNC_VALUES 1 UBYTE COLUMN_DIR DIRECT /end RECORD_LAYOUT
/begin COMPU_METHOD CU_CCSFLTLINKEN_C "Conversion method for CcsFltLinkEn_C" RAT_FUNC "%10.0" "1" COEFFS 0.000000 1.000000 -0.000000 0.000000 0.000000 1.000000 /end COMPU_METHOD
/* Scalar calibration for DDE 'CcsFltPpCpRatCmax_C'. */
/begin CHARACTERISTIC CcsFltPpCpRatCmax_C "Leacky Bucket maximum value for counter that sets the fault flag for Proximity Pilot State Correlation with Pilot RATIONALITY in CcsFltPpWrd" VALUE 0x7001740e RL_CCSFLTPPCPRATCMAX_C 65535.000000 CU_CCSFLTPPCPRATCMAX_C 0.000000 65535.000000 BYTE_ORDER MSB_LAST /end CHARACTERISTIC
/begin RECORD_LAYOUT RL_CCSFLTPPCPRATCMAX_C FNC_VALUES 1 UWORD COLUMN_DIR DIRECT /end RECORD_LAYOUT
/begin COMPU_METHOD CU_CCSFLTPPCPRATCMAX_C "Conversion method for CcsFltPpCpRatCmax_C" RAT_FUNC "%10.0" "1" COEFFS 0.000000 1.000000 -0.000000 0.000000 0.000000 1.000000 /end COMPU_METHOD
/* Scalar calibration for DDE 'CcsFltPpEn_C'. */
/begin CHARACTERISTIC CcsFltPpEn_C "Each bit of this parameter, if set to 1, enables diagnostic of associated (with the same bit number) fault flag in CcsFltPpWrd" VALUE 0x7001760c RL_CCSFLTPPEN_C 255.000000 CU_CCSFLTPPEN_C 0.000000 255.000000 BYTE_ORDER MSB_LAST /end CHARACTERISTIC
/begin RECORD_LAYOUT RL_CCSFLTPPEN_C FNC_VALUES 1 UBYTE COLUMN_DIR DIRECT /end RECORD_LAYOUT
/begin COMPU_METHOD CU_CCSFLTPPEN_C "Conversion method for CcsFltPpEn_C" RAT_FUNC "%10.0" "1" COEFFS 0.000000 1.000000 -0.000000 0.000000 0.000000 1.000000 /end COMPU_METHOD
/* Scalar calibration for DDE 'CcsFltPpVoltOorhCmax_C'. */
/begin CHARACTERISTIC CcsFltPpVoltOorhCmax_C "Leacky Bucket maximum value for counter that sets the fault flag for Proximity Pilot Voltage OUT OF RANGE HIGH in CcsFltPpWrd" VALUE 0x70017642 RL_CCSFLTPPVOLTOORHCMAX_C 65535.000000 CU_CCSFLTPPVOLTOORHCMAX_C 0.000000 65535.000000 BYTE_ORDER MSB_LAST /end CHARACTERISTIC
/begin RECORD_LAYOUT RL_CCSFLTPPVOLTOORHCMAX_C FNC_VALUES 1 UWORD COLUMN_DIR DIRECT /end RECORD_LAYOUT
/begin COMPU_METHOD CU_CCSFLTPPVOLTOORHCMAX_C "Conversion method for CcsFltPpVoltOorhCmax_C" RAT_FUNC "%10.0" "1" COEFFS 0.000000 1.000000 -0.000000 0.000000 0.000000 1.000000 /end COMPU_METHOD
/* Scalar calibration for DDE 'CcsFltPpVoltOorhLim_C'. */
/begin CHARACTERISTIC CcsFltPpVoltOorhLim_C "Threshold Limit for setting fault flag for Proximity Pilot Voltage OUT OF RANGE HIGH in CcsFltPpWrd" VALUE 0x7001761c RL_CCSFLTPPVOLTOORHLIM_C 2000000.000000 CU_CCSFLTPPVOLTOORHLIM_C -1000000.000000 1000000.000000 BYTE_ORDER MSB_LAST /end CHARACTERISTIC
/begin RECORD_LAYOUT RL_CCSFLTPPVOLTOORHLIM_C FNC_VALUES 1 FLOAT32_IEEE COLUMN_DIR DIRECT /end RECORD_LAYOUT
/begin COMPU_METHOD CU_CCSFLTPPVOLTOORHLIM_C "Conversion method for CcsFltPpVoltOorhLim_C" RAT_FUNC "%10.0" "V" COEFFS 0.000000 1.000000 -0.000000 0.000000 0.000000 1.000000 /end COMPU_METHOD
/* Scalar calibration for DDE 'CcsFltPpVoltOorlCmax_C'. */
/begin CHARACTERISTIC CcsFltPpVoltOorlCmax_C "Leacky Bucket maximum value for counter that sets the fault flag for Proximity Pilot Voltage OUT OF RANGE LOW in CcsFltPpWrd" VALUE 0x7001767e RL_CCSFLTPPVOLTOORLCMAX_C 65535.000000 CU_CCSFLTPPVOLTOORLCMAX_C 0.000000 65535.000000 BYTE_ORDER MSB_LAST /end CHARACTERISTIC
/begin RECORD_LAYOUT RL_CCSFLTPPVOLTOORLCMAX_C FNC_VALUES 1 UWORD COLUMN_DIR DIRECT /end RECORD_LAYOUT
/begin COMPU_METHOD CU_CCSFLTPPVOLTOORLCMAX_C "Conversion method for CcsFltPpVoltOorlCmax_C" RAT_FUNC "%10.0" "1" COEFFS 0.000000 1.000000 -0.000000 0.000000 0.000000 1.000000 /end COMPU_METHOD
/* Scalar calibration for DDE 'CcsFltPpVoltOorlLim_C'. */
/begin CHARACTERISTIC CcsFltPpVoltOorlLim_C "Threshold Limit for setting fault flag for Proximity Pilot Voltage OUT OF RANGE LOW in CcsFltPpWrd" VALUE 0x70017658 RL_CCSFLTPPVOLTOORLLIM_C 2000000.000000 CU_CCSFLTPPVOLTOORLLIM_C -1000000.000000 1000000.000000 BYTE_ORDER MSB_LAST /end CHARACTERISTIC
/begin RECORD_LAYOUT RL_CCSFLTPPVOLTOORLLIM_C FNC_VALUES 1 FLOAT32_IEEE COLUMN_DIR DIRECT /end RECORD_LAYOUT
/begin COMPU_METHOD CU_CCSFLTPPVOLTOORLLIM_C "Conversion method for CcsFltPpVoltOorlLim_C" RAT_FUNC "%10.0" "V" COEFFS 0.000000 1.000000 -0.000000 0.000000 0.000000 1.000000 /end COMPU_METHOD
/* Scalar calibration for DDE 'CcsFltPpVrefOorCmax_C'. */
/begin CHARACTERISTIC CcsFltPpVrefOorCmax_C "Leacky Bucket maximum value for counter that sets the fault flag for EVSE Proximity Supply VREFA Voltage OUT OF RANGE in CcsFltPpWrd" VALUE 0x70017594 RL_CCSFLTPPVREFOORCMAX_C 65535.000000 CU_CCSFLTPPVREFOORCMAX_C 0.000000 65535.000000 BYTE_ORDER MSB_LAST /end CHARACTERISTIC
/begin RECORD_LAYOUT RL_CCSFLTPPVREFOORCMAX_C FNC_VALUES 1 UWORD COLUMN_DIR DIRECT /end RECORD_LAYOUT
/begin COMPU_METHOD CU_CCSFLTPPVREFOORCMAX_C "Conversion method for CcsFltPpVrefOorCmax_C" RAT_FUNC "%10.0" "1" COEFFS 0.000000 1.000000 -0.000000 0.000000 0.000000 1.000000 /end COMPU_METHOD
/* Scalar calibration for DDE 'CcsFltPpVrefOorhLim_C'. */
/begin CHARACTERISTIC CcsFltPpVrefOorhLim_C "Threshold Limit for setting fault flag for EVSE Proximity Supply VREFA Voltage OUT OF RANGE in CcsFltPpWrd" VALUE 0x700176a8 RL_CCSFLTPPVREFOORHLIM_C 2000000.000000 CU_CCSFLTPPVREFOORHLIM_C -1000000.000000 1000000.000000 BYTE_ORDER MSB_LAST /end CHARACTERISTIC
/begin RECORD_LAYOUT RL_CCSFLTPPVREFOORHLIM_C FNC_VALUES 1 FLOAT32_IEEE COLUMN_DIR DIRECT /end RECORD_LAYOUT
/begin COMPU_METHOD CU_CCSFLTPPVREFOORHLIM_C "Conversion method for CcsFltPpVrefOorhLim_C" RAT_FUNC "%10.0" "V" COEFFS 0.000000 1.000000 -0.000000 0.000000 0.000000 1.000000 /end COMPU_METHOD
/* Scalar calibration for DDE 'CcsFltPpVrefOorlLim_C'. */
/begin CHARACTERISTIC CcsFltPpVrefOorlLim_C "Threshold Limit for setting fault flag for EVSE Proximity Supply VREFA Voltage OUT OF RANGE in CcsFltPpWrd" VALUE 0x7001750c RL_CCSFLTPPVREFOORLLIM_C 2000000.000000 CU_CCSFLTPPVREFOORLLIM_C -1000000.000000 1000000.000000 BYTE_ORDER MSB_LAST /end CHARACTERISTIC
/begin RECORD_LAYOUT RL_CCSFLTPPVREFOORLLIM_C FNC_VALUES 1 FLOAT32_IEEE COLUMN_DIR DIRECT /end RECORD_LAYOUT
/begin COMPU_METHOD CU_CCSFLTPPVREFOORLLIM_C "Conversion method for CcsFltPpVrefOorlLim_C" RAT_FUNC "%10.0" "V" COEFFS 0.000000 1.000000 -0.000000 0.000000 0.000000 1.000000 /end COMPU_METHOD
/* Scalar calibration for DDE 'CcsFltRxEgyTrnsTypeEn_C'. */
/begin CHARACTERISTIC CcsFltRxEgyTrnsTypeEn_C "Each bit of this parameter, if set to 1, enables diagnostic of associated (with the same bit number) fault flag in CcsFltRxEgyTrnsTypeWrd" VALUE 0x700186d4 RL_CCSFLTRXEGYTRNSTYPEEN_C 255.000000 CU_CCSFLTRXEGYTRNSTYPEEN_C 0.000000 255.000000 BYTE_ORDER MSB_LAST /end CHARACTERISTIC
/begin RECORD_LAYOUT RL_CCSFLTRXEGYTRNSTYPEEN_C FNC_VALUES 1 UBYTE COLUMN_DIR DIRECT /end RECORD_LAYOUT
/begin COMPU_METHOD CU_CCSFLTRXEGYTRNSTYPEEN_C "Conversion method for CcsFltRxEgyTrnsTypeEn_C" RAT_FUNC "%10.0" "1" COEFFS 0.000000 1.000000 -0.000000 0.000000 0.000000 1.000000 /end COMPU_METHOD
/* Scalar calibration for DDE 'CcsFltRxEvVoltEn_C'. */
/begin CHARACTERISTIC CcsFltRxEvVoltEn_C "Each bit of this parameter, if set to 1, enables diagnostic of associated (with the same bit number) fault flag in CcsFltRxEvVoltWrd" VALUE 0x7001753e RL_CCSFLTRXEVVOLTEN_C 255.000000 CU_CCSFLTRXEVVOLTEN_C 0.000000 255.000000 BYTE_ORDER MSB_LAST /end CHARACTERISTIC
/begin RECORD_LAYOUT RL_CCSFLTRXEVVOLTEN_C FNC_VALUES 1 UBYTE COLUMN_DIR DIRECT /end RECORD_LAYOUT
/begin COMPU_METHOD CU_CCSFLTRXEVVOLTEN_C "Conversion method for CcsFltRxEvVoltEn_C" RAT_FUNC "%10.0" "1" COEFFS 0.000000 1.000000 -0.000000 0.000000 0.000000 1.000000 /end COMPU_METHOD
/* Scalar calibration for DDE 'CcsFltRxEvseCrntEn_C'. */
/begin CHARACTERISTIC CcsFltRxEvseCrntEn_C "Each bit of this parameter, if set to 1, enables diagnostic of associated (with the same bit number) fault flag in CcsFltRxEvseCrntWrd" VALUE 0x700186e8 RL_CCSFLTRXEVSECRNTEN_C 255.000000 CU_CCSFLTRXEVSECRNTEN_C 0.000000 255.000000 BYTE_ORDER MSB_LAST /end CHARACTERISTIC
/begin RECORD_LAYOUT RL_CCSFLTRXEVSECRNTEN_C FNC_VALUES 1 UBYTE COLUMN_DIR DIRECT /end RECORD_LAYOUT
/begin COMPU_METHOD CU_CCSFLTRXEVSECRNTEN_C "Conversion method for CcsFltRxEvseCrntEn_C" RAT_FUNC "%10.0" "1" COEFFS 0.000000 1.000000 -0.000000 0.000000 0.000000 1.000000 /end COMPU_METHOD
/* Scalar calibration for DDE 'CcsFltRxEvseCrntPortOocCmax_C'. */
/begin CHARACTERISTIC CcsFltRxEvseCrntPortOocCmax_C "Leacky Bucket maximum value for counter that sets the fault flag for V2G signal EVSE Current DC with respect to Port Current OUT OF CORRELATION in CcsFltRxEvseCrntWrd" VALUE 0x700173e4 RL_CCSFLTRXEVSECRNTPORTOOCCMAX0 65535.000000 CU_CCSFLTRXEVSECRNTPORTOOCCMAX0 0.000000 65535.000000 BYTE_ORDER MSB_LAST /end CHARACTERISTIC
/begin RECORD_LAYOUT RL_CCSFLTRXEVSECRNTPORTOOCCMAX0 FNC_VALUES 1 UWORD COLUMN_DIR DIRECT /end RECORD_LAYOUT
/begin COMPU_METHOD CU_CCSFLTRXEVSECRNTPORTOOCCMAX0 "Conversion method for CcsFltRxEvseCrntPortOocCmax_C" RAT_FUNC "%10.0" "1" COEFFS 0.000000 1.000000 -0.000000 0.000000 0.000000 1.000000 /end COMPU_METHOD
/* Scalar calibration for DDE 'CcsFltRxEvseCrntPortOocLim_C'. */
/begin CHARACTERISTIC CcsFltRxEvseCrntPortOocLim_C "Threshold Limit for setting fault flag for V2G signal EVSE Current DC with respect to Port Current OUT OF CORRELATION in CcsFltRxEvseCrntWrd" VALUE 0x700173dc RL_CCSFLTRXEVSECRNTPORTOOCLIM_C 2000000.000000 CU_CCSFLTRXEVSECRNTPORTOOCLIM_C -1000000.000000 1000000.000000 BYTE_ORDER MSB_LAST /end CHARACTERISTIC
/begin RECORD_LAYOUT RL_CCSFLTRXEVSECRNTPORTOOCLIM_C FNC_VALUES 1 FLOAT32_IEEE COLUMN_DIR DIRECT /end RECORD_LAYOUT
/begin COMPU_METHOD CU_CCSFLTRXEVSECRNTPORTOOCLIM_C "Conversion method for CcsFltRxEvseCrntPortOocLim_C" RAT_FUNC "%10.0" "A" COEFFS 0.000000 1.000000 -0.000000 0.000000 0.000000 1.000000 /end COMPU_METHOD
/* Scalar calibration for DDE 'CcsFltRxEvseIsolStEn_C'. */
/begin CHARACTERISTIC CcsFltRxEvseIsolStEn_C "Each bit of this parameter, if set to 1, enables diagnostic of associated (with the same bit number) fault flag in CcsFltRxEvseIsolStWrd" VALUE 0x70017698 RL_CCSFLTRXEVSEISOLSTEN_C 255.000000 CU_CCSFLTRXEVSEISOLSTEN_C 0.000000 255.000000 BYTE_ORDER MSB_LAST /end CHARACTERISTIC
/begin RECORD_LAYOUT RL_CCSFLTRXEVSEISOLSTEN_C FNC_VALUES 1 UBYTE COLUMN_DIR DIRECT /end RECORD_LAYOUT
/begin COMPU_METHOD CU_CCSFLTRXEVSEISOLSTEN_C "Conversion method for CcsFltRxEvseIsolStEn_C" RAT_FUNC "%10.0" "1" COEFFS 0.000000 1.000000 -0.000000 0.000000 0.000000 1.000000 /end COMPU_METHOD
/* Scalar calibration for DDE 'CcsFltRxEvseProcStEn_C'. */
/begin CHARACTERISTIC CcsFltRxEvseProcStEn_C "Each bit of this parameter, if set to 1, enables diagnostic of associated (with the same bit number) fault flag in CcsFltRxEvseProcStWrd" VALUE 0x70017510 RL_CCSFLTRXEVSEPROCSTEN_C 255.000000 CU_CCSFLTRXEVSEPROCSTEN_C 0.000000 255.000000 BYTE_ORDER MSB_LAST /end CHARACTERISTIC
/begin RECORD_LAYOUT RL_CCSFLTRXEVSEPROCSTEN_C FNC_VALUES 1 UBYTE COLUMN_DIR DIRECT /end RECORD_LAYOUT
/begin COMPU_METHOD CU_CCSFLTRXEVSEPROCSTEN_C "Conversion method for CcsFltRxEvseProcStEn_C" RAT_FUNC "%10.0" "1" COEFFS 0.000000 1.000000 -0.000000 0.000000 0.000000 1.000000 /end COMPU_METHOD
/* Scalar calibration for DDE 'CcsFltRxEvsePwrEn_C'. */
/begin CHARACTERISTIC CcsFltRxEvsePwrEn_C "Each bit of this parameter, if set to 1, enables diagnostic of associated (with the same bit number) fault flag in CcsFltRxEvsePwrWrd" VALUE 0x70017432 RL_CCSFLTRXEVSEPWREN_C 255.000000 CU_CCSFLTRXEVSEPWREN_C 0.000000 255.000000 BYTE_ORDER MSB_LAST /end CHARACTERISTIC
/begin RECORD_LAYOUT RL_CCSFLTRXEVSEPWREN_C FNC_VALUES 1 UBYTE COLUMN_DIR DIRECT /end RECORD_LAYOUT
/begin COMPU_METHOD CU_CCSFLTRXEVSEPWREN_C "Conversion method for CcsFltRxEvsePwrEn_C" RAT_FUNC "%10.0" "1" COEFFS 0.000000 1.000000 -0.000000 0.000000 0.000000 1.000000 /end COMPU_METHOD
/* Scalar calibration for DDE 'CcsFltRxEvseStCodeEn_C'. */
/begin CHARACTERISTIC CcsFltRxEvseStCodeEn_C "Each bit of this parameter, if set to 1, enables diagnostic of associated (with the same bit number) fault flag in CcsFltRxEvseStCodeWrd" VALUE 0x70017524 RL_CCSFLTRXEVSESTCODEEN_C 255.000000 CU_CCSFLTRXEVSESTCODEEN_C 0.000000 255.000000 BYTE_ORDER MSB_LAST /end CHARACTERISTIC
/begin RECORD_LAYOUT RL_CCSFLTRXEVSESTCODEEN_C FNC_VALUES 1 UBYTE COLUMN_DIR DIRECT /end RECORD_LAYOUT
/begin COMPU_METHOD CU_CCSFLTRXEVSESTCODEEN_C "Conversion method for CcsFltRxEvseStCodeEn_C" RAT_FUNC "%10.0" "1" COEFFS 0.000000 1.000000 -0.000000 0.000000 0.000000 1.000000 /end COMPU_METHOD
/* Scalar calibration for DDE 'CcsFltRxEvseVoltEn_C'. */
/begin CHARACTERISTIC CcsFltRxEvseVoltEn_C "Each bit of this parameter, if set to 1, enables diagnostic of associated (with the same bit number) fault flag in CcsFltRxEvseVoltWrd" VALUE 0x70019e98 RL_CCSFLTRXEVSEVOLTEN_C 255.000000 CU_CCSFLTRXEVSEVOLTEN_C 0.000000 255.000000 BYTE_ORDER MSB_LAST /end CHARACTERISTIC
/begin RECORD_LAYOUT RL_CCSFLTRXEVSEVOLTEN_C FNC_VALUES 1 UBYTE COLUMN_DIR DIRECT /end RECORD_LAYOUT
/begin COMPU_METHOD CU_CCSFLTRXEVSEVOLTEN_C "Conversion method for CcsFltRxEvseVoltEn_C" RAT_FUNC "%10.0" "1" COEFFS 0.000000 1.000000 -0.000000 0.000000 0.000000 1.000000 /end COMPU_METHOD
/* Scalar calibration for DDE 'CcsFltRxEvseVoltPortOocCmax_C'. */
/begin CHARACTERISTIC CcsFltRxEvseVoltPortOocCmax_C "Leacky Bucket maximum value for counter that sets the fault flag for V2G signal EVSE Volt DC with respect to Port Voltage OUT OF CORRELATION in CcsFltRxEvseVoltWrd" VALUE 0x7001753c RL_CCSFLTRXEVSEVOLTPORTOOCCMAX0 65535.000000 CU_CCSFLTRXEVSEVOLTPORTOOCCMAX0 0.000000 65535.000000 BYTE_ORDER MSB_LAST /end CHARACTERISTIC
/begin RECORD_LAYOUT RL_CCSFLTRXEVSEVOLTPORTOOCCMAX0 FNC_VALUES 1 UWORD COLUMN_DIR DIRECT /end RECORD_LAYOUT
/begin COMPU_METHOD CU_CCSFLTRXEVSEVOLTPORTOOCCMAX0 "Conversion method for CcsFltRxEvseVoltPortOocCmax_C" RAT_FUNC "%10.0" "1" COEFFS 0.000000 1.000000 -0.000000 0.000000 0.000000 1.000000 /end COMPU_METHOD
/* Scalar calibration for DDE 'CcsFltRxEvseVoltPortOocLim_C'. */
/begin CHARACTERISTIC CcsFltRxEvseVoltPortOocLim_C "Threshold Limit for setting fault flag for V2G signal EVSE Volt DC with respect to Port Voltage OUT OF CORRELATION in CcsFltRxEvseVoltWrd" VALUE 0x70017538 RL_CCSFLTRXEVSEVOLTPORTOOCLIM_C 2000000.000000 CU_CCSFLTRXEVSEVOLTPORTOOCLIM_C -1000000.000000 1000000.000000 BYTE_ORDER MSB_LAST /end CHARACTERISTIC
/begin RECORD_LAYOUT RL_CCSFLTRXEVSEVOLTPORTOOCLIM_C FNC_VALUES 1 FLOAT32_IEEE COLUMN_DIR DIRECT /end RECORD_LAYOUT
/begin COMPU_METHOD CU_CCSFLTRXEVSEVOLTPORTOOCLIM_C "Conversion method for CcsFltRxEvseVoltPortOocLim_C" RAT_FUNC "%10.0" "V" COEFFS 0.000000 1.000000 -0.000000 0.000000 0.000000 1.000000 /end COMPU_METHOD
/* Scalar calibration for DDE 'CcsFltRxEvseVoltRessOocCmax_C'. */
/begin CHARACTERISTIC CcsFltRxEvseVoltRessOocCmax_C "Leacky Bucket maximum value for counter that sets the fault flag for V2G signal EVSE Volt DC with respect to RESS Voltage OUT OF CORRELATION in CcsFltRxEvseVoltWrd" VALUE 0x700176ac RL_CCSFLTRXEVSEVOLTRESSOOCCMAX0 65535.000000 CU_CCSFLTRXEVSEVOLTRESSOOCCMAX0 0.000000 65535.000000 BYTE_ORDER MSB_LAST /end CHARACTERISTIC
/begin RECORD_LAYOUT RL_CCSFLTRXEVSEVOLTRESSOOCCMAX0 FNC_VALUES 1 UWORD COLUMN_DIR DIRECT /end RECORD_LAYOUT
/begin COMPU_METHOD CU_CCSFLTRXEVSEVOLTRESSOOCCMAX0 "Conversion method for CcsFltRxEvseVoltRessOocCmax_C" RAT_FUNC "%10.0" "1" COEFFS 0.000000 1.000000 -0.000000 0.000000 0.000000 1.000000 /end COMPU_METHOD
/* Scalar calibration for DDE 'CcsFltRxEvseVoltRessOocLim_C'. */
/begin CHARACTERISTIC CcsFltRxEvseVoltRessOocLim_C "Threshold Limit for setting fault flag for V2G signal EVSE Volt DC with respect to RESS Voltage OUT OF CORRELATION in CcsFltRxEvseVoltWrd" VALUE 0x70017530 RL_CCSFLTRXEVSEVOLTRESSOOCLIM_C 2000000.000000 CU_CCSFLTRXEVSEVOLTRESSOOCLIM_C -1000000.000000 1000000.000000 BYTE_ORDER MSB_LAST /end CHARACTERISTIC
/begin RECORD_LAYOUT RL_CCSFLTRXEVSEVOLTRESSOOCLIM_C FNC_VALUES 1 FLOAT32_IEEE COLUMN_DIR DIRECT /end RECORD_LAYOUT
/begin COMPU_METHOD CU_CCSFLTRXEVSEVOLTRESSOOCLIM_C "Conversion method for CcsFltRxEvseVoltRessOocLim_C" RAT_FUNC "%10.0" "V" COEFFS 0.000000 1.000000 -0.000000 0.000000 0.000000 1.000000 /end COMPU_METHOD
/* Scalar calibration for DDE 'CcsFltRxSvcDiscEn_C'. */
/begin CHARACTERISTIC CcsFltRxSvcDiscEn_C "Each bit of this parameter, if set to 1, enables diagnostic of associated (with the same bit number) fault flag in CcsFltEvseSupPrtclWrd" VALUE 0x70017400 RL_CCSFLTRXSVCDISCEN_C 255.000000 CU_CCSFLTRXSVCDISCEN_C 0.000000 255.000000 BYTE_ORDER MSB_LAST /end CHARACTERISTIC
/begin RECORD_LAYOUT RL_CCSFLTRXSVCDISCEN_C FNC_VALUES 1 UBYTE COLUMN_DIR DIRECT /end RECORD_LAYOUT
/begin COMPU_METHOD CU_CCSFLTRXSVCDISCEN_C "Conversion method for CcsFltRxSvcDiscEn_C" RAT_FUNC "%10.0" "1" COEFFS 0.000000 1.000000 -0.000000 0.000000 0.000000 1.000000 /end COMPU_METHOD
/* Scalar calibration for DDE 'CcsFltSeqChgReadyVstoCmax_C'. */
/begin CHARACTERISTIC CcsFltSeqChgReadyVstoCmax_C "Leacky Bucket maximum value for counter that sets the fault flag for V2G Performance (Sequence) Timeout Charge Ready V2G MESSAGE RECEIVE SEQUENCE TIMEOUT in CcsFltSeqWrd" VALUE 0x700173f8 RL_CCSFLTSEQCHGREADYVSTOCMAX_C 65535.000000 CU_CCSFLTSEQCHGREADYVSTOCMAX_C 0.000000 65535.000000 BYTE_ORDER MSB_LAST /end CHARACTERISTIC
/begin RECORD_LAYOUT RL_CCSFLTSEQCHGREADYVSTOCMAX_C FNC_VALUES 1 UWORD COLUMN_DIR DIRECT /end RECORD_LAYOUT
/begin COMPU_METHOD CU_CCSFLTSEQCHGREADYVSTOCMAX_C "Conversion method for CcsFltSeqChgReadyVstoCmax_C" RAT_FUNC "%10.0" "1" COEFFS 0.000000 1.000000 -0.000000 0.000000 0.000000 1.000000 /end COMPU_METHOD
/* Scalar calibration for DDE 'CcsFltSeqChgReadyVstoLim_C'. */
/begin CHARACTERISTIC CcsFltSeqChgReadyVstoLim_C "Threshold Limit for setting fault flag for V2G Performance (Sequence) Timeout Charge Ready V2G MESSAGE RECEIVE SEQUENCE TIMEOUT in CcsFltSeqWrd" VALUE 0x700173ec RL_CCSFLTSEQCHGREADYVSTOLIM_C 1000000.000000 CU_CCSFLTSEQCHGREADYVSTOLIM_C 0.000000 1000000.000000 BYTE_ORDER MSB_LAST /end CHARACTERISTIC
/begin RECORD_LAYOUT RL_CCSFLTSEQCHGREADYVSTOLIM_C FNC_VALUES 1 FLOAT32_IEEE COLUMN_DIR DIRECT /end RECORD_LAYOUT
/begin COMPU_METHOD CU_CCSFLTSEQCHGREADYVSTOLIM_C "Conversion method for CcsFltSeqChgReadyVstoLim_C" RAT_FUNC "%10.0" "s" COEFFS 0.000000 1.000000 -0.000000 0.000000 0.000000 1.000000 /end COMPU_METHOD
/* Scalar calibration for DDE 'CcsFltSeqCommSetupVstoCmax_C'. */
/begin CHARACTERISTIC CcsFltSeqCommSetupVstoCmax_C "Leacky Bucket maximum value for counter that sets the fault flag for V2G Performance (Sequence) Timeout Communication Setup V2G MESSAGE RECEIVE SEQUENCE TIMEOUT in CcsFltSeqWrd" VALUE 0x7001741c RL_CCSFLTSEQCOMMSETUPVSTOCMAX_C 65535.000000 CU_CCSFLTSEQCOMMSETUPVSTOCMAX_C 0.000000 65535.000000 BYTE_ORDER MSB_LAST /end CHARACTERISTIC
/begin RECORD_LAYOUT RL_CCSFLTSEQCOMMSETUPVSTOCMAX_C FNC_VALUES 1 UWORD COLUMN_DIR DIRECT /end RECORD_LAYOUT
/begin COMPU_METHOD CU_CCSFLTSEQCOMMSETUPVSTOCMAX_C "Conversion method for CcsFltSeqCommSetupVstoCmax_C" RAT_FUNC "%10.0" "1" COEFFS 0.000000 1.000000 -0.000000 0.000000 0.000000 1.000000 /end COMPU_METHOD
/* Scalar calibration for DDE 'CcsFltSeqCommSetupVstoLim_C'. */
/begin CHARACTERISTIC CcsFltSeqCommSetupVstoLim_C "Threshold Limit for setting fault flag for V2G Performance (Sequence) Timeout Communication Setup V2G MESSAGE RECEIVE SEQUENCE TIMEOUT in CcsFltSeqWrd" VALUE 0x700175e0 RL_CCSFLTSEQCOMMSETUPVSTOLIM_C 1000000.000000 CU_CCSFLTSEQCOMMSETUPVSTOLIM_C 0.000000 1000000.000000 BYTE_ORDER MSB_LAST /end CHARACTERISTIC
/begin RECORD_LAYOUT RL_CCSFLTSEQCOMMSETUPVSTOLIM_C FNC_VALUES 1 FLOAT32_IEEE COLUMN_DIR DIRECT /end RECORD_LAYOUT
/begin COMPU_METHOD CU_CCSFLTSEQCOMMSETUPVSTOLIM_C "Conversion method for CcsFltSeqCommSetupVstoLim_C" RAT_FUNC "%10.0" "s" COEFFS 0.000000 1.000000 -0.000000 0.000000 0.000000 1.000000 /end COMPU_METHOD
/* Scalar calibration for DDE 'CcsFltSeqEn_C'. */
/begin CHARACTERISTIC CcsFltSeqEn_C "Each bit of this parameter, if set to 1, enables diagnostic of associated (with the same bit number) fault flag in CcsFltSeqWrd" VALUE 0x70017445 RL_CCSFLTSEQEN_C 255.000000 CU_CCSFLTSEQEN_C 0.000000 255.000000 BYTE_ORDER MSB_LAST /end CHARACTERISTIC
/begin RECORD_LAYOUT RL_CCSFLTSEQEN_C FNC_VALUES 1 UBYTE COLUMN_DIR DIRECT /end RECORD_LAYOUT
/begin COMPU_METHOD CU_CCSFLTSEQEN_C "Conversion method for CcsFltSeqEn_C" RAT_FUNC "%10.0" "1" COEFFS 0.000000 1.000000 -0.000000 0.000000 0.000000 1.000000 /end COMPU_METHOD
/* Scalar calibration for DDE 'CcsFltSeqIsolCheckVstoCmax_C'. */
/begin CHARACTERISTIC CcsFltSeqIsolCheckVstoCmax_C "Leacky Bucket maximum value for counter that sets the fault flag for V2G Performance (Sequence) Timeout Cable Check V2G MESSAGE RECEIVE SEQUENCE TIMEOUT in CcsFltSeqWrd" VALUE 0x700175d8 RL_CCSFLTSEQISOLCHECKVSTOCMAX_C 65535.000000 CU_CCSFLTSEQISOLCHECKVSTOCMAX_C 0.000000 65535.000000 BYTE_ORDER MSB_LAST /end CHARACTERISTIC
/begin RECORD_LAYOUT RL_CCSFLTSEQISOLCHECKVSTOCMAX_C FNC_VALUES 1 UWORD COLUMN_DIR DIRECT /end RECORD_LAYOUT
/begin COMPU_METHOD CU_CCSFLTSEQISOLCHECKVSTOCMAX_C "Conversion method for CcsFltSeqIsolCheckVstoCmax_C" RAT_FUNC "%10.0" "1" COEFFS 0.000000 1.000000 -0.000000 0.000000 0.000000 1.000000 /end COMPU_METHOD
/* Scalar calibration for DDE 'CcsFltSeqIsolCheckVstoLim_C'. */
/begin CHARACTERISTIC CcsFltSeqIsolCheckVstoLim_C "Threshold Limit for setting fault flag for V2G Performance (Sequence) Timeout Cable Check V2G MESSAGE RECEIVE SEQUENCE TIMEOUT in CcsFltSeqWrd" VALUE 0x700175cc RL_CCSFLTSEQISOLCHECKVSTOLIM_C 1000000.000000 CU_CCSFLTSEQISOLCHECKVSTOLIM_C 0.000000 1000000.000000 BYTE_ORDER MSB_LAST /end CHARACTERISTIC
/begin RECORD_LAYOUT RL_CCSFLTSEQISOLCHECKVSTOLIM_C FNC_VALUES 1 FLOAT32_IEEE COLUMN_DIR DIRECT /end RECORD_LAYOUT
/begin COMPU_METHOD CU_CCSFLTSEQISOLCHECKVSTOLIM_C "Conversion method for CcsFltSeqIsolCheckVstoLim_C" RAT_FUNC "%10.0" "s" COEFFS 0.000000 1.000000 -0.000000 0.000000 0.000000 1.000000 /end COMPU_METHOD
/* Scalar calibration for DDE 'CcsFltSeqIsolStopVstoCmax_C'. */
/begin CHARACTERISTIC CcsFltSeqIsolStopVstoCmax_C "Leacky Bucket maximum value for counter that sets the fault flag for Sequence Timeout EV Stops Isolation Check V2G MESSAGE RECEIVE SEQUENCE TIMEOUT in CcsFltSeqWrd" VALUE 0x70017442 RL_CCSFLTSEQISOLSTOPVSTOCMAX_C 65535.000000 CU_CCSFLTSEQISOLSTOPVSTOCMAX_C 0.000000 65535.000000 BYTE_ORDER MSB_LAST /end CHARACTERISTIC
/begin RECORD_LAYOUT RL_CCSFLTSEQISOLSTOPVSTOCMAX_C FNC_VALUES 1 UWORD COLUMN_DIR DIRECT /end RECORD_LAYOUT
/begin COMPU_METHOD CU_CCSFLTSEQISOLSTOPVSTOCMAX_C "Conversion method for CcsFltSeqIsolStopVstoCmax_C" RAT_FUNC "%10.0" "1" COEFFS 0.000000 1.000000 -0.000000 0.000000 0.000000 1.000000 /end COMPU_METHOD
/* Scalar calibration for DDE 'CcsFltSeqIsolStopVstoLim_C'. */
/begin CHARACTERISTIC CcsFltSeqIsolStopVstoLim_C "Threshold Limit for setting fault flag for Sequence Timeout EV Stops Isolation Check V2G MESSAGE RECEIVE SEQUENCE TIMEOUT in CcsFltSeqWrd" VALUE 0x7001743c RL_CCSFLTSEQISOLSTOPVSTOLIM_C 1000000.000000 CU_CCSFLTSEQISOLSTOPVSTOLIM_C 0.000000 1000000.000000 BYTE_ORDER MSB_LAST /end CHARACTERISTIC
/begin RECORD_LAYOUT RL_CCSFLTSEQISOLSTOPVSTOLIM_C FNC_VALUES 1 FLOAT32_IEEE COLUMN_DIR DIRECT /end RECORD_LAYOUT
/begin COMPU_METHOD CU_CCSFLTSEQISOLSTOPVSTOLIM_C "Conversion method for CcsFltSeqIsolStopVstoLim_C" RAT_FUNC "%10.0" "s" COEFFS 0.000000 1.000000 -0.000000 0.000000 0.000000 1.000000 /end COMPU_METHOD
/* Scalar calibration for DDE 'CcsFltSeqLockEnVstoCmax_C'. */
/begin CHARACTERISTIC CcsFltSeqLockEnVstoCmax_C "Leacky Bucket maximum value for counter that sets the fault flag for Sequence Timeout Enabling Charge Lock V2G MESSAGE RECEIVE SEQUENCE TIMEOUT in CcsFltSeqWrd" VALUE 0x70017430 RL_CCSFLTSEQLOCKENVSTOCMAX_C 65535.000000 CU_CCSFLTSEQLOCKENVSTOCMAX_C 0.000000 65535.000000 BYTE_ORDER MSB_LAST /end CHARACTERISTIC
/begin RECORD_LAYOUT RL_CCSFLTSEQLOCKENVSTOCMAX_C FNC_VALUES 1 UWORD COLUMN_DIR DIRECT /end RECORD_LAYOUT
/begin COMPU_METHOD CU_CCSFLTSEQLOCKENVSTOCMAX_C "Conversion method for CcsFltSeqLockEnVstoCmax_C" RAT_FUNC "%10.0" "1" COEFFS 0.000000 1.000000 -0.000000 0.000000 0.000000 1.000000 /end COMPU_METHOD
/* Scalar calibration for DDE 'CcsFltSeqLockEnVstoLim_C'. */
/begin CHARACTERISTIC CcsFltSeqLockEnVstoLim_C "Threshold Limit for setting fault flag for Sequence Timeout Enabling Charge Lock V2G MESSAGE RECEIVE SEQUENCE TIMEOUT in CcsFltSeqWrd" VALUE 0x70017424 RL_CCSFLTSEQLOCKENVSTOLIM_C 1000000.000000 CU_CCSFLTSEQLOCKENVSTOLIM_C 0.000000 1000000.000000 BYTE_ORDER MSB_LAST /end CHARACTERISTIC
/begin RECORD_LAYOUT RL_CCSFLTSEQLOCKENVSTOLIM_C FNC_VALUES 1 FLOAT32_IEEE COLUMN_DIR DIRECT /end RECORD_LAYOUT
/begin COMPU_METHOD CU_CCSFLTSEQLOCKENVSTOLIM_C "Conversion method for CcsFltSeqLockEnVstoLim_C" RAT_FUNC "%10.0" "s" COEFFS 0.000000 1.000000 -0.000000 0.000000 0.000000 1.000000 /end COMPU_METHOD
/* Scalar calibration for DDE 'CcsFltSeqPrechgVstoCmax_C'. */
/begin CHARACTERISTIC CcsFltSeqPrechgVstoCmax_C "Leacky Bucket maximum value for counter that sets the fault flag for V2G Performance (Sequence) Timeout Precharge V2G MESSAGE RECEIVE SEQUENCE TIMEOUT in CcsFltSeqWrd" VALUE 0x700175ac RL_CCSFLTSEQPRECHGVSTOCMAX_C 65535.000000 CU_CCSFLTSEQPRECHGVSTOCMAX_C 0.000000 65535.000000 BYTE_ORDER MSB_LAST /end CHARACTERISTIC
/begin RECORD_LAYOUT RL_CCSFLTSEQPRECHGVSTOCMAX_C FNC_VALUES 1 UWORD COLUMN_DIR DIRECT /end RECORD_LAYOUT
/begin COMPU_METHOD CU_CCSFLTSEQPRECHGVSTOCMAX_C "Conversion method for CcsFltSeqPrechgVstoCmax_C" RAT_FUNC "%10.0" "1" COEFFS 0.000000 1.000000 -0.000000 0.000000 0.000000 1.000000 /end COMPU_METHOD
/* Scalar calibration for DDE 'CcsFltSeqPrechgVstoLim_C'. */
/begin CHARACTERISTIC CcsFltSeqPrechgVstoLim_C "Threshold Limit for setting fault flag for V2G Performance (Sequence) Timeout Precharge V2G MESSAGE RECEIVE SEQUENCE TIMEOUT in CcsFltSeqWrd" VALUE 0x700175a8 RL_CCSFLTSEQPRECHGVSTOLIM_C 1000000.000000 CU_CCSFLTSEQPRECHGVSTOLIM_C 0.000000 1000000.000000 BYTE_ORDER MSB_LAST /end CHARACTERISTIC
/begin RECORD_LAYOUT RL_CCSFLTSEQPRECHGVSTOLIM_C FNC_VALUES 1 FLOAT32_IEEE COLUMN_DIR DIRECT /end RECORD_LAYOUT
/begin COMPU_METHOD CU_CCSFLTSEQPRECHGVSTOLIM_C "Conversion method for CcsFltSeqPrechgVstoLim_C" RAT_FUNC "%10.0" "s" COEFFS 0.000000 1.000000 -0.000000 0.000000 0.000000 1.000000 /end COMPU_METHOD
/* Scalar calibration for DDE 'CcsFltSeqRlyCloseVstoCmax_C'. */
/begin CHARACTERISTIC CcsFltSeqRlyCloseVstoCmax_C "Leacky Bucket maximum value for counter that sets the fault flag for Sequence Timeout Closing Relay(s) V2G MESSAGE RECEIVE SEQUENCE TIMEOUT in CcsFltSeqWrd" VALUE 0x70017616 RL_CCSFLTSEQRLYCLOSEVSTOCMAX_C 65535.000000 CU_CCSFLTSEQRLYCLOSEVSTOCMAX_C 0.000000 65535.000000 BYTE_ORDER MSB_LAST /end CHARACTERISTIC
/begin RECORD_LAYOUT RL_CCSFLTSEQRLYCLOSEVSTOCMAX_C FNC_VALUES 1 UWORD COLUMN_DIR DIRECT /end RECORD_LAYOUT
/begin COMPU_METHOD CU_CCSFLTSEQRLYCLOSEVSTOCMAX_C "Conversion method for CcsFltSeqRlyCloseVstoCmax_C" RAT_FUNC "%10.0" "1" COEFFS 0.000000 1.000000 -0.000000 0.000000 0.000000 1.000000 /end COMPU_METHOD
/* Scalar calibration for DDE 'CcsFltSeqRlyCloseVstoLim_C'. */
/begin CHARACTERISTIC CcsFltSeqRlyCloseVstoLim_C "Threshold Limit for setting fault flag for Sequence Timeout Closing Relay(s) V2G MESSAGE RECEIVE SEQUENCE TIMEOUT in CcsFltSeqWrd" VALUE 0x70017434 RL_CCSFLTSEQRLYCLOSEVSTOLIM_C 1000000.000000 CU_CCSFLTSEQRLYCLOSEVSTOLIM_C 0.000000 1000000.000000 BYTE_ORDER MSB_LAST /end CHARACTERISTIC
/begin RECORD_LAYOUT RL_CCSFLTSEQRLYCLOSEVSTOLIM_C FNC_VALUES 1 FLOAT32_IEEE COLUMN_DIR DIRECT /end RECORD_LAYOUT
/begin COMPU_METHOD CU_CCSFLTSEQRLYCLOSEVSTOLIM_C "Conversion method for CcsFltSeqRlyCloseVstoLim_C" RAT_FUNC "%10.0" "s" COEFFS 0.000000 1.000000 -0.000000 0.000000 0.000000 1.000000 /end COMPU_METHOD
/* Scalar calibration for DDE 'CcsFltStopFltResponseOf_C'. */
/begin CHARACTERISTIC CcsFltStopFltResponseOf_C "Enables overriding the state machine fault reaction" VALUE 0x700184f6 RL_CCSFLTSTOPFLTRESPONSEOF_C 1.000000 CU_CCSFLTSTOPFLTRESPONSEOF_C 0.000000 1.000000 BYTE_ORDER MSB_LAST /end CHARACTERISTIC
/begin RECORD_LAYOUT RL_CCSFLTSTOPFLTRESPONSEOF_C FNC_VALUES 1 UBYTE COLUMN_DIR DIRECT /end RECORD_LAYOUT
/begin COMPU_METHOD CU_CCSFLTSTOPFLTRESPONSEOF_C "Conversion method for CcsFltStopFltResponseOf_C" RAT_FUNC "%10.0" "b" COEFFS 0.000000 1.000000 -0.000000 0.000000 0.000000 1.000000 /end COMPU_METHOD
/* Scalar calibration for DDE 'CcsFltStopFltResponseOv_C'. */
/begin CHARACTERISTIC CcsFltStopFltResponseOv_C "Override value for the state machine fault reaction" VALUE 0x700196a8 RL_CCSFLTSTOPFLTRESPONSEOV_C 4294967295.000000 CU_CCSFLTSTOPFLTRESPONSEOV_C -2147483648.000000 2147483647.000000 BYTE_ORDER MSB_LAST /end CHARACTERISTIC
/begin RECORD_LAYOUT RL_CCSFLTSTOPFLTRESPONSEOV_C FNC_VALUES 1 SLONG COLUMN_DIR DIRECT /end RECORD_LAYOUT
/begin COMPU_METHOD CU_CCSFLTSTOPFLTRESPONSEOV_C "Conversion method for CcsFltStopFltResponseOv_C" TAB_VERB "%12.0" "enum" COMPU_TAB_REF CT_CCSFLTSTOPFLTRESPONSEOV_C /end COMPU_METHOD
/begin COMPU_VTAB CT_CCSFLTSTOPFLTRESPONSEOV_C "Conversion method for CcsFltStopFltResponseOv_C" TAB_VERB 4 0 "NO_FAULT_CONTINUE" 1 "NO_FAULT_NORMAL_STOP" 2 "FAULT_NONCRITICAL_STOP" 3 "FAULT_EMERGENCY_STOP" /end COMPU_VTAB
/* Scalar calibration for DDE 'CcsFltV2gMsgAuthVmto_C'. */
/begin CHARACTERISTIC CcsFltV2gMsgAuthVmto_C "Timeout Threshold for receiving the expected V2G response message ContractAuthenticationRes" VALUE 0x70017490 RL_CCSFLTV2GMSGAUTHVMTO_C 1000000.000000 CU_CCSFLTV2GMSGAUTHVMTO_C 0.000000 1000000.000000 BYTE_ORDER MSB_LAST /end CHARACTERISTIC
/begin RECORD_LAYOUT RL_CCSFLTV2GMSGAUTHVMTO_C FNC_VALUES 1 FLOAT32_IEEE COLUMN_DIR DIRECT /end RECORD_LAYOUT
/begin COMPU_METHOD CU_CCSFLTV2GMSGAUTHVMTO_C "Conversion method for CcsFltV2gMsgAuthVmto_C" RAT_FUNC "%10.0" "s" COEFFS 0.000000 1.000000 -0.000000 0.000000 0.000000 1.000000 /end COMPU_METHOD
/* Scalar calibration for DDE 'CcsFltV2gMsgBptCtrlVmto_C'. */
/begin CHARACTERISTIC CcsFltV2gMsgBptCtrlVmto_C "Timeout Threshold for receiving the expected V2G response message BiDirectional Control Response." VALUE 0x700174fc RL_CCSFLTV2GMSGBPTCTRLVMTO_C 1000000.000000 CU_CCSFLTV2GMSGBPTCTRLVMTO_C 0.000000 1000000.000000 BYTE_ORDER MSB_LAST /end CHARACTERISTIC
/begin RECORD_LAYOUT RL_CCSFLTV2GMSGBPTCTRLVMTO_C FNC_VALUES 1 FLOAT32_IEEE COLUMN_DIR DIRECT /end RECORD_LAYOUT
/begin COMPU_METHOD CU_CCSFLTV2GMSGBPTCTRLVMTO_C "Conversion method for CcsFltV2gMsgBptCtrlVmto_C" RAT_FUNC "%10.0" "s" COEFFS 0.000000 1.000000 -0.000000 0.000000 0.000000 1.000000 /end COMPU_METHOD
/* Scalar calibration for DDE 'CcsFltV2gMsgCblChkVmto_C'. */
/begin CHARACTERISTIC CcsFltV2gMsgCblChkVmto_C "Timeout Threshold for receiving the expected V2G response message CableCheckReq" VALUE 0x700174a0 RL_CCSFLTV2GMSGCBLCHKVMTO_C 1000000.000000 CU_CCSFLTV2GMSGCBLCHKVMTO_C 0.000000 1000000.000000 BYTE_ORDER MSB_LAST /end CHARACTERISTIC
/begin RECORD_LAYOUT RL_CCSFLTV2GMSGCBLCHKVMTO_C FNC_VALUES 1 FLOAT32_IEEE COLUMN_DIR DIRECT /end RECORD_LAYOUT
/begin COMPU_METHOD CU_CCSFLTV2GMSGCBLCHKVMTO_C "Conversion method for CcsFltV2gMsgCblChkVmto_C" RAT_FUNC "%10.0" "s" COEFFS 0.000000 1.000000 -0.000000 0.000000 0.000000 1.000000 /end COMPU_METHOD
/* Scalar measurable for DDE 'V2gSupPrtclSelected'. */
/begin MEASUREMENT V2gSupPrtclSelected "Indicates the V2G protcol that the SECC has determined to use for this charging session" UBYTE CU_V2GSUPPRTCLSELECTED 1 100 0.0 1.0 ECU_ADDRESS 0x70017f8e BYTE_ORDER MSB_LAST /end MEASUREMENT
/begin COMPU_METHOD CU_V2GSUPPRTCLSELECTED "Conversion method for V2gSupPrtclSelected" RAT_FUNC "%10.0" "b" COEFFS 0.000000 1.000000 -0.000000 0.000000 0.000000 1.000000 /end COMPU_METHOD
/* Scalar measurable for DDE 'V2gTxBptParamEnable'. */
/begin MEASUREMENT V2gTxBptParamEnable "If EV bidirectional parameter is enabled by the EV" UBYTE CU_V2GTXBPTPARAMENABLE 1 100 0.0 1.0 ECU_ADDRESS 0x7001826c BYTE_ORDER MSB_LAST /end MEASUREMENT
/begin COMPU_METHOD CU_V2GTXBPTPARAMENABLE "Conversion method for V2gTxBptParamEnable" RAT_FUNC "%10.0" "b" COEFFS 0.000000 1.000000 -0.000000 0.000000 0.000000 1.000000 /end COMPU_METHOD
/* Scalar measurable for DDE 'V2gTxBulkChargingComplete'. */
/begin MEASUREMENT V2gTxBulkChargingComplete "If set to TRUE, the vehicle indicates that bulk charge is complete." UBYTE CU_V2GTXBULKCHARGINGCOMPLETE 1 100 0.0 1.0 ECU_ADDRESS 0x700182fc BYTE_ORDER MSB_LAST /end MEASUREMENT
/begin COMPU_METHOD CU_V2GTXBULKCHARGINGCOMPLETE "Conversion method for V2gTxBulkChargingComplete" RAT_FUNC "%10.0" "b" COEFFS 0.000000 1.000000 -0.000000 0.000000 0.000000 1.000000 /end COMPU_METHOD
/* Scalar measurable for DDE 'V2gTxBulkSoc'. */
/begin MEASUREMENT V2gTxBulkSoc "State of charge at which the vehicle considers a fast charge process to be complete" FLOAT32_IEEE CU_V2GTXBULKSOC 1 100 0.0 100.0 ECU_ADDRESS 0x70017ea4 BYTE_ORDER MSB_LAST /end MEASUREMENT
/begin COMPU_METHOD CU_V2GTXBULKSOC "Conversion method for V2gTxBulkSoc" RAT_FUNC "%10.0" "%" COEFFS 0.000000 1.000000 -0.000000 0.000000 0.000000 1.000000 /end COMPU_METHOD
/* Scalar measurable for DDE 'V2gTxChargeProgress'. */
/begin MEASUREMENT V2gTxChargeProgress "Charge Progress signal determined for ISO15118 Power Delivery Req message." SLONG CU_V2GTXCHARGEPROGRESS 1 100 -2147483648.0 2147483647.0 ECU_ADDRESS 0x70017e98 BYTE_ORDER MSB_LAST /end MEASUREMENT
/begin COMPU_METHOD CU_V2GTXCHARGEPROGRESS "Conversion method for V2gTxChargeProgress" TAB_VERB "%12.0" "1" COMPU_TAB_REF CT_V2GTXCHARGEPROGRESS /end COMPU_METHOD
/begin COMPU_VTAB CT_V2GTXCHARGEPROGRESS "Conversion method for V2gTxChargeProgress" TAB_VERB 3 0 "START" 1 "STOP" 2 "RENEGOTIATE" /end COMPU_VTAB
/* Scalar measurable for DDE 'V2gTxChargingComplete'. */
/begin MEASUREMENT V2gTxChargingComplete "If set to TRUE, the vehicle indicates that full charge is complete." UBYTE CU_V2GTXCHARGINGCOMPLETE 1 100 0.0 1.0 ECU_ADDRESS 0x70017ee8 BYTE_ORDER MSB_LAST /end MEASUREMENT
/begin COMPU_METHOD CU_V2GTXCHARGINGCOMPLETE "Conversion method for V2gTxChargingComplete" RAT_FUNC "%10.0" "b" COEFFS 0.000000 1.000000 -0.000000 0.000000 0.000000 1.000000 /end COMPU_METHOD
/* Scalar measurable for DDE 'V2gTxDcChgParamEnable'. */
/begin MEASUREMENT V2gTxDcChgParamEnable "If the Charge parmeter is enabled by the EV" UBYTE CU_V2GTXDCCHGPARAMENABLE 1 100 0.0 1.0 ECU_ADDRESS 0x70017dfc BYTE_ORDER MSB_LAST /end MEASUREMENT
/begin COMPU_METHOD CU_V2GTXDCCHGPARAMENABLE "Conversion method for V2gTxDcChgParamEnable" RAT_FUNC "%10.0" "b" COEFFS 0.000000 1.000000 -0.000000 0.000000 0.000000 1.000000 /end COMPU_METHOD
/* Scalar measurable for DDE 'V2gTxEvCrntMaxLim'. */
/begin MEASUREMENT V2gTxEvCrntMaxLim "Maximum current supported by the vehicle." FLOAT32_IEEE CU_V2GTXEVCRNTMAXLIM 1 100 0.0 196605.0 ECU_ADDRESS 0x7001844c BYTE_ORDER MSB_LAST /end MEASUREMENT
/begin COMPU_METHOD CU_V2GTXEVCRNTMAXLIM "Conversion method for V2gTxEvCrntMaxLim" RAT_FUNC "%10.0" "A" COEFFS 0.000000 1.000000 -0.000000 0.000000 0.000000 1.000000 /end COMPU_METHOD
/* Scalar measurable for DDE 'V2gTxEvCrntMinLim'. */
/begin MEASUREMENT V2gTxEvCrntMinLim "Minimum current supported by the vehicle." FLOAT32_IEEE CU_V2GTXEVCRNTMINLIM 1 100 0.0 196605.0 ECU_ADDRESS 0x70017dec BYTE_ORDER MSB_LAST /end MEASUREMENT
/begin COMPU_METHOD CU_V2GTXEVCRNTMINLIM "Conversion method for V2gTxEvCrntMinLim" RAT_FUNC "%10.0" "A" COEFFS 0.000000 1.000000 -0.000000 0.000000 0.000000 1.000000 /end COMPU_METHOD
/* Scalar measurable for DDE 'V2gTxEvDisChgCrntMaxLim'. */
/begin MEASUREMENT V2gTxEvDisChgCrntMaxLim "Maximum discharge current supported by the EV" FLOAT32_IEEE CU_V2GTXEVDISCHGCRNTMAXLIM 1 100 0.0 196605.0 ECU_ADDRESS 0x70017cec BYTE_ORDER MSB_LAST /end MEASUREMENT
/begin COMPU_METHOD CU_V2GTXEVDISCHGCRNTMAXLIM "Conversion method for V2gTxEvDisChgCrntMaxLim" RAT_FUNC "%10.0" "A" COEFFS 0.000000 1.000000 -0.000000 0.000000 0.000000 1.000000 /end COMPU_METHOD
/* Scalar measurable for DDE 'V2gTxEvDisChgCrntMinLim'. */
/begin MEASUREMENT V2gTxEvDisChgCrntMinLim "Minimum discharge current supported by the EV" FLOAT32_IEEE CU_V2GTXEVDISCHGCRNTMINLIM 1 100 0.0 196605.0 ECU_ADDRESS 0x70017ed0 BYTE_ORDER MSB_LAST /end MEASUREMENT
/begin COMPU_METHOD CU_V2GTXEVDISCHGCRNTMINLIM "Conversion method for V2gTxEvDisChgCrntMinLim" RAT_FUNC "%10.0" "A" COEFFS 0.000000 1.000000 -0.000000 0.000000 0.000000 1.000000 /end COMPU_METHOD
/* Scalar measurable for DDE 'V2gTxEvDisChgPwrMaxLim'. */
/begin MEASUREMENT V2gTxEvDisChgPwrMaxLim "Maximum discharge power supported by the EV" FLOAT32_IEEE CU_V2GTXEVDISCHGPWRMAXLIM 1 100 0.0 196605.0 ECU_ADDRESS 0x700182a0 BYTE_ORDER MSB_LAST /end MEASUREMENT
/begin COMPU_METHOD CU_V2GTXEVDISCHGPWRMAXLIM "Conversion method for V2gTxEvDisChgPwrMaxLim" RAT_FUNC "%10.0" "A" COEFFS 0.000000 1.000000 -0.000000 0.000000 0.000000 1.000000 /end COMPU_METHOD
/* Scalar measurable for DDE 'V2gTxEvDisChgPwrMinLim'. */
/begin MEASUREMENT V2gTxEvDisChgPwrMinLim "Minimum discharge power supported by the EV" FLOAT32_IEEE CU_V2GTXEVDISCHGPWRMINLIM 1 100 0.0 196605.0 ECU_ADDRESS 0x70017e04 BYTE_ORDER MSB_LAST /end MEASUREMENT
/begin COMPU_METHOD CU_V2GTXEVDISCHGPWRMINLIM "Conversion method for V2gTxEvDisChgPwrMinLim" RAT_FUNC "%10.0" "A" COEFFS 0.000000 1.000000 -0.000000 0.000000 0.000000 1.000000 /end COMPU_METHOD
/* Scalar measurable for DDE 'V2gTxEvEgyCapacity'. */
/begin MEASUREMENT V2gTxEvEgyCapacity "Maximum energy capacity supported by the vehicle" FLOAT32_IEEE CU_V2GTXEVEGYCAPACITY 1 100 0.0 196605.0 ECU_ADDRESS 0x70017e64 BYTE_ORDER MSB_LAST /end MEASUREMENT
/begin COMPU_METHOD CU_V2GTXEVEGYCAPACITY "Conversion method for V2gTxEvEgyCapacity" RAT_FUNC "%10.0" "Wh" COEFFS 0.000000 1.000000 -0.000000 0.000000 0.000000 1.000000 /end COMPU_METHOD
/* Scalar measurable for DDE 'V2gTxEvEgyReqAmount'. */
/begin MEASUREMENT V2gTxEvEgyReqAmount "Amount of energy requested by the vehicle" FLOAT32_IEEE CU_V2GTXEVEGYREQAMOUNT 1 100 0.0 196605.0 ECU_ADDRESS 0x7001824c BYTE_ORDER MSB_LAST /end MEASUREMENT
/begin COMPU_METHOD CU_V2GTXEVEGYREQAMOUNT "Conversion method for V2gTxEvEgyReqAmount" RAT_FUNC "%10.0" "Wh" COEFFS 0.000000 1.000000 -0.000000 0.000000 0.000000 1.000000 /end COMPU_METHOD
/* Scalar measurable for DDE 'V2gTxEvErrorCode'. */
/begin MEASUREMENT V2gTxEvErrorCode "Indicates the EV internal status" SLONG CU_V2GTXEVERRORCODE 1 100 -2147483648.0 2147483647.0 ECU_ADDRESS 0x70018154 BYTE_ORDER MSB_LAST /end MEASUREMENT
/begin COMPU_METHOD CU_V2GTXEVERRORCODE "Conversion method for V2gTxEvErrorCode" TAB_VERB "%12.0" "enum" COMPU_TAB_REF CT_V2GTXEVERRORCODE /end COMPU_METHOD
/begin COMPU_VTAB CT_V2GTXEVERRORCODE "Conversion method for V2gTxEvErrorCode" TAB_VERB 12 0 "EVERRORCODE_NO_ERROR" 1 "FAILED_RESS_TEMP_INHIBIT" 2 "FAILED_EV_SHIFT_POSITION" 3 "FAILED_CHARGER_CONNECTOR_LOCK_FLT" 4 "FAILED_RESS_MALFUNCTION" 5 "FAILED_CHARGE_CRNT_DIFFERENTIAL" 6 "FAILED_CHARGE_VOLT_OOR" 7 "Reserved_A_C1" 8 "Reserved_A_C2" 9 "Reserved_A_C3" 10 "FAILED_CHARGE_SYSTEM_INCOMPATIBLE" 11 "EVERRORCODE_NO_DATA" /end COMPU_VTAB
/* Scalar measurable for DDE 'V2gTxEvMaxEgyReq'. */
/begin MEASUREMENT V2gTxEvMaxEgyReq "Maximum energy energy level accepted by the EV at any given time during the energy transfer loop" FLOAT32_IEEE CU_V2GTXEVMAXEGYREQ 1 100 0.0 196605.0 ECU_ADDRESS 0x70018240 BYTE_ORDER MSB_LAST /end MEASUREMENT
/begin COMPU_METHOD CU_V2GTXEVMAXEGYREQ "Conversion method for V2gTxEvMaxEgyReq" RAT_FUNC "%10.0" "Wh" COEFFS 0.000000 1.000000 -0.000000 0.000000 0.000000 1.000000 /end COMPU_METHOD
/* Scalar measurable for DDE 'V2gTxEvMinEgyReq'. */
/begin MEASUREMENT V2gTxEvMinEgyReq "Minimum energy requested by the EV at any given time during the energy transfer loop" FLOAT32_IEEE CU_V2GTXEVMINEGYREQ 1 100 0.0 196605.0 ECU_ADDRESS 0x70018004 BYTE_ORDER MSB_LAST /end MEASUREMENT
/begin COMPU_METHOD CU_V2GTXEVMINEGYREQ "Conversion method for V2gTxEvMinEgyReq" RAT_FUNC "%10.0" "Wh" COEFFS 0.000000 1.000000 -0.000000 0.000000 0.000000 1.000000 /end COMPU_METHOD
/* Scalar measurable for DDE 'V2gTxEvOperation'. */
/begin MEASUREMENT V2gTxEvOperation "If set to 1, the vehicle indicates that EV is operating in Charge Mode, 0 indicates BPT Mode" UBYTE CU_V2GTXEVOPERATION 1 100 0.0 1.0 ECU_ADDRESS 0x70017fe4 BYTE_ORDER MSB_LAST /end MEASUREMENT
/begin COMPU_METHOD CU_V2GTXEVOPERATION "Conversion method for V2gTxEvOperation" RAT_FUNC "%10.0" "1" COEFFS 0.000000 1.000000 -0.000000 0.000000 0.000000 1.000000 /end COMPU_METHOD
/* Scalar measurable for DDE 'V2gTxEvOperationEn'. */
/begin MEASUREMENT V2gTxEvOperationEn "Enable of the EV Operation signal" UBYTE CU_V2GTXEVOPERATIONEN 1 100 0.0 1.0 ECU_ADDRESS 0x70017cb0 BYTE_ORDER MSB_LAST /end MEASUREMENT
/begin COMPU_METHOD CU_V2GTXEVOPERATIONEN "Conversion method for V2gTxEvOperationEn" RAT_FUNC "%10.0" "b" COEFFS 0.000000 1.000000 -0.000000 0.000000 0.000000 1.000000 /end COMPU_METHOD
/* Scalar measurable for DDE 'V2gTxEvPwrMaxLim'. */
/begin MEASUREMENT V2gTxEvPwrMaxLim "Maximum power supported by the vehicle." FLOAT32_IEEE CU_V2GTXEVPWRMAXLIM 1 100 0.0 196605.0 ECU_ADDRESS 0x70018454 BYTE_ORDER MSB_LAST /end MEASUREMENT
/begin COMPU_METHOD CU_V2GTXEVPWRMAXLIM "Conversion method for V2gTxEvPwrMaxLim" RAT_FUNC "%10.0" "W" COEFFS 0.000000 1.000000 -0.000000 0.000000 0.000000 1.000000 /end COMPU_METHOD
/* Scalar measurable for DDE 'V2gTxEvPwrMinLim'. */
/begin MEASUREMENT V2gTxEvPwrMinLim "Minimum power supported by the vehicle." FLOAT32_IEEE CU_V2GTXEVPWRMINLIM 1 100 0.0 196605.0 ECU_ADDRESS 0x700184b4 BYTE_ORDER MSB_LAST /end MEASUREMENT
/begin COMPU_METHOD CU_V2GTXEVPWRMINLIM "Conversion method for V2gTxEvPwrMinLim" RAT_FUNC "%10.0" "W" COEFFS 0.000000 1.000000 -0.000000 0.000000 0.000000 1.000000 /end COMPU_METHOD
/* Scalar measurable for DDE 'V2gTxEvReady'. */
/begin MEASUREMENT V2gTxEvReady "If set to TRUE, the vehicle is ready to charge." UBYTE CU_V2GTXEVREADY 1 100 0.0 1.0 ECU_ADDRESS 0x7001828c BYTE_ORDER MSB_LAST /end MEASUREMENT
/begin COMPU_METHOD CU_V2GTXEVREADY "Conversion method for V2gTxEvReady" RAT_FUNC "%10.0" "b" COEFFS 0.000000 1.000000 -0.000000 0.000000 0.000000 1.000000 /end COMPU_METHOD
/* Scalar measurable for DDE 'V2gTxEvReqEgyTransferType'. */
/begin MEASUREMENT V2gTxEvReqEgyTransferType "final V2G value of the energy transfer type for charging to be sent to EVSE" UBYTE CU_V2GTXEVREQEGYTRANSFERTYPE 1 100 0.0 255.0 ECU_ADDRESS 0x70017c2c BYTE_ORDER MSB_LAST /end MEASUREMENT
/begin COMPU_METHOD CU_V2GTXEVREQEGYTRANSFERTYPE "Conversion method for V2gTxEvReqEgyTransferType" RAT_FUNC "%10.0" "1" COEFFS 0.000000 1.000000 -0.000000 0.000000 0.000000 1.000000 /end COMPU_METHOD
/* Scalar measurable for DDE 'V2gTxEvRessCondition'. */
/begin MEASUREMENT V2gTxEvRessCondition "The vehicle is using energy from the DC charger to condition the RESS to a target temperature" UBYTE CU_V2GTXEVRESSCONDITION 1 100 0.0 1.0 ECU_ADDRESS 0x70018308 BYTE_ORDER MSB_LAST /end MEASUREMENT
/begin COMPU_METHOD CU_V2GTXEVRESSCONDITION "Conversion method for V2gTxEvRessCondition" RAT_FUNC "%10.0" "b" COEFFS 0.000000 1.000000 -0.000000 0.000000 0.000000 1.000000 /end COMPU_METHOD
/* Scalar measurable for DDE 'V2gTxEvRessSoc'. */
/begin MEASUREMENT V2gTxEvRessSoc "State of charge of the vehicle’s battery" FLOAT32_IEEE CU_V2GTXEVRESSSOC 1 100 0.0 100.0 ECU_ADDRESS 0x70018260 BYTE_ORDER MSB_LAST /end MEASUREMENT
/begin COMPU_METHOD CU_V2GTXEVRESSSOC "Conversion method for V2gTxEvRessSoc" RAT_FUNC "%10.0" "%" COEFFS 0.000000 1.000000 -0.000000 0.000000 0.000000 1.000000 /end COMPU_METHOD
/* Scalar measurable for DDE 'V2gTxEvTargetCrnt'. */
/begin MEASUREMENT V2gTxEvTargetCrnt "Instantaneous current requested by the vehicle" FLOAT32_IEEE CU_V2GTXEVTARGETCRNT 1 100 0.0 196605.0 ECU_ADDRESS 0x70017fd0 BYTE_ORDER MSB_LAST /end MEASUREMENT
/begin COMPU_METHOD CU_V2GTXEVTARGETCRNT "Conversion method for V2gTxEvTargetCrnt" RAT_FUNC "%10.0" "A" COEFFS 0.000000 1.000000 -0.000000 0.000000 0.000000 1.000000 /end COMPU_METHOD
/* Scalar measurable for DDE 'V2gTxEvTargetVolt'. */
/begin MEASUREMENT V2gTxEvTargetVolt "Target Voltage requested by EV" FLOAT32_IEEE CU_V2GTXEVTARGETVOLT 1 100 0.0 196605.0 ECU_ADDRESS 0x70018244 BYTE_ORDER MSB_LAST /end MEASUREMENT
/begin COMPU_METHOD CU_V2GTXEVTARGETVOLT "Conversion method for V2gTxEvTargetVolt" RAT_FUNC "%10.0" "V" COEFFS 0.000000 1.000000 -0.000000 0.000000 0.000000 1.000000 /end COMPU_METHOD
/* Scalar measurable for DDE 'V2gTxEvVoltMaxLim'. */
/begin MEASUREMENT V2gTxEvVoltMaxLim "Maximum voltage supported by the vehicle." FLOAT32_IEEE CU_V2GTXEVVOLTMAXLIM 1 100 0.0 196605.0 ECU_ADDRESS 0x70017c28 BYTE_ORDER MSB_LAST /end MEASUREMENT
/begin COMPU_METHOD CU_V2GTXEVVOLTMAXLIM "Conversion method for V2gTxEvVoltMaxLim" RAT_FUNC "%10.0" "V" COEFFS 0.000000 1.000000 -0.000000 0.000000 0.000000 1.000000 /end COMPU_METHOD
/* Scalar measurable for DDE 'V2gTxEvVoltMinLim'. */
/begin MEASUREMENT V2gTxEvVoltMinLim "Minimum voltage supported by the vehicle." FLOAT32_IEEE CU_V2GTXEVVOLTMINLIM 1 100 0.0 196605.0 ECU_ADDRESS 0x70017f9c BYTE_ORDER MSB_LAST /end MEASUREMENT
/begin COMPU_METHOD CU_V2GTXEVVOLTMINLIM "Conversion method for V2gTxEvVoltMinLim" RAT_FUNC "%10.0" "V" COEFFS 0.000000 1.000000 -0.000000 0.000000 0.000000 1.000000 /end COMPU_METHOD
/* Scalar measurable for DDE 'V2gTxFullSoc'. */
/begin MEASUREMENT V2gTxFullSoc "State of charge at which the vehicle considers the battery fully charged." FLOAT32_IEEE CU_V2GTXFULLSOC 1 100 0.0 100.0 ECU_ADDRESS 0x70018144 BYTE_ORDER MSB_LAST /end MEASUREMENT
/begin COMPU_METHOD CU_V2GTXFULLSOC "Conversion method for V2gTxFullSoc" RAT_FUNC "%10.0" "%" COEFFS 0.000000 1.000000 -0.000000 0.000000 0.000000 1.000000 /end COMPU_METHOD
/* Scalar measurable for DDE 'V2gTxParameterSetId'. */
/begin MEASUREMENT V2gTxParameterSetId "Used to select a specific parameter set for a specific ServiceID when selecting a service" UWORD CU_V2GTXPARAMETERSETID 1 100 0.0 65535.0 ECU_ADDRESS 0x7001818a BYTE_ORDER MSB_LAST /end MEASUREMENT
/begin COMPU_METHOD CU_V2GTXPARAMETERSETID "Conversion method for V2gTxParameterSetId" RAT_FUNC "%10.0" "1" COEFFS 0.000000 1.000000 -0.000000 0.000000 0.000000 1.000000 /end COMPU_METHOD
/* Scalar measurable for DDE 'V2gTxProfileEntryCnt'. */
/begin MEASUREMENT V2gTxProfileEntryCnt "Identifies the number of charging profile entries that have been provided in the ChargingProfileEntryStart and ChargingProfileEntryMaxPower parameters." UWORD CU_V2GTXPROFILEENTRYCNT 1 100 0.0 24.0 ECU_ADDRESS 0x700181fc BYTE_ORDER MSB_LAST /end MEASUREMENT
/begin COMPU_METHOD CU_V2GTXPROFILEENTRYCNT "Conversion method for V2gTxProfileEntryCnt" RAT_FUNC "%10.0" "1" COEFFS 0.000000 1.000000 -0.000000 0.000000 0.000000 1.000000 /end COMPU_METHOD
/* Scalar measurable for DDE 'V2gTxRemainTimeToFullSoc'. */
/begin MEASUREMENT V2gTxRemainTimeToFullSoc "Estimated or calculated time until full charge is complete. For displaying on EVSE for user only." FLOAT32_IEEE CU_V2GTXREMAINTIMETOFULLSOC 1 100 0.0 196605.0 ECU_ADDRESS 0x70017fe8 BYTE_ORDER MSB_LAST /end MEASUREMENT
/begin COMPU_METHOD CU_V2GTXREMAINTIMETOFULLSOC "Conversion method for V2gTxRemainTimeToFullSoc" RAT_FUNC "%10.0" "s" COEFFS 0.000000 1.000000 -0.000000 0.000000 0.000000 1.000000 /end COMPU_METHOD
/* Scalar measurable for DDE 'V2gTxRemainTimetoBulkSoc'. */
/begin MEASUREMENT V2gTxRemainTimetoBulkSoc "Estimated or calculated time until bulk charge is complete. For displaying on EVSE for user only." FLOAT32_IEEE CU_V2GTXREMAINTIMETOBULKSOC 1 100 0.0 196605.0 ECU_ADDRESS 0x70017eec BYTE_ORDER MSB_LAST /end MEASUREMENT
/begin COMPU_METHOD CU_V2GTXREMAINTIMETOBULKSOC "Conversion method for V2gTxRemainTimetoBulkSoc" RAT_FUNC "%10.0" "s" COEFFS 0.000000 1.000000 -0.000000 0.000000 0.000000 1.000000 /end COMPU_METHOD
/* Scalar measurable for DDE 'V2gTxSaSchdlTupleId'. */
/begin MEASUREMENT V2gTxSaSchdlTupleId "Unique identifier within a charging session referring to the selected SAScheduleTuple element from the SAScheduleListType as described by J2847-2" UBYTE CU_V2GTXSASCHDLTUPLEID 1 100 0.0 255.0 ECU_ADDRESS 0x70017ef1 BYTE_ORDER MSB_LAST /end MEASUREMENT
/begin COMPU_METHOD CU_V2GTXSASCHDLTUPLEID "Conversion method for V2gTxSaSchdlTupleId" RAT_FUNC "%10.0" "1" COEFFS 0.000000 1.000000 -0.000000 0.000000 0.000000 1.000000 /end COMPU_METHOD
/* Scalar measurable for DDE 'V2gTxSaSchdlTupleIdEn'. */
/begin MEASUREMENT V2gTxSaSchdlTupleIdEn "Flag to indicate if SASchedule Tuple ID is enabled (1) or disabled (0) as a message element during power delivery request" UBYTE CU_V2GTXSASCHDLTUPLEIDEN 1 100 0.0 1.0 ECU_ADDRESS 0x70018239 BYTE_ORDER MSB_LAST /end MEASUREMENT
/begin COMPU_METHOD CU_V2GTXSASCHDLTUPLEIDEN "Conversion method for V2gTxSaSchdlTupleIdEn" RAT_FUNC "%10.0" "b" COEFFS 0.000000 1.000000 -0.000000 0.000000 0.000000 1.000000 /end COMPU_METHOD
/* Scalar measurable for DDE 'V2gTxServiceId'. */
/begin MEASUREMENT V2gTxServiceId "Unique identifier of the service as applicable to the SelectedServiceType described by J2847-2." UWORD CU_V2GTXSERVICEID 1 100 0.0 65535.0 ECU_ADDRESS 0x70017e18 BYTE_ORDER MSB_LAST /end MEASUREMENT
/begin COMPU_METHOD CU_V2GTXSERVICEID "Conversion method for V2gTxServiceId" RAT_FUNC "%10.0" "1" COEFFS 0.000000 1.000000 -0.000000 0.000000 0.000000 1.000000 /end COMPU_METHOD
/* Scalar measurable for DDE 'V2gTxSupSvcIdsLen'. */
/begin MEASUREMENT V2gTxSupSvcIdsLen "Number of service IDs supported by the EV" UBYTE CU_V2GTXSUPSVCIDSLEN 1 100 0.0 10.0 ECU_ADDRESS 0x70018494 BYTE_ORDER MSB_LAST /end MEASUREMENT
/begin COMPU_METHOD CU_V2GTXSUPSVCIDSLEN "Conversion method for V2gTxSupSvcIdsLen" RAT_FUNC "%10.0" "1" COEFFS 0.000000 1.000000 -0.000000 0.000000 0.000000 1.000000 /end COMPU_METHOD
/* Scalar measurable for DDE 'V2gTxSupSvcIds[0]'. */
/begin MEASUREMENT V2gTxSupSvcIds[0] "List of all service IDs supported by the EV" UWORD CU_V2GTXSUPSVCIDS[0] 1 100 0.0 65535.0 ECU_ADDRESS 0x700182e6 BYTE_ORDER MSB_LAST /end MEASUREMENT
/begin COMPU_METHOD CU_V2GTXSUPSVCIDS[0] "Conversion method for V2gTxSupSvcIds[0]" RAT_FUNC "%10.0" "1" COEFFS 0.000000 1.000000 -0.000000 0.000000 0.000000 1.000000 /end COMPU_METHOD
/* Scalar measurable for DDE 'V2gTxSupSvcIds[1]'. */
/begin MEASUREMENT V2gTxSupSvcIds[1] "List of all service IDs supported by the EV" UWORD CU_V2GTXSUPSVCIDS[1] 1 100 0.0 65535.0 ECU_ADDRESS 0x700182e8 BYTE_ORDER MSB_LAST /end MEASUREMENT
/begin COMPU_METHOD CU_V2GTXSUPSVCIDS[1] "Conversion method for V2gTxSupSvcIds[1]" RAT_FUNC "%10.0" "1" COEFFS 0.000000 1.000000 -0.000000 0.000000 0.000000 1.000000 /end COMPU_METHOD
/* Scalar measurable for DDE 'V2gTxSupSvcIds[2]'. */
/begin MEASUREMENT V2gTxSupSvcIds[2] "List of all service IDs supported by the EV" UWORD CU_V2GTXSUPSVCIDS[2] 1 100 0.0 65535.0 ECU_ADDRESS 0x700182ea BYTE_ORDER MSB_LAST /end MEASUREMENT
/begin COMPU_METHOD CU_V2GTXSUPSVCIDS[2] "Conversion method for V2gTxSupSvcIds[2]" RAT_FUNC "%10.0" "1" COEFFS 0.000000 1.000000 -0.000000 0.000000 0.000000 1.000000 /end COMPU_METHOD
/* Scalar measurable for DDE 'V2gTxSupSvcIds[3]'. */
/begin MEASUREMENT V2gTxSupSvcIds[3] "List of all service IDs supported by the EV" UWORD CU_V2GTXSUPSVCIDS[3] 1 100 0.0 65535.0 ECU_ADDRESS 0x700182ec BYTE_ORDER MSB_LAST /end MEASUREMENT
/begin COMPU_METHOD CU_V2GTXSUPSVCIDS[3] "Conversion method for V2gTxSupSvcIds[3]" RAT_FUNC "%10.0" "1" COEFFS 0.000000 1.000000 -0.000000 0.000000 0.000000 1.000000 /end COMPU_METHOD
/* Scalar measurable for DDE 'V2gTxSupSvcIds[4]'. */
/begin MEASUREMENT V2gTxSupSvcIds[4] "List of all service IDs supported by the EV" UWORD CU_V2GTXSUPSVCIDS[4] 1 100 0.0 65535.0 ECU_ADDRESS 0x700182ee BYTE_ORDER MSB_LAST /end MEASUREMENT
/begin COMPU_METHOD CU_V2GTXSUPSVCIDS[4] "Conversion method for V2gTxSupSvcIds[4]" RAT_FUNC "%10.0" "1" COEFFS 0.000000 1.000000 -0.000000 0.000000 0.000000 1.000000 /end COMPU_METHOD
/* Scalar measurable for DDE 'V2gTxSupSvcIds[5]'. */
/begin MEASUREMENT V2gTxSupSvcIds[5] "List of all service IDs supported by the EV" UWORD CU_V2GTXSUPSVCIDS[5] 1 100 0.0 65535.0 ECU_ADDRESS 0x700182f0 BYTE_ORDER MSB_LAST /end MEASUREMENT
/begin COMPU_METHOD CU_V2GTXSUPSVCIDS[5] "Conversion method for V2gTxSupSvcIds[5]" RAT_FUNC "%10.0" "1" COEFFS 0.000000 1.000000 -0.000000 0.000000 0.000000 1.000000 /end COMPU_METHOD
/* Scalar measurable for DDE 'V2gTxSupSvcIds[6]'. */
/begin MEASUREMENT V2gTxSupSvcIds[6] "List of all service IDs supported by the EV" UWORD CU_V2GTXSUPSVCIDS[6] 1 100 0.0 65535.0 ECU_ADDRESS 0x700182f2 BYTE_ORDER MSB_LAST /end MEASUREMENT
/begin COMPU_METHOD CU_V2GTXSUPSVCIDS[6] "Conversion method for V2gTxSupSvcIds[6]" RAT_FUNC "%10.0" "1" COEFFS 0.000000 1.000000 -0.000000 0.000000 0.000000 1.000000 /end COMPU_METHOD
/* Scalar measurable for DDE 'V2gTxSupSvcIds[7]'. */
/begin MEASUREMENT V2gTxSupSvcIds[7] "List of all service IDs supported by the EV" UWORD CU_V2GTXSUPSVCIDS[7] 1 100 0.0 65535.0 ECU_ADDRESS 0x700182f4 BYTE_ORDER MSB_LAST /end MEASUREMENT
/begin COMPU_METHOD CU_V2GTXSUPSVCIDS[7] "Conversion method for V2gTxSupSvcIds[7]" RAT_FUNC "%10.0" "1" COEFFS 0.000000 1.000000 -0.000000 0.000000 0.000000 1.000000 /end COMPU_METHOD
/* Scalar measurable for DDE 'V2gTxSupSvcIds[8]'. */
/begin MEASUREMENT V2gTxSupSvcIds[8] "List of all service IDs supported by the EV" UWORD CU_V2GTXSUPSVCIDS[8] 1 100 0.0 65535.0 ECU_ADDRESS 0x700182f6 BYTE_ORDER MSB_LAST /end MEASUREMENT
/begin COMPU_METHOD CU_V2GTXSUPSVCIDS[8] "Conversion method for V2gTxSupSvcIds[8]" RAT_FUNC "%10.0" "1" COEFFS 0.000000 1.000000 -0.000000 0.000000 0.000000 1.000000 /end COMPU_METHOD
/* Scalar measurable for DDE 'V2gTxSupSvcIds[9]'. */
/begin MEASUREMENT V2gTxSupSvcIds[9] "List of all service IDs supported by the EV" UWORD CU_V2GTXSUPSVCIDS[9] 1 100 0.0 65535.0 ECU_ADDRESS 0x700182f8 BYTE_ORDER MSB_LAST /end MEASUREMENT
/begin COMPU_METHOD CU_V2GTXSUPSVCIDS[9] "Conversion method for V2gTxSupSvcIds[9]" RAT_FUNC "%10.0" "1" COEFFS 0.000000 1.000000 -0.000000 0.000000 0.000000 1.000000 /end COMPU_METHOD
/* Scalar measurable for DDE 'V2gTxTargetSoc'. */
/begin MEASUREMENT V2gTxTargetSoc "State of charge desired by the EV, could be less than full SOC" FLOAT32_IEEE CU_V2GTXTARGETSOC 1 100 0.0 100.0 ECU_ADDRESS 0x70018164 BYTE_ORDER MSB_LAST /end MEASUREMENT
/begin COMPU_METHOD CU_V2GTXTARGETSOC "Conversion method for V2gTxTargetSoc" RAT_FUNC "%10.0" "%" COEFFS 0.000000 1.000000 -0.000000 0.000000 0.000000 1.000000 /end COMPU_METHOD
/* Scalar measurable for DDE 'Vbat_MaxFlt'. */
/begin MEASUREMENT Vbat_MaxFlt "Vbat above max threshold latched after debounce (CCU pin L2/L3)" UBYTE CU_VBAT_MAXFLT 1 100 0.0 1.0 ECU_ADDRESS 0x7001a10a BYTE_ORDER MSB_LAST /end MEASUREMENT
/begin COMPU_METHOD CU_VBAT_MAXFLT "Conversion method for Vbat_MaxFlt" RAT_FUNC "%10.0" "(not defined)" COEFFS 0.000000 1.000000 -0.000000 0.000000 0.000000 1.000000 /end COMPU_METHOD
/* Scalar measurable for DDE 'Vbat_MaxFltActv'. */
/begin MEASUREMENT Vbat_MaxFltActv "Active fault high L2/L3 (Max fault no latch or debounce)" UBYTE CU_VBAT_MAXFLTACTV 1 100 0.0 1.0 ECU_ADDRESS 0x70019fa1 BYTE_ORDER MSB_LAST /end MEASUREMENT
/begin COMPU_METHOD CU_VBAT_MAXFLTACTV "Conversion method for Vbat_MaxFltActv" RAT_FUNC "%10.0" "(not defined)" COEFFS 0.000000 1.000000 -0.000000 0.000000 0.000000 1.000000 /end COMPU_METHOD
/* Scalar measurable for DDE 'Vbat_MinFlt'. */
/begin MEASUREMENT Vbat_MinFlt "Vbat below min threshold latched after debounce (CCU pin L2/L3)" UBYTE CU_VBAT_MINFLT 1 100 0.0 1.0 ECU_ADDRESS 0x7001a0db BYTE_ORDER MSB_LAST /end MEASUREMENT
/begin COMPU_METHOD CU_VBAT_MINFLT "Conversion method for Vbat_MinFlt" RAT_FUNC "%10.0" "(not defined)" COEFFS 0.000000 1.000000 -0.000000 0.000000 0.000000 1.000000 /end COMPU_METHOD
/* Scalar measurable for DDE 'Vbat_MinFltActv'. */
/begin MEASUREMENT Vbat_MinFltActv "Active fault low L2/L3 (Min fault no latch or debounce)" UBYTE CU_VBAT_MINFLTACTV 1 100 0.0 1.0 ECU_ADDRESS 0x70019f68 BYTE_ORDER MSB_LAST /end MEASUREMENT
/begin COMPU_METHOD CU_VBAT_MINFLTACTV "Conversion method for Vbat_MinFltActv" RAT_FUNC "%10.0" "(not defined)" COEFFS 0.000000 1.000000 -0.000000 0.000000 0.000000 1.000000 /end COMPU_METHOD
/* Scalar measurable for DDE 'VrefA_MaxFlt'. */
/begin MEASUREMENT VrefA_MaxFlt "VrefA above max threshold latched after debounce" UBYTE CU_VREFA_MAXFLT 1 100 0.0 1.0 ECU_ADDRESS 0x7001a0fe BYTE_ORDER MSB_LAST /end MEASUREMENT
/begin COMPU_METHOD CU_VREFA_MAXFLT "Conversion method for VrefA_MaxFlt" RAT_FUNC "%10.0" "(not defined)" COEFFS 0.000000 1.000000 -0.000000 0.000000 0.000000 1.000000 /end COMPU_METHOD
/* Scalar measurable for DDE 'VrefA_MaxFltActv'. */
/begin MEASUREMENT VrefA_MaxFltActv "Active fault high (Max fault no latch or debounce)" UBYTE CU_VREFA_MAXFLTACTV 1 100 0.0 1.0 ECU_ADDRESS 0x7001a01b BYTE_ORDER MSB_LAST /end MEASUREMENT
/begin COMPU_METHOD CU_VREFA_MAXFLTACTV "Conversion method for VrefA_MaxFltActv" RAT_FUNC "%10.0" "(not defined)" COEFFS 0.000000 1.000000 -0.000000 0.000000 0.000000 1.000000 /end COMPU_METHOD
/* Scalar measurable for DDE 'VrefA_MinFlt'. */
/begin MEASUREMENT VrefA_MinFlt "VrefA below min threshold latched after debounce" UBYTE CU_VREFA_MINFLT 1 100 0.0 1.0 ECU_ADDRESS 0x70019eb1 BYTE_ORDER MSB_LAST /end MEASUREMENT
/begin COMPU_METHOD CU_VREFA_MINFLT "Conversion method for VrefA_MinFlt" RAT_FUNC "%10.0" "(not defined)" COEFFS 0.000000 1.000000 -0.000000 0.000000 0.000000 1.000000 /end COMPU_METHOD
/* Scalar measurable for DDE 'VrefA_MinFltActv'. */
/begin MEASUREMENT VrefA_MinFltActv "Active fault low (Min fault no latch or debounce)" UBYTE CU_VREFA_MINFLTACTV 1 100 0.0 1.0 ECU_ADDRESS 0x7001a03e BYTE_ORDER MSB_LAST /end MEASUREMENT
/begin COMPU_METHOD CU_VREFA_MINFLTACTV "Conversion method for VrefA_MinFltActv" RAT_FUNC "%10.0" "(not defined)" COEFFS 0.000000 1.000000 -0.000000 0.000000 0.000000 1.000000 /end COMPU_METHOD
/* Scalar measurable for DDE 'VrefB_MaxFlt'. */
/begin MEASUREMENT VrefB_MaxFlt "VrefB above max threshold latched after debounce" UBYTE CU_VREFB_MAXFLT 1 100 0.0 1.0 ECU_ADDRESS 0x70019ec6 BYTE_ORDER MSB_LAST /end MEASUREMENT
/begin COMPU_METHOD CU_VREFB_MAXFLT "Conversion method for VrefB_MaxFlt" RAT_FUNC "%10.0" "(not defined)" COEFFS 0.000000 1.000000 -0.000000 0.000000 0.000000 1.000000 /end COMPU_METHOD
/* Scalar measurable for DDE 'VrefB_MaxFltActv'. */
/begin MEASUREMENT VrefB_MaxFltActv "Active fault high (Max fault no latch or debounce)" UBYTE CU_VREFB_MAXFLTACTV 1 100 0.0 1.0 ECU_ADDRESS 0x7001a04f BYTE_ORDER MSB_LAST /end MEASUREMENT
/begin COMPU_METHOD CU_VREFB_MAXFLTACTV "Conversion method for VrefB_MaxFltActv" RAT_FUNC "%10.0" "(not defined)" COEFFS 0.000000 1.000000 -0.000000 0.000000 0.000000 1.000000 /end COMPU_METHOD
/* Scalar measurable for DDE 'VrefB_MinFlt'. */
/begin MEASUREMENT VrefB_MinFlt "VrefB below min threshold latched after debounce" UBYTE CU_VREFB_MINFLT 1 100 0.0 1.0 ECU_ADDRESS 0x70019ede BYTE_ORDER MSB_LAST /end MEASUREMENT
/begin COMPU_METHOD CU_VREFB_MINFLT "Conversion method for VrefB_MinFlt" RAT_FUNC "%10.0" "(not defined)" COEFFS 0.000000 1.000000 -0.000000 0.000000 0.000000 1.000000 /end COMPU_METHOD
/* Scalar measurable for DDE 'VrefB_MinFltActv'. */
/begin MEASUREMENT VrefB_MinFltActv "Active fault low (Min fault no latch or debounce)" UBYTE CU_VREFB_MINFLTACTV 1 100 0.0 1.0 ECU_ADDRESS 0x7001a072 BYTE_ORDER MSB_LAST /end MEASUREMENT
/begin COMPU_METHOD CU_VREFB_MINFLTACTV "Conversion method for VrefB_MinFltActv" RAT_FUNC "%10.0" "(not defined)" COEFFS 0.000000 1.000000 -0.000000 0.000000 0.000000 1.000000 /end COMPU_METHOD
/* Scalar measurable for DDE 'ain_3V3io_ext_filt'. */
/begin MEASUREMENT ain_3V3io_ext_filt "Internal 3V3 IO scaled filtered" FLOAT32_IEEE CU_AIN_3V3IO_EXT_FILT 1 100 0.0 5.0 ECU_ADDRESS 0x70019f00 BYTE_ORDER MSB_LAST /end MEASUREMENT
/begin COMPU_METHOD CU_AIN_3V3IO_EXT_FILT "Conversion method for ain_3V3io_ext_filt" RAT_FUNC "%10.3" "V" COEFFS 0.000000 1.000000 -0.000000 0.000000 0.000000 1.000000 /end COMPU_METHOD
/* Scalar measurable for DDE 'ain_3V3io_ext_unfilt'. */
/begin MEASUREMENT ain_3V3io_ext_unfilt "Internal 3V3 IO scaled unfiltered" FLOAT32_IEEE CU_AIN_3V3IO_EXT_UNFILT 1 100 0.0 5.0 ECU_ADDRESS 0x7001a090 BYTE_ORDER MSB_LAST /end MEASUREMENT
/begin COMPU_METHOD CU_AIN_3V3IO_EXT_UNFILT "Conversion method for ain_3V3io_ext_unfilt" RAT_FUNC "%10.3" "V" COEFFS 0.000000 1.000000 -0.000000 0.000000 0.000000 1.000000 /end COMPU_METHOD
/* Scalar measurable for DDE 'ain_3V3io_int_filt'. */
/begin MEASUREMENT ain_3V3io_int_filt "Internal 3V3 IO filtered" FLOAT32_IEEE CU_AIN_3V3IO_INT_FILT 1 100 0.0 5.0 ECU_ADDRESS 0x70019f20 BYTE_ORDER MSB_LAST /end MEASUREMENT
/begin COMPU_METHOD CU_AIN_3V3IO_INT_FILT "Conversion method for ain_3V3io_int_filt" RAT_FUNC "%10.3" "V" COEFFS 0.000000 1.000000 -0.000000 0.000000 0.000000 1.000000 /end COMPU_METHOD
/* Scalar measurable for DDE 'ain_3V3io_int_unfilt'. */
/begin MEASUREMENT ain_3V3io_int_unfilt "Internal 3V3 IO raw unfiltered" FLOAT32_IEEE CU_AIN_3V3IO_INT_UNFILT 1 100 0.0 5.0 ECU_ADDRESS 0x7001a0b4 BYTE_ORDER MSB_LAST /end MEASUREMENT
/begin COMPU_METHOD CU_AIN_3V3IO_INT_UNFILT "Conversion method for ain_3V3io_int_unfilt" RAT_FUNC "%10.3" "V" COEFFS 0.000000 1.000000 -0.000000 0.000000 0.000000 1.000000 /end COMPU_METHOD
/* Scalar measurable for DDE 'ain_3V3qca_ext_filt'. */
/begin MEASUREMENT ain_3V3qca_ext_filt "Internal 3V3 QCA scaled filtered" FLOAT32_IEEE CU_AIN_3V3QCA_EXT_FILT 1 100 0.0 5.0 ECU_ADDRESS 0x70019fb8 BYTE_ORDER MSB_LAST /end MEASUREMENT
/begin COMPU_METHOD CU_AIN_3V3QCA_EXT_FILT "Conversion method for ain_3V3qca_ext_filt" RAT_FUNC "%10.3" "V" COEFFS 0.000000 1.000000 -0.000000 0.000000 0.000000 1.000000 /end COMPU_METHOD
/* Scalar measurable for DDE 'ain_3V3qca_ext_unfilt'. */
/begin MEASUREMENT ain_3V3qca_ext_unfilt "Internal 3V3 QCA scaled unfiltered" FLOAT32_IEEE CU_AIN_3V3QCA_EXT_UNFILT 1 100 0.0 5.0 ECU_ADDRESS 0x7001a154 BYTE_ORDER MSB_LAST /end MEASUREMENT
/begin COMPU_METHOD CU_AIN_3V3QCA_EXT_UNFILT "Conversion method for ain_3V3qca_ext_unfilt" RAT_FUNC "%10.3" "V" COEFFS 0.000000 1.000000 -0.000000 0.000000 0.000000 1.000000 /end COMPU_METHOD
/* Scalar measurable for DDE 'ain_3V3qca_int_filt'. */
/begin MEASUREMENT ain_3V3qca_int_filt "Internal 3V3 QCA filtered" FLOAT32_IEEE CU_AIN_3V3QCA_INT_FILT 1 100 0.0 5.0 ECU_ADDRESS 0x70019fe8 BYTE_ORDER MSB_LAST /end MEASUREMENT
/begin COMPU_METHOD CU_AIN_3V3QCA_INT_FILT "Conversion method for ain_3V3qca_int_filt" RAT_FUNC "%10.3" "V" COEFFS 0.000000 1.000000 -0.000000 0.000000 0.000000 1.000000 /end COMPU_METHOD
/* Scalar measurable for DDE 'ain_3V3qca_int_unfilt'. */
/begin MEASUREMENT ain_3V3qca_int_unfilt "Internal 3V3 QCA raw unfiltered" FLOAT32_IEEE CU_AIN_3V3QCA_INT_UNFILT 1 100 0.0 5.0 ECU_ADDRESS 0x7001a17c BYTE_ORDER MSB_LAST /end MEASUREMENT
/begin COMPU_METHOD CU_AIN_3V3QCA_INT_UNFILT "Conversion method for ain_3V3qca_int_unfilt" RAT_FUNC "%10.3" "V" COEFFS 0.000000 1.000000 -0.000000 0.000000 0.000000 1.000000 /end COMPU_METHOD
/* Scalar measurable for DDE 'ain_3V3uc_ext_filt'. */
/begin MEASUREMENT ain_3V3uc_ext_filt "Internal 3V3 Micro scaled filtered" FLOAT32_IEEE CU_AIN_3V3UC_EXT_FILT 1 100 0.0 5.0 ECU_ADDRESS 0x7001a00c BYTE_ORDER MSB_LAST /end MEASUREMENT
/begin COMPU_METHOD CU_AIN_3V3UC_EXT_FILT "Conversion method for ain_3V3uc_ext_filt" RAT_FUNC "%10.3" "V" COEFFS 0.000000 1.000000 -0.000000 0.000000 0.000000 1.000000 /end COMPU_METHOD
/* Scalar measurable for DDE 'ain_3V3uc_ext_unfilt'. */
/begin MEASUREMENT ain_3V3uc_ext_unfilt "Internal 3V3 Micro scaled unfiltered" FLOAT32_IEEE CU_AIN_3V3UC_EXT_UNFILT 1 100 0.0 5.0 ECU_ADDRESS 0x70019ea0 BYTE_ORDER MSB_LAST /end MEASUREMENT
/begin COMPU_METHOD CU_AIN_3V3UC_EXT_UNFILT "Conversion method for ain_3V3uc_ext_unfilt" RAT_FUNC "%10.3" "V" COEFFS 0.000000 1.000000 -0.000000 0.000000 0.000000 1.000000 /end COMPU_METHOD
/* Scalar measurable for DDE 'ain_3V3uc_int_filt'. */
/begin MEASUREMENT ain_3V3uc_int_filt "Internal 3V3 Micro filtered" FLOAT32_IEEE CU_AIN_3V3UC_INT_FILT 1 100 0.0 5.0 ECU_ADDRESS 0x7001a030 BYTE_ORDER MSB_LAST /end MEASUREMENT
/begin COMPU_METHOD CU_AIN_3V3UC_INT_FILT "Conversion method for ain_3V3uc_int_filt" RAT_FUNC "%10.3" "V" COEFFS 0.000000 1.000000 -0.000000 0.000000 0.000000 1.000000 /end COMPU_METHOD
/* Scalar measurable for DDE 'ain_3V3uc_int_unfilt'. */
/begin MEASUREMENT ain_3V3uc_int_unfilt "Internal 3V3 Micro raw unfiltered" FLOAT32_IEEE CU_AIN_3V3UC_INT_UNFILT 1 100 0.0 5.0 ECU_ADDRESS 0x7001a160 BYTE_ORDER MSB_LAST /end MEASUREMENT
/begin COMPU_METHOD CU_AIN_3V3UC_INT_UNFILT "Conversion method for ain_3V3uc_int_unfilt" RAT_FUNC "%10.3" "V" COEFFS 0.000000 1.000000 -0.000000 0.000000 0.000000 1.000000 /end COMPU_METHOD
/* Scalar measurable for DDE 'ain_5vdd_ext_filt'. */
/begin MEASUREMENT ain_5vdd_ext_filt "Internal 5VDD scaled filtered" FLOAT32_IEEE CU_AIN_5VDD_EXT_FILT 1 100 0.0 20.0 ECU_ADDRESS 0x70019ffc BYTE_ORDER MSB_LAST /end MEASUREMENT
/begin COMPU_METHOD CU_AIN_5VDD_EXT_FILT "Conversion method for ain_5vdd_ext_filt" RAT_FUNC "%10.3" "V" COEFFS 0.000000 1.000000 -0.000000 0.000000 0.000000 1.000000 /end COMPU_METHOD
/* Scalar measurable for DDE 'ain_5vdd_ext_unfilt'. */
/begin MEASUREMENT ain_5vdd_ext_unfilt "Internal 5VDD scaled unfiltered" FLOAT32_IEEE CU_AIN_5VDD_EXT_UNFILT 1 100 0.0 20.0 ECU_ADDRESS 0x7001a1a0 BYTE_ORDER MSB_LAST /end MEASUREMENT
/begin COMPU_METHOD CU_AIN_5VDD_EXT_UNFILT "Conversion method for ain_5vdd_ext_unfilt" RAT_FUNC "%10.3" "V" COEFFS 0.000000 1.000000 -0.000000 0.000000 0.000000 1.000000 /end COMPU_METHOD
/* Scalar measurable for DDE 'ain_5vdd_int_filt'. */
/begin MEASUREMENT ain_5vdd_int_filt "Internal 5VDD filtered" FLOAT32_IEEE CU_AIN_5VDD_INT_FILT 1 100 0.0 5.0 ECU_ADDRESS 0x7001a094 BYTE_ORDER MSB_LAST /end MEASUREMENT
/begin COMPU_METHOD CU_AIN_5VDD_INT_FILT "Conversion method for ain_5vdd_int_filt" RAT_FUNC "%10.3" "V" COEFFS 0.000000 1.000000 -0.000000 0.000000 0.000000 1.000000 /end COMPU_METHOD
/* Scalar measurable for DDE 'ain_5vdd_int_unfilt'. */
/begin MEASUREMENT ain_5vdd_int_unfilt "Internal 5VDD raw unfiltered" FLOAT32_IEEE CU_AIN_5VDD_INT_UNFILT 1 100 0.0 5.0 ECU_ADDRESS 0x70019f24 BYTE_ORDER MSB_LAST /end MEASUREMENT
/begin COMPU_METHOD CU_AIN_5VDD_INT_UNFILT "Conversion method for ain_5vdd_int_unfilt" RAT_FUNC "%10.3" "V" COEFFS 0.000000 1.000000 -0.000000 0.000000 0.000000 1.000000 /end COMPU_METHOD
/* Scalar measurable for DDE 'ain_A2_vproxim_ext_filt'. */
/begin MEASUREMENT ain_A2_vproxim_ext_filt "Proximity scaled filtered (CCU pin A2)" FLOAT32_IEEE CU_AIN_A2_VPROXIM_EXT_FILT 1 100 0.0 40.0 ECU_ADDRESS 0x7001a0b8 BYTE_ORDER MSB_LAST /end MEASUREMENT
/begin COMPU_METHOD CU_AIN_A2_VPROXIM_EXT_FILT "Conversion method for ain_A2_vproxim_ext_filt" RAT_FUNC "%10.3" "V" COEFFS 0.000000 1.000000 -0.000000 0.000000 0.000000 1.000000 /end COMPU_METHOD
/* Scalar measurable for DDE 'ain_A2_vproxim_ext_unfilt'. */
/begin MEASUREMENT ain_A2_vproxim_ext_unfilt "Proximity scaled unfiltered (CCU pin A2)" FLOAT32_IEEE CU_AIN_A2_VPROXIM_EXT_UNFILT 1 100 0.0 40.0 ECU_ADDRESS 0x70019f3c BYTE_ORDER MSB_LAST /end MEASUREMENT
/begin COMPU_METHOD CU_AIN_A2_VPROXIM_EXT_UNFILT "Conversion method for ain_A2_vproxim_ext_unfilt" RAT_FUNC "%10.3" "V" COEFFS 0.000000 1.000000 -0.000000 0.000000 0.000000 1.000000 /end COMPU_METHOD
/* Scalar measurable for DDE 'ain_A2_vproxim_int_filt'. */
/begin MEASUREMENT ain_A2_vproxim_int_filt "Proximity filtered (CCU pin A2)" FLOAT32_IEEE CU_AIN_A2_VPROXIM_INT_FILT 1 100 0.0 5.0 ECU_ADDRESS 0x7001a0d4 BYTE_ORDER MSB_LAST /end MEASUREMENT
/begin COMPU_METHOD CU_AIN_A2_VPROXIM_INT_FILT "Conversion method for ain_A2_vproxim_int_filt" RAT_FUNC "%10.3" "V" COEFFS 0.000000 1.000000 -0.000000 0.000000 0.000000 1.000000 /end COMPU_METHOD
/* Scalar measurable for DDE 'ain_A2_vproxim_int_unfilt'. */
/begin MEASUREMENT ain_A2_vproxim_int_unfilt "Proximity raw unfiltered (CCU pin A2)" FLOAT32_IEEE CU_AIN_A2_VPROXIM_INT_UNFILT 1 100 0.0 5.0 ECU_ADDRESS 0x70019f58 BYTE_ORDER MSB_LAST /end MEASUREMENT
/begin COMPU_METHOD CU_AIN_A2_VPROXIM_INT_UNFILT "Conversion method for ain_A2_vproxim_int_unfilt" RAT_FUNC "%10.3" "V" COEFFS 0.000000 1.000000 -0.000000 0.000000 0.000000 1.000000 /end COMPU_METHOD
/* Scalar measurable for DDE 'ain_A3_vpilot_ext_filt'. */
/begin MEASUREMENT ain_A3_vpilot_ext_filt "Pilot scaled filtered (CCU pin A3)" FLOAT32_IEEE CU_AIN_A3_VPILOT_EXT_FILT 1 100 -15.0 40.0 ECU_ADDRESS 0x7001a0ec BYTE_ORDER MSB_LAST /end MEASUREMENT
/begin COMPU_METHOD CU_AIN_A3_VPILOT_EXT_FILT "Conversion method for ain_A3_vpilot_ext_filt" RAT_FUNC "%10.3" "V" COEFFS 0.000000 1.000000 -0.000000 0.000000 0.000000 1.000000 /end COMPU_METHOD
/* Scalar measurable for DDE 'ain_A3_vpilot_ext_unfilt'. */
/begin MEASUREMENT ain_A3_vpilot_ext_unfilt "Pilot scaled unfiltered (CCU pin A3)" FLOAT32_IEEE CU_AIN_A3_VPILOT_EXT_UNFILT 1 100 -15.0 40.0 ECU_ADDRESS 0x70019f80 BYTE_ORDER MSB_LAST /end MEASUREMENT
/begin COMPU_METHOD CU_AIN_A3_VPILOT_EXT_UNFILT "Conversion method for ain_A3_vpilot_ext_unfilt" RAT_FUNC "%10.3" "V" COEFFS 0.000000 1.000000 -0.000000 0.000000 0.000000 1.000000 /end COMPU_METHOD
/* Scalar measurable for DDE 'ain_A3_vpilot_int_filt'. */
/begin MEASUREMENT ain_A3_vpilot_int_filt "Pilot filtered (CCU pin A3)" FLOAT32_IEEE CU_AIN_A3_VPILOT_INT_FILT 1 100 0.0 5.0 ECU_ADDRESS 0x7001a10c BYTE_ORDER MSB_LAST /end MEASUREMENT
/begin COMPU_METHOD CU_AIN_A3_VPILOT_INT_FILT "Conversion method for ain_A3_vpilot_int_filt" RAT_FUNC "%10.3" "V" COEFFS 0.000000 1.000000 -0.000000 0.000000 0.000000 1.000000 /end COMPU_METHOD
/* Scalar measurable for DDE 'ain_A3_vpilot_int_unfilt'. */
/begin MEASUREMENT ain_A3_vpilot_int_unfilt "Pilot raw unfiltered (CCU pin A3)" FLOAT32_IEEE CU_AIN_A3_VPILOT_INT_UNFILT 1 100 0.0 5.0 ECU_ADDRESS 0x70019fa4 BYTE_ORDER MSB_LAST /end MEASUREMENT
/begin COMPU_METHOD CU_AIN_A3_VPILOT_INT_UNFILT "Conversion method for ain_A3_vpilot_int_unfilt" RAT_FUNC "%10.3" "V" COEFFS 0.000000 1.000000 -0.000000 0.000000 0.000000 1.000000 /end COMPU_METHOD
/* Scalar measurable for DDE 'ain_A3_vpilpeak_ext_filt'. */
/begin MEASUREMENT ain_A3_vpilpeak_ext_filt "Pilot Peak scaled filtered (CCU pin A3)" FLOAT32_IEEE CU_AIN_A3_VPILPEAK_EXT_FILT 1 100 -15.0 40.0 ECU_ADDRESS 0x7001a144 BYTE_ORDER MSB_LAST /end MEASUREMENT
/begin COMPU_METHOD CU_AIN_A3_VPILPEAK_EXT_FILT "Conversion method for ain_A3_vpilpeak_ext_filt" RAT_FUNC "%10.3" "V" COEFFS 0.000000 1.000000 -0.000000 0.000000 0.000000 1.000000 /end COMPU_METHOD
/* Scalar measurable for DDE 'ain_A3_vpilpeak_ext_unfilt'. */
/begin MEASUREMENT ain_A3_vpilpeak_ext_unfilt "Pilot Peak scaled unfiltered (CCU pin A3)" FLOAT32_IEEE CU_AIN_A3_VPILPEAK_EXT_UNFILT 1 100 -15.0 40.0 ECU_ADDRESS 0x7001a048 BYTE_ORDER MSB_LAST /end MEASUREMENT
/begin COMPU_METHOD CU_AIN_A3_VPILPEAK_EXT_UNFILT "Conversion method for ain_A3_vpilpeak_ext_unfilt" RAT_FUNC "%10.3" "V" COEFFS 0.000000 1.000000 -0.000000 0.000000 0.000000 1.000000 /end COMPU_METHOD
/* Scalar measurable for DDE 'ain_A3_vpilpeak_int_filt'. */
/begin MEASUREMENT ain_A3_vpilpeak_int_filt "Pilot Peak filtered (CCU pin A3)" FLOAT32_IEEE CU_AIN_A3_VPILPEAK_INT_FILT 1 100 0.0 5.0 ECU_ADDRESS 0x70019ed0 BYTE_ORDER MSB_LAST /end MEASUREMENT
/begin COMPU_METHOD CU_AIN_A3_VPILPEAK_INT_FILT "Conversion method for ain_A3_vpilpeak_int_filt" RAT_FUNC "%10.3" "V" COEFFS 0.000000 1.000000 -0.000000 0.000000 0.000000 1.000000 /end COMPU_METHOD
/* Scalar measurable for DDE 'ain_A3_vpilpeak_int_preFilt'. */
/begin MEASUREMENT ain_A3_vpilpeak_int_preFilt "VPILPEAK before low pass filter. Will be raw A3_VPILPEAK value if dotc_Enbl_OverrideVpkClr is set to 1." FLOAT32_IEEE CU_AIN_A3_VPILPEAK_INT_PREFILT 1 100 0.0 5.0 ECU_ADDRESS 0x7001a064 BYTE_ORDER MSB_LAST /end MEASUREMENT
/begin COMPU_METHOD CU_AIN_A3_VPILPEAK_INT_PREFILT "Conversion method for ain_A3_vpilpeak_int_preFilt" RAT_FUNC "%10.3" "V" COEFFS 0.000000 1.000000 -0.000000 0.000000 0.000000 1.000000 /end COMPU_METHOD
/* Scalar measurable for DDE 'ain_A3_vpilpeak_int_unfilt'. */
/begin MEASUREMENT ain_A3_vpilpeak_int_unfilt "Pilot Peak raw unfiltered (CCU pin A3)" FLOAT32_IEEE CU_AIN_A3_VPILPEAK_INT_UNFILT 1 100 0.0 5.0 ECU_ADDRESS 0x70019ef4 BYTE_ORDER MSB_LAST /end MEASUREMENT
/begin COMPU_METHOD CU_AIN_A3_VPILPEAK_INT_UNFILT "Conversion method for ain_A3_vpilpeak_int_unfilt" RAT_FUNC "%10.3" "V" COEFFS 0.000000 1.000000 -0.000000 0.000000 0.000000 1.000000 /end COMPU_METHOD
/* Scalar measurable for DDE 'ain_A3_vpilpeak_int_unfilt_held'. */
/begin MEASUREMENT ain_A3_vpilpeak_int_unfilt_held "Pilot peak raw value held during reset." FLOAT32_IEEE CU_AIN_A3_VPILPEAK_INT_UNFILT_0 1 100 0.0 5.0 ECU_ADDRESS 0x7001a084 BYTE_ORDER MSB_LAST /end MEASUREMENT
/begin COMPU_METHOD CU_AIN_A3_VPILPEAK_INT_UNFILT_0 "Conversion method for ain_A3_vpilpeak_int_unfilt_held" RAT_FUNC "%10.3" "V" COEFFS 0.000000 1.000000 -0.000000 0.000000 0.000000 1.000000 /end COMPU_METHOD
/* Scalar measurable for DDE 'ain_B2_vtempa_filt'. */
/begin MEASUREMENT ain_B2_vtempa_filt "Thermistor sensor A filtered (CCU pin B2)" FLOAT32_IEEE CU_AIN_B2_VTEMPA_FILT 1 100 0.0 5.0 ECU_ADDRESS 0x70019f10 BYTE_ORDER MSB_LAST /end MEASUREMENT
/begin COMPU_METHOD CU_AIN_B2_VTEMPA_FILT "Conversion method for ain_B2_vtempa_filt" RAT_FUNC "%10.3" "V" COEFFS 0.000000 1.000000 -0.000000 0.000000 0.000000 1.000000 /end COMPU_METHOD
/* Scalar measurable for DDE 'ain_B2_vtempa_unfilt'. */
/begin MEASUREMENT ain_B2_vtempa_unfilt "Thermistor sensor A raw unfiltered (CCU pin B2)" FLOAT32_IEEE CU_AIN_B2_VTEMPA_UNFILT 1 100 0.0 5.0 ECU_ADDRESS 0x7001a0a4 BYTE_ORDER MSB_LAST /end MEASUREMENT
/begin COMPU_METHOD CU_AIN_B2_VTEMPA_UNFILT "Conversion method for ain_B2_vtempa_unfilt" RAT_FUNC "%10.3" "V" COEFFS 0.000000 1.000000 -0.000000 0.000000 0.000000 1.000000 /end COMPU_METHOD
/* Scalar measurable for DDE 'ain_B3_vtempb_filt'. */
/begin MEASUREMENT ain_B3_vtempb_filt "Thermistor sensor B filtered (CCU pin B3)" FLOAT32_IEEE CU_AIN_B3_VTEMPB_FILT 1 100 0.0 5.0 ECU_ADDRESS 0x70019ee0 BYTE_ORDER MSB_LAST /end MEASUREMENT
/begin COMPU_METHOD CU_AIN_B3_VTEMPB_FILT "Conversion method for ain_B3_vtempb_filt" RAT_FUNC "%10.3" "V" COEFFS 0.000000 1.000000 -0.000000 0.000000 0.000000 1.000000 /end COMPU_METHOD
/* Scalar measurable for DDE 'ain_B3_vtempb_unfilt'. */
/begin MEASUREMENT ain_B3_vtempb_unfilt "Thermistor sensor B raw unfiltered (CCU pin B3)" FLOAT32_IEEE CU_AIN_B3_VTEMPB_UNFILT 1 100 0.0 5.0 ECU_ADDRESS 0x7001a074 BYTE_ORDER MSB_LAST /end MEASUREMENT
/begin COMPU_METHOD CU_AIN_B3_VTEMPB_UNFILT "Conversion method for ain_B3_vtempb_unfilt" RAT_FUNC "%10.3" "V" COEFFS 0.000000 1.000000 -0.000000 0.000000 0.000000 1.000000 /end COMPU_METHOD
/* Scalar measurable for DDE 'ain_B4_vtempc_filt'. */
/begin MEASUREMENT ain_B4_vtempc_filt "Thermistor sensor C filtered (CCU pin B4)" FLOAT32_IEEE CU_AIN_B4_VTEMPC_FILT 1 100 0.0 5.0 ECU_ADDRESS 0x70019ed8 BYTE_ORDER MSB_LAST /end MEASUREMENT
/begin COMPU_METHOD CU_AIN_B4_VTEMPC_FILT "Conversion method for ain_B4_vtempc_filt" RAT_FUNC "%10.3" "V" COEFFS 0.000000 1.000000 -0.000000 0.000000 0.000000 1.000000 /end COMPU_METHOD
/* Scalar measurable for DDE 'ain_B4_vtempc_unfilt'. */
/begin MEASUREMENT ain_B4_vtempc_unfilt "Thermistor sensor C raw unfiltered (CCU pin B4)" FLOAT32_IEEE CU_AIN_B4_VTEMPC_UNFILT 1 100 0.0 5.0 ECU_ADDRESS 0x7001a038 BYTE_ORDER MSB_LAST /end MEASUREMENT
/begin COMPU_METHOD CU_AIN_B4_VTEMPC_UNFILT "Conversion method for ain_B4_vtempc_unfilt" RAT_FUNC "%10.3" "V" COEFFS 0.000000 1.000000 -0.000000 0.000000 0.000000 1.000000 /end COMPU_METHOD
/* Scalar measurable for DDE 'ain_C2_vtempd_filt'. */
/begin MEASUREMENT ain_C2_vtempd_filt "Thermistor sensor D filtered (CCU pin C2)" FLOAT32_IEEE CU_AIN_C2_VTEMPD_FILT 1 100 0.0 5.0 ECU_ADDRESS 0x7001a028 BYTE_ORDER MSB_LAST /end MEASUREMENT
/begin COMPU_METHOD CU_AIN_C2_VTEMPD_FILT "Conversion method for ain_C2_vtempd_filt" RAT_FUNC "%10.3" "V" COEFFS 0.000000 1.000000 -0.000000 0.000000 0.000000 1.000000 /end COMPU_METHOD
/* Scalar measurable for DDE 'ain_C2_vtempd_unfilt'. */
/begin MEASUREMENT ain_C2_vtempd_unfilt "Thermistor sensor D raw unfiltered (CCU pin C2)" FLOAT32_IEEE CU_AIN_C2_VTEMPD_UNFILT 1 100 0.0 5.0 ECU_ADDRESS 0x70019f74 BYTE_ORDER MSB_LAST /end MEASUREMENT
/begin COMPU_METHOD CU_AIN_C2_VTEMPD_UNFILT "Conversion method for ain_C2_vtempd_unfilt" RAT_FUNC "%10.3" "V" COEFFS 0.000000 1.000000 -0.000000 0.000000 0.000000 1.000000 /end COMPU_METHOD
/* Scalar measurable for DDE 'ain_D3_AinE_ext_filt'. */
/begin MEASUREMENT ain_D3_AinE_ext_filt "AinE/ChgLock scaled filtered (CCU pin D3)" FLOAT32_IEEE CU_AIN_D3_AINE_EXT_FILT 1 100 0.0 40.0 ECU_ADDRESS 0x7001a0c8 BYTE_ORDER MSB_LAST /end MEASUREMENT
/begin COMPU_METHOD CU_AIN_D3_AINE_EXT_FILT "Conversion method for ain_D3_AinE_ext_filt" RAT_FUNC "%10.3" "V" COEFFS 0.000000 1.000000 -0.000000 0.000000 0.000000 1.000000 /end COMPU_METHOD
/* Scalar measurable for DDE 'ain_D3_AinE_ext_unfilt'. */
/begin MEASUREMENT ain_D3_AinE_ext_unfilt "AinE/ChgLock scaled unfiltered (CCU pin D3)" FLOAT32_IEEE CU_AIN_D3_AINE_EXT_UNFILT 1 100 0.0 40.0 ECU_ADDRESS 0x7001a040 BYTE_ORDER MSB_LAST /end MEASUREMENT
/begin COMPU_METHOD CU_AIN_D3_AINE_EXT_UNFILT "Conversion method for ain_D3_AinE_ext_unfilt" RAT_FUNC "%10.3" "V" COEFFS 0.000000 1.000000 -0.000000 0.000000 0.000000 1.000000 /end COMPU_METHOD
/* Scalar measurable for DDE 'ain_D3_AinE_int_filt'. */
/begin MEASUREMENT ain_D3_AinE_int_filt "AinE/ChgLock filtered (CCU pin D3)" FLOAT32_IEEE CU_AIN_D3_AINE_INT_FILT 1 100 0.0 5.0 ECU_ADDRESS 0x7001a1a8 BYTE_ORDER MSB_LAST /end MEASUREMENT
/begin COMPU_METHOD CU_AIN_D3_AINE_INT_FILT "Conversion method for ain_D3_AinE_int_filt" RAT_FUNC "%10.3" "V" COEFFS 0.000000 1.000000 -0.000000 0.000000 0.000000 1.000000 /end COMPU_METHOD
/* Scalar measurable for DDE 'ain_D3_AinE_int_unfilt'. */
/begin MEASUREMENT ain_D3_AinE_int_unfilt "AinE/ChgLock raw unfiltered (CCU pin D3)" FLOAT32_IEEE CU_AIN_D3_AINE_INT_UNFILT 1 100 0.0 5.0 ECU_ADDRESS 0x70019fa8 BYTE_ORDER MSB_LAST /end MEASUREMENT
/begin COMPU_METHOD CU_AIN_D3_AINE_INT_UNFILT "Conversion method for ain_D3_AinE_int_unfilt" RAT_FUNC "%10.3" "V" COEFFS 0.000000 1.000000 -0.000000 0.000000 0.000000 1.000000 /end COMPU_METHOD
/* Scalar measurable for DDE 'ain_F2_LedA_ext_filt'. */
/begin MEASUREMENT ain_F2_LedA_ext_filt "LEDA scaled filtered (CCU pin F2)" FLOAT32_IEEE CU_AIN_F2_LEDA_EXT_FILT 1 100 0.0 40.0 ECU_ADDRESS 0x70019f9c BYTE_ORDER MSB_LAST /end MEASUREMENT
/begin COMPU_METHOD CU_AIN_F2_LEDA_EXT_FILT "Conversion method for ain_F2_LedA_ext_filt" RAT_FUNC "%10.3" "V" COEFFS 0.000000 1.000000 -0.000000 0.000000 0.000000 1.000000 /end COMPU_METHOD
/* Scalar measurable for DDE 'ain_F2_LedA_ext_unfilt'. */
/begin MEASUREMENT ain_F2_LedA_ext_unfilt "LEDA scaled unfiltered (CCU pin F2)" FLOAT32_IEEE CU_AIN_F2_LEDA_EXT_UNFILT 1 100 0.0 40.0 ECU_ADDRESS 0x7001a068 BYTE_ORDER MSB_LAST /end MEASUREMENT
/begin COMPU_METHOD CU_AIN_F2_LEDA_EXT_UNFILT "Conversion method for ain_F2_LedA_ext_unfilt" RAT_FUNC "%10.3" "V" COEFFS 0.000000 1.000000 -0.000000 0.000000 0.000000 1.000000 /end COMPU_METHOD
/* Scalar measurable for DDE 'ain_F2_LedA_int_filt'. */
/begin MEASUREMENT ain_F2_LedA_int_filt "LEDA filtered (CCU pin F2)" FLOAT32_IEEE CU_AIN_F2_LEDA_INT_FILT 1 100 0.0 5.0 ECU_ADDRESS 0x7001a054 BYTE_ORDER MSB_LAST /end MEASUREMENT
/begin COMPU_METHOD CU_AIN_F2_LEDA_INT_FILT "Conversion method for ain_F2_LedA_int_filt" RAT_FUNC "%10.3" "V" COEFFS 0.000000 1.000000 -0.000000 0.000000 0.000000 1.000000 /end COMPU_METHOD
/* Scalar measurable for DDE 'ain_F2_LedA_int_unfilt'. */
/begin MEASUREMENT ain_F2_LedA_int_unfilt "LEDA raw unfiltered (CCU pin F2)" FLOAT32_IEEE CU_AIN_F2_LEDA_INT_UNFILT 1 100 0.0 5.0 ECU_ADDRESS 0x70019fb0 BYTE_ORDER MSB_LAST /end MEASUREMENT
/begin COMPU_METHOD CU_AIN_F2_LEDA_INT_UNFILT "Conversion method for ain_F2_LedA_int_unfilt" RAT_FUNC "%10.3" "V" COEFFS 0.000000 1.000000 -0.000000 0.000000 0.000000 1.000000 /end COMPU_METHOD
/* Scalar measurable for DDE 'ain_F3_LedB_ext_filt'. */
/begin MEASUREMENT ain_F3_LedB_ext_filt "LEDB scaled filtered (CCU pin F3)" FLOAT32_IEEE CU_AIN_F3_LEDB_EXT_FILT 1 100 0.0 40.0 ECU_ADDRESS 0x7001a100 BYTE_ORDER MSB_LAST /end MEASUREMENT
/begin COMPU_METHOD CU_AIN_F3_LEDB_EXT_FILT "Conversion method for ain_F3_LedB_ext_filt" RAT_FUNC "%10.3" "V" COEFFS 0.000000 1.000000 -0.000000 0.000000 0.000000 1.000000 /end COMPU_METHOD
/* Scalar measurable for DDE 'ain_F3_LedB_ext_unfilt'. */
/begin MEASUREMENT ain_F3_LedB_ext_unfilt "LEDB scaled unfiltered (CCU pin F3)" FLOAT32_IEEE CU_AIN_F3_LEDB_EXT_UNFILT 1 100 0.0 40.0 ECU_ADDRESS 0x7001a0f8 BYTE_ORDER MSB_LAST /end MEASUREMENT
/begin COMPU_METHOD CU_AIN_F3_LEDB_EXT_UNFILT "Conversion method for ain_F3_LedB_ext_unfilt" RAT_FUNC "%10.3" "V" COEFFS 0.000000 1.000000 -0.000000 0.000000 0.000000 1.000000 /end COMPU_METHOD
/* Scalar measurable for DDE 'ain_F3_LedB_int_filt'. */
/begin MEASUREMENT ain_F3_LedB_int_filt "LEDB filtered (CCU pin F3)" FLOAT32_IEEE CU_AIN_F3_LEDB_INT_FILT 1 100 0.0 5.0 ECU_ADDRESS 0x7001a014 BYTE_ORDER MSB_LAST /end MEASUREMENT
/begin COMPU_METHOD CU_AIN_F3_LEDB_INT_FILT "Conversion method for ain_F3_LedB_int_filt" RAT_FUNC "%10.3" "V" COEFFS 0.000000 1.000000 -0.000000 0.000000 0.000000 1.000000 /end COMPU_METHOD
/* Scalar measurable for DDE 'ain_F3_LedB_int_unfilt'. */
/begin MEASUREMENT ain_F3_LedB_int_unfilt "LEDB raw unfiltered (CCU pin F3)" FLOAT32_IEEE CU_AIN_F3_LEDB_INT_UNFILT 1 100 0.0 5.0 ECU_ADDRESS 0x70019fec BYTE_ORDER MSB_LAST /end MEASUREMENT
/begin COMPU_METHOD CU_AIN_F3_LEDB_INT_UNFILT "Conversion method for ain_F3_LedB_int_unfilt" RAT_FUNC "%10.3" "V" COEFFS 0.000000 1.000000 -0.000000 0.000000 0.000000 1.000000 /end COMPU_METHOD
/* Scalar measurable for DDE 'ain_F4_LedC_ext_filt'. */
/begin MEASUREMENT ain_F4_LedC_ext_filt "LEDC scaled filtered (CCU pin F4)" FLOAT32_IEEE CU_AIN_F4_LEDC_EXT_FILT 1 100 0.0 40.0 ECU_ADDRESS 0x70019fe0 BYTE_ORDER MSB_LAST /end MEASUREMENT
/begin COMPU_METHOD CU_AIN_F4_LEDC_EXT_FILT "Conversion method for ain_F4_LedC_ext_filt" RAT_FUNC "%10.3" "V" COEFFS 0.000000 1.000000 -0.000000 0.000000 0.000000 1.000000 /end COMPU_METHOD
/* Scalar measurable for DDE 'ain_F4_LedC_ext_unfilt'. */
/begin MEASUREMENT ain_F4_LedC_ext_unfilt "LEDC scaled unfiltered (CCU pin F4)" FLOAT32_IEEE CU_AIN_F4_LEDC_EXT_UNFILT 1 100 0.0 40.0 ECU_ADDRESS 0x7001a0a8 BYTE_ORDER MSB_LAST /end MEASUREMENT
/begin COMPU_METHOD CU_AIN_F4_LEDC_EXT_UNFILT "Conversion method for ain_F4_LedC_ext_unfilt" RAT_FUNC "%10.3" "V" COEFFS 0.000000 1.000000 -0.000000 0.000000 0.000000 1.000000 /end COMPU_METHOD
/* Scalar measurable for DDE 'ain_F4_LedC_int_filt'. */
/begin MEASUREMENT ain_F4_LedC_int_filt "LEDC filtered (CCU pin F4)" FLOAT32_IEEE CU_AIN_F4_LEDC_INT_FILT 1 100 0.0 5.0 ECU_ADDRESS 0x7001a09c BYTE_ORDER MSB_LAST /end MEASUREMENT
/begin COMPU_METHOD CU_AIN_F4_LEDC_INT_FILT "Conversion method for ain_F4_LedC_int_filt" RAT_FUNC "%10.3" "V" COEFFS 0.000000 1.000000 -0.000000 0.000000 0.000000 1.000000 /end COMPU_METHOD
/* Scalar measurable for DDE 'ain_F4_LedC_int_unfilt'. */
/begin MEASUREMENT ain_F4_LedC_int_unfilt "LEDC raw unfiltered (CCU pin F4)" FLOAT32_IEEE CU_AIN_F4_LEDC_INT_UNFILT 1 100 0.0 5.0 ECU_ADDRESS 0x7001a07c BYTE_ORDER MSB_LAST /end MEASUREMENT
/begin COMPU_METHOD CU_AIN_F4_LEDC_INT_UNFILT "Conversion method for ain_F4_LedC_int_unfilt" RAT_FUNC "%10.3" "V" COEFFS 0.000000 1.000000 -0.000000 0.000000 0.000000 1.000000 /end COMPU_METHOD
/* Scalar measurable for DDE 'ain_K3_ignition_ext_filt'. */
/begin MEASUREMENT ain_K3_ignition_ext_filt "Ignition scaled filtered (CCU pin K3)" FLOAT32_IEEE CU_AIN_K3_IGNITION_EXT_FILT 1 100 0.0 40.0 ECU_ADDRESS 0x7001a0f0 BYTE_ORDER MSB_LAST /end MEASUREMENT
/begin COMPU_METHOD CU_AIN_K3_IGNITION_EXT_FILT "Conversion method for ain_K3_ignition_ext_filt" RAT_FUNC "%10.3" "V" COEFFS 0.000000 1.000000 -0.000000 0.000000 0.000000 1.000000 /end COMPU_METHOD
/* Scalar measurable for DDE 'ain_K3_ignition_ext_unfilt'. */
/begin MEASUREMENT ain_K3_ignition_ext_unfilt "Ignition scaled unfiltered (CCU pin K3)" FLOAT32_IEEE CU_AIN_K3_IGNITION_EXT_UNFILT 1 100 0.0 5.0 ECU_ADDRESS 0x7001a0e4 BYTE_ORDER MSB_LAST /end MEASUREMENT
/begin COMPU_METHOD CU_AIN_K3_IGNITION_EXT_UNFILT "Conversion method for ain_K3_ignition_ext_unfilt" RAT_FUNC "%10.3" "V" COEFFS 0.000000 1.000000 -0.000000 0.000000 0.000000 1.000000 /end COMPU_METHOD
/* Scalar measurable for DDE 'ain_K3_ignition_int_filt'. */
/begin MEASUREMENT ain_K3_ignition_int_filt "Ignition filtered (CCU pin K3)" FLOAT32_IEEE CU_AIN_K3_IGNITION_INT_FILT 1 100 0.0 40.0 ECU_ADDRESS 0x7001a0cc BYTE_ORDER MSB_LAST /end MEASUREMENT
/begin COMPU_METHOD CU_AIN_K3_IGNITION_INT_FILT "Conversion method for ain_K3_ignition_int_filt" RAT_FUNC "%10.3" "V" COEFFS 0.000000 1.000000 -0.000000 0.000000 0.000000 1.000000 /end COMPU_METHOD
/* Scalar measurable for DDE 'ain_K3_ignition_int_unfilt'. */
/begin MEASUREMENT ain_K3_ignition_int_unfilt "Ignition raw unfiltered (CCU pin K3)" FLOAT32_IEEE CU_AIN_K3_IGNITION_INT_UNFILT 1 100 0.0 5.0 ECU_ADDRESS 0x70019ea4 BYTE_ORDER MSB_LAST /end MEASUREMENT
/begin COMPU_METHOD CU_AIN_K3_IGNITION_INT_UNFILT "Conversion method for ain_K3_ignition_int_unfilt" RAT_FUNC "%10.3" "V" COEFFS 0.000000 1.000000 -0.000000 0.000000 0.000000 1.000000 /end COMPU_METHOD
/* Scalar measurable for DDE 'ain_M2_HbrNVmon_ext_filt'. */
/begin MEASUREMENT ain_M2_HbrNVmon_ext_filt "HbrN Vmon scaled filtered (CCU pin M2)" FLOAT32_IEEE CU_AIN_M2_HBRNVMON_EXT_FILT 1 100 0.0 40.0 ECU_ADDRESS 0x7001a1ac BYTE_ORDER MSB_LAST /end MEASUREMENT
/begin COMPU_METHOD CU_AIN_M2_HBRNVMON_EXT_FILT "Conversion method for ain_M2_HbrNVmon_ext_filt" RAT_FUNC "%10.3" "V" COEFFS 0.000000 1.000000 -0.000000 0.000000 0.000000 1.000000 /end COMPU_METHOD
/* Scalar measurable for DDE 'ain_M2_HbrNVmon_ext_unfilt'. */
/begin MEASUREMENT ain_M2_HbrNVmon_ext_unfilt "HbrN Vmon scaled unfiltered (CCU pin M2)" FLOAT32_IEEE CU_AIN_M2_HBRNVMON_EXT_UNFILT 1 100 0.0 40.0 ECU_ADDRESS 0x70019fdc BYTE_ORDER MSB_LAST /end MEASUREMENT
/begin COMPU_METHOD CU_AIN_M2_HBRNVMON_EXT_UNFILT "Conversion method for ain_M2_HbrNVmon_ext_unfilt" RAT_FUNC "%10.3" "V" COEFFS 0.000000 1.000000 -0.000000 0.000000 0.000000 1.000000 /end COMPU_METHOD
/* Scalar measurable for DDE 'ain_M2_HbrNVmon_int_filt'. */
/begin MEASUREMENT ain_M2_HbrNVmon_int_filt "HbrN Vmon filtered (CCU pin M2)" FLOAT32_IEEE CU_AIN_M2_HBRNVMON_INT_FILT 1 100 0.0 5.0 ECU_ADDRESS 0x7001a06c BYTE_ORDER MSB_LAST /end MEASUREMENT
/begin COMPU_METHOD CU_AIN_M2_HBRNVMON_INT_FILT "Conversion method for ain_M2_HbrNVmon_int_filt" RAT_FUNC "%10.3" "V" COEFFS 0.000000 1.000000 -0.000000 0.000000 0.000000 1.000000 /end COMPU_METHOD
/* Scalar measurable for DDE 'ain_M2_HbrNVmon_int_unfilt'. */
/begin MEASUREMENT ain_M2_HbrNVmon_int_unfilt "HbrN Vmon raw unfiltered (CCU pin M2)" FLOAT32_IEEE CU_AIN_M2_HBRNVMON_INT_UNFILT 1 100 0.0 5.0 ECU_ADDRESS 0x70019ec0 BYTE_ORDER MSB_LAST /end MEASUREMENT
/begin COMPU_METHOD CU_AIN_M2_HBRNVMON_INT_UNFILT "Conversion method for ain_M2_HbrNVmon_int_unfilt" RAT_FUNC "%10.3" "V" COEFFS 0.000000 1.000000 -0.000000 0.000000 0.000000 1.000000 /end COMPU_METHOD
/* Scalar measurable for DDE 'ain_M3_HbrPVmon_ext_filt'. */
/begin MEASUREMENT ain_M3_HbrPVmon_ext_filt "HbrP Vmon scaled filtered (CCU pin M3)" FLOAT32_IEEE CU_AIN_M3_HBRPVMON_EXT_FILT 1 100 0.0 40.0 ECU_ADDRESS 0x70019eb8 BYTE_ORDER MSB_LAST /end MEASUREMENT
/begin COMPU_METHOD CU_AIN_M3_HBRPVMON_EXT_FILT "Conversion method for ain_M3_HbrPVmon_ext_filt" RAT_FUNC "%10.3" "V" COEFFS 0.000000 1.000000 -0.000000 0.000000 0.000000 1.000000 /end COMPU_METHOD
/* Scalar measurable for DDE 'ain_M3_HbrPVmon_ext_unfilt'. */
/begin MEASUREMENT ain_M3_HbrPVmon_ext_unfilt "HbrP Vmon scaled unfiltered (CCU pin M3)" FLOAT32_IEEE CU_AIN_M3_HBRPVMON_EXT_UNFILT 1 100 0.0 40.0 ECU_ADDRESS 0x7001a104 BYTE_ORDER MSB_LAST /end MEASUREMENT
/begin COMPU_METHOD CU_AIN_M3_HBRPVMON_EXT_UNFILT "Conversion method for ain_M3_HbrPVmon_ext_unfilt" RAT_FUNC "%10.3" "V" COEFFS 0.000000 1.000000 -0.000000 0.000000 0.000000 1.000000 /end COMPU_METHOD
/* Scalar measurable for DDE 'ain_M3_HbrPVmon_int_filt'. */
/begin MEASUREMENT ain_M3_HbrPVmon_int_filt "HbrP Vmon filtered (CCU pin M3)" FLOAT32_IEEE CU_AIN_M3_HBRPVMON_INT_FILT 1 100 0.0 5.0 ECU_ADDRESS 0x70019f4c BYTE_ORDER MSB_LAST /end MEASUREMENT
/begin COMPU_METHOD CU_AIN_M3_HBRPVMON_INT_FILT "Conversion method for ain_M3_HbrPVmon_int_filt" RAT_FUNC "%10.3" "V" COEFFS 0.000000 1.000000 -0.000000 0.000000 0.000000 1.000000 /end COMPU_METHOD
/* Scalar measurable for DDE 'ain_M3_HbrPVmon_int_unfilt'. */
/begin MEASUREMENT ain_M3_HbrPVmon_int_unfilt "HbrP Vmon raw unfiltered (CCU pin M3)" FLOAT32_IEEE CU_AIN_M3_HBRPVMON_INT_UNFILT 1 100 0.0 5.0 ECU_ADDRESS 0x70019f44 BYTE_ORDER MSB_LAST /end MEASUREMENT
/begin COMPU_METHOD CU_AIN_M3_HBRPVMON_INT_UNFILT "Conversion method for ain_M3_HbrPVmon_int_unfilt" RAT_FUNC "%10.3" "V" COEFFS 0.000000 1.000000 -0.000000 0.000000 0.000000 1.000000 /end COMPU_METHOD
/* Scalar measurable for DDE 'ain_TempIntDegC'. */
/begin MEASUREMENT ain_TempIntDegC "Temp Internal DegC scaled filtered (CCU pin J3)" FLOAT32_IEEE CU_AIN_TEMPINTDEGC 1 100 -60.0 150.0 ECU_ADDRESS 0x7001a020 BYTE_ORDER MSB_LAST /end MEASUREMENT
/begin COMPU_METHOD CU_AIN_TEMPINTDEGC "Conversion method for ain_TempIntDegC" RAT_FUNC "%10.2" "C" COEFFS 0.000000 1.000000 -0.000000 0.000000 0.000000 1.000000 /end COMPU_METHOD
/* Scalar measurable for DDE 'ain_TempInt_ext_filt'. */
/begin MEASUREMENT ain_TempInt_ext_filt "Internal Temp scaled filtered" FLOAT32_IEEE CU_AIN_TEMPINT_EXT_FILT 1 100 0.0 40.0 ECU_ADDRESS 0x7001a148 BYTE_ORDER MSB_LAST /end MEASUREMENT
/begin COMPU_METHOD CU_AIN_TEMPINT_EXT_FILT "Conversion method for ain_TempInt_ext_filt" RAT_FUNC "%10.3" "V" COEFFS 0.000000 1.000000 -0.000000 0.000000 0.000000 1.000000 /end COMPU_METHOD
/* Scalar measurable for DDE 'ain_TempInt_ext_unfilt'. */
/begin MEASUREMENT ain_TempInt_ext_unfilt "Internal Temp scaled unfiltered" FLOAT32_IEEE CU_AIN_TEMPINT_EXT_UNFILT 1 100 0.0 40.0 ECU_ADDRESS 0x7001a13c BYTE_ORDER MSB_LAST /end MEASUREMENT
/begin COMPU_METHOD CU_AIN_TEMPINT_EXT_UNFILT "Conversion method for ain_TempInt_ext_unfilt" RAT_FUNC "%10.3" "V" COEFFS 0.000000 1.000000 -0.000000 0.000000 0.000000 1.000000 /end COMPU_METHOD
/* Scalar measurable for DDE 'ain_TempInt_int_filt'. */
/begin MEASUREMENT ain_TempInt_int_filt "Internal Temp filtered" FLOAT32_IEEE CU_AIN_TEMPINT_INT_FILT 1 100 0.0 5.0 ECU_ADDRESS 0x70019ef8 BYTE_ORDER MSB_LAST /end MEASUREMENT
/begin COMPU_METHOD CU_AIN_TEMPINT_INT_FILT "Conversion method for ain_TempInt_int_filt" RAT_FUNC "%10.3" "V" COEFFS 0.000000 1.000000 -0.000000 0.000000 0.000000 1.000000 /end COMPU_METHOD
/* Scalar measurable for DDE 'ain_TempInt_int_unfilt'. */
/begin MEASUREMENT ain_TempInt_int_unfilt "Internal Temp raw unfiltered" FLOAT32_IEEE CU_AIN_TEMPINT_INT_UNFILT 1 100 0.0 5.0 ECU_ADDRESS 0x70019ee8 BYTE_ORDER MSB_LAST /end MEASUREMENT
/begin COMPU_METHOD CU_AIN_TEMPINT_INT_UNFILT "Conversion method for ain_TempInt_int_unfilt" RAT_FUNC "%10.3" "V" COEFFS 0.000000 1.000000 -0.000000 0.000000 0.000000 1.000000 /end COMPU_METHOD
/* Scalar measurable for DDE 'ain_Vbat_ext_filt'. */
/begin MEASUREMENT ain_Vbat_ext_filt "Vbat scaled filtered (CCU pin L2/L3)" FLOAT32_IEEE CU_AIN_VBAT_EXT_FILT 1 100 0.0 40.0 ECU_ADDRESS 0x70019ec8 BYTE_ORDER MSB_LAST /end MEASUREMENT
/begin COMPU_METHOD CU_AIN_VBAT_EXT_FILT "Conversion method for ain_Vbat_ext_filt" RAT_FUNC "%10.3" "V" COEFFS 0.000000 1.000000 -0.000000 0.000000 0.000000 1.000000 /end COMPU_METHOD
/* Scalar measurable for DDE 'ain_Vbat_ext_unfilt'. */
/begin MEASUREMENT ain_Vbat_ext_unfilt "Vbat scaled unfiltered (CCU pin L2/L3)" FLOAT32_IEEE CU_AIN_VBAT_EXT_UNFILT 1 100 0.0 40.0 ECU_ADDRESS 0x70019f94 BYTE_ORDER MSB_LAST /end MEASUREMENT
/begin COMPU_METHOD CU_AIN_VBAT_EXT_UNFILT "Conversion method for ain_Vbat_ext_unfilt" RAT_FUNC "%10.3" "V" COEFFS 0.000000 1.000000 -0.000000 0.000000 0.000000 1.000000 /end COMPU_METHOD
/* Scalar measurable for DDE 'ain_Vbat_int_filt'. */
/begin MEASUREMENT ain_Vbat_int_filt "Vbat filtered (CCU pin L2/L3)" FLOAT32_IEEE CU_AIN_VBAT_INT_FILT 1 100 0.0 5.0 ECU_ADDRESS 0x70019f8c BYTE_ORDER MSB_LAST /end MEASUREMENT
/begin COMPU_METHOD CU_AIN_VBAT_INT_FILT "Conversion method for ain_Vbat_int_filt" RAT_FUNC "%10.3" "V" COEFFS 0.000000 1.000000 -0.000000 0.000000 0.000000 1.000000 /end COMPU_METHOD
/* Scalar measurable for DDE 'ain_Vbat_int_unfilt'. */
/begin MEASUREMENT ain_Vbat_int_unfilt "Vbat raw unfiltered (CCU pin L2/L3)" FLOAT32_IEEE CU_AIN_VBAT_INT_UNFILT 1 100 0.0 5.0 ECU_ADDRESS 0x70019f18 BYTE_ORDER MSB_LAST /end MEASUREMENT
/begin COMPU_METHOD CU_AIN_VBAT_INT_UNFILT "Conversion method for ain_Vbat_int_unfilt" RAT_FUNC "%10.3" "V" COEFFS 0.000000 1.000000 -0.000000 0.000000 0.000000 1.000000 /end COMPU_METHOD
/* Scalar measurable for DDE 'ain_VrefA_ext_filt'. */
/begin MEASUREMENT ain_VrefA_ext_filt "VrefA scaled filtered" FLOAT32_IEEE CU_AIN_VREFA_EXT_FILT 1 100 0.0 20.0 ECU_ADDRESS 0x7001a180 BYTE_ORDER MSB_LAST /end MEASUREMENT
/begin COMPU_METHOD CU_AIN_VREFA_EXT_FILT "Conversion method for ain_VrefA_ext_filt" RAT_FUNC "%10.3" "V" COEFFS 0.000000 1.000000 -0.000000 0.000000 0.000000 1.000000 /end COMPU_METHOD
/* Scalar measurable for DDE 'ain_VrefA_ext_unfilt'. */
/begin MEASUREMENT ain_VrefA_ext_unfilt "VrefA scaled unfiltered" FLOAT32_IEEE CU_AIN_VREFA_EXT_UNFILT 1 100 0.0 20.0 ECU_ADDRESS 0x7001a16c BYTE_ORDER MSB_LAST /end MEASUREMENT
/begin COMPU_METHOD CU_AIN_VREFA_EXT_UNFILT "Conversion method for ain_VrefA_ext_unfilt" RAT_FUNC "%10.3" "V" COEFFS 0.000000 1.000000 -0.000000 0.000000 0.000000 1.000000 /end COMPU_METHOD
/* Scalar measurable for DDE 'ain_VrefA_int_filt'. */
/begin MEASUREMENT ain_VrefA_int_filt "VrefA filtered" FLOAT32_IEEE CU_AIN_VREFA_INT_FILT 1 100 0.0 5.0 ECU_ADDRESS 0x70019f34 BYTE_ORDER MSB_LAST /end MEASUREMENT
/begin COMPU_METHOD CU_AIN_VREFA_INT_FILT "Conversion method for ain_VrefA_int_filt" RAT_FUNC "%10.3" "V" COEFFS 0.000000 1.000000 -0.000000 0.000000 0.000000 1.000000 /end COMPU_METHOD
/* Scalar measurable for DDE 'ain_VrefA_int_unfilt'. */
/begin MEASUREMENT ain_VrefA_int_unfilt "VrefA raw unfiltered" FLOAT32_IEEE CU_AIN_VREFA_INT_UNFILT 1 100 0.0 5.0 ECU_ADDRESS 0x70019f2c BYTE_ORDER MSB_LAST /end MEASUREMENT
/begin COMPU_METHOD CU_AIN_VREFA_INT_UNFILT "Conversion method for ain_VrefA_int_unfilt" RAT_FUNC "%10.3" "V" COEFFS 0.000000 1.000000 -0.000000 0.000000 0.000000 1.000000 /end COMPU_METHOD
/* Scalar measurable for DDE 'ain_VrefB_ext_filt'. */
/begin MEASUREMENT ain_VrefB_ext_filt "VrefB scaled filtered" FLOAT32_IEEE CU_AIN_VREFB_EXT_FILT 1 100 0.0 20.0 ECU_ADDRESS 0x70019f08 BYTE_ORDER MSB_LAST /end MEASUREMENT
/begin COMPU_METHOD CU_AIN_VREFB_EXT_FILT "Conversion method for ain_VrefB_ext_filt" RAT_FUNC "%10.3" "V" COEFFS 0.000000 1.000000 -0.000000 0.000000 0.000000 1.000000 /end COMPU_METHOD
/* Scalar measurable for DDE 'ain_VrefB_ext_unfilt'. */
/begin MEASUREMENT ain_VrefB_ext_unfilt "VrefB scaled unfiltered" FLOAT32_IEEE CU_AIN_VREFB_EXT_UNFILT 1 100 0.0 20.0 ECU_ADDRESS 0x70019f84 BYTE_ORDER MSB_LAST /end MEASUREMENT
/begin COMPU_METHOD CU_AIN_VREFB_EXT_UNFILT "Conversion method for ain_VrefB_ext_unfilt" RAT_FUNC "%10.3" "V" COEFFS 0.000000 1.000000 -0.000000 0.000000 0.000000 1.000000 /end COMPU_METHOD
/* Scalar measurable for DDE 'ain_VrefB_int_filt'. */
/begin MEASUREMENT ain_VrefB_int_filt "VrefB filtered" FLOAT32_IEEE CU_AIN_VREFB_INT_FILT 1 100 0.0 5.0 ECU_ADDRESS 0x70019f78 BYTE_ORDER MSB_LAST /end MEASUREMENT
/begin COMPU_METHOD CU_AIN_VREFB_INT_FILT "Conversion method for ain_VrefB_int_filt" RAT_FUNC "%10.3" "V" COEFFS 0.000000 1.000000 -0.000000 0.000000 0.000000 1.000000 /end COMPU_METHOD
/* Scalar measurable for DDE 'ain_VrefB_int_unfilt'. */
/begin MEASUREMENT ain_VrefB_int_unfilt "VrefB raw unfiltered" FLOAT32_IEEE CU_AIN_VREFB_INT_UNFILT 1 100 0.0 5.0 ECU_ADDRESS 0x70019f50 BYTE_ORDER MSB_LAST /end MEASUREMENT
/begin COMPU_METHOD CU_AIN_VREFB_INT_UNFILT "Conversion method for ain_VrefB_int_unfilt" RAT_FUNC "%10.3" "V" COEFFS 0.000000 1.000000 -0.000000 0.000000 0.000000 1.000000 /end COMPU_METHOD
/* Scalar measurable for DDE 'ain_cpilot_dcycle'. */
/begin MEASUREMENT ain_cpilot_dcycle "Frequency for control pilot voltage (CCCU pin A3)" FLOAT32_IEEE CU_AIN_CPILOT_DCYCLE 1 100 0.0 1.0 ECU_ADDRESS 0x7001a034 BYTE_ORDER MSB_LAST /end MEASUREMENT
/begin COMPU_METHOD CU_AIN_CPILOT_DCYCLE "Conversion method for ain_cpilot_dcycle" RAT_FUNC "%10.2" "proportion" COEFFS 0.000000 1.000000 -0.000000 0.000000 0.000000 1.000000 /end COMPU_METHOD
/* Scalar measurable for DDE 'ain_cpilot_freq'. */
/begin MEASUREMENT ain_cpilot_freq "Duty cycle for control pilot voltage (CCCU pin A3)" FLOAT32_IEEE CU_AIN_CPILOT_FREQ 1 100 0.5 10000.0 ECU_ADDRESS 0x70019ed4 BYTE_ORDER MSB_LAST /end MEASUREMENT
/begin COMPU_METHOD CU_AIN_CPILOT_FREQ "Conversion method for ain_cpilot_freq" RAT_FUNC "%10.1" "Hz" COEFFS 0.000000 1.000000 -0.000000 0.000000 0.000000 1.000000 /end COMPU_METHOD
/* Scalar measurable for DDE 'ain_cpilot_state'. */
/begin MEASUREMENT ain_cpilot_state "Pin state for control pilot voltage (CCCU pin A3)" UBYTE CU_AIN_CPILOT_STATE 1 100 0.0 1.0 ECU_ADDRESS 0x70019ff0 BYTE_ORDER MSB_LAST /end MEASUREMENT
/begin COMPU_METHOD CU_AIN_CPILOT_STATE "Conversion method for ain_cpilot_state" RAT_FUNC "%10.0" "(not defined)" COEFFS 0.000000 1.000000 -0.000000 0.000000 0.000000 1.000000 /end COMPU_METHOD
/* Scalar measurable for DDE 'ain_cpilot_timeout'. */
/begin MEASUREMENT ain_cpilot_timeout "Timeout flag for control pilot voltage (CCCU pin A3)" UBYTE CU_AIN_CPILOT_TIMEOUT 1 100 0.0 1.0 ECU_ADDRESS 0x70019f70 BYTE_ORDER MSB_LAST /end MEASUREMENT
/begin COMPU_METHOD CU_AIN_CPILOT_TIMEOUT "Conversion method for ain_cpilot_timeout" RAT_FUNC "%10.0" "(not defined)" COEFFS 0.000000 1.000000 -0.000000 0.000000 0.000000 1.000000 /end COMPU_METHOD
/* Scalar measurable for DDE 'ain_cpilot_timeout_count'. */
/begin MEASUREMENT ain_cpilot_timeout_count "Timeout count for control pilot voltage (CCCU pin A3)" ULONG CU_AIN_CPILOT_TIMEOUT_COUNT 1 100 0.0 100.0 ECU_ADDRESS 0x7001a088 BYTE_ORDER MSB_LAST /end MEASUREMENT
/begin COMPU_METHOD CU_AIN_CPILOT_TIMEOUT_COUNT "Conversion method for ain_cpilot_timeout_count" RAT_FUNC "%10.0" "proportion" COEFFS 0.000000 1.000000 -0.000000 0.000000 0.000000 1.000000 /end COMPU_METHOD
/* Scalar measurable for DDE 'ain_ihbr_ext_filt'. */
/begin MEASUREMENT ain_ihbr_ext_filt "Hbr imon scaled filtered (CCU pin M3/M2)" FLOAT32_IEEE CU_AIN_IHBR_EXT_FILT 1 100 0.0 10.0 ECU_ADDRESS 0x7001a158 BYTE_ORDER MSB_LAST /end MEASUREMENT
/begin COMPU_METHOD CU_AIN_IHBR_EXT_FILT "Conversion method for ain_ihbr_ext_filt" RAT_FUNC "%10.3" "A" COEFFS 0.000000 1.000000 -0.000000 0.000000 0.000000 1.000000 /end COMPU_METHOD
/* Scalar measurable for DDE 'ain_ihbr_ext_unfilt'. */
/begin MEASUREMENT ain_ihbr_ext_unfilt "Hbr imon scaled unfiltered (CCU pin M3/M2)" FLOAT32_IEEE CU_AIN_IHBR_EXT_UNFILT 1 100 0.0 10.0 ECU_ADDRESS 0x7001a134 BYTE_ORDER MSB_LAST /end MEASUREMENT
/begin COMPU_METHOD CU_AIN_IHBR_EXT_UNFILT "Conversion method for ain_ihbr_ext_unfilt" RAT_FUNC "%10.3" "A" COEFFS 0.000000 1.000000 -0.000000 0.000000 0.000000 1.000000 /end COMPU_METHOD
/* Scalar measurable for DDE 'ain_ihbr_int_filt'. */
/begin MEASUREMENT ain_ihbr_int_filt "Hbr imon filtered (CCU pin M3/M2)" FLOAT32_IEEE CU_AIN_IHBR_INT_FILT 1 100 0.0 5.0 ECU_ADDRESS 0x70019f14 BYTE_ORDER MSB_LAST /end MEASUREMENT
/begin COMPU_METHOD CU_AIN_IHBR_INT_FILT "Conversion method for ain_ihbr_int_filt" RAT_FUNC "%10.3" "V" COEFFS 0.000000 1.000000 -0.000000 0.000000 0.000000 1.000000 /end COMPU_METHOD
/* Scalar measurable for DDE 'ain_ihbr_int_unfilt'. */
/begin MEASUREMENT ain_ihbr_int_unfilt "Hbr imon raw unfiltered (CCU pin M3/M2)" FLOAT32_IEEE CU_AIN_IHBR_INT_UNFILT 1 100 0.0 5.0 ECU_ADDRESS 0x7001a0ac BYTE_ORDER MSB_LAST /end MEASUREMENT
/begin COMPU_METHOD CU_AIN_IHBR_INT_UNFILT "Conversion method for ain_ihbr_int_unfilt" RAT_FUNC "%10.3" "V" COEFFS 0.000000 1.000000 -0.000000 0.000000 0.000000 1.000000 /end COMPU_METHOD
/* Scalar measurable for DDE 'ccu_cpu_loading'. */
/begin MEASUREMENT ccu_cpu_loading "CPU loading seen in last 50ms" UBYTE CU_CCU_CPU_LOADING 1 100 0.0 0.0 ECU_ADDRESS 0x70019ee5 BYTE_ORDER MSB_LAST /end MEASUREMENT
/begin COMPU_METHOD CU_CCU_CPU_LOADING "Conversion method for ccu_cpu_loading" RAT_FUNC "%10.0" "%" COEFFS 0.000000 1.000000 -0.000000 0.000000 0.000000 1.000000 /end COMPU_METHOD
/* Scalar measurable for DDE 'ccu_cpu_loading_max'. */
/begin MEASUREMENT ccu_cpu_loading_max "Maximum CPU loading seen in any 50ms period" UBYTE CU_CCU_CPU_LOADING_MAX 1 100 0.0 0.0 ECU_ADDRESS 0x7001a002 BYTE_ORDER MSB_LAST /end MEASUREMENT
/begin COMPU_METHOD CU_CCU_CPU_LOADING_MAX "Conversion method for ccu_cpu_loading_max" RAT_FUNC "%10.0" "%" COEFFS 0.000000 1.000000 -0.000000 0.000000 0.000000 1.000000 /end COMPU_METHOD
/* Scalar measurable for DDE 'ccu_stack_used'. */
/begin MEASUREMENT ccu_stack_used "Amount of used stack" ULONG CU_CCU_STACK_USED 1 100 0.0 0.0 ECU_ADDRESS 0x0 BYTE_ORDER MSB_LAST /end MEASUREMENT
/begin COMPU_METHOD CU_CCU_STACK_USED "Conversion method for ccu_stack_used" RAT_FUNC "%10.0" "bytes" COEFFS 0.000000 1.000000 -0.000000 0.000000 0.000000 1.000000 /end COMPU_METHOD
/* Scalar measurable for DDE 'ccu_task_duration_1s'. */
/begin MEASUREMENT ccu_task_duration_1s "Duration of 1s task (last measured valued)" ULONG CU_CCU_TASK_DURATION_1S 1 100 0.0 0.0 ECU_ADDRESS 0x7001a0c0 BYTE_ORDER MSB_LAST /end MEASUREMENT
/begin COMPU_METHOD CU_CCU_TASK_DURATION_1S "Conversion method for ccu_task_duration_1s" RAT_FUNC "%10.0" "microseconds" COEFFS 0.000000 1.000000 -0.000000 0.000000 0.000000 1.000000 /end COMPU_METHOD
/* Scalar measurable for DDE 'ccu_task_duration_1s_max'. */
/begin MEASUREMENT ccu_task_duration_1s_max "Duration of 1s task (maximum since power up)" ULONG CU_CCU_TASK_DURATION_1S_MAX 1 100 0.0 0.0 ECU_ADDRESS 0x70019ea8 BYTE_ORDER MSB_LAST /end MEASUREMENT
/begin COMPU_METHOD CU_CCU_TASK_DURATION_1S_MAX "Conversion method for ccu_task_duration_1s_max" RAT_FUNC "%10.0" "microseconds" COEFFS 0.000000 1.000000 -0.000000 0.000000 0.000000 1.000000 /end COMPU_METHOD
/* Scalar measurable for DDE 'din_nHbrFlt'. */
/begin MEASUREMENT din_nHbrFlt "(not defined)" UBYTE CU_DIN_NHBRFLT 1 100 0.0 255.0 ECU_ADDRESS 0x7001a168 BYTE_ORDER MSB_LAST /end MEASUREMENT
/begin COMPU_METHOD CU_DIN_NHBRFLT "Conversion method for din_nHbrFlt" RAT_FUNC "%10.0" "(not defined)" COEFFS 0.000000 1.000000 -0.000000 0.000000 0.000000 1.000000 /end COMPU_METHOD
/* Scalar measurable for DDE 'din_p10_8_nplcirq'. */
/begin MEASUREMENT din_p10_8_nplcirq "NPLCIRQ" UBYTE CU_DIN_P10_8_NPLCIRQ 1 100 0.0 1.0 ECU_ADDRESS 0x7001a0e1 BYTE_ORDER MSB_LAST /end MEASUREMENT
/begin COMPU_METHOD CU_DIN_P10_8_NPLCIRQ "Conversion method for din_p10_8_nplcirq" RAT_FUNC "%10.0" "(not defined)" COEFFS 0.000000 1.000000 -0.000000 0.000000 0.000000 1.000000 /end COMPU_METHOD
/* Scalar measurable for DDE 'din_p15_1_run'. */
/begin MEASUREMENT din_p15_1_run "RUN  (CCU pin K3)" UBYTE CU_DIN_P15_1_RUN 1 100 0.0 1.0 ECU_ADDRESS 0x70019efc BYTE_ORDER MSB_LAST /end MEASUREMENT
/begin COMPU_METHOD CU_DIN_P15_1_RUN "Conversion method for din_p15_1_run" RAT_FUNC "%10.0" "(not defined)" COEFFS 0.000000 1.000000 -0.000000 0.000000 0.000000 1.000000 /end COMPU_METHOD
/* Scalar measurable for DDE 'din_p22_0_qout3'. */
/begin MEASUREMENT din_p22_0_qout3 "QOUT3" UBYTE CU_DIN_P22_0_QOUT3 1 100 0.0 1.0 ECU_ADDRESS 0x70019eb4 BYTE_ORDER MSB_LAST /end MEASUREMENT
/begin COMPU_METHOD CU_DIN_P22_0_QOUT3 "Conversion method for din_p22_0_qout3" RAT_FUNC "%10.0" "(not defined)" COEFFS 0.000000 1.000000 -0.000000 0.000000 0.000000 1.000000 /end COMPU_METHOD
/* Scalar measurable for DDE 'din_p33_0_can_wake'. */
/begin MEASUREMENT din_p33_0_can_wake "CAN_WAKE" UBYTE CU_DIN_P33_0_CAN_WAKE 1 100 0.0 1.0 ECU_ADDRESS 0x7001a044 BYTE_ORDER MSB_LAST /end MEASUREMENT
/begin COMPU_METHOD CU_DIN_P33_0_CAN_WAKE "Conversion method for din_p33_0_can_wake" RAT_FUNC "%10.0" "(not defined)" COEFFS 0.000000 1.000000 -0.000000 0.000000 0.000000 1.000000 /end COMPU_METHOD
/* Scalar measurable for DDE 'din_p33_1_pilwake'. */
/begin MEASUREMENT din_p33_1_pilwake "PILWAKE (CCU pin A3)" UBYTE CU_DIN_P33_1_PILWAKE 1 100 0.0 1.0 ECU_ADDRESS 0x7001a110 BYTE_ORDER MSB_LAST /end MEASUREMENT
/begin COMPU_METHOD CU_DIN_P33_1_PILWAKE "Conversion method for din_p33_1_pilwake" RAT_FUNC "%10.0" "(not defined)" COEFFS 0.000000 1.000000 -0.000000 0.000000 0.000000 1.000000 /end COMPU_METHOD
/* Scalar measurable for DDE 'din_p33_9_ss1'. */
/begin MEASUREMENT din_p33_9_ss1 "SS1" UBYTE CU_DIN_P33_9_SS1 1 100 0.0 1.0 ECU_ADDRESS 0x7001a0e0 BYTE_ORDER MSB_LAST /end MEASUREMENT
/begin COMPU_METHOD CU_DIN_P33_9_SS1 "Conversion method for din_p33_9_ss1" RAT_FUNC "%10.0" "(not defined)" COEFFS 0.000000 1.000000 -0.000000 0.000000 0.000000 1.000000 /end COMPU_METHOD
/* Scalar measurable for DDE 'din_scu_fsp'. */
/begin MEASUREMENT din_scu_fsp "(not defined)" UBYTE CU_DIN_SCU_FSP 1 100 0.0 255.0 ECU_ADDRESS 0x70019ecc BYTE_ORDER MSB_LAST /end MEASUREMENT
/begin COMPU_METHOD CU_DIN_SCU_FSP "Conversion method for din_scu_fsp" RAT_FUNC "%10.0" "(not defined)" COEFFS 0.000000 1.000000 -0.000000 0.000000 0.000000 1.000000 /end COMPU_METHOD
/* Scalar measurable for DDE 'din_ss2_alt'. */
/begin MEASUREMENT din_ss2_alt "(not defined)" UBYTE CU_DIN_SS2_ALT 1 100 0.0 255.0 ECU_ADDRESS 0x70019fbc BYTE_ORDER MSB_LAST /end MEASUREMENT
/begin COMPU_METHOD CU_DIN_SS2_ALT "Conversion method for din_ss2_alt" RAT_FUNC "%10.0" "(not defined)" COEFFS 0.000000 1.000000 -0.000000 0.000000 0.000000 1.000000 /end COMPU_METHOD
/* Scalar measurable for DDE 'din_ss2_scu_stop'. */
/begin MEASUREMENT din_ss2_scu_stop "(not defined)" UBYTE CU_DIN_SS2_SCU_STOP 1 100 0.0 255.0 ECU_ADDRESS 0x7001a108 BYTE_ORDER MSB_LAST /end MEASUREMENT
/begin COMPU_METHOD CU_DIN_SS2_SCU_STOP "Conversion method for din_ss2_scu_stop" RAT_FUNC "%10.0" "(not defined)" COEFFS 0.000000 1.000000 -0.000000 0.000000 0.000000 1.000000 /end COMPU_METHOD
/* Scalar measurable for DDE 'flt_ain_bits'. */
/begin MEASUREMENT flt_ain_bits "Analog faults." UBYTE CU_FLT_AIN_BITS 1 100 0.0 255.0 ECU_ADDRESS 0x7001a001 BYTE_ORDER MSB_LAST /end MEASUREMENT
/begin COMPU_METHOD CU_FLT_AIN_BITS "Conversion method for flt_ain_bits" RAT_FUNC "%10.0" "(not defined)" COEFFS 0.000000 1.000000 -0.000000 0.000000 0.000000 1.000000 /end COMPU_METHOD
/* Scalar measurable for DDE 'ihbr_MaxFlt'. */
/begin MEASUREMENT ihbr_MaxFlt "Hbr imon above max threshold latched after debounce (CCU pin M3/M2)" UBYTE CU_IHBR_MAXFLT 1 100 0.0 1.0 ECU_ADDRESS 0x7001a138 BYTE_ORDER MSB_LAST /end MEASUREMENT
/begin COMPU_METHOD CU_IHBR_MAXFLT "Conversion method for ihbr_MaxFlt" RAT_FUNC "%10.0" "(not defined)" COEFFS 0.000000 1.000000 -0.000000 0.000000 0.000000 1.000000 /end COMPU_METHOD
/* Scalar measurable for DDE 'ihbr_MaxFltActv'. */
/begin MEASUREMENT ihbr_MaxFltActv "Active fault high M3/M2 (Max fault no latch or debounce)" UBYTE CU_IHBR_MAXFLTACTV 1 100 0.0 1.0 ECU_ADDRESS 0x7001a112 BYTE_ORDER MSB_LAST /end MEASUREMENT
/begin COMPU_METHOD CU_IHBR_MAXFLTACTV "Conversion method for ihbr_MaxFltActv" RAT_FUNC "%10.0" "(not defined)" COEFFS 0.000000 1.000000 -0.000000 0.000000 0.000000 1.000000 /end COMPU_METHOD
/* Scalar measurable for DDE 'ihbr_MinFlt'. */
/begin MEASUREMENT ihbr_MinFlt "Hbr imon below min threshold latched after debounce (CCU pin M3/M2)" UBYTE CU_IHBR_MINFLT 1 100 0.0 1.0 ECU_ADDRESS 0x7001a150 BYTE_ORDER MSB_LAST /end MEASUREMENT
/begin COMPU_METHOD CU_IHBR_MINFLT "Conversion method for ihbr_MinFlt" RAT_FUNC "%10.0" "(not defined)" COEFFS 0.000000 1.000000 -0.000000 0.000000 0.000000 1.000000 /end COMPU_METHOD
/* Scalar measurable for DDE 'ihbr_MinFltActv'. */
/begin MEASUREMENT ihbr_MinFltActv "Active fault low M3/M2 (Min fault no latch or debounce)" UBYTE CU_IHBR_MINFLTACTV 1 100 0.0 1.0 ECU_ADDRESS 0x7001a024 BYTE_ORDER MSB_LAST /end MEASUREMENT
/begin COMPU_METHOD CU_IHBR_MINFLTACTV "Conversion method for ihbr_MinFltActv" RAT_FUNC "%10.0" "(not defined)" COEFFS 0.000000 1.000000 -0.000000 0.000000 0.000000 1.000000 /end COMPU_METHOD
/* Scalar measurable for DDE 'out_vpilpeak_reset_output'. */
/begin MEASUREMENT out_vpilpeak_reset_output "Command for pilot peak reset." UBYTE CU_OUT_VPILPEAK_RESET_OUTPUT 1 100 0.0 255.0 ECU_ADDRESS 0x7001a04c BYTE_ORDER MSB_LAST /end MEASUREMENT
/begin COMPU_METHOD CU_OUT_VPILPEAK_RESET_OUTPUT "Conversion method for out_vpilpeak_reset_output" RAT_FUNC "%10.0" "(not defined)" COEFFS 0.000000 1.000000 -0.000000 0.000000 0.000000 1.000000 /end COMPU_METHOD
/* Scalar measurable for DDE 'v3V3io_MaxFlt'. */
/begin MEASUREMENT v3V3io_MaxFlt "Internal 3V3 IO above max threshold latched after debounce" UBYTE CU_V3V3IO_MAXFLT 1 100 0.0 1.0 ECU_ADDRESS 0x7001a0d9 BYTE_ORDER MSB_LAST /end MEASUREMENT
/begin COMPU_METHOD CU_V3V3IO_MAXFLT "Conversion method for v3V3io_MaxFlt" RAT_FUNC "%10.0" "(not defined)" COEFFS 0.000000 1.000000 -0.000000 0.000000 0.000000 1.000000 /end COMPU_METHOD
/* Scalar measurable for DDE 'v3V3io_MaxFltActv'. */
/begin MEASUREMENT v3V3io_MaxFltActv "Active fault high (Max fault no latch or debounce)" UBYTE CU_V3V3IO_MAXFLTACTV 1 100 0.0 1.0 ECU_ADDRESS 0x7001a051 BYTE_ORDER MSB_LAST /end MEASUREMENT
/begin COMPU_METHOD CU_V3V3IO_MAXFLTACTV "Conversion method for v3V3io_MaxFltActv" RAT_FUNC "%10.0" "(not defined)" COEFFS 0.000000 1.000000 -0.000000 0.000000 0.000000 1.000000 /end COMPU_METHOD
/* Scalar measurable for DDE 'v3V3io_MinFlt'. */
/begin MEASUREMENT v3V3io_MinFlt "Internal 3V3 IO below min threshold latched after debounce" UBYTE CU_V3V3IO_MINFLT 1 100 0.0 1.0 ECU_ADDRESS 0x7001a151 BYTE_ORDER MSB_LAST /end MEASUREMENT
/begin COMPU_METHOD CU_V3V3IO_MINFLT "Conversion method for v3V3io_MinFlt" RAT_FUNC "%10.0" "(not defined)" COEFFS 0.000000 1.000000 -0.000000 0.000000 0.000000 1.000000 /end COMPU_METHOD
/* Scalar measurable for DDE 'v3V3io_MinFltActv'. */
/begin MEASUREMENT v3V3io_MinFltActv "Active fault low (Min fault no latch or debounce)" UBYTE CU_V3V3IO_MINFLTACTV 1 100 0.0 1.0 ECU_ADDRESS 0x70019f5c BYTE_ORDER MSB_LAST /end MEASUREMENT
/begin COMPU_METHOD CU_V3V3IO_MINFLTACTV "Conversion method for v3V3io_MinFltActv" RAT_FUNC "%10.0" "(not defined)" COEFFS 0.000000 1.000000 -0.000000 0.000000 0.000000 1.000000 /end COMPU_METHOD
/* Scalar measurable for DDE 'v3V3qca_MaxFlt'. */
/begin MEASUREMENT v3V3qca_MaxFlt "Internal 3V3 QCA above max threshold latched after debounce" UBYTE CU_V3V3QCA_MAXFLT 1 100 0.0 1.0 ECU_ADDRESS 0x7001a099 BYTE_ORDER MSB_LAST /end MEASUREMENT
/begin COMPU_METHOD CU_V3V3QCA_MAXFLT "Conversion method for v3V3qca_MaxFlt" RAT_FUNC "%10.0" "(not defined)" COEFFS 0.000000 1.000000 -0.000000 0.000000 0.000000 1.000000 /end COMPU_METHOD
/* Scalar measurable for DDE 'v3V3qca_MaxFltActv'. */
/begin MEASUREMENT v3V3qca_MaxFltActv "Active fault high (Max fault no latch or debounce)" UBYTE CU_V3V3QCA_MAXFLTACTV 1 100 0.0 1.0 ECU_ADDRESS 0x70019ebd BYTE_ORDER MSB_LAST /end MEASUREMENT
/begin COMPU_METHOD CU_V3V3QCA_MAXFLTACTV "Conversion method for v3V3qca_MaxFltActv" RAT_FUNC "%10.0" "(not defined)" COEFFS 0.000000 1.000000 -0.000000 0.000000 0.000000 1.000000 /end COMPU_METHOD
/* Scalar measurable for DDE 'v3V3qca_MinFlt'. */
/begin MEASUREMENT v3V3qca_MinFlt "Internal 3V3 QCA below min threshold latched after debounce" UBYTE CU_V3V3QCA_MINFLT 1 100 0.0 1.0 ECU_ADDRESS 0x7001a08c BYTE_ORDER MSB_LAST /end MEASUREMENT
/begin COMPU_METHOD CU_V3V3QCA_MINFLT "Conversion method for v3V3qca_MinFlt" RAT_FUNC "%10.0" "(not defined)" COEFFS 0.000000 1.000000 -0.000000 0.000000 0.000000 1.000000 /end COMPU_METHOD
/* Scalar measurable for DDE 'v3V3qca_MinFltActv'. */
/begin MEASUREMENT v3V3qca_MinFltActv "Active fault low (Min fault no latch or debounce)" UBYTE CU_V3V3QCA_MINFLTACTV 1 100 0.0 1.0 ECU_ADDRESS 0x7001a184 BYTE_ORDER MSB_LAST /end MEASUREMENT
/begin COMPU_METHOD CU_V3V3QCA_MINFLTACTV "Conversion method for v3V3qca_MinFltActv" RAT_FUNC "%10.0" "(not defined)" COEFFS 0.000000 1.000000 -0.000000 0.000000 0.000000 1.000000 /end COMPU_METHOD
/* Scalar measurable for DDE 'v3V3uc_MaxFlt'. */
/begin MEASUREMENT v3V3uc_MaxFlt "Internal 3V3 Micro above max threshold latched after debounce" UBYTE CU_V3V3UC_MAXFLT 1 100 0.0 1.0 ECU_ADDRESS 0x7001a080 BYTE_ORDER MSB_LAST /end MEASUREMENT
/begin COMPU_METHOD CU_V3V3UC_MAXFLT "Conversion method for v3V3uc_MaxFlt" RAT_FUNC "%10.0" "(not defined)" COEFFS 0.000000 1.000000 -0.000000 0.000000 0.000000 1.000000 /end COMPU_METHOD
/* Scalar measurable for DDE 'v3V3uc_MaxFltActv'. */
/begin MEASUREMENT v3V3uc_MaxFltActv "Active fault high (Max fault no latch or debounce)" UBYTE CU_V3V3UC_MAXFLTACTV 1 100 0.0 1.0 ECU_ADDRESS 0x7001a010 BYTE_ORDER MSB_LAST /end MEASUREMENT
/begin COMPU_METHOD CU_V3V3UC_MAXFLTACTV "Conversion method for v3V3uc_MaxFltActv" RAT_FUNC "%10.0" "(not defined)" COEFFS 0.000000 1.000000 -0.000000 0.000000 0.000000 1.000000 /end COMPU_METHOD
/* Scalar measurable for DDE 'v3V3uc_MinFlt'. */
/begin MEASUREMENT v3V3uc_MinFlt "Internal 3V3 Micro below min threshold latched after debounce" UBYTE CU_V3V3UC_MINFLT 1 100 0.0 1.0 ECU_ADDRESS 0x70019f38 BYTE_ORDER MSB_LAST /end MEASUREMENT
/begin COMPU_METHOD CU_V3V3UC_MINFLT "Conversion method for v3V3uc_MinFlt" RAT_FUNC "%10.0" "(not defined)" COEFFS 0.000000 1.000000 -0.000000 0.000000 0.000000 1.000000 /end COMPU_METHOD
/* Scalar measurable for DDE 'v3V3uc_MinFltActv'. */
/begin MEASUREMENT v3V3uc_MinFltActv "Active fault low (Min fault no latch or debounce)" UBYTE CU_V3V3UC_MINFLTACTV 1 100 0.0 1.0 ECU_ADDRESS 0x70019f04 BYTE_ORDER MSB_LAST /end MEASUREMENT
/begin COMPU_METHOD CU_V3V3UC_MINFLTACTV "Conversion method for v3V3uc_MinFltActv" RAT_FUNC "%10.0" "(not defined)" COEFFS 0.000000 1.000000 -0.000000 0.000000 0.000000 1.000000 /end COMPU_METHOD
/* Scalar measurable for DDE 'v5vdd_MaxFlt'. */
/begin MEASUREMENT v5vdd_MaxFlt "Internal 5VDD above max threshold latched after debounce" UBYTE CU_V5VDD_MAXFLT 1 100 0.0 1.0 ECU_ADDRESS 0x70019f98 BYTE_ORDER MSB_LAST /end MEASUREMENT
/begin COMPU_METHOD CU_V5VDD_MAXFLT "Conversion method for v5vdd_MaxFlt" RAT_FUNC "%10.0" "(not defined)" COEFFS 0.000000 1.000000 -0.000000 0.000000 0.000000 1.000000 /end COMPU_METHOD
/* Scalar measurable for DDE 'v5vdd_MaxFltActv'. */
/begin MEASUREMENT v5vdd_MaxFltActv "Active fault high (Max fault no latch or debounce)" UBYTE CU_V5VDD_MAXFLTACTV 1 100 0.0 1.0 ECU_ADDRESS 0x70019fb4 BYTE_ORDER MSB_LAST /end MEASUREMENT
/begin COMPU_METHOD CU_V5VDD_MAXFLTACTV "Conversion method for v5vdd_MaxFltActv" RAT_FUNC "%10.0" "(not defined)" COEFFS 0.000000 1.000000 -0.000000 0.000000 0.000000 1.000000 /end COMPU_METHOD
/* Scalar measurable for DDE 'v5vdd_MinFlt'. */
/begin MEASUREMENT v5vdd_MinFlt "Internal 5VDD below min threshold latched after debounce" UBYTE CU_V5VDD_MINFLT 1 100 0.0 1.0 ECU_ADDRESS 0x70019f65 BYTE_ORDER MSB_LAST /end MEASUREMENT
/begin COMPU_METHOD CU_V5VDD_MINFLT "Conversion method for v5vdd_MinFlt" RAT_FUNC "%10.0" "(not defined)" COEFFS 0.000000 1.000000 -0.000000 0.000000 0.000000 1.000000 /end COMPU_METHOD
/* Scalar measurable for DDE 'v5vdd_MinFltActv'. */
/begin MEASUREMENT v5vdd_MinFltActv "Active fault low (Min fault no latch or debounce)" UBYTE CU_V5VDD_MINFLTACTV 1 100 0.0 1.0 ECU_ADDRESS 0x70019f0c BYTE_ORDER MSB_LAST /end MEASUREMENT
/begin COMPU_METHOD CU_V5VDD_MINFLTACTV "Conversion method for v5vdd_MinFltActv" RAT_FUNC "%10.0" "(not defined)" COEFFS 0.000000 1.000000 -0.000000 0.000000 0.000000 1.000000 /end COMPU_METHOD
/begin FUNCTION Signals "Group /ByType/Signals"
 /begin LOC_MEASUREMENT V2gSupPrtclSelected V2gTxBptParamEnable V2gTxBulkChargingComplete V2gTxBulkSoc V2gTxChargeProgress V2gTxChargingComplete V2gTxDcChgParamEnable V2gTxEvCrntMaxLim V2gTxEvCrntMinLim V2gTxEvDisChgCrntMaxLim V2gTxEvDisChgCrntMinLim V2gTxEvDisChgPwrMaxLim V2gTxEvDisChgPwrMinLim V2gTxEvEgyCapacity V2gTxEvEgyReqAmount V2gTxEvErrorCode V2gTxEvMaxEgyReq V2gTxEvMinEgyReq V2gTxEvOperation V2gTxEvOperationEn V2gTxEvPwrMaxLim V2gTxEvPwrMinLim V2gTxEvReady V2gTxEvReqEgyTransferType V2gTxEvRessCondition V2gTxEvRessSoc V2gTxEvTargetCrnt V2gTxEvTargetVolt V2gTxEvVoltMaxLim V2gTxEvVoltMinLim V2gTxFullSoc V2gTxParameterSetId V2gTxProfileEntryCnt V2gTxRemainTimeToFullSoc V2gTxRemainTimetoBulkSoc V2gTxSaSchdlTupleId V2gTxSaSchdlTupleIdEn V2gTxServiceId V2gTxSupSvcIdsLen V2gTxSupSvcIds[0] V2gTxSupSvcIds[1] V2gTxSupSvcIds[2] V2gTxSupSvcIds[3] V2gTxSupSvcIds[4] V2gTxSupSvcIds[5] V2gTxSupSvcIds[6] V2gTxSupSvcIds[7] V2gTxSupSvcIds[8] V2gTxSupSvcIds[9] V2gTxTargetSoc Vbat_MaxFlt Vbat_MaxFltActv Vbat_MinFlt Vbat_MinFltActv VrefA_MaxFlt VrefA_MaxFltActv VrefA_MinFlt VrefA_MinFltActv VrefB_MaxFlt VrefB_MaxFltActv VrefB_MinFlt VrefB_MinFltActv ain_3V3io_ext_filt ain_3V3io_ext_unfilt ain_3V3io_int_filt ain_3V3io_int_unfilt ain_3V3qca_ext_filt ain_3V3qca_ext_unfilt ain_3V3qca_int_filt ain_3V3qca_int_unfilt ain_3V3uc_ext_filt ain_3V3uc_ext_unfilt ain_3V3uc_int_filt ain_3V3uc_int_unfilt ain_5vdd_ext_filt ain_5vdd_ext_unfilt ain_5vdd_int_filt ain_5vdd_int_unfilt ain_A2_vproxim_ext_filt ain_A2_vproxim_ext_unfilt ain_A2_vproxim_int_filt ain_A2_vproxim_int_unfilt ain_A3_vpilot_ext_filt ain_A3_vpilot_ext_unfilt ain_A3_vpilot_int_filt ain_A3_vpilot_int_unfilt ain_A3_vpilpeak_ext_filt ain_A3_vpilpeak_ext_unfilt ain_A3_vpilpeak_int_filt ain_A3_vpilpeak_int_preFilt ain_A3_vpilpeak_int_unfilt ain_A3_vpilpeak_int_unfilt_held ain_B2_vtempa_filt ain_B2_vtempa_unfilt ain_B3_vtempb_filt ain_B3_vtempb_unfilt ain_B4_vtempc_filt ain_B4_vtempc_unfilt ain_C2_vtempd_filt ain_C2_vtempd_unfilt ain_D3_AinE_ext_filt ain_D3_AinE_ext_unfilt ain_D3_AinE_int_filt ain_D3_AinE_int_unfilt ain_F2_LedA_ext_filt ain_F2_LedA_ext_unfilt ain_F2_LedA_int_filt ain_F2_LedA_int_unfilt ain_F3_LedB_ext_filt ain_F3_LedB_ext_unfilt ain_F3_LedB_int_filt ain_F3_LedB_int_unfilt ain_F4_LedC_ext_filt ain_F4_LedC_ext_unfilt ain_F4_LedC_int_filt ain_F4_LedC_int_unfilt ain_K3_ignition_ext_filt ain_K3_ignition_ext_unfilt ain_K3_ignition_int_filt ain_K3_ignition_int_unfilt ain_M2_HbrNVmon_ext_filt ain_M2_HbrNVmon_ext_unfilt ain_M2_HbrNVmon_int_filt ain_M2_HbrNVmon_int_unfilt ain_M3_HbrPVmon_ext_filt ain_M3_HbrPVmon_ext_unfilt ain_M3_HbrPVmon_int_filt ain_M3_HbrPVmon_int_unfilt ain_TempIntDegC ain_TempInt_ext_filt ain_TempInt_ext_unfilt ain_TempInt_int_filt ain_TempInt_int_unfilt ain_Vbat_ext_filt ain_Vbat_ext_unfilt ain_Vbat_int_filt ain_Vbat_int_unfilt ain_VrefA_ext_filt ain_VrefA_ext_unfilt ain_VrefA_int_filt ain_VrefA_int_unfilt ain_VrefB_ext_filt ain_VrefB_ext_unfilt ain_VrefB_int_filt ain_VrefB_int_unfilt ain_cpilot_dcycle ain_cpilot_freq ain_cpilot_state ain_cpilot_timeout ain_cpilot_timeout_count ain_ihbr_ext_filt ain_ihbr_ext_unfilt ain_ihbr_int_filt ain_ihbr_int_unfilt ccu_cpu_loading ccu_cpu_loading_max ccu_stack_used ccu_task_duration_1s ccu_task_duration_1s_max din_nHbrFlt din_p10_8_nplcirq din_p15_1_run din_p22_0_qout3 din_p33_0_can_wake din_p33_1_pilwake din_p33_9_ss1 din_scu_fsp din_ss2_alt din_ss2_scu_stop flt_ain_bits ihbr_MaxFlt ihbr_MaxFltActv ihbr_MinFlt ihbr_MinFltActv out_vpilpeak_reset_output v3V3io_MaxFlt v3V3io_MaxFltActv v3V3io_MinFlt v3V3io_MinFltActv v3V3qca_MaxFlt v3V3qca_MaxFltActv v3V3qca_MinFlt v3V3qca_MinFltActv v3V3uc_MaxFlt v3V3uc_MaxFltActv v3V3uc_MinFlt v3V3uc_MinFltActv v5vdd_MaxFlt v5vdd_MaxFltActv v5vdd_MinFlt v5vdd_MinFltActv /end LOC_MEASUREMENT
/end FUNCTION
/begin FUNCTION ByType "Group /ByType" /begin SUB_FUNCTION Arrays Automatic Scalars Signals /end SUB_FUNCTION /end FUNCTION
/begin FUNCTION Others "Group /Others"
 /begin REF_CHARACTERISTIC CcsCtlAuthSetupEnable_C CcsIprPpHystLoMid_C CcsIprPpHystMidHi_C CcsIprPpHystWidth_C CcsStmCrntSafeLevelTimeout1_C CcsStmCrntSafeLevelTimeout2_C CcsStmDelayBiDirCtrlReq_C CcsStmDelayCableCheckReq_C CcsStmDelayChgParamDiscovReq_C CcsStmDelayContractAuthenReq_C CcsStmDelayCrntDemandReq_C CcsStmDelayEvseShutdn2Init_C CcsStmDelayInit_C CcsStmDelayMsg10aTx_C CcsStmDelayPreChgReq_C CcsStmDelayPwrDelivReq_C CcsStmDelaySvcDetailReq_C CcsStmDelayWaitOpenChgRly_C CcsStmDelayWaitVoltSafeLevel_C CcsStmDelayWeldingDetectReq_C CcsStmPrxMsg10bTimeout_C CcsStmPrxMsg9bTimeout_C CcsStmSlacTerminateTimeout_C CcsStmUseTargetSocForShutdn_C /end REF_CHARACTERISTIC
/end FUNCTION
/end MODULE
/end PROJECT
