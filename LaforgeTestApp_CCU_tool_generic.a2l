/* ASAP2 file for OpenECU and a generic calibration tool.
* Auto-generated from 'capi.py' (version 4.0.19 picard-noCS-pxros) at Mon Aug 14 10:47:22 2023 (local time).
* Information taken from:
* LaforgeTestApp_CCU.dde_group.tmp
* automatic library DDEs
*/
ASAP2_VERSION 1 31
/begin PROJECT LaForge_CCU_TestApp "Test Application for LaForge TC367"
/begin HEADER "Dana" VERSION "0_3_1" /end HEADER
/begin MODULE OpenECU_TC367_001 ""
/begin MOD_PAR ""
 /begin MEMORY_SEGMENT Strategy "Strategy/application code" CODE FLASH INTERN 0x80128800 0xb5540 -1 -1 -1 -1 -1 /end MEMORY_SEGMENT
 /begin MEMORY_SEGMENT Calibration "Calibration data" DATA FLASH INTERN 0xa0108000 0x20000 -1 -1 -1 -1 -1 /end MEMORY_SEGMENT
/end MOD_PAR
/* Scalar measurable for DDE 'A2_vproxim_MaxFlt'. */
/begin MEASUREMENT A2_vproxim_MaxFlt "Proximity above max threshold latched after debounce (CCU pin A2)" UBYTE CU_A2_VPROXIM_MAXFLT 1 100 0.0 1.0 ECU_ADDRESS 0x70019f28 BYTE_ORDER MSB_LAST /end MEASUREMENT
/begin COMPU_METHOD CU_A2_VPROXIM_MAXFLT "Conversion method for A2_vproxim_MaxFlt" RAT_FUNC "%10.0" "(not defined)" COEFFS 0.000000 1.000000 -0.000000 0.000000 0.000000 1.000000 /end COMPU_METHOD
/* Scalar measurable for DDE 'A2_vproxim_MaxFltActv'. */
/begin MEASUREMENT A2_vproxim_MaxFltActv "Active fault high A2 (Max fault no latch or debounce)" UBYTE CU_A2_VPROXIM_MAXFLTACTV 1 100 0.0 1.0 ECU_ADDRESS 0x70019eb2 BYTE_ORDER MSB_LAST /end MEASUREMENT
/begin COMPU_METHOD CU_A2_VPROXIM_MAXFLTACTV "Conversion method for A2_vproxim_MaxFltActv" RAT_FUNC "%10.0" "(not defined)" COEFFS 0.000000 1.000000 -0.000000 0.000000 0.000000 1.000000 /end COMPU_METHOD
/* Scalar measurable for DDE 'A2_vproxim_MinFlt'. */
/begin MEASUREMENT A2_vproxim_MinFlt "Proximity below min threshold latched after debounce (CCU pin A2)" UBYTE CU_A2_VPROXIM_MINFLT 1 100 0.0 1.0 ECU_ADDRESS 0x7001a131 BYTE_ORDER MSB_LAST /end MEASUREMENT
/begin COMPU_METHOD CU_A2_VPROXIM_MINFLT "Conversion method for A2_vproxim_MinFlt" RAT_FUNC "%10.0" "(not defined)" COEFFS 0.000000 1.000000 -0.000000 0.000000 0.000000 1.000000 /end COMPU_METHOD
/* Scalar measurable for DDE 'A2_vproxim_MinFltActv'. */
/begin MEASUREMENT A2_vproxim_MinFltActv "Active fault low A2 (Min fault no latch or debounce)" UBYTE CU_A2_VPROXIM_MINFLTACTV 1 100 0.0 1.0 ECU_ADDRESS 0x7001a0a1 BYTE_ORDER MSB_LAST /end MEASUREMENT
/begin COMPU_METHOD CU_A2_VPROXIM_MINFLTACTV "Conversion method for A2_vproxim_MinFltActv" RAT_FUNC "%10.0" "(not defined)" COEFFS 0.000000 1.000000 -0.000000 0.000000 0.000000 1.000000 /end COMPU_METHOD
/* Scalar measurable for DDE 'A3_vpilot_MaxFlt'. */
/begin MEASUREMENT A3_vpilot_MaxFlt "Pilot above max threshold latched after debounce (CCU pin A3)" UBYTE CU_A3_VPILOT_MAXFLT 1 100 0.0 1.0 ECU_ADDRESS 0x7001a02c BYTE_ORDER MSB_LAST /end MEASUREMENT
/begin COMPU_METHOD CU_A3_VPILOT_MAXFLT "Conversion method for A3_vpilot_MaxFlt" RAT_FUNC "%10.0" "(not defined)" COEFFS 0.000000 1.000000 -0.000000 0.000000 0.000000 1.000000 /end COMPU_METHOD
/* Scalar measurable for DDE 'A3_vpilot_MaxFltActv'. */
/begin MEASUREMENT A3_vpilot_MaxFltActv "Active fault high A3 (Max fault no latch or debounce)" UBYTE CU_A3_VPILOT_MAXFLTACTV 1 100 0.0 1.0 ECU_ADDRESS 0x70019fa0 BYTE_ORDER MSB_LAST /end MEASUREMENT
/begin COMPU_METHOD CU_A3_VPILOT_MAXFLTACTV "Conversion method for A3_vpilot_MaxFltActv" RAT_FUNC "%10.0" "(not defined)" COEFFS 0.000000 1.000000 -0.000000 0.000000 0.000000 1.000000 /end COMPU_METHOD
/* Scalar measurable for DDE 'A3_vpilot_MinFlt'. */
/begin MEASUREMENT A3_vpilot_MinFlt "Pilot below min threshold latched after debounce (CCU pin A3)" UBYTE CU_A3_VPILOT_MINFLT 1 100 0.0 1.0 ECU_ADDRESS 0x70019f1c BYTE_ORDER MSB_LAST /end MEASUREMENT
/begin COMPU_METHOD CU_A3_VPILOT_MINFLT "Conversion method for A3_vpilot_MinFlt" RAT_FUNC "%10.0" "(not defined)" COEFFS 0.000000 1.000000 -0.000000 0.000000 0.000000 1.000000 /end COMPU_METHOD
/* Scalar measurable for DDE 'A3_vpilot_MinFltActv'. */
/begin MEASUREMENT A3_vpilot_MinFltActv "Active fault low A3 (Min fault no latch or debounce)" UBYTE CU_A3_VPILOT_MINFLTACTV 1 100 0.0 1.0 ECU_ADDRESS 0x70019eac BYTE_ORDER MSB_LAST /end MEASUREMENT
/begin COMPU_METHOD CU_A3_VPILOT_MINFLTACTV "Conversion method for A3_vpilot_MinFltActv" RAT_FUNC "%10.0" "(not defined)" COEFFS 0.000000 1.000000 -0.000000 0.000000 0.000000 1.000000 /end COMPU_METHOD
/* Scalar measurable for DDE 'A3_vpilpeak_MaxFlt'. */
/begin MEASUREMENT A3_vpilpeak_MaxFlt "Pilot Peak above max threshold latched after debounce (CCU pin A3)" UBYTE CU_A3_VPILPEAK_MAXFLT 1 100 0.0 1.0 ECU_ADDRESS 0x7001a111 BYTE_ORDER MSB_LAST /end MEASUREMENT
/begin COMPU_METHOD CU_A3_VPILPEAK_MAXFLT "Conversion method for A3_vpilpeak_MaxFlt" RAT_FUNC "%10.0" "(not defined)" COEFFS 0.000000 1.000000 -0.000000 0.000000 0.000000 1.000000 /end COMPU_METHOD
/* Scalar measurable for DDE 'A3_vpilpeak_MaxFltActv'. */
/begin MEASUREMENT A3_vpilpeak_MaxFltActv "Active fault high A3 (Max fault no latch or debounce)" UBYTE CU_A3_VPILPEAK_MAXFLTACTV 1 100 0.0 1.0 ECU_ADDRESS 0x7001a098 BYTE_ORDER MSB_LAST /end MEASUREMENT
/begin COMPU_METHOD CU_A3_VPILPEAK_MAXFLTACTV "Conversion method for A3_vpilpeak_MaxFltActv" RAT_FUNC "%10.0" "(not defined)" COEFFS 0.000000 1.000000 -0.000000 0.000000 0.000000 1.000000 /end COMPU_METHOD
/* Scalar measurable for DDE 'A3_vpilpeak_MinFlt'. */
/begin MEASUREMENT A3_vpilpeak_MinFlt "Pilot Peak below min threshold latched after debounce (CCU pin A3)" UBYTE CU_A3_VPILPEAK_MINFLT 1 100 0.0 1.0 ECU_ADDRESS 0x7001a01c BYTE_ORDER MSB_LAST /end MEASUREMENT
/begin COMPU_METHOD CU_A3_VPILPEAK_MINFLT "Conversion method for A3_vpilpeak_MinFlt" RAT_FUNC "%10.0" "(not defined)" COEFFS 0.000000 1.000000 -0.000000 0.000000 0.000000 1.000000 /end COMPU_METHOD
/* Scalar measurable for DDE 'A3_vpilpeak_MinFltActv'. */
/begin MEASUREMENT A3_vpilpeak_MinFltActv "Active fault low A3 (Min fault no latch or debounce)" UBYTE CU_A3_VPILPEAK_MINFLTACTV 1 100 0.0 1.0 ECU_ADDRESS 0x70019f92 BYTE_ORDER MSB_LAST /end MEASUREMENT
/begin COMPU_METHOD CU_A3_VPILPEAK_MINFLTACTV "Conversion method for A3_vpilpeak_MinFltActv" RAT_FUNC "%10.0" "(not defined)" COEFFS 0.000000 1.000000 -0.000000 0.000000 0.000000 1.000000 /end COMPU_METHOD
/* Scalar measurable for DDE 'B2_vtempa_MaxFlt'. */
/begin MEASUREMENT B2_vtempa_MaxFlt "Thermistor sensor A above max threshold latched after debounce (CCU pin B2)" UBYTE CU_B2_VTEMPA_MAXFLT 1 100 0.0 1.0 ECU_ADDRESS 0x70019e9e BYTE_ORDER MSB_LAST /end MEASUREMENT
/begin COMPU_METHOD CU_B2_VTEMPA_MAXFLT "Conversion method for B2_vtempa_MaxFlt" RAT_FUNC "%10.0" "(not defined)" COEFFS 0.000000 1.000000 -0.000000 0.000000 0.000000 1.000000 /end COMPU_METHOD
/* Scalar measurable for DDE 'B2_vtempa_MaxFltActv'. */
/begin MEASUREMENT B2_vtempa_MaxFltActv "Active fault high B2 (Max fault no latch or debounce)" UBYTE CU_B2_VTEMPA_MAXFLTACTV 1 100 0.0 1.0 ECU_ADDRESS 0x7001a109 BYTE_ORDER MSB_LAST /end MEASUREMENT
/begin COMPU_METHOD CU_B2_VTEMPA_MAXFLTACTV "Conversion method for B2_vtempa_MaxFltActv" RAT_FUNC "%10.0" "(not defined)" COEFFS 0.000000 1.000000 -0.000000 0.000000 0.000000 1.000000 /end COMPU_METHOD
/* Scalar measurable for DDE 'B2_vtempa_MinFlt'. */
/begin MEASUREMENT B2_vtempa_MinFlt "Thermistor sensor A below min threshold latched after debounce (CCU pin B2)" UBYTE CU_B2_VTEMPA_MINFLT 1 100 0.0 1.0 ECU_ADDRESS 0x7001a08d BYTE_ORDER MSB_LAST /end MEASUREMENT
/begin COMPU_METHOD CU_B2_VTEMPA_MINFLT "Conversion method for B2_vtempa_MinFlt" RAT_FUNC "%10.0" "(not defined)" COEFFS 0.000000 1.000000 -0.000000 0.000000 0.000000 1.000000 /end COMPU_METHOD
/* Scalar measurable for DDE 'B2_vtempa_MinFltActv'. */
/begin MEASUREMENT B2_vtempa_MinFltActv "Active fault low B2 (Min fault no latch or debounce)" UBYTE CU_B2_VTEMPA_MINFLTACTV 1 100 0.0 1.0 ECU_ADDRESS 0x7001a018 BYTE_ORDER MSB_LAST /end MEASUREMENT
/begin COMPU_METHOD CU_B2_VTEMPA_MINFLTACTV "Conversion method for B2_vtempa_MinFltActv" RAT_FUNC "%10.0" "(not defined)" COEFFS 0.000000 1.000000 -0.000000 0.000000 0.000000 1.000000 /end COMPU_METHOD
/* Scalar measurable for DDE 'B3_vtempb_MaxFlt'. */
/begin MEASUREMENT B3_vtempb_MaxFlt "Thermistor sensor B above max threshold latched after debounce (CCU pin B3)" UBYTE CU_B3_VTEMPB_MAXFLT 1 100 0.0 1.0 ECU_ADDRESS 0x70019f88 BYTE_ORDER MSB_LAST /end MEASUREMENT
/begin COMPU_METHOD CU_B3_VTEMPB_MAXFLT "Conversion method for B3_vtempb_MaxFlt" RAT_FUNC "%10.0" "(not defined)" COEFFS 0.000000 1.000000 -0.000000 0.000000 0.000000 1.000000 /end COMPU_METHOD
/* Scalar measurable for DDE 'B3_vtempb_MaxFltActv'. */
/begin MEASUREMENT B3_vtempb_MaxFltActv "Active fault high B3 (Max fault no latch or debounce)" UBYTE CU_B3_VTEMPB_MAXFLTACTV 1 100 0.0 1.0 ECU_ADDRESS 0x70019f05 BYTE_ORDER MSB_LAST /end MEASUREMENT
/begin COMPU_METHOD CU_B3_VTEMPB_MAXFLTACTV "Conversion method for B3_vtempb_MaxFltActv" RAT_FUNC "%10.0" "(not defined)" COEFFS 0.000000 1.000000 -0.000000 0.000000 0.000000 1.000000 /end COMPU_METHOD
/* Scalar measurable for DDE 'B3_vtempb_MinFlt'. */
/begin MEASUREMENT B3_vtempb_MinFlt "Thermistor sensor B below min threshold latched after debounce (CCU pin B3)" UBYTE CU_B3_VTEMPB_MINFLT 1 100 0.0 1.0 ECU_ADDRESS 0x7001a1a4 BYTE_ORDER MSB_LAST /end MEASUREMENT
/begin COMPU_METHOD CU_B3_VTEMPB_MINFLT "Conversion method for B3_vtempb_MinFlt" RAT_FUNC "%10.0" "(not defined)" COEFFS 0.000000 1.000000 -0.000000 0.000000 0.000000 1.000000 /end COMPU_METHOD
/* Scalar measurable for DDE 'B3_vtempb_MinFltActv'. */
/begin MEASUREMENT B3_vtempb_MinFltActv "Active fault low B3 (Min fault no latch or debounce)" UBYTE CU_B3_VTEMPB_MINFLTACTV 1 100 0.0 1.0 ECU_ADDRESS 0x7001a0ff BYTE_ORDER MSB_LAST /end MEASUREMENT
/begin COMPU_METHOD CU_B3_VTEMPB_MINFLTACTV "Conversion method for B3_vtempb_MinFltActv" RAT_FUNC "%10.0" "(not defined)" COEFFS 0.000000 1.000000 -0.000000 0.000000 0.000000 1.000000 /end COMPU_METHOD
/* Scalar measurable for DDE 'B4_vtempc_MaxFlt'. */
/begin MEASUREMENT B4_vtempc_MaxFlt "Thermistor sensor C above max threshold latched after debounce (CCU pin B4)" UBYTE CU_B4_VTEMPC_MAXFLT 1 100 0.0 1.0 ECU_ADDRESS 0x7001a082 BYTE_ORDER MSB_LAST /end MEASUREMENT
/begin COMPU_METHOD CU_B4_VTEMPC_MAXFLT "Conversion method for B4_vtempc_MaxFlt" RAT_FUNC "%10.0" "(not defined)" COEFFS 0.000000 1.000000 -0.000000 0.000000 0.000000 1.000000 /end COMPU_METHOD
/* Scalar measurable for DDE 'B4_vtempc_MaxFltActv'. */
/begin MEASUREMENT B4_vtempc_MaxFltActv "Active fault high B4 (Max fault no latch or debounce)" UBYTE CU_B4_VTEMPC_MAXFLTACTV 1 100 0.0 1.0 ECU_ADDRESS 0x7001a008 BYTE_ORDER MSB_LAST /end MEASUREMENT
/begin COMPU_METHOD CU_B4_VTEMPC_MAXFLTACTV "Conversion method for B4_vtempc_MaxFltActv" RAT_FUNC "%10.0" "(not defined)" COEFFS 0.000000 1.000000 -0.000000 0.000000 0.000000 1.000000 /end COMPU_METHOD
/* Scalar measurable for DDE 'B4_vtempc_MinFlt'. */
/begin MEASUREMENT B4_vtempc_MinFlt "Thermistor sensor C below min threshold latched after debounce (CCU pin B4)" UBYTE CU_B4_VTEMPC_MINFLT 1 100 0.0 1.0 ECU_ADDRESS 0x70019f7c BYTE_ORDER MSB_LAST /end MEASUREMENT
/begin COMPU_METHOD CU_B4_VTEMPC_MINFLT "Conversion method for B4_vtempc_MinFlt" RAT_FUNC "%10.0" "(not defined)" COEFFS 0.000000 1.000000 -0.000000 0.000000 0.000000 1.000000 /end COMPU_METHOD
/* Scalar measurable for DDE 'B4_vtempc_MinFltActv'. */
/begin MEASUREMENT B4_vtempc_MinFltActv "Active fault low B4 (Min fault no latch or debounce)" UBYTE CU_B4_VTEMPC_MINFLTACTV 1 100 0.0 1.0 ECU_ADDRESS 0x70019efd BYTE_ORDER MSB_LAST /end MEASUREMENT
/begin COMPU_METHOD CU_B4_VTEMPC_MINFLTACTV "Conversion method for B4_vtempc_MinFltActv" RAT_FUNC "%10.0" "(not defined)" COEFFS 0.000000 1.000000 -0.000000 0.000000 0.000000 1.000000 /end COMPU_METHOD
/* Scalar measurable for DDE 'C2_vtempd_MaxFlt'. */
/begin MEASUREMENT C2_vtempd_MaxFlt "Thermistor sensor D above max threshold latched after debounce (CCU pin C2)" UBYTE CU_C2_VTEMPD_MAXFLT 1 100 0.0 1.0 ECU_ADDRESS 0x7001a185 BYTE_ORDER MSB_LAST /end MEASUREMENT
/begin COMPU_METHOD CU_C2_VTEMPD_MAXFLT "Conversion method for C2_vtempd_MaxFlt" RAT_FUNC "%10.0" "(not defined)" COEFFS 0.000000 1.000000 -0.000000 0.000000 0.000000 1.000000 /end COMPU_METHOD
/* Scalar measurable for DDE 'C2_vtempd_MaxFltActv'. */
/begin MEASUREMENT C2_vtempd_MaxFltActv "Active fault high C2 (Max fault no latch or debounce)" UBYTE CU_C2_VTEMPD_MAXFLTACTV 1 100 0.0 1.0 ECU_ADDRESS 0x7001a0f4 BYTE_ORDER MSB_LAST /end MEASUREMENT
/begin COMPU_METHOD CU_C2_VTEMPD_MAXFLTACTV "Conversion method for C2_vtempd_MaxFltActv" RAT_FUNC "%10.0" "(not defined)" COEFFS 0.000000 1.000000 -0.000000 0.000000 0.000000 1.000000 /end COMPU_METHOD
/* Scalar measurable for DDE 'C2_vtempd_MinFlt'. */
/begin MEASUREMENT C2_vtempd_MinFlt "Thermistor sensor D below min threshold latched after debounce (CCU pin C2)" UBYTE CU_C2_VTEMPD_MINFLT 1 100 0.0 1.0 ECU_ADDRESS 0x7001a078 BYTE_ORDER MSB_LAST /end MEASUREMENT
/begin COMPU_METHOD CU_C2_VTEMPD_MINFLT "Conversion method for C2_vtempd_MinFlt" RAT_FUNC "%10.0" "(not defined)" COEFFS 0.000000 1.000000 -0.000000 0.000000 0.000000 1.000000 /end COMPU_METHOD
/* Scalar measurable for DDE 'C2_vtempd_MinFltActv'. */
/begin MEASUREMENT C2_vtempd_MinFltActv "Active fault low C2 (Min fault no latch or debounce)" UBYTE CU_C2_VTEMPD_MINFLTACTV 1 100 0.0 1.0 ECU_ADDRESS 0x7001a000 BYTE_ORDER MSB_LAST /end MEASUREMENT
/begin COMPU_METHOD CU_C2_VTEMPD_MINFLTACTV "Conversion method for C2_vtempd_MinFltActv" RAT_FUNC "%10.0" "(not defined)" COEFFS 0.000000 1.000000 -0.000000 0.000000 0.000000 1.000000 /end COMPU_METHOD
/* Scalar measurable for DDE 'CANFDCounter'. */
/begin MEASUREMENT CANFDCounter "(not defined)" ULONG CU_CANFDCOUNTER 1 100 0.0 4294967295.0 ECU_ADDRESS 0x70019ef0 BYTE_ORDER MSB_LAST /end MEASUREMENT
/begin COMPU_METHOD CU_CANFDCOUNTER "Conversion method for CANFDCounter" RAT_FUNC "%10.0" "(not defined)" COEFFS 0.000000 1.000000 -0.000000 0.000000 0.000000 1.000000 /end COMPU_METHOD
/* Scalar measurable for DDE 'CANFDRxErr'. */
/begin MEASUREMENT CANFDRxErr "(not defined)" UBYTE CU_CANFDRXERR 1 100 0.0 255.0 ECU_ADDRESS 0x7001a0e8 BYTE_ORDER MSB_LAST /end MEASUREMENT
/begin COMPU_METHOD CU_CANFDRXERR "Conversion method for CANFDRxErr" RAT_FUNC "%10.0" "(not defined)" COEFFS 0.000000 1.000000 -0.000000 0.000000 0.000000 1.000000 /end COMPU_METHOD
/* Scalar measurable for DDE 'CANFDRxOverrun'. */
/begin MEASUREMENT CANFDRxOverrun "(not defined)" UBYTE CU_CANFDRXOVERRUN 1 100 0.0 255.0 ECU_ADDRESS 0x7001a070 BYTE_ORDER MSB_LAST /end MEASUREMENT
/begin COMPU_METHOD CU_CANFDRXOVERRUN "Conversion method for CANFDRxOverrun" RAT_FUNC "%10.0" "(not defined)" COEFFS 0.000000 1.000000 -0.000000 0.000000 0.000000 1.000000 /end COMPU_METHOD
/* Scalar measurable for DDE 'CANFDRxTrig'. */
/begin MEASUREMENT CANFDRxTrig "(not defined)" FLOAT32_IEEE CU_CANFDRXTRIG 1 100 -3.40282346639e+38 3.40282346639e+38 ECU_ADDRESS 0x70019ff4 BYTE_ORDER MSB_LAST /end MEASUREMENT
/begin COMPU_METHOD CU_CANFDRXTRIG "Conversion method for CANFDRxTrig" RAT_FUNC "%10.0" "(not defined)" COEFFS 0.000000 1.000000 -0.000000 0.000000 0.000000 1.000000 /end COMPU_METHOD
/* Scalar measurable for DDE 'CANFDRxTxCompare[0]'. */
/begin MEASUREMENT CANFDRxTxCompare[0] "(not defined)" UBYTE CU_CANFDRXTXCOMPARE[0] 1 100 0.0 255.0 ECU_ADDRESS 0x70019f5d BYTE_ORDER MSB_LAST /end MEASUREMENT
/begin COMPU_METHOD CU_CANFDRXTXCOMPARE[0] "Conversion method for CANFDRxTxCompare[0]" RAT_FUNC "%10.0" "(not defined)" COEFFS 0.000000 1.000000 -0.000000 0.000000 0.000000 1.000000 /end COMPU_METHOD
/* Scalar measurable for DDE 'CANFDRxTxCompare[1]'. */
/begin MEASUREMENT CANFDRxTxCompare[1] "(not defined)" UBYTE CU_CANFDRXTXCOMPARE[1] 1 100 0.0 255.0 ECU_ADDRESS 0x70019f5e BYTE_ORDER MSB_LAST /end MEASUREMENT
/begin COMPU_METHOD CU_CANFDRXTXCOMPARE[1] "Conversion method for CANFDRxTxCompare[1]" RAT_FUNC "%10.0" "(not defined)" COEFFS 0.000000 1.000000 -0.000000 0.000000 0.000000 1.000000 /end COMPU_METHOD
/* Scalar measurable for DDE 'CANFDRxTxCompare[2]'. */
/begin MEASUREMENT CANFDRxTxCompare[2] "(not defined)" UBYTE CU_CANFDRXTXCOMPARE[2] 1 100 0.0 255.0 ECU_ADDRESS 0x70019f5f BYTE_ORDER MSB_LAST /end MEASUREMENT
/begin COMPU_METHOD CU_CANFDRXTXCOMPARE[2] "Conversion method for CANFDRxTxCompare[2]" RAT_FUNC "%10.0" "(not defined)" COEFFS 0.000000 1.000000 -0.000000 0.000000 0.000000 1.000000 /end COMPU_METHOD
/* Scalar measurable for DDE 'CANFDRxTxCompare[3]'. */
/begin MEASUREMENT CANFDRxTxCompare[3] "(not defined)" UBYTE CU_CANFDRXTXCOMPARE[3] 1 100 0.0 255.0 ECU_ADDRESS 0x70019f60 BYTE_ORDER MSB_LAST /end MEASUREMENT
/begin COMPU_METHOD CU_CANFDRXTXCOMPARE[3] "Conversion method for CANFDRxTxCompare[3]" RAT_FUNC "%10.0" "(not defined)" COEFFS 0.000000 1.000000 -0.000000 0.000000 0.000000 1.000000 /end COMPU_METHOD
/* Scalar measurable for DDE 'CANFDRxTxCompare[4]'. */
/begin MEASUREMENT CANFDRxTxCompare[4] "(not defined)" UBYTE CU_CANFDRXTXCOMPARE[4] 1 100 0.0 255.0 ECU_ADDRESS 0x70019f61 BYTE_ORDER MSB_LAST /end MEASUREMENT
/begin COMPU_METHOD CU_CANFDRXTXCOMPARE[4] "Conversion method for CANFDRxTxCompare[4]" RAT_FUNC "%10.0" "(not defined)" COEFFS 0.000000 1.000000 -0.000000 0.000000 0.000000 1.000000 /end COMPU_METHOD
/* Scalar measurable for DDE 'CANFDRxTxCompare[5]'. */
/begin MEASUREMENT CANFDRxTxCompare[5] "(not defined)" UBYTE CU_CANFDRXTXCOMPARE[5] 1 100 0.0 255.0 ECU_ADDRESS 0x70019f62 BYTE_ORDER MSB_LAST /end MEASUREMENT
/begin COMPU_METHOD CU_CANFDRXTXCOMPARE[5] "Conversion method for CANFDRxTxCompare[5]" RAT_FUNC "%10.0" "(not defined)" COEFFS 0.000000 1.000000 -0.000000 0.000000 0.000000 1.000000 /end COMPU_METHOD
/* Scalar measurable for DDE 'CANFDRxTxCompare[6]'. */
/begin MEASUREMENT CANFDRxTxCompare[6] "(not defined)" UBYTE CU_CANFDRXTXCOMPARE[6] 1 100 0.0 255.0 ECU_ADDRESS 0x70019f63 BYTE_ORDER MSB_LAST /end MEASUREMENT
/begin COMPU_METHOD CU_CANFDRXTXCOMPARE[6] "Conversion method for CANFDRxTxCompare[6]" RAT_FUNC "%10.0" "(not defined)" COEFFS 0.000000 1.000000 -0.000000 0.000000 0.000000 1.000000 /end COMPU_METHOD
/* Scalar measurable for DDE 'CANFDRxTxCompare[7]'. */
/begin MEASUREMENT CANFDRxTxCompare[7] "(not defined)" UBYTE CU_CANFDRXTXCOMPARE[7] 1 100 0.0 255.0 ECU_ADDRESS 0x70019f64 BYTE_ORDER MSB_LAST /end MEASUREMENT
/begin COMPU_METHOD CU_CANFDRXTXCOMPARE[7] "Conversion method for CANFDRxTxCompare[7]" RAT_FUNC "%10.0" "(not defined)" COEFFS 0.000000 1.000000 -0.000000 0.000000 0.000000 1.000000 /end COMPU_METHOD
/* Scalar measurable for DDE 'CANFDRxTxFault'. */
/begin MEASUREMENT CANFDRxTxFault "(not defined)" UBYTE CU_CANFDRXTXFAULT 1 100 0.0 255.0 ECU_ADDRESS 0x70019ee4 BYTE_ORDER MSB_LAST /end MEASUREMENT
/begin COMPU_METHOD CU_CANFDRXTXFAULT "Conversion method for CANFDRxTxFault" RAT_FUNC "%10.0" "(not defined)" COEFFS 0.000000 1.000000 -0.000000 0.000000 0.000000 1.000000 /end COMPU_METHOD
/* Scalar measurable for DDE 'CANFDRx[0]'. */
/begin MEASUREMENT CANFDRx[0] "(not defined)" UBYTE CU_CANFDRX[0] 1 100 0.0 255.0 ECU_ADDRESS 0x7001a171 BYTE_ORDER MSB_LAST /end MEASUREMENT
/begin COMPU_METHOD CU_CANFDRX[0] "Conversion method for CANFDRx[0]" RAT_FUNC "%10.0" "(not defined)" COEFFS 0.000000 1.000000 -0.000000 0.000000 0.000000 1.000000 /end COMPU_METHOD
/* Scalar measurable for DDE 'CANFDRx[1]'. */
/begin MEASUREMENT CANFDRx[1] "(not defined)" UBYTE CU_CANFDRX[1] 1 100 0.0 255.0 ECU_ADDRESS 0x7001a172 BYTE_ORDER MSB_LAST /end MEASUREMENT
/begin COMPU_METHOD CU_CANFDRX[1] "Conversion method for CANFDRx[1]" RAT_FUNC "%10.0" "(not defined)" COEFFS 0.000000 1.000000 -0.000000 0.000000 0.000000 1.000000 /end COMPU_METHOD
/* Scalar measurable for DDE 'CANFDRx[2]'. */
/begin MEASUREMENT CANFDRx[2] "(not defined)" UBYTE CU_CANFDRX[2] 1 100 0.0 255.0 ECU_ADDRESS 0x7001a173 BYTE_ORDER MSB_LAST /end MEASUREMENT
/begin COMPU_METHOD CU_CANFDRX[2] "Conversion method for CANFDRx[2]" RAT_FUNC "%10.0" "(not defined)" COEFFS 0.000000 1.000000 -0.000000 0.000000 0.000000 1.000000 /end COMPU_METHOD
/* Scalar measurable for DDE 'CANFDRx[3]'. */
/begin MEASUREMENT CANFDRx[3] "(not defined)" UBYTE CU_CANFDRX[3] 1 100 0.0 255.0 ECU_ADDRESS 0x7001a174 BYTE_ORDER MSB_LAST /end MEASUREMENT
/begin COMPU_METHOD CU_CANFDRX[3] "Conversion method for CANFDRx[3]" RAT_FUNC "%10.0" "(not defined)" COEFFS 0.000000 1.000000 -0.000000 0.000000 0.000000 1.000000 /end COMPU_METHOD
/* Scalar measurable for DDE 'CANFDRx[4]'. */
/begin MEASUREMENT CANFDRx[4] "(not defined)" UBYTE CU_CANFDRX[4] 1 100 0.0 255.0 ECU_ADDRESS 0x7001a175 BYTE_ORDER MSB_LAST /end MEASUREMENT
/begin COMPU_METHOD CU_CANFDRX[4] "Conversion method for CANFDRx[4]" RAT_FUNC "%10.0" "(not defined)" COEFFS 0.000000 1.000000 -0.000000 0.000000 0.000000 1.000000 /end COMPU_METHOD
/* Scalar measurable for DDE 'CANFDRx[5]'. */
/begin MEASUREMENT CANFDRx[5] "(not defined)" UBYTE CU_CANFDRX[5] 1 100 0.0 255.0 ECU_ADDRESS 0x7001a176 BYTE_ORDER MSB_LAST /end MEASUREMENT
/begin COMPU_METHOD CU_CANFDRX[5] "Conversion method for CANFDRx[5]" RAT_FUNC "%10.0" "(not defined)" COEFFS 0.000000 1.000000 -0.000000 0.000000 0.000000 1.000000 /end COMPU_METHOD
/* Scalar measurable for DDE 'CANFDRx[6]'. */
/begin MEASUREMENT CANFDRx[6] "(not defined)" UBYTE CU_CANFDRX[6] 1 100 0.0 255.0 ECU_ADDRESS 0x7001a177 BYTE_ORDER MSB_LAST /end MEASUREMENT
/begin COMPU_METHOD CU_CANFDRX[6] "Conversion method for CANFDRx[6]" RAT_FUNC "%10.0" "(not defined)" COEFFS 0.000000 1.000000 -0.000000 0.000000 0.000000 1.000000 /end COMPU_METHOD
/* Scalar measurable for DDE 'CANFDRx[7]'. */
/begin MEASUREMENT CANFDRx[7] "(not defined)" UBYTE CU_CANFDRX[7] 1 100 0.0 255.0 ECU_ADDRESS 0x7001a178 BYTE_ORDER MSB_LAST /end MEASUREMENT
/begin COMPU_METHOD CU_CANFDRX[7] "Conversion method for CANFDRx[7]" RAT_FUNC "%10.0" "(not defined)" COEFFS 0.000000 1.000000 -0.000000 0.000000 0.000000 1.000000 /end COMPU_METHOD
/* Scalar measurable for DDE 'CANFDTrig'. */
/begin MEASUREMENT CANFDTrig "(not defined)" FLOAT32_IEEE CU_CANFDTRIG 1 100 -3.40282346639e+38 3.40282346639e+38 ECU_ADDRESS 0x7001a164 BYTE_ORDER MSB_LAST /end MEASUREMENT
/begin COMPU_METHOD CU_CANFDTRIG "Conversion method for CANFDTrig" RAT_FUNC "%10.0" "(not defined)" COEFFS 0.000000 1.000000 -0.000000 0.000000 0.000000 1.000000 /end COMPU_METHOD
/* Scalar measurable for DDE 'CANFDTxAckCnt'. */
/begin MEASUREMENT CANFDTxAckCnt "(not defined)" ULONG CU_CANFDTXACKCNT 1 100 0.0 4294967295.0 ECU_ADDRESS 0x7001a0dc BYTE_ORDER MSB_LAST /end MEASUREMENT
/begin COMPU_METHOD CU_CANFDTXACKCNT "Conversion method for CANFDTxAckCnt" RAT_FUNC "%10.0" "cnt" COEFFS 0.000000 1.000000 -0.000000 0.000000 0.000000 1.000000 /end COMPU_METHOD
/* Scalar measurable for DDE 'CANFDTxData[0]'. */
/begin MEASUREMENT CANFDTxData[0] "(not defined)" UBYTE CU_CANFDTXDATA[0] 1 100 0.0 255.0 ECU_ADDRESS 0x7001a05c BYTE_ORDER MSB_LAST /end MEASUREMENT
/begin COMPU_METHOD CU_CANFDTXDATA[0] "Conversion method for CANFDTxData[0]" RAT_FUNC "%10.0" "(not defined)" COEFFS 0.000000 1.000000 -0.000000 0.000000 0.000000 1.000000 /end COMPU_METHOD
/* Scalar measurable for DDE 'CANFDTxData[1]'. */
/begin MEASUREMENT CANFDTxData[1] "(not defined)" UBYTE CU_CANFDTXDATA[1] 1 100 0.0 255.0 ECU_ADDRESS 0x7001a05d BYTE_ORDER MSB_LAST /end MEASUREMENT
/begin COMPU_METHOD CU_CANFDTXDATA[1] "Conversion method for CANFDTxData[1]" RAT_FUNC "%10.0" "(not defined)" COEFFS 0.000000 1.000000 -0.000000 0.000000 0.000000 1.000000 /end COMPU_METHOD
/* Scalar measurable for DDE 'CANFDTxData[2]'. */
/begin MEASUREMENT CANFDTxData[2] "(not defined)" UBYTE CU_CANFDTXDATA[2] 1 100 0.0 255.0 ECU_ADDRESS 0x7001a05e BYTE_ORDER MSB_LAST /end MEASUREMENT
/begin COMPU_METHOD CU_CANFDTXDATA[2] "Conversion method for CANFDTxData[2]" RAT_FUNC "%10.0" "(not defined)" COEFFS 0.000000 1.000000 -0.000000 0.000000 0.000000 1.000000 /end COMPU_METHOD
/* Scalar measurable for DDE 'CANFDTxData[3]'. */
/begin MEASUREMENT CANFDTxData[3] "(not defined)" UBYTE CU_CANFDTXDATA[3] 1 100 0.0 255.0 ECU_ADDRESS 0x7001a05f BYTE_ORDER MSB_LAST /end MEASUREMENT
/begin COMPU_METHOD CU_CANFDTXDATA[3] "Conversion method for CANFDTxData[3]" RAT_FUNC "%10.0" "(not defined)" COEFFS 0.000000 1.000000 -0.000000 0.000000 0.000000 1.000000 /end COMPU_METHOD
/* Scalar measurable for DDE 'CANFDTxData[4]'. */
/begin MEASUREMENT CANFDTxData[4] "(not defined)" UBYTE CU_CANFDTXDATA[4] 1 100 0.0 255.0 ECU_ADDRESS 0x7001a060 BYTE_ORDER MSB_LAST /end MEASUREMENT
/begin COMPU_METHOD CU_CANFDTXDATA[4] "Conversion method for CANFDTxData[4]" RAT_FUNC "%10.0" "(not defined)" COEFFS 0.000000 1.000000 -0.000000 0.000000 0.000000 1.000000 /end COMPU_METHOD
/* Scalar measurable for DDE 'CANFDTxData[5]'. */
/begin MEASUREMENT CANFDTxData[5] "(not defined)" UBYTE CU_CANFDTXDATA[5] 1 100 0.0 255.0 ECU_ADDRESS 0x7001a061 BYTE_ORDER MSB_LAST /end MEASUREMENT
/begin COMPU_METHOD CU_CANFDTXDATA[5] "Conversion method for CANFDTxData[5]" RAT_FUNC "%10.0" "(not defined)" COEFFS 0.000000 1.000000 -0.000000 0.000000 0.000000 1.000000 /end COMPU_METHOD
/* Scalar measurable for DDE 'CANFDTxData[6]'. */
/begin MEASUREMENT CANFDTxData[6] "(not defined)" UBYTE CU_CANFDTXDATA[6] 1 100 0.0 255.0 ECU_ADDRESS 0x7001a062 BYTE_ORDER MSB_LAST /end MEASUREMENT
/begin COMPU_METHOD CU_CANFDTXDATA[6] "Conversion method for CANFDTxData[6]" RAT_FUNC "%10.0" "(not defined)" COEFFS 0.000000 1.000000 -0.000000 0.000000 0.000000 1.000000 /end COMPU_METHOD
/* Scalar measurable for DDE 'CANFDTxData[7]'. */
/begin MEASUREMENT CANFDTxData[7] "(not defined)" UBYTE CU_CANFDTXDATA[7] 1 100 0.0 255.0 ECU_ADDRESS 0x7001a063 BYTE_ORDER MSB_LAST /end MEASUREMENT
/begin COMPU_METHOD CU_CANFDTXDATA[7] "Conversion method for CANFDTxData[7]" RAT_FUNC "%10.0" "(not defined)" COEFFS 0.000000 1.000000 -0.000000 0.000000 0.000000 1.000000 /end COMPU_METHOD
/* Scalar measurable for DDE 'CANFDTxErrFlg'. */
/begin MEASUREMENT CANFDTxErrFlg "(not defined)" UBYTE CU_CANFDTXERRFLG 1 100 0.0 255.0 ECU_ADDRESS 0x70019fe5 BYTE_ORDER MSB_LAST /end MEASUREMENT
/begin COMPU_METHOD CU_CANFDTXERRFLG "Conversion method for CANFDTxErrFlg" RAT_FUNC "%10.0" "(not defined)" COEFFS 0.000000 1.000000 -0.000000 0.000000 0.000000 1.000000 /end COMPU_METHOD
/* Scalar measurable for DDE 'CANFDTxTimeout'. */
/begin MEASUREMENT CANFDTxTimeout "(not defined)" UBYTE CU_CANFDTXTIMEOUT 1 100 0.0 255.0 ECU_ADDRESS 0x70019f54 BYTE_ORDER MSB_LAST /end MEASUREMENT
/begin COMPU_METHOD CU_CANFDTXTIMEOUT "Conversion method for CANFDTxTimeout" RAT_FUNC "%10.0" "b" COEFFS 0.000000 1.000000 -0.000000 0.000000 0.000000 1.000000 /end COMPU_METHOD
/* Scalar measurable for DDE 'CcsPilotClear'. */
/begin MEASUREMENT CcsPilotClear "Pilot Peak Reset signal from the Reset Timer block" UBYTE CU_CCSPILOTCLEAR 1 100 0.0 255.0 ECU_ADDRESS 0x70019edc BYTE_ORDER MSB_LAST /end MEASUREMENT
/begin COMPU_METHOD CU_CCSPILOTCLEAR "Conversion method for CcsPilotClear" RAT_FUNC "%10.0" "(not defined)" COEFFS 0.000000 1.000000 -0.000000 0.000000 0.000000 1.000000 /end COMPU_METHOD
/* Scalar measurable for DDE 'CtlEcuPsuPowerHold'. */
/begin MEASUREMENT CtlEcuPsuPowerHold "True value indicates the ECU power is currently being held by one of its own digital outputs, note that one of ECU extenal wakeup sources might still be active and holding ECU power" UBYTE CU_CTLECUPSUPOWERHOLD 1 100 0.0 1.0 ECU_ADDRESS 0x70017ec2 BYTE_ORDER MSB_LAST /end MEASUREMENT
/begin COMPU_METHOD CU_CTLECUPSUPOWERHOLD "Conversion method for CtlEcuPsuPowerHold" RAT_FUNC "%10.0" "b" COEFFS 0.000000 1.000000 -0.000000 0.000000 0.000000 1.000000 /end COMPU_METHOD
/* Scalar measurable for DDE 'D3_AinE_MaxFlt'. */
/begin MEASUREMENT D3_AinE_MaxFlt "AinE/ChgLock above max threshold latched after debounce (CCU pin D3)" UBYTE CU_D3_AINE_MAXFLT 1 100 0.0 1.0 ECU_ADDRESS 0x7001a0d8 BYTE_ORDER MSB_LAST /end MEASUREMENT
/begin COMPU_METHOD CU_D3_AINE_MAXFLT "Conversion method for D3_AinE_MaxFlt" RAT_FUNC "%10.0" "(not defined)" COEFFS 0.000000 1.000000 -0.000000 0.000000 0.000000 1.000000 /end COMPU_METHOD
/* Scalar measurable for DDE 'D3_AinE_MaxFltActv'. */
/begin MEASUREMENT D3_AinE_MaxFltActv "Active fault high D3 (Max fault no latch or debounce)" UBYTE CU_D3_AINE_MAXFLTACTV 1 100 0.0 1.0 ECU_ADDRESS 0x7001a050 BYTE_ORDER MSB_LAST /end MEASUREMENT
/begin COMPU_METHOD CU_D3_AINE_MAXFLTACTV "Conversion method for D3_AinE_MaxFltActv" RAT_FUNC "%10.0" "(not defined)" COEFFS 0.000000 1.000000 -0.000000 0.000000 0.000000 1.000000 /end COMPU_METHOD
/* Scalar measurable for DDE 'D3_AinE_MinFlt'. */
/begin MEASUREMENT D3_AinE_MinFlt "AinE/ChgLock below min threshold latched after debounce (CCU pin D3)" UBYTE CU_D3_AINE_MINFLT 1 100 0.0 1.0 ECU_ADDRESS 0x70019fd8 BYTE_ORDER MSB_LAST /end MEASUREMENT
/begin COMPU_METHOD CU_D3_AINE_MINFLT "Conversion method for D3_AinE_MinFlt" RAT_FUNC "%10.0" "(not defined)" COEFFS 0.000000 1.000000 -0.000000 0.000000 0.000000 1.000000 /end COMPU_METHOD
/* Scalar measurable for DDE 'D3_AinE_MinFltActv'. */
/begin MEASUREMENT D3_AinE_MinFltActv "Active fault low D3 (Min fault no latch or debounce)" UBYTE CU_D3_AINE_MINFLTACTV 1 100 0.0 1.0 ECU_ADDRESS 0x70019f49 BYTE_ORDER MSB_LAST /end MEASUREMENT
/begin COMPU_METHOD CU_D3_AINE_MINFLTACTV "Conversion method for D3_AinE_MinFltActv" RAT_FUNC "%10.0" "(not defined)" COEFFS 0.000000 1.000000 -0.000000 0.000000 0.000000 1.000000 /end COMPU_METHOD
/* Scalar measurable for DDE 'DynamicModeEn'. */
/begin MEASUREMENT DynamicModeEn "Flag that indicated whether dynamic mode is enabled from the Service Discovery and Detail Parser" UBYTE CU_DYNAMICMODEEN 1 100 0.0 1.0 ECU_ADDRESS 0x70017c97 BYTE_ORDER MSB_LAST /end MEASUREMENT
/begin COMPU_METHOD CU_DYNAMICMODEEN "Conversion method for DynamicModeEn" RAT_FUNC "%10.0" "b" COEFFS 0.000000 1.000000 -0.000000 0.000000 0.000000 1.000000 /end COMPU_METHOD
/* Scalar measurable for DDE 'F2_LedA_MaxFlt'. */
/begin MEASUREMENT F2_LedA_MaxFlt "LEDA above max threshold latched after debounce (CCU pin F2)" UBYTE CU_F2_LEDA_MAXFLT 1 100 0.0 1.0 ECU_ADDRESS 0x7001a152 BYTE_ORDER MSB_LAST /end MEASUREMENT
/begin COMPU_METHOD CU_F2_LEDA_MAXFLT "Conversion method for F2_LedA_MaxFlt" RAT_FUNC "%10.0" "(not defined)" COEFFS 0.000000 1.000000 -0.000000 0.000000 0.000000 1.000000 /end COMPU_METHOD
/* Scalar measurable for DDE 'F2_LedA_MaxFltActv'. */
/begin MEASUREMENT F2_LedA_MaxFltActv "Active fault high F2 (Max fault no latch or debounce)" UBYTE CU_F2_LEDA_MAXFLTACTV 1 100 0.0 1.0 ECU_ADDRESS 0x7001a0d0 BYTE_ORDER MSB_LAST /end MEASUREMENT
/begin COMPU_METHOD CU_F2_LEDA_MAXFLTACTV "Conversion method for F2_LedA_MaxFltActv" RAT_FUNC "%10.0" "(not defined)" COEFFS 0.000000 1.000000 -0.000000 0.000000 0.000000 1.000000 /end COMPU_METHOD
/* Scalar measurable for DDE 'F2_LedA_MinFlt'. */
/begin MEASUREMENT F2_LedA_MinFlt "LEDA below min threshold latched after debounce (CCU pin F2)" UBYTE CU_F2_LEDA_MINFLT 1 100 0.0 1.0 ECU_ADDRESS 0x7001a04d BYTE_ORDER MSB_LAST /end MEASUREMENT
/begin COMPU_METHOD CU_F2_LEDA_MINFLT "Conversion method for F2_LedA_MinFlt" RAT_FUNC "%10.0" "(not defined)" COEFFS 0.000000 1.000000 -0.000000 0.000000 0.000000 1.000000 /end COMPU_METHOD
/* Scalar measurable for DDE 'F2_LedA_MinFltActv'. */
/begin MEASUREMENT F2_LedA_MinFltActv "Active fault low F2 (Min fault no latch or debounce)" UBYTE CU_F2_LEDA_MINFLTACTV 1 100 0.0 1.0 ECU_ADDRESS 0x70019fbd BYTE_ORDER MSB_LAST /end MEASUREMENT
/begin COMPU_METHOD CU_F2_LEDA_MINFLTACTV "Conversion method for F2_LedA_MinFltActv" RAT_FUNC "%10.0" "(not defined)" COEFFS 0.000000 1.000000 -0.000000 0.000000 0.000000 1.000000 /end COMPU_METHOD
/* Scalar measurable for DDE 'F3_LedB_MaxFlt'. */
/begin MEASUREMENT F3_LedB_MaxFlt "LEDB above max threshold latched after debounce (CCU pin F3)" UBYTE CU_F3_LEDB_MAXFLT 1 100 0.0 1.0 ECU_ADDRESS 0x70019f40 BYTE_ORDER MSB_LAST /end MEASUREMENT
/begin COMPU_METHOD CU_F3_LEDB_MAXFLT "Conversion method for F3_LedB_MaxFlt" RAT_FUNC "%10.0" "(not defined)" COEFFS 0.000000 1.000000 -0.000000 0.000000 0.000000 1.000000 /end COMPU_METHOD
/* Scalar measurable for DDE 'F3_LedB_MaxFltActv'. */
/begin MEASUREMENT F3_LedB_MaxFltActv "Active fault high F3 (Max fault no latch or debounce)" UBYTE CU_F3_LEDB_MAXFLTACTV 1 100 0.0 1.0 ECU_ADDRESS 0x70019ec7 BYTE_ORDER MSB_LAST /end MEASUREMENT
/begin COMPU_METHOD CU_F3_LEDB_MAXFLTACTV "Conversion method for F3_LedB_MaxFltActv" RAT_FUNC "%10.0" "(not defined)" COEFFS 0.000000 1.000000 -0.000000 0.000000 0.000000 1.000000 /end COMPU_METHOD
/* Scalar measurable for DDE 'F3_LedB_MinFlt'. */
/begin MEASUREMENT F3_LedB_MinFlt "LEDB below min threshold latched after debounce (CCU pin F3)" UBYTE CU_F3_LEDB_MINFLT 1 100 0.0 1.0 ECU_ADDRESS 0x7001a14f BYTE_ORDER MSB_LAST /end MEASUREMENT
/begin COMPU_METHOD CU_F3_LEDB_MINFLT "Conversion method for F3_LedB_MinFlt" RAT_FUNC "%10.0" "(not defined)" COEFFS 0.000000 1.000000 -0.000000 0.000000 0.000000 1.000000 /end COMPU_METHOD
/* Scalar measurable for DDE 'F3_LedB_MinFltActv'. */
/begin MEASUREMENT F3_LedB_MinFltActv "Active fault low F3 (Min fault no latch or debounce)" UBYTE CU_F3_LEDB_MINFLTACTV 1 100 0.0 1.0 ECU_ADDRESS 0x7001a0c5 BYTE_ORDER MSB_LAST /end MEASUREMENT
/begin COMPU_METHOD CU_F3_LEDB_MINFLTACTV "Conversion method for F3_LedB_MinFltActv" RAT_FUNC "%10.0" "(not defined)" COEFFS 0.000000 1.000000 -0.000000 0.000000 0.000000 1.000000 /end COMPU_METHOD
/* Scalar measurable for DDE 'F4_LedC_MaxFlt'. */
/begin MEASUREMENT F4_LedC_MaxFlt "LEDC above max threshold latched after debounce (CCU pin F4)" UBYTE CU_F4_LEDC_MAXFLT 1 100 0.0 1.0 ECU_ADDRESS 0x7001a045 BYTE_ORDER MSB_LAST /end MEASUREMENT
/begin COMPU_METHOD CU_F4_LEDC_MAXFLT "Conversion method for F4_LedC_MaxFlt" RAT_FUNC "%10.0" "(not defined)" COEFFS 0.000000 1.000000 -0.000000 0.000000 0.000000 1.000000 /end COMPU_METHOD
/* Scalar measurable for DDE 'F4_LedC_MaxFltActv'. */
/begin MEASUREMENT F4_LedC_MaxFltActv "Active fault high F4 (Max fault no latch or debounce)" UBYTE CU_F4_LEDC_MAXFLTACTV 1 100 0.0 1.0 ECU_ADDRESS 0x70019fb5 BYTE_ORDER MSB_LAST /end MEASUREMENT
/begin COMPU_METHOD CU_F4_LEDC_MAXFLTACTV "Conversion method for F4_LedC_MaxFltActv" RAT_FUNC "%10.0" "(not defined)" COEFFS 0.000000 1.000000 -0.000000 0.000000 0.000000 1.000000 /end COMPU_METHOD
/* Scalar measurable for DDE 'F4_LedC_MinFlt'. */
/begin MEASUREMENT F4_LedC_MinFlt "LEDC below min threshold latched after debounce (CCU pin F4)" UBYTE CU_F4_LEDC_MINFLT 1 100 0.0 1.0 ECU_ADDRESS 0x70019f39 BYTE_ORDER MSB_LAST /end MEASUREMENT
/begin COMPU_METHOD CU_F4_LEDC_MINFLT "Conversion method for F4_LedC_MinFlt" RAT_FUNC "%10.0" "(not defined)" COEFFS 0.000000 1.000000 -0.000000 0.000000 0.000000 1.000000 /end COMPU_METHOD
/* Scalar measurable for DDE 'F4_LedC_MinFltActv'. */
/begin MEASUREMENT F4_LedC_MinFltActv "Active fault low F4 (Min fault no latch or debounce)" UBYTE CU_F4_LEDC_MINFLTACTV 1 100 0.0 1.0 ECU_ADDRESS 0x70019ec4 BYTE_ORDER MSB_LAST /end MEASUREMENT
/begin COMPU_METHOD CU_F4_LEDC_MINFLTACTV "Conversion method for F4_LedC_MinFltActv" RAT_FUNC "%10.0" "(not defined)" COEFFS 0.000000 1.000000 -0.000000 0.000000 0.000000 1.000000 /end COMPU_METHOD
/* Scalar measurable for DDE 'K3_ignition_MaxFlt'. */
/begin MEASUREMENT K3_ignition_MaxFlt "Ignition above max threshold latched after debounce (CCU pin K3)" UBYTE CU_K3_IGNITION_MAXFLT 1 100 0.0 1.0 ECU_ADDRESS 0x7001a14c BYTE_ORDER MSB_LAST /end MEASUREMENT
/begin COMPU_METHOD CU_K3_IGNITION_MAXFLT "Conversion method for K3_ignition_MaxFlt" RAT_FUNC "%10.0" "(not defined)" COEFFS 0.000000 1.000000 -0.000000 0.000000 0.000000 1.000000 /end COMPU_METHOD
/* Scalar measurable for DDE 'K3_ignition_MaxFltActv'. */
/begin MEASUREMENT K3_ignition_MaxFltActv "Active fault high K3 (Max fault no latch or debounce)" UBYTE CU_K3_IGNITION_MAXFLTACTV 1 100 0.0 1.0 ECU_ADDRESS 0x7001a0bc BYTE_ORDER MSB_LAST /end MEASUREMENT
/begin COMPU_METHOD CU_K3_IGNITION_MAXFLTACTV "Conversion method for K3_ignition_MaxFltActv" RAT_FUNC "%10.0" "(not defined)" COEFFS 0.000000 1.000000 -0.000000 0.000000 0.000000 1.000000 /end COMPU_METHOD
/* Scalar measurable for DDE 'K3_ignition_MinFlt'. */
/begin MEASUREMENT K3_ignition_MinFlt "Ignition below min threshold latched after debounce (CCU pin K3)" UBYTE CU_K3_IGNITION_MINFLT 1 100 0.0 1.0 ECU_ADDRESS 0x7001a03f BYTE_ORDER MSB_LAST /end MEASUREMENT
/begin COMPU_METHOD CU_K3_IGNITION_MINFLT "Conversion method for K3_ignition_MinFlt" RAT_FUNC "%10.0" "(not defined)" COEFFS 0.000000 1.000000 -0.000000 0.000000 0.000000 1.000000 /end COMPU_METHOD
/* Scalar measurable for DDE 'K3_ignition_MinFltActv'. */
/begin MEASUREMENT K3_ignition_MinFltActv "Active fault low K3 (Min fault no latch or debounce)" UBYTE CU_K3_IGNITION_MINFLTACTV 1 100 0.0 1.0 ECU_ADDRESS 0x70019faf BYTE_ORDER MSB_LAST /end MEASUREMENT
/begin COMPU_METHOD CU_K3_IGNITION_MINFLTACTV "Conversion method for K3_ignition_MinFltActv" RAT_FUNC "%10.0" "(not defined)" COEFFS 0.000000 1.000000 -0.000000 0.000000 0.000000 1.000000 /end COMPU_METHOD
/* Scalar measurable for DDE 'M2_HbrNVmon_MaxFlt'. */
/begin MEASUREMENT M2_HbrNVmon_MaxFlt "HbrN Vmon above max threshold latched after debounce (CCU pin M2)" UBYTE CU_M2_HBRNVMON_MAXFLT 1 100 0.0 1.0 ECU_ADDRESS 0x70019f31 BYTE_ORDER MSB_LAST /end MEASUREMENT
/begin COMPU_METHOD CU_M2_HBRNVMON_MAXFLT "Conversion method for M2_HbrNVmon_MaxFlt" RAT_FUNC "%10.0" "(not defined)" COEFFS 0.000000 1.000000 -0.000000 0.000000 0.000000 1.000000 /end COMPU_METHOD
/* Scalar measurable for DDE 'M2_HbrNVmon_MaxFltActv'. */
/begin MEASUREMENT M2_HbrNVmon_MaxFltActv "Active fault high M2 (Max fault no latch or debounce)" UBYTE CU_M2_HBRNVMON_MAXFLTACTV 1 100 0.0 1.0 ECU_ADDRESS 0x70019ebc BYTE_ORDER MSB_LAST /end MEASUREMENT
/begin COMPU_METHOD CU_M2_HBRNVMON_MAXFLTACTV "Conversion method for M2_HbrNVmon_MaxFltActv" RAT_FUNC "%10.0" "(not defined)" COEFFS 0.000000 1.000000 -0.000000 0.000000 0.000000 1.000000 /end COMPU_METHOD
/* Scalar measurable for DDE 'M2_HbrNVmon_MinFlt'. */
/begin MEASUREMENT M2_HbrNVmon_MinFlt "HbrN Vmon below min threshold latched after debounce (CCU pin M2)" UBYTE CU_M2_HBRNVMON_MINFLT 1 100 0.0 1.0 ECU_ADDRESS 0x7001a140 BYTE_ORDER MSB_LAST /end MEASUREMENT
/begin COMPU_METHOD CU_M2_HBRNVMON_MINFLT "Conversion method for M2_HbrNVmon_MinFlt" RAT_FUNC "%10.0" "(not defined)" COEFFS 0.000000 1.000000 -0.000000 0.000000 0.000000 1.000000 /end COMPU_METHOD
/* Scalar measurable for DDE 'M2_HbrNVmon_MinFltActv'. */
/begin MEASUREMENT M2_HbrNVmon_MinFltActv "Active fault low M2 (Min fault no latch or debounce)" UBYTE CU_M2_HBRNVMON_MINFLTACTV 1 100 0.0 1.0 ECU_ADDRESS 0x7001a0b0 BYTE_ORDER MSB_LAST /end MEASUREMENT
/begin COMPU_METHOD CU_M2_HBRNVMON_MINFLTACTV "Conversion method for M2_HbrNVmon_MinFltActv" RAT_FUNC "%10.0" "(not defined)" COEFFS 0.000000 1.000000 -0.000000 0.000000 0.000000 1.000000 /end COMPU_METHOD
/* Scalar measurable for DDE 'M3_HbrPVmon_MaxFlt'. */
/begin MEASUREMENT M3_HbrPVmon_MaxFlt "HbrP Vmon above max threshold latched after debounce (CCU pin M3)" UBYTE CU_M3_HBRPVMON_MAXFLT 1 100 0.0 1.0 ECU_ADDRESS 0x7001a03c BYTE_ORDER MSB_LAST /end MEASUREMENT
/begin COMPU_METHOD CU_M3_HBRPVMON_MAXFLT "Conversion method for M3_HbrPVmon_MaxFlt" RAT_FUNC "%10.0" "(not defined)" COEFFS 0.000000 1.000000 -0.000000 0.000000 0.000000 1.000000 /end COMPU_METHOD
/* Scalar measurable for DDE 'M3_HbrPVmon_MaxFltActv'. */
/begin MEASUREMENT M3_HbrPVmon_MaxFltActv "Active fault high M3 (Max fault no latch or debounce)" UBYTE CU_M3_HBRPVMON_MAXFLTACTV 1 100 0.0 1.0 ECU_ADDRESS 0x70019fac BYTE_ORDER MSB_LAST /end MEASUREMENT
/begin COMPU_METHOD CU_M3_HBRPVMON_MAXFLTACTV "Conversion method for M3_HbrPVmon_MaxFltActv" RAT_FUNC "%10.0" "(not defined)" COEFFS 0.000000 1.000000 -0.000000 0.000000 0.000000 1.000000 /end COMPU_METHOD
/* Scalar measurable for DDE 'M3_HbrPVmon_MinFlt'. */
/begin MEASUREMENT M3_HbrPVmon_MinFlt "HbrP Vmon below min threshold latched after debounce (CCU pin M3)" UBYTE CU_M3_HBRPVMON_MINFLT 1 100 0.0 1.0 ECU_ADDRESS 0x70019f29 BYTE_ORDER MSB_LAST /end MEASUREMENT
/begin COMPU_METHOD CU_M3_HBRPVMON_MINFLT "Conversion method for M3_HbrPVmon_MinFlt" RAT_FUNC "%10.0" "(not defined)" COEFFS 0.000000 1.000000 -0.000000 0.000000 0.000000 1.000000 /end COMPU_METHOD
/* Scalar measurable for DDE 'M3_HbrPVmon_MinFltActv'. */
/begin MEASUREMENT M3_HbrPVmon_MinFltActv "Active fault low M3 (Min fault no latch or debounce)" UBYTE CU_M3_HBRPVMON_MINFLTACTV 1 100 0.0 1.0 ECU_ADDRESS 0x70019eb3 BYTE_ORDER MSB_LAST /end MEASUREMENT
/begin COMPU_METHOD CU_M3_HBRPVMON_MINFLTACTV "Conversion method for M3_HbrPVmon_MinFltActv" RAT_FUNC "%10.0" "(not defined)" COEFFS 0.000000 1.000000 -0.000000 0.000000 0.000000 1.000000 /end COMPU_METHOD
/* Scalar measurable for DDE 'ParamSetIdSelected'. */
/begin MEASUREMENT ParamSetIdSelected "Selected Parameter Set Id from the Service Discovery and Detail Parser" UWORD CU_PARAMSETIDSELECTED 1 100 0.0 65535.0 ECU_ADDRESS 0x70017eb2 BYTE_ORDER MSB_LAST /end MEASUREMENT
/begin COMPU_METHOD CU_PARAMSETIDSELECTED "Conversion method for ParamSetIdSelected" RAT_FUNC "%10.0" "NU" COEFFS 0.000000 1.000000 -0.000000 0.000000 0.000000 1.000000 /end COMPU_METHOD
/* Scalar measurable for DDE 'ServiceIdSelected'. */
/begin MEASUREMENT ServiceIdSelected "Selected Service Id from the Service Discovery and Detail Parser" UWORD CU_SERVICEIDSELECTED 1 100 0.0 65535.0 ECU_ADDRESS 0x70018142 BYTE_ORDER MSB_LAST /end MEASUREMENT
/begin COMPU_METHOD CU_SERVICEIDSELECTED "Conversion method for ServiceIdSelected" RAT_FUNC "%10.0" "NU" COEFFS 0.000000 1.000000 -0.000000 0.000000 0.000000 1.000000 /end COMPU_METHOD
/* Scalar measurable for DDE 'SimRessSoc'. */
/begin MEASUREMENT SimRessSoc "Processed HV battery SOC value received from HV battery controller" FLOAT32_IEEE CU_SIMRESSSOC 1 100 0.0 100.0 ECU_ADDRESS 0x700183c8 BYTE_ORDER MSB_LAST /end MEASUREMENT
/begin COMPU_METHOD CU_SIMRESSSOC "Conversion method for SimRessSoc" RAT_FUNC "%10.0" "%" COEFFS 0.000000 1.000000 -0.000000 0.000000 0.000000 1.000000 /end COMPU_METHOD
/* Scalar measurable for DDE 'SimRessVolt'. */
/begin MEASUREMENT SimRessVolt "Processed value of HV battery voltage" FLOAT32_IEEE CU_SIMRESSVOLT 1 100 -10.0 1500.0 ECU_ADDRESS 0x70017df4 BYTE_ORDER MSB_LAST /end MEASUREMENT
/begin COMPU_METHOD CU_SIMRESSVOLT "Conversion method for SimRessVolt" RAT_FUNC "%10.0" "V" COEFFS 0.000000 1.000000 -0.000000 0.000000 0.000000 1.000000 /end COMPU_METHOD
/* Scalar measurable for DDE 'SvcSearchSt'. */
/begin MEASUREMENT SvcSearchSt "Service Discovery and Detail Parser Search Status" SLONG CU_SVCSEARCHST 1 100 -2147483648.0 2147483647.0 ECU_ADDRESS 0x70017c30 BYTE_ORDER MSB_LAST /end MEASUREMENT
/begin COMPU_METHOD CU_SVCSEARCHST "Conversion method for SvcSearchSt" TAB_VERB "%12.0" "enum" COMPU_TAB_REF CT_SVCSEARCHST /end COMPU_METHOD
/begin COMPU_VTAB CT_SVCSEARCHST "Conversion method for SvcSearchSt" TAB_VERB 5 0 "SEARCH_ONGOING" 1 "WAIT_FOR_SVCDETAIL" 2 "FINISHED_NO_RESULT" 3 "SEARCH_FINISHED" 4 "SEARCH_STARTUP" /end COMPU_VTAB
/* Scalar measurable for DDE 'TLF35584DataFrom[0]'. */
/begin MEASUREMENT TLF35584DataFrom[0] "(not defined)" UBYTE CU_TLF35584DATAFROM[0] 1 100 0.0 255.0 ECU_ADDRESS 0x7001a118 BYTE_ORDER MSB_LAST /end MEASUREMENT
/begin COMPU_METHOD CU_TLF35584DATAFROM[0] "Conversion method for TLF35584DataFrom[0]" RAT_FUNC "%10.0" "(not defined)" COEFFS 0.000000 1.000000 -0.000000 0.000000 0.000000 1.000000 /end COMPU_METHOD
/* Scalar measurable for DDE 'TLF35584DataFrom[10]'. */
/begin MEASUREMENT TLF35584DataFrom[10] "(not defined)" UBYTE CU_TLF35584DATAFROM[10] 1 100 0.0 255.0 ECU_ADDRESS 0x7001a122 BYTE_ORDER MSB_LAST /end MEASUREMENT
/begin COMPU_METHOD CU_TLF35584DATAFROM[10] "Conversion method for TLF35584DataFrom[10]" RAT_FUNC "%10.0" "(not defined)" COEFFS 0.000000 1.000000 -0.000000 0.000000 0.000000 1.000000 /end COMPU_METHOD
/* Scalar measurable for DDE 'TLF35584DataFrom[11]'. */
/begin MEASUREMENT TLF35584DataFrom[11] "(not defined)" UBYTE CU_TLF35584DATAFROM[11] 1 100 0.0 255.0 ECU_ADDRESS 0x7001a123 BYTE_ORDER MSB_LAST /end MEASUREMENT
/begin COMPU_METHOD CU_TLF35584DATAFROM[11] "Conversion method for TLF35584DataFrom[11]" RAT_FUNC "%10.0" "(not defined)" COEFFS 0.000000 1.000000 -0.000000 0.000000 0.000000 1.000000 /end COMPU_METHOD
/* Scalar measurable for DDE 'TLF35584DataFrom[12]'. */
/begin MEASUREMENT TLF35584DataFrom[12] "(not defined)" UBYTE CU_TLF35584DATAFROM[12] 1 100 0.0 255.0 ECU_ADDRESS 0x7001a124 BYTE_ORDER MSB_LAST /end MEASUREMENT
/begin COMPU_METHOD CU_TLF35584DATAFROM[12] "Conversion method for TLF35584DataFrom[12]" RAT_FUNC "%10.0" "(not defined)" COEFFS 0.000000 1.000000 -0.000000 0.000000 0.000000 1.000000 /end COMPU_METHOD
/* Scalar measurable for DDE 'TLF35584DataFrom[13]'. */
/begin MEASUREMENT TLF35584DataFrom[13] "(not defined)" UBYTE CU_TLF35584DATAFROM[13] 1 100 0.0 255.0 ECU_ADDRESS 0x7001a125 BYTE_ORDER MSB_LAST /end MEASUREMENT
/begin COMPU_METHOD CU_TLF35584DATAFROM[13] "Conversion method for TLF35584DataFrom[13]" RAT_FUNC "%10.0" "(not defined)" COEFFS 0.000000 1.000000 -0.000000 0.000000 0.000000 1.000000 /end COMPU_METHOD
/* Scalar measurable for DDE 'TLF35584DataFrom[14]'. */
/begin MEASUREMENT TLF35584DataFrom[14] "(not defined)" UBYTE CU_TLF35584DATAFROM[14] 1 100 0.0 255.0 ECU_ADDRESS 0x7001a126 BYTE_ORDER MSB_LAST /end MEASUREMENT
/begin COMPU_METHOD CU_TLF35584DATAFROM[14] "Conversion method for TLF35584DataFrom[14]" RAT_FUNC "%10.0" "(not defined)" COEFFS 0.000000 1.000000 -0.000000 0.000000 0.000000 1.000000 /end COMPU_METHOD
/* Scalar measurable for DDE 'TLF35584DataFrom[15]'. */
/begin MEASUREMENT TLF35584DataFrom[15] "(not defined)" UBYTE CU_TLF35584DATAFROM[15] 1 100 0.0 255.0 ECU_ADDRESS 0x7001a127 BYTE_ORDER MSB_LAST /end MEASUREMENT
/begin COMPU_METHOD CU_TLF35584DATAFROM[15] "Conversion method for TLF35584DataFrom[15]" RAT_FUNC "%10.0" "(not defined)" COEFFS 0.000000 1.000000 -0.000000 0.000000 0.000000 1.000000 /end COMPU_METHOD
/* Scalar measurable for DDE 'TLF35584DataFrom[16]'. */
/begin MEASUREMENT TLF35584DataFrom[16] "(not defined)" UBYTE CU_TLF35584DATAFROM[16] 1 100 0.0 255.0 ECU_ADDRESS 0x7001a128 BYTE_ORDER MSB_LAST /end MEASUREMENT
/begin COMPU_METHOD CU_TLF35584DATAFROM[16] "Conversion method for TLF35584DataFrom[16]" RAT_FUNC "%10.0" "(not defined)" COEFFS 0.000000 1.000000 -0.000000 0.000000 0.000000 1.000000 /end COMPU_METHOD
/* Scalar measurable for DDE 'TLF35584DataFrom[17]'. */
/begin MEASUREMENT TLF35584DataFrom[17] "(not defined)" UBYTE CU_TLF35584DATAFROM[17] 1 100 0.0 255.0 ECU_ADDRESS 0x7001a129 BYTE_ORDER MSB_LAST /end MEASUREMENT
/begin COMPU_METHOD CU_TLF35584DATAFROM[17] "Conversion method for TLF35584DataFrom[17]" RAT_FUNC "%10.0" "(not defined)" COEFFS 0.000000 1.000000 -0.000000 0.000000 0.000000 1.000000 /end COMPU_METHOD
/* Scalar measurable for DDE 'TLF35584DataFrom[18]'. */
/begin MEASUREMENT TLF35584DataFrom[18] "(not defined)" UBYTE CU_TLF35584DATAFROM[18] 1 100 0.0 255.0 ECU_ADDRESS 0x7001a12a BYTE_ORDER MSB_LAST /end MEASUREMENT
/begin COMPU_METHOD CU_TLF35584DATAFROM[18] "Conversion method for TLF35584DataFrom[18]" RAT_FUNC "%10.0" "(not defined)" COEFFS 0.000000 1.000000 -0.000000 0.000000 0.000000 1.000000 /end COMPU_METHOD
/* Scalar measurable for DDE 'TLF35584DataFrom[19]'. */
/begin MEASUREMENT TLF35584DataFrom[19] "(not defined)" UBYTE CU_TLF35584DATAFROM[19] 1 100 0.0 255.0 ECU_ADDRESS 0x7001a12b BYTE_ORDER MSB_LAST /end MEASUREMENT
/begin COMPU_METHOD CU_TLF35584DATAFROM[19] "Conversion method for TLF35584DataFrom[19]" RAT_FUNC "%10.0" "(not defined)" COEFFS 0.000000 1.000000 -0.000000 0.000000 0.000000 1.000000 /end COMPU_METHOD
/* Scalar measurable for DDE 'TLF35584DataFrom[1]'. */
/begin MEASUREMENT TLF35584DataFrom[1] "(not defined)" UBYTE CU_TLF35584DATAFROM[1] 1 100 0.0 255.0 ECU_ADDRESS 0x7001a119 BYTE_ORDER MSB_LAST /end MEASUREMENT
/begin COMPU_METHOD CU_TLF35584DATAFROM[1] "Conversion method for TLF35584DataFrom[1]" RAT_FUNC "%10.0" "(not defined)" COEFFS 0.000000 1.000000 -0.000000 0.000000 0.000000 1.000000 /end COMPU_METHOD
/* Scalar measurable for DDE 'TLF35584DataFrom[20]'. */
/begin MEASUREMENT TLF35584DataFrom[20] "(not defined)" UBYTE CU_TLF35584DATAFROM[20] 1 100 0.0 255.0 ECU_ADDRESS 0x7001a12c BYTE_ORDER MSB_LAST /end MEASUREMENT
/begin COMPU_METHOD CU_TLF35584DATAFROM[20] "Conversion method for TLF35584DataFrom[20]" RAT_FUNC "%10.0" "(not defined)" COEFFS 0.000000 1.000000 -0.000000 0.000000 0.000000 1.000000 /end COMPU_METHOD
/* Scalar measurable for DDE 'TLF35584DataFrom[21]'. */
/begin MEASUREMENT TLF35584DataFrom[21] "(not defined)" UBYTE CU_TLF35584DATAFROM[21] 1 100 0.0 255.0 ECU_ADDRESS 0x7001a12d BYTE_ORDER MSB_LAST /end MEASUREMENT
/begin COMPU_METHOD CU_TLF35584DATAFROM[21] "Conversion method for TLF35584DataFrom[21]" RAT_FUNC "%10.0" "(not defined)" COEFFS 0.000000 1.000000 -0.000000 0.000000 0.000000 1.000000 /end COMPU_METHOD
/* Scalar measurable for DDE 'TLF35584DataFrom[22]'. */
/begin MEASUREMENT TLF35584DataFrom[22] "(not defined)" UBYTE CU_TLF35584DATAFROM[22] 1 100 0.0 255.0 ECU_ADDRESS 0x7001a12e BYTE_ORDER MSB_LAST /end MEASUREMENT
/begin COMPU_METHOD CU_TLF35584DATAFROM[22] "Conversion method for TLF35584DataFrom[22]" RAT_FUNC "%10.0" "(not defined)" COEFFS 0.000000 1.000000 -0.000000 0.000000 0.000000 1.000000 /end COMPU_METHOD
/* Scalar measurable for DDE 'TLF35584DataFrom[23]'. */
/begin MEASUREMENT TLF35584DataFrom[23] "(not defined)" UBYTE CU_TLF35584DATAFROM[23] 1 100 0.0 255.0 ECU_ADDRESS 0x7001a12f BYTE_ORDER MSB_LAST /end MEASUREMENT
/begin COMPU_METHOD CU_TLF35584DATAFROM[23] "Conversion method for TLF35584DataFrom[23]" RAT_FUNC "%10.0" "(not defined)" COEFFS 0.000000 1.000000 -0.000000 0.000000 0.000000 1.000000 /end COMPU_METHOD
/* Scalar measurable for DDE 'TLF35584DataFrom[24]'. */
/begin MEASUREMENT TLF35584DataFrom[24] "(not defined)" UBYTE CU_TLF35584DATAFROM[24] 1 100 0.0 255.0 ECU_ADDRESS 0x7001a130 BYTE_ORDER MSB_LAST /end MEASUREMENT
/begin COMPU_METHOD CU_TLF35584DATAFROM[24] "Conversion method for TLF35584DataFrom[24]" RAT_FUNC "%10.0" "(not defined)" COEFFS 0.000000 1.000000 -0.000000 0.000000 0.000000 1.000000 /end COMPU_METHOD
/* Scalar measurable for DDE 'TLF35584DataFrom[2]'. */
/begin MEASUREMENT TLF35584DataFrom[2] "(not defined)" UBYTE CU_TLF35584DATAFROM[2] 1 100 0.0 255.0 ECU_ADDRESS 0x7001a11a BYTE_ORDER MSB_LAST /end MEASUREMENT
/begin COMPU_METHOD CU_TLF35584DATAFROM[2] "Conversion method for TLF35584DataFrom[2]" RAT_FUNC "%10.0" "(not defined)" COEFFS 0.000000 1.000000 -0.000000 0.000000 0.000000 1.000000 /end COMPU_METHOD
/* Scalar measurable for DDE 'TLF35584DataFrom[3]'. */
/begin MEASUREMENT TLF35584DataFrom[3] "(not defined)" UBYTE CU_TLF35584DATAFROM[3] 1 100 0.0 255.0 ECU_ADDRESS 0x7001a11b BYTE_ORDER MSB_LAST /end MEASUREMENT
/begin COMPU_METHOD CU_TLF35584DATAFROM[3] "Conversion method for TLF35584DataFrom[3]" RAT_FUNC "%10.0" "(not defined)" COEFFS 0.000000 1.000000 -0.000000 0.000000 0.000000 1.000000 /end COMPU_METHOD
/* Scalar measurable for DDE 'TLF35584DataFrom[4]'. */
/begin MEASUREMENT TLF35584DataFrom[4] "(not defined)" UBYTE CU_TLF35584DATAFROM[4] 1 100 0.0 255.0 ECU_ADDRESS 0x7001a11c BYTE_ORDER MSB_LAST /end MEASUREMENT
/begin COMPU_METHOD CU_TLF35584DATAFROM[4] "Conversion method for TLF35584DataFrom[4]" RAT_FUNC "%10.0" "(not defined)" COEFFS 0.000000 1.000000 -0.000000 0.000000 0.000000 1.000000 /end COMPU_METHOD
/* Scalar measurable for DDE 'TLF35584DataFrom[5]'. */
/begin MEASUREMENT TLF35584DataFrom[5] "(not defined)" UBYTE CU_TLF35584DATAFROM[5] 1 100 0.0 255.0 ECU_ADDRESS 0x7001a11d BYTE_ORDER MSB_LAST /end MEASUREMENT
/begin COMPU_METHOD CU_TLF35584DATAFROM[5] "Conversion method for TLF35584DataFrom[5]" RAT_FUNC "%10.0" "(not defined)" COEFFS 0.000000 1.000000 -0.000000 0.000000 0.000000 1.000000 /end COMPU_METHOD
/* Scalar measurable for DDE 'TLF35584DataFrom[6]'. */
/begin MEASUREMENT TLF35584DataFrom[6] "(not defined)" UBYTE CU_TLF35584DATAFROM[6] 1 100 0.0 255.0 ECU_ADDRESS 0x7001a11e BYTE_ORDER MSB_LAST /end MEASUREMENT
/begin COMPU_METHOD CU_TLF35584DATAFROM[6] "Conversion method for TLF35584DataFrom[6]" RAT_FUNC "%10.0" "(not defined)" COEFFS 0.000000 1.000000 -0.000000 0.000000 0.000000 1.000000 /end COMPU_METHOD
/* Scalar measurable for DDE 'TLF35584DataFrom[7]'. */
/begin MEASUREMENT TLF35584DataFrom[7] "(not defined)" UBYTE CU_TLF35584DATAFROM[7] 1 100 0.0 255.0 ECU_ADDRESS 0x7001a11f BYTE_ORDER MSB_LAST /end MEASUREMENT
/begin COMPU_METHOD CU_TLF35584DATAFROM[7] "Conversion method for TLF35584DataFrom[7]" RAT_FUNC "%10.0" "(not defined)" COEFFS 0.000000 1.000000 -0.000000 0.000000 0.000000 1.000000 /end COMPU_METHOD
/* Scalar measurable for DDE 'TLF35584DataFrom[8]'. */
/begin MEASUREMENT TLF35584DataFrom[8] "(not defined)" UBYTE CU_TLF35584DATAFROM[8] 1 100 0.0 255.0 ECU_ADDRESS 0x7001a120 BYTE_ORDER MSB_LAST /end MEASUREMENT
/begin COMPU_METHOD CU_TLF35584DATAFROM[8] "Conversion method for TLF35584DataFrom[8]" RAT_FUNC "%10.0" "(not defined)" COEFFS 0.000000 1.000000 -0.000000 0.000000 0.000000 1.000000 /end COMPU_METHOD
/* Scalar measurable for DDE 'TLF35584DataFrom[9]'. */
/begin MEASUREMENT TLF35584DataFrom[9] "(not defined)" UBYTE CU_TLF35584DATAFROM[9] 1 100 0.0 255.0 ECU_ADDRESS 0x7001a121 BYTE_ORDER MSB_LAST /end MEASUREMENT
/begin COMPU_METHOD CU_TLF35584DATAFROM[9] "Conversion method for TLF35584DataFrom[9]" RAT_FUNC "%10.0" "(not defined)" COEFFS 0.000000 1.000000 -0.000000 0.000000 0.000000 1.000000 /end COMPU_METHOD
/* Scalar measurable for DDE 'TLF35584GetJobResult'. */
/begin MEASUREMENT TLF35584GetJobResult "(not defined)" UBYTE CU_TLF35584GETJOBRESULT 1 100 0.0 255.0 ECU_ADDRESS 0x70019fae BYTE_ORDER MSB_LAST /end MEASUREMENT
/begin COMPU_METHOD CU_TLF35584GETJOBRESULT "Conversion method for TLF35584GetJobResult" RAT_FUNC "%10.0" "(not defined)" COEFFS 0.000000 1.000000 -0.000000 0.000000 0.000000 1.000000 /end COMPU_METHOD
/* Scalar measurable for DDE 'TLF35584JobResult'. */
/begin MEASUREMENT TLF35584JobResult "(not defined)" UBYTE CU_TLF35584JOBRESULT 1 100 0.0 255.0 ECU_ADDRESS 0x7001a14e BYTE_ORDER MSB_LAST /end MEASUREMENT
/begin COMPU_METHOD CU_TLF35584JOBRESULT "Conversion method for TLF35584JobResult" RAT_FUNC "%10.0" "(not defined)" COEFFS 0.000000 1.000000 -0.000000 0.000000 0.000000 1.000000 /end COMPU_METHOD
/* Scalar measurable for DDE 'TLF35584RqstdCmd[0]'. */
/begin MEASUREMENT TLF35584RqstdCmd[0] "(not defined)" UBYTE CU_TLF35584RQSTDCMD[0] 1 100 0.0 255.0 ECU_ADDRESS 0x70019fbf BYTE_ORDER MSB_LAST /end MEASUREMENT
/begin COMPU_METHOD CU_TLF35584RQSTDCMD[0] "Conversion method for TLF35584RqstdCmd[0]" RAT_FUNC "%10.0" "(not defined)" COEFFS 0.000000 1.000000 -0.000000 0.000000 0.000000 1.000000 /end COMPU_METHOD
/* Scalar measurable for DDE 'TLF35584RqstdCmd[10]'. */
/begin MEASUREMENT TLF35584RqstdCmd[10] "(not defined)" UBYTE CU_TLF35584RQSTDCMD[10] 1 100 0.0 255.0 ECU_ADDRESS 0x70019fc9 BYTE_ORDER MSB_LAST /end MEASUREMENT
/begin COMPU_METHOD CU_TLF35584RQSTDCMD[10] "Conversion method for TLF35584RqstdCmd[10]" RAT_FUNC "%10.0" "(not defined)" COEFFS 0.000000 1.000000 -0.000000 0.000000 0.000000 1.000000 /end COMPU_METHOD
/* Scalar measurable for DDE 'TLF35584RqstdCmd[11]'. */
/begin MEASUREMENT TLF35584RqstdCmd[11] "(not defined)" UBYTE CU_TLF35584RQSTDCMD[11] 1 100 0.0 255.0 ECU_ADDRESS 0x70019fca BYTE_ORDER MSB_LAST /end MEASUREMENT
/begin COMPU_METHOD CU_TLF35584RQSTDCMD[11] "Conversion method for TLF35584RqstdCmd[11]" RAT_FUNC "%10.0" "(not defined)" COEFFS 0.000000 1.000000 -0.000000 0.000000 0.000000 1.000000 /end COMPU_METHOD
/* Scalar measurable for DDE 'TLF35584RqstdCmd[12]'. */
/begin MEASUREMENT TLF35584RqstdCmd[12] "(not defined)" UBYTE CU_TLF35584RQSTDCMD[12] 1 100 0.0 255.0 ECU_ADDRESS 0x70019fcb BYTE_ORDER MSB_LAST /end MEASUREMENT
/begin COMPU_METHOD CU_TLF35584RQSTDCMD[12] "Conversion method for TLF35584RqstdCmd[12]" RAT_FUNC "%10.0" "(not defined)" COEFFS 0.000000 1.000000 -0.000000 0.000000 0.000000 1.000000 /end COMPU_METHOD
/* Scalar measurable for DDE 'TLF35584RqstdCmd[13]'. */
/begin MEASUREMENT TLF35584RqstdCmd[13] "(not defined)" UBYTE CU_TLF35584RQSTDCMD[13] 1 100 0.0 255.0 ECU_ADDRESS 0x70019fcc BYTE_ORDER MSB_LAST /end MEASUREMENT
/begin COMPU_METHOD CU_TLF35584RQSTDCMD[13] "Conversion method for TLF35584RqstdCmd[13]" RAT_FUNC "%10.0" "(not defined)" COEFFS 0.000000 1.000000 -0.000000 0.000000 0.000000 1.000000 /end COMPU_METHOD
/* Scalar measurable for DDE 'TLF35584RqstdCmd[14]'. */
/begin MEASUREMENT TLF35584RqstdCmd[14] "(not defined)" UBYTE CU_TLF35584RQSTDCMD[14] 1 100 0.0 255.0 ECU_ADDRESS 0x70019fcd BYTE_ORDER MSB_LAST /end MEASUREMENT
/begin COMPU_METHOD CU_TLF35584RQSTDCMD[14] "Conversion method for TLF35584RqstdCmd[14]" RAT_FUNC "%10.0" "(not defined)" COEFFS 0.000000 1.000000 -0.000000 0.000000 0.000000 1.000000 /end COMPU_METHOD
/* Scalar measurable for DDE 'TLF35584RqstdCmd[15]'. */
/begin MEASUREMENT TLF35584RqstdCmd[15] "(not defined)" UBYTE CU_TLF35584RQSTDCMD[15] 1 100 0.0 255.0 ECU_ADDRESS 0x70019fce BYTE_ORDER MSB_LAST /end MEASUREMENT
/begin COMPU_METHOD CU_TLF35584RQSTDCMD[15] "Conversion method for TLF35584RqstdCmd[15]" RAT_FUNC "%10.0" "(not defined)" COEFFS 0.000000 1.000000 -0.000000 0.000000 0.000000 1.000000 /end COMPU_METHOD
/* Scalar measurable for DDE 'TLF35584RqstdCmd[16]'. */
/begin MEASUREMENT TLF35584RqstdCmd[16] "(not defined)" UBYTE CU_TLF35584RQSTDCMD[16] 1 100 0.0 255.0 ECU_ADDRESS 0x70019fcf BYTE_ORDER MSB_LAST /end MEASUREMENT
/begin COMPU_METHOD CU_TLF35584RQSTDCMD[16] "Conversion method for TLF35584RqstdCmd[16]" RAT_FUNC "%10.0" "(not defined)" COEFFS 0.000000 1.000000 -0.000000 0.000000 0.000000 1.000000 /end COMPU_METHOD
/* Scalar measurable for DDE 'TLF35584RqstdCmd[17]'. */
/begin MEASUREMENT TLF35584RqstdCmd[17] "(not defined)" UBYTE CU_TLF35584RQSTDCMD[17] 1 100 0.0 255.0 ECU_ADDRESS 0x70019fd0 BYTE_ORDER MSB_LAST /end MEASUREMENT
/begin COMPU_METHOD CU_TLF35584RQSTDCMD[17] "Conversion method for TLF35584RqstdCmd[17]" RAT_FUNC "%10.0" "(not defined)" COEFFS 0.000000 1.000000 -0.000000 0.000000 0.000000 1.000000 /end COMPU_METHOD
/* Scalar measurable for DDE 'TLF35584RqstdCmd[18]'. */
/begin MEASUREMENT TLF35584RqstdCmd[18] "(not defined)" UBYTE CU_TLF35584RQSTDCMD[18] 1 100 0.0 255.0 ECU_ADDRESS 0x70019fd1 BYTE_ORDER MSB_LAST /end MEASUREMENT
/begin COMPU_METHOD CU_TLF35584RQSTDCMD[18] "Conversion method for TLF35584RqstdCmd[18]" RAT_FUNC "%10.0" "(not defined)" COEFFS 0.000000 1.000000 -0.000000 0.000000 0.000000 1.000000 /end COMPU_METHOD
/* Scalar measurable for DDE 'TLF35584RqstdCmd[19]'. */
/begin MEASUREMENT TLF35584RqstdCmd[19] "(not defined)" UBYTE CU_TLF35584RQSTDCMD[19] 1 100 0.0 255.0 ECU_ADDRESS 0x70019fd2 BYTE_ORDER MSB_LAST /end MEASUREMENT
/begin COMPU_METHOD CU_TLF35584RQSTDCMD[19] "Conversion method for TLF35584RqstdCmd[19]" RAT_FUNC "%10.0" "(not defined)" COEFFS 0.000000 1.000000 -0.000000 0.000000 0.000000 1.000000 /end COMPU_METHOD
/* Scalar measurable for DDE 'TLF35584RqstdCmd[1]'. */
/begin MEASUREMENT TLF35584RqstdCmd[1] "(not defined)" UBYTE CU_TLF35584RQSTDCMD[1] 1 100 0.0 255.0 ECU_ADDRESS 0x70019fc0 BYTE_ORDER MSB_LAST /end MEASUREMENT
/begin COMPU_METHOD CU_TLF35584RQSTDCMD[1] "Conversion method for TLF35584RqstdCmd[1]" RAT_FUNC "%10.0" "(not defined)" COEFFS 0.000000 1.000000 -0.000000 0.000000 0.000000 1.000000 /end COMPU_METHOD
/* Scalar measurable for DDE 'TLF35584RqstdCmd[20]'. */
/begin MEASUREMENT TLF35584RqstdCmd[20] "(not defined)" UBYTE CU_TLF35584RQSTDCMD[20] 1 100 0.0 255.0 ECU_ADDRESS 0x70019fd3 BYTE_ORDER MSB_LAST /end MEASUREMENT
/begin COMPU_METHOD CU_TLF35584RQSTDCMD[20] "Conversion method for TLF35584RqstdCmd[20]" RAT_FUNC "%10.0" "(not defined)" COEFFS 0.000000 1.000000 -0.000000 0.000000 0.000000 1.000000 /end COMPU_METHOD
/* Scalar measurable for DDE 'TLF35584RqstdCmd[21]'. */
/begin MEASUREMENT TLF35584RqstdCmd[21] "(not defined)" UBYTE CU_TLF35584RQSTDCMD[21] 1 100 0.0 255.0 ECU_ADDRESS 0x70019fd4 BYTE_ORDER MSB_LAST /end MEASUREMENT
/begin COMPU_METHOD CU_TLF35584RQSTDCMD[21] "Conversion method for TLF35584RqstdCmd[21]" RAT_FUNC "%10.0" "(not defined)" COEFFS 0.000000 1.000000 -0.000000 0.000000 0.000000 1.000000 /end COMPU_METHOD
/* Scalar measurable for DDE 'TLF35584RqstdCmd[22]'. */
/begin MEASUREMENT TLF35584RqstdCmd[22] "(not defined)" UBYTE CU_TLF35584RQSTDCMD[22] 1 100 0.0 255.0 ECU_ADDRESS 0x70019fd5 BYTE_ORDER MSB_LAST /end MEASUREMENT
/begin COMPU_METHOD CU_TLF35584RQSTDCMD[22] "Conversion method for TLF35584RqstdCmd[22]" RAT_FUNC "%10.0" "(not defined)" COEFFS 0.000000 1.000000 -0.000000 0.000000 0.000000 1.000000 /end COMPU_METHOD
/* Scalar measurable for DDE 'TLF35584RqstdCmd[23]'. */
/begin MEASUREMENT TLF35584RqstdCmd[23] "(not defined)" UBYTE CU_TLF35584RQSTDCMD[23] 1 100 0.0 255.0 ECU_ADDRESS 0x70019fd6 BYTE_ORDER MSB_LAST /end MEASUREMENT
/begin COMPU_METHOD CU_TLF35584RQSTDCMD[23] "Conversion method for TLF35584RqstdCmd[23]" RAT_FUNC "%10.0" "(not defined)" COEFFS 0.000000 1.000000 -0.000000 0.000000 0.000000 1.000000 /end COMPU_METHOD
/* Scalar measurable for DDE 'TLF35584RqstdCmd[24]'. */
/begin MEASUREMENT TLF35584RqstdCmd[24] "(not defined)" UBYTE CU_TLF35584RQSTDCMD[24] 1 100 0.0 255.0 ECU_ADDRESS 0x70019fd7 BYTE_ORDER MSB_LAST /end MEASUREMENT
/begin COMPU_METHOD CU_TLF35584RQSTDCMD[24] "Conversion method for TLF35584RqstdCmd[24]" RAT_FUNC "%10.0" "(not defined)" COEFFS 0.000000 1.000000 -0.000000 0.000000 0.000000 1.000000 /end COMPU_METHOD
/* Scalar measurable for DDE 'TLF35584RqstdCmd[2]'. */
/begin MEASUREMENT TLF35584RqstdCmd[2] "(not defined)" UBYTE CU_TLF35584RQSTDCMD[2] 1 100 0.0 255.0 ECU_ADDRESS 0x70019fc1 BYTE_ORDER MSB_LAST /end MEASUREMENT
/begin COMPU_METHOD CU_TLF35584RQSTDCMD[2] "Conversion method for TLF35584RqstdCmd[2]" RAT_FUNC "%10.0" "(not defined)" COEFFS 0.000000 1.000000 -0.000000 0.000000 0.000000 1.000000 /end COMPU_METHOD
/* Scalar measurable for DDE 'TLF35584RqstdCmd[3]'. */
/begin MEASUREMENT TLF35584RqstdCmd[3] "(not defined)" UBYTE CU_TLF35584RQSTDCMD[3] 1 100 0.0 255.0 ECU_ADDRESS 0x70019fc2 BYTE_ORDER MSB_LAST /end MEASUREMENT
/begin COMPU_METHOD CU_TLF35584RQSTDCMD[3] "Conversion method for TLF35584RqstdCmd[3]" RAT_FUNC "%10.0" "(not defined)" COEFFS 0.000000 1.000000 -0.000000 0.000000 0.000000 1.000000 /end COMPU_METHOD
/* Scalar measurable for DDE 'TLF35584RqstdCmd[4]'. */
/begin MEASUREMENT TLF35584RqstdCmd[4] "(not defined)" UBYTE CU_TLF35584RQSTDCMD[4] 1 100 0.0 255.0 ECU_ADDRESS 0x70019fc3 BYTE_ORDER MSB_LAST /end MEASUREMENT
/begin COMPU_METHOD CU_TLF35584RQSTDCMD[4] "Conversion method for TLF35584RqstdCmd[4]" RAT_FUNC "%10.0" "(not defined)" COEFFS 0.000000 1.000000 -0.000000 0.000000 0.000000 1.000000 /end COMPU_METHOD
/* Scalar measurable for DDE 'TLF35584RqstdCmd[5]'. */
/begin MEASUREMENT TLF35584RqstdCmd[5] "(not defined)" UBYTE CU_TLF35584RQSTDCMD[5] 1 100 0.0 255.0 ECU_ADDRESS 0x70019fc4 BYTE_ORDER MSB_LAST /end MEASUREMENT
/begin COMPU_METHOD CU_TLF35584RQSTDCMD[5] "Conversion method for TLF35584RqstdCmd[5]" RAT_FUNC "%10.0" "(not defined)" COEFFS 0.000000 1.000000 -0.000000 0.000000 0.000000 1.000000 /end COMPU_METHOD
/* Scalar measurable for DDE 'TLF35584RqstdCmd[6]'. */
/begin MEASUREMENT TLF35584RqstdCmd[6] "(not defined)" UBYTE CU_TLF35584RQSTDCMD[6] 1 100 0.0 255.0 ECU_ADDRESS 0x70019fc5 BYTE_ORDER MSB_LAST /end MEASUREMENT
/begin COMPU_METHOD CU_TLF35584RQSTDCMD[6] "Conversion method for TLF35584RqstdCmd[6]" RAT_FUNC "%10.0" "(not defined)" COEFFS 0.000000 1.000000 -0.000000 0.000000 0.000000 1.000000 /end COMPU_METHOD
/* Scalar measurable for DDE 'TLF35584RqstdCmd[7]'. */
/begin MEASUREMENT TLF35584RqstdCmd[7] "(not defined)" UBYTE CU_TLF35584RQSTDCMD[7] 1 100 0.0 255.0 ECU_ADDRESS 0x70019fc6 BYTE_ORDER MSB_LAST /end MEASUREMENT
/begin COMPU_METHOD CU_TLF35584RQSTDCMD[7] "Conversion method for TLF35584RqstdCmd[7]" RAT_FUNC "%10.0" "(not defined)" COEFFS 0.000000 1.000000 -0.000000 0.000000 0.000000 1.000000 /end COMPU_METHOD
/* Scalar measurable for DDE 'TLF35584RqstdCmd[8]'. */
/begin MEASUREMENT TLF35584RqstdCmd[8] "(not defined)" UBYTE CU_TLF35584RQSTDCMD[8] 1 100 0.0 255.0 ECU_ADDRESS 0x70019fc7 BYTE_ORDER MSB_LAST /end MEASUREMENT
/begin COMPU_METHOD CU_TLF35584RQSTDCMD[8] "Conversion method for TLF35584RqstdCmd[8]" RAT_FUNC "%10.0" "(not defined)" COEFFS 0.000000 1.000000 -0.000000 0.000000 0.000000 1.000000 /end COMPU_METHOD
/* Scalar measurable for DDE 'TLF35584RqstdCmd[9]'. */
/begin MEASUREMENT TLF35584RqstdCmd[9] "(not defined)" UBYTE CU_TLF35584RQSTDCMD[9] 1 100 0.0 255.0 ECU_ADDRESS 0x70019fc8 BYTE_ORDER MSB_LAST /end MEASUREMENT
/begin COMPU_METHOD CU_TLF35584RQSTDCMD[9] "Conversion method for TLF35584RqstdCmd[9]" RAT_FUNC "%10.0" "(not defined)" COEFFS 0.000000 1.000000 -0.000000 0.000000 0.000000 1.000000 /end COMPU_METHOD
/* Scalar measurable for DDE 'TLF35584Send'. */
/begin MEASUREMENT TLF35584Send "(not defined)" UBYTE CU_TLF35584SEND 1 100 0.0 255.0 ECU_ADDRESS 0x7001a15e BYTE_ORDER MSB_LAST /end MEASUREMENT
/begin COMPU_METHOD CU_TLF35584SEND "Conversion method for TLF35584Send" RAT_FUNC "%10.0" "(not defined)" COEFFS 0.000000 1.000000 -0.000000 0.000000 0.000000 1.000000 /end COMPU_METHOD
/* Scalar measurable for DDE 'TLF35584Size'. */
/begin MEASUREMENT TLF35584Size "(not defined)" UWORD CU_TLF35584SIZE 1 100 0.0 65535.0 ECU_ADDRESS 0x70019ffa BYTE_ORDER MSB_LAST /end MEASUREMENT
/begin COMPU_METHOD CU_TLF35584SIZE "Conversion method for TLF35584Size" RAT_FUNC "%10.0" "(not defined)" COEFFS 0.000000 1.000000 -0.000000 0.000000 0.000000 1.000000 /end COMPU_METHOD
/* Scalar measurable for DDE 'TLF35584UserData[0]'. */
/begin MEASUREMENT TLF35584UserData[0] "(not defined)" UBYTE CU_TLF35584USERDATA[0] 1 100 0.0 255.0 ECU_ADDRESS 0x7001a187 BYTE_ORDER MSB_LAST /end MEASUREMENT
/begin COMPU_METHOD CU_TLF35584USERDATA[0] "Conversion method for TLF35584UserData[0]" RAT_FUNC "%10.0" "(not defined)" COEFFS 0.000000 1.000000 -0.000000 0.000000 0.000000 1.000000 /end COMPU_METHOD
/* Scalar measurable for DDE 'TLF35584UserData[10]'. */
/begin MEASUREMENT TLF35584UserData[10] "(not defined)" UBYTE CU_TLF35584USERDATA[10] 1 100 0.0 255.0 ECU_ADDRESS 0x7001a191 BYTE_ORDER MSB_LAST /end MEASUREMENT
/begin COMPU_METHOD CU_TLF35584USERDATA[10] "Conversion method for TLF35584UserData[10]" RAT_FUNC "%10.0" "(not defined)" COEFFS 0.000000 1.000000 -0.000000 0.000000 0.000000 1.000000 /end COMPU_METHOD
/* Scalar measurable for DDE 'TLF35584UserData[11]'. */
/begin MEASUREMENT TLF35584UserData[11] "(not defined)" UBYTE CU_TLF35584USERDATA[11] 1 100 0.0 255.0 ECU_ADDRESS 0x7001a192 BYTE_ORDER MSB_LAST /end MEASUREMENT
/begin COMPU_METHOD CU_TLF35584USERDATA[11] "Conversion method for TLF35584UserData[11]" RAT_FUNC "%10.0" "(not defined)" COEFFS 0.000000 1.000000 -0.000000 0.000000 0.000000 1.000000 /end COMPU_METHOD
/* Scalar measurable for DDE 'TLF35584UserData[12]'. */
/begin MEASUREMENT TLF35584UserData[12] "(not defined)" UBYTE CU_TLF35584USERDATA[12] 1 100 0.0 255.0 ECU_ADDRESS 0x7001a193 BYTE_ORDER MSB_LAST /end MEASUREMENT
/begin COMPU_METHOD CU_TLF35584USERDATA[12] "Conversion method for TLF35584UserData[12]" RAT_FUNC "%10.0" "(not defined)" COEFFS 0.000000 1.000000 -0.000000 0.000000 0.000000 1.000000 /end COMPU_METHOD
/* Scalar measurable for DDE 'TLF35584UserData[13]'. */
/begin MEASUREMENT TLF35584UserData[13] "(not defined)" UBYTE CU_TLF35584USERDATA[13] 1 100 0.0 255.0 ECU_ADDRESS 0x7001a194 BYTE_ORDER MSB_LAST /end MEASUREMENT
/begin COMPU_METHOD CU_TLF35584USERDATA[13] "Conversion method for TLF35584UserData[13]" RAT_FUNC "%10.0" "(not defined)" COEFFS 0.000000 1.000000 -0.000000 0.000000 0.000000 1.000000 /end COMPU_METHOD
/* Scalar measurable for DDE 'TLF35584UserData[14]'. */
/begin MEASUREMENT TLF35584UserData[14] "(not defined)" UBYTE CU_TLF35584USERDATA[14] 1 100 0.0 255.0 ECU_ADDRESS 0x7001a195 BYTE_ORDER MSB_LAST /end MEASUREMENT
/begin COMPU_METHOD CU_TLF35584USERDATA[14] "Conversion method for TLF35584UserData[14]" RAT_FUNC "%10.0" "(not defined)" COEFFS 0.000000 1.000000 -0.000000 0.000000 0.000000 1.000000 /end COMPU_METHOD
/* Scalar measurable for DDE 'TLF35584UserData[15]'. */
/begin MEASUREMENT TLF35584UserData[15] "(not defined)" UBYTE CU_TLF35584USERDATA[15] 1 100 0.0 255.0 ECU_ADDRESS 0x7001a196 BYTE_ORDER MSB_LAST /end MEASUREMENT
/begin COMPU_METHOD CU_TLF35584USERDATA[15] "Conversion method for TLF35584UserData[15]" RAT_FUNC "%10.0" "(not defined)" COEFFS 0.000000 1.000000 -0.000000 0.000000 0.000000 1.000000 /end COMPU_METHOD
/* Scalar measurable for DDE 'TLF35584UserData[16]'. */
/begin MEASUREMENT TLF35584UserData[16] "(not defined)" UBYTE CU_TLF35584USERDATA[16] 1 100 0.0 255.0 ECU_ADDRESS 0x7001a197 BYTE_ORDER MSB_LAST /end MEASUREMENT
/begin COMPU_METHOD CU_TLF35584USERDATA[16] "Conversion method for TLF35584UserData[16]" RAT_FUNC "%10.0" "(not defined)" COEFFS 0.000000 1.000000 -0.000000 0.000000 0.000000 1.000000 /end COMPU_METHOD
/* Scalar measurable for DDE 'TLF35584UserData[17]'. */
/begin MEASUREMENT TLF35584UserData[17] "(not defined)" UBYTE CU_TLF35584USERDATA[17] 1 100 0.0 255.0 ECU_ADDRESS 0x7001a198 BYTE_ORDER MSB_LAST /end MEASUREMENT
/begin COMPU_METHOD CU_TLF35584USERDATA[17] "Conversion method for TLF35584UserData[17]" RAT_FUNC "%10.0" "(not defined)" COEFFS 0.000000 1.000000 -0.000000 0.000000 0.000000 1.000000 /end COMPU_METHOD
/* Scalar measurable for DDE 'TLF35584UserData[18]'. */
/begin MEASUREMENT TLF35584UserData[18] "(not defined)" UBYTE CU_TLF35584USERDATA[18] 1 100 0.0 255.0 ECU_ADDRESS 0x7001a199 BYTE_ORDER MSB_LAST /end MEASUREMENT
/begin COMPU_METHOD CU_TLF35584USERDATA[18] "Conversion method for TLF35584UserData[18]" RAT_FUNC "%10.0" "(not defined)" COEFFS 0.000000 1.000000 -0.000000 0.000000 0.000000 1.000000 /end COMPU_METHOD
/* Scalar measurable for DDE 'TLF35584UserData[19]'. */
/begin MEASUREMENT TLF35584UserData[19] "(not defined)" UBYTE CU_TLF35584USERDATA[19] 1 100 0.0 255.0 ECU_ADDRESS 0x7001a19a BYTE_ORDER MSB_LAST /end MEASUREMENT
/begin COMPU_METHOD CU_TLF35584USERDATA[19] "Conversion method for TLF35584UserData[19]" RAT_FUNC "%10.0" "(not defined)" COEFFS 0.000000 1.000000 -0.000000 0.000000 0.000000 1.000000 /end COMPU_METHOD
/* Scalar measurable for DDE 'TLF35584UserData[1]'. */
/begin MEASUREMENT TLF35584UserData[1] "(not defined)" UBYTE CU_TLF35584USERDATA[1] 1 100 0.0 255.0 ECU_ADDRESS 0x7001a188 BYTE_ORDER MSB_LAST /end MEASUREMENT
/begin COMPU_METHOD CU_TLF35584USERDATA[1] "Conversion method for TLF35584UserData[1]" RAT_FUNC "%10.0" "(not defined)" COEFFS 0.000000 1.000000 -0.000000 0.000000 0.000000 1.000000 /end COMPU_METHOD
/* Scalar measurable for DDE 'TLF35584UserData[20]'. */
/begin MEASUREMENT TLF35584UserData[20] "(not defined)" UBYTE CU_TLF35584USERDATA[20] 1 100 0.0 255.0 ECU_ADDRESS 0x7001a19b BYTE_ORDER MSB_LAST /end MEASUREMENT
/begin COMPU_METHOD CU_TLF35584USERDATA[20] "Conversion method for TLF35584UserData[20]" RAT_FUNC "%10.0" "(not defined)" COEFFS 0.000000 1.000000 -0.000000 0.000000 0.000000 1.000000 /end COMPU_METHOD
/* Scalar measurable for DDE 'TLF35584UserData[21]'. */
/begin MEASUREMENT TLF35584UserData[21] "(not defined)" UBYTE CU_TLF35584USERDATA[21] 1 100 0.0 255.0 ECU_ADDRESS 0x7001a19c BYTE_ORDER MSB_LAST /end MEASUREMENT
/begin COMPU_METHOD CU_TLF35584USERDATA[21] "Conversion method for TLF35584UserData[21]" RAT_FUNC "%10.0" "(not defined)" COEFFS 0.000000 1.000000 -0.000000 0.000000 0.000000 1.000000 /end COMPU_METHOD
/* Scalar measurable for DDE 'TLF35584UserData[22]'. */
/begin MEASUREMENT TLF35584UserData[22] "(not defined)" UBYTE CU_TLF35584USERDATA[22] 1 100 0.0 255.0 ECU_ADDRESS 0x7001a19d BYTE_ORDER MSB_LAST /end MEASUREMENT
/begin COMPU_METHOD CU_TLF35584USERDATA[22] "Conversion method for TLF35584UserData[22]" RAT_FUNC "%10.0" "(not defined)" COEFFS 0.000000 1.000000 -0.000000 0.000000 0.000000 1.000000 /end COMPU_METHOD
/* Scalar measurable for DDE 'TLF35584UserData[23]'. */
/begin MEASUREMENT TLF35584UserData[23] "(not defined)" UBYTE CU_TLF35584USERDATA[23] 1 100 0.0 255.0 ECU_ADDRESS 0x7001a19e BYTE_ORDER MSB_LAST /end MEASUREMENT
/begin COMPU_METHOD CU_TLF35584USERDATA[23] "Conversion method for TLF35584UserData[23]" RAT_FUNC "%10.0" "(not defined)" COEFFS 0.000000 1.000000 -0.000000 0.000000 0.000000 1.000000 /end COMPU_METHOD
/* Scalar measurable for DDE 'TLF35584UserData[24]'. */
/begin MEASUREMENT TLF35584UserData[24] "(not defined)" UBYTE CU_TLF35584USERDATA[24] 1 100 0.0 255.0 ECU_ADDRESS 0x7001a19f BYTE_ORDER MSB_LAST /end MEASUREMENT
/begin COMPU_METHOD CU_TLF35584USERDATA[24] "Conversion method for TLF35584UserData[24]" RAT_FUNC "%10.0" "(not defined)" COEFFS 0.000000 1.000000 -0.000000 0.000000 0.000000 1.000000 /end COMPU_METHOD
/* Scalar measurable for DDE 'TLF35584UserData[2]'. */
/begin MEASUREMENT TLF35584UserData[2] "(not defined)" UBYTE CU_TLF35584USERDATA[2] 1 100 0.0 255.0 ECU_ADDRESS 0x7001a189 BYTE_ORDER MSB_LAST /end MEASUREMENT
/begin COMPU_METHOD CU_TLF35584USERDATA[2] "Conversion method for TLF35584UserData[2]" RAT_FUNC "%10.0" "(not defined)" COEFFS 0.000000 1.000000 -0.000000 0.000000 0.000000 1.000000 /end COMPU_METHOD
/* Scalar measurable for DDE 'TLF35584UserData[3]'. */
/begin MEASUREMENT TLF35584UserData[3] "(not defined)" UBYTE CU_TLF35584USERDATA[3] 1 100 0.0 255.0 ECU_ADDRESS 0x7001a18a BYTE_ORDER MSB_LAST /end MEASUREMENT
/begin COMPU_METHOD CU_TLF35584USERDATA[3] "Conversion method for TLF35584UserData[3]" RAT_FUNC "%10.0" "(not defined)" COEFFS 0.000000 1.000000 -0.000000 0.000000 0.000000 1.000000 /end COMPU_METHOD
/* Scalar measurable for DDE 'TLF35584UserData[4]'. */
/begin MEASUREMENT TLF35584UserData[4] "(not defined)" UBYTE CU_TLF35584USERDATA[4] 1 100 0.0 255.0 ECU_ADDRESS 0x7001a18b BYTE_ORDER MSB_LAST /end MEASUREMENT
/begin COMPU_METHOD CU_TLF35584USERDATA[4] "Conversion method for TLF35584UserData[4]" RAT_FUNC "%10.0" "(not defined)" COEFFS 0.000000 1.000000 -0.000000 0.000000 0.000000 1.000000 /end COMPU_METHOD
/* Scalar measurable for DDE 'TLF35584UserData[5]'. */
/begin MEASUREMENT TLF35584UserData[5] "(not defined)" UBYTE CU_TLF35584USERDATA[5] 1 100 0.0 255.0 ECU_ADDRESS 0x7001a18c BYTE_ORDER MSB_LAST /end MEASUREMENT
/begin COMPU_METHOD CU_TLF35584USERDATA[5] "Conversion method for TLF35584UserData[5]" RAT_FUNC "%10.0" "(not defined)" COEFFS 0.000000 1.000000 -0.000000 0.000000 0.000000 1.000000 /end COMPU_METHOD
/* Scalar measurable for DDE 'TLF35584UserData[6]'. */
/begin MEASUREMENT TLF35584UserData[6] "(not defined)" UBYTE CU_TLF35584USERDATA[6] 1 100 0.0 255.0 ECU_ADDRESS 0x7001a18d BYTE_ORDER MSB_LAST /end MEASUREMENT
/begin COMPU_METHOD CU_TLF35584USERDATA[6] "Conversion method for TLF35584UserData[6]" RAT_FUNC "%10.0" "(not defined)" COEFFS 0.000000 1.000000 -0.000000 0.000000 0.000000 1.000000 /end COMPU_METHOD
/* Scalar measurable for DDE 'TLF35584UserData[7]'. */
/begin MEASUREMENT TLF35584UserData[7] "(not defined)" UBYTE CU_TLF35584USERDATA[7] 1 100 0.0 255.0 ECU_ADDRESS 0x7001a18e BYTE_ORDER MSB_LAST /end MEASUREMENT
/begin COMPU_METHOD CU_TLF35584USERDATA[7] "Conversion method for TLF35584UserData[7]" RAT_FUNC "%10.0" "(not defined)" COEFFS 0.000000 1.000000 -0.000000 0.000000 0.000000 1.000000 /end COMPU_METHOD
/* Scalar measurable for DDE 'TLF35584UserData[8]'. */
/begin MEASUREMENT TLF35584UserData[8] "(not defined)" UBYTE CU_TLF35584USERDATA[8] 1 100 0.0 255.0 ECU_ADDRESS 0x7001a18f BYTE_ORDER MSB_LAST /end MEASUREMENT
/begin COMPU_METHOD CU_TLF35584USERDATA[8] "Conversion method for TLF35584UserData[8]" RAT_FUNC "%10.0" "(not defined)" COEFFS 0.000000 1.000000 -0.000000 0.000000 0.000000 1.000000 /end COMPU_METHOD
/* Scalar measurable for DDE 'TLF35584UserData[9]'. */
/begin MEASUREMENT TLF35584UserData[9] "(not defined)" UBYTE CU_TLF35584USERDATA[9] 1 100 0.0 255.0 ECU_ADDRESS 0x7001a190 BYTE_ORDER MSB_LAST /end MEASUREMENT
/begin COMPU_METHOD CU_TLF35584USERDATA[9] "Conversion method for TLF35584UserData[9]" RAT_FUNC "%10.0" "(not defined)" COEFFS 0.000000 1.000000 -0.000000 0.000000 0.000000 1.000000 /end COMPU_METHOD
/* Scalar measurable for DDE 'TempIntDegC_MaxFlt'. */
/begin MEASUREMENT TempIntDegC_MaxFlt "Temp Internal DegC above max threshold latched after debounce" UBYTE CU_TEMPINTDEGC_MAXFLT 1 100 0.0 1.0 ECU_ADDRESS 0x7001a01a BYTE_ORDER MSB_LAST /end MEASUREMENT
/begin COMPU_METHOD CU_TEMPINTDEGC_MAXFLT "Conversion method for TempIntDegC_MaxFlt" RAT_FUNC "%10.0" "(not defined)" COEFFS 0.000000 1.000000 -0.000000 0.000000 0.000000 1.000000 /end COMPU_METHOD
/* Scalar measurable for DDE 'TempIntDegC_MaxFltActv'. */
/begin MEASUREMENT TempIntDegC_MaxFltActv "Active fault high TempInt DegC (Max fault no latch or debounce)" UBYTE CU_TEMPINTDEGC_MAXFLTACTV 1 100 0.0 1.0 ECU_ADDRESS 0x70019eb0 BYTE_ORDER MSB_LAST /end MEASUREMENT
/begin COMPU_METHOD CU_TEMPINTDEGC_MAXFLTACTV "Conversion method for TempIntDegC_MaxFltActv" RAT_FUNC "%10.0" "(not defined)" COEFFS 0.000000 1.000000 -0.000000 0.000000 0.000000 1.000000 /end COMPU_METHOD
/* Scalar measurable for DDE 'TempIntDegC_MinFlt'. */
/begin MEASUREMENT TempIntDegC_MinFlt "Temp Internal DegC below min threshold latched after debounce" UBYTE CU_TEMPINTDEGC_MINFLT 1 100 0.0 1.0 ECU_ADDRESS 0x7001a03d BYTE_ORDER MSB_LAST /end MEASUREMENT
/begin COMPU_METHOD CU_TEMPINTDEGC_MINFLT "Conversion method for TempIntDegC_MinFlt" RAT_FUNC "%10.0" "(not defined)" COEFFS 0.000000 1.000000 -0.000000 0.000000 0.000000 1.000000 /end COMPU_METHOD
/* Scalar measurable for DDE 'TempIntDegC_MinFltActv'. */
/begin MEASUREMENT TempIntDegC_MinFltActv "Active fault low TempInt DegC (Min fault no latch or debounce)" UBYTE CU_TEMPINTDEGC_MINFLTACTV 1 100 0.0 1.0 ECU_ADDRESS 0x70019f3a BYTE_ORDER MSB_LAST /end MEASUREMENT
/begin COMPU_METHOD CU_TEMPINTDEGC_MINFLTACTV "Conversion method for TempIntDegC_MinFltActv" RAT_FUNC "%10.0" "(not defined)" COEFFS 0.000000 1.000000 -0.000000 0.000000 0.000000 1.000000 /end COMPU_METHOD
/* Scalar measurable for DDE 'TempInt_MaxFlt'. */
/begin MEASUREMENT TempInt_MaxFlt "Internal Temp above max threshold latched after debounce" UBYTE CU_TEMPINT_MAXFLT 1 100 0.0 1.0 ECU_ADDRESS 0x7001a0d1 BYTE_ORDER MSB_LAST /end MEASUREMENT
/begin COMPU_METHOD CU_TEMPINT_MAXFLT "Conversion method for TempInt_MaxFlt" RAT_FUNC "%10.0" "(not defined)" COEFFS 0.000000 1.000000 -0.000000 0.000000 0.000000 1.000000 /end COMPU_METHOD
/* Scalar measurable for DDE 'TempInt_MaxFltActv'. */
/begin MEASUREMENT TempInt_MaxFltActv "Active fault high (Max fault no latch or debounce)" UBYTE CU_TEMPINT_MAXFLTACTV 1 100 0.0 1.0 ECU_ADDRESS 0x70019f55 BYTE_ORDER MSB_LAST /end MEASUREMENT
/begin COMPU_METHOD CU_TEMPINT_MAXFLTACTV "Conversion method for TempInt_MaxFltActv" RAT_FUNC "%10.0" "(not defined)" COEFFS 0.000000 1.000000 -0.000000 0.000000 0.000000 1.000000 /end COMPU_METHOD
/* Scalar measurable for DDE 'TempInt_MinFlt'. */
/begin MEASUREMENT TempInt_MinFlt "Internal Temp below min threshold latched after debounce" UBYTE CU_TEMPINT_MINFLT 1 100 0.0 1.0 ECU_ADDRESS 0x7001a0e9 BYTE_ORDER MSB_LAST /end MEASUREMENT
/begin COMPU_METHOD CU_TEMPINT_MINFLT "Conversion method for TempInt_MinFlt" RAT_FUNC "%10.0" "(not defined)" COEFFS 0.000000 1.000000 -0.000000 0.000000 0.000000 1.000000 /end COMPU_METHOD
/* Scalar measurable for DDE 'TempInt_MinFltActv'. */
/begin MEASUREMENT TempInt_MinFltActv "Active fault low (Min fault no latch or debounce)" UBYTE CU_TEMPINT_MINFLTACTV 1 100 0.0 1.0 ECU_ADDRESS 0x70019f7d BYTE_ORDER MSB_LAST /end MEASUREMENT
/begin COMPU_METHOD CU_TEMPINT_MINFLTACTV "Conversion method for TempInt_MinFltActv" RAT_FUNC "%10.0" "(not defined)" COEFFS 0.000000 1.000000 -0.000000 0.000000 0.000000 1.000000 /end COMPU_METHOD
/* Scalar measurable for DDE 'V2gRxMsgAuthEvseProcessing'. */
/begin MEASUREMENT V2gRxMsgAuthEvseProcessing "Message YB: Parameter indicating that the EVSE has finished the processing that was initiated after the ContractAuthenticationReq or that the EVSE is still processing at the time the response message was sent." SLONG CU_V2GRXMSGAUTHEVSEPROCESSING 1 100 -2147483648.0 2147483647.0 ECU_ADDRESS 0x70017edc BYTE_ORDER MSB_LAST /end MEASUREMENT
/begin COMPU_METHOD CU_V2GRXMSGAUTHEVSEPROCESSING "Conversion method for V2gRxMsgAuthEvseProcessing" TAB_VERB "%12.0" "enum" COMPU_TAB_REF CT_V2GRXMSGAUTHEVSEPROCESSING /end COMPU_METHOD
/begin COMPU_VTAB CT_V2GRXMSGAUTHEVSEPROCESSING "Conversion method for V2gRxMsgAuthEvseProcessing" TAB_VERB 3 0 "FINISHED" 1 "ONGOING" 2 "ONGOING_WAITINGFORCUSTOMERINTERACTION" /end COMPU_VTAB
/* Scalar measurable for DDE 'V2gRxMsgAuthNotif'. */
/begin MEASUREMENT V2gRxMsgAuthNotif "The arbitrated Notification Max Delay parameter in the received message from EVSE" SLONG CU_V2GRXMSGAUTHNOTIF 1 100 -2147483648.0 2147483647.0 ECU_ADDRESS 0x70018250 BYTE_ORDER MSB_LAST /end MEASUREMENT
/begin COMPU_METHOD CU_V2GRXMSGAUTHNOTIF "Conversion method for V2gRxMsgAuthNotif" TAB_VERB "%12.0" "1" COMPU_TAB_REF CT_V2GRXMSGAUTHNOTIF /end COMPU_METHOD
/begin COMPU_VTAB CT_V2GRXMSGAUTHNOTIF "Conversion method for V2gRxMsgAuthNotif" TAB_VERB 3 0 "NONE" 1 "STOPCHARGING" 2 "RENEGOTIATION" /end COMPU_VTAB
/* Scalar measurable for DDE 'V2gRxMsgAuthNotifFlg'. */
/begin MEASUREMENT V2gRxMsgAuthNotifFlg "The arbitrated Notification parameter in the received message from EVSE" UBYTE CU_V2GRXMSGAUTHNOTIFFLG 1 100 0.0 1.0 ECU_ADDRESS 0x70017fec BYTE_ORDER MSB_LAST /end MEASUREMENT
/begin COMPU_METHOD CU_V2GRXMSGAUTHNOTIFFLG "Conversion method for V2gRxMsgAuthNotifFlg" RAT_FUNC "%10.0" "b" COEFFS 0.000000 1.000000 -0.000000 0.000000 0.000000 1.000000 /end COMPU_METHOD
/* Scalar measurable for DDE 'V2gRxMsgAuthNotifMaxDelay'. */
/begin MEASUREMENT V2gRxMsgAuthNotifMaxDelay "The arbitrated Notification Max Delay parameter in the received message from EVSE" UWORD CU_V2GRXMSGAUTHNOTIFMAXDELAY 1 100 0.0 65535.0 ECU_ADDRESS 0x70017e60 BYTE_ORDER MSB_LAST /end MEASUREMENT
/begin COMPU_METHOD CU_V2GRXMSGAUTHNOTIFMAXDELAY "Conversion method for V2gRxMsgAuthNotifMaxDelay" RAT_FUNC "%10.0" "s" COEFFS 0.000000 1.000000 -0.000000 0.000000 0.000000 1.000000 /end COMPU_METHOD
/* Scalar measurable for DDE 'V2gRxMsgAuthRescode'. */
/begin MEASUREMENT V2gRxMsgAuthRescode "for message Yb: indicates the acknowledgment status of  this V2G messages received by the SECC." UBYTE CU_V2GRXMSGAUTHRESCODE 1 100 0.0 255.0 ECU_ADDRESS 0x70017c8b BYTE_ORDER MSB_LAST /end MEASUREMENT
/begin COMPU_METHOD CU_V2GRXMSGAUTHRESCODE "Conversion method for V2gRxMsgAuthRescode" RAT_FUNC "%10.0" "1" COEFFS 0.000000 1.000000 -0.000000 0.000000 0.000000 1.000000 /end COMPU_METHOD
/* Scalar measurable for DDE 'V2gRxMsgAuthTrg'. */
/begin MEASUREMENT V2gRxMsgAuthTrg "Trigger falg that on a rising edge indicates the event for receiving the PLC (V2G) message response Yb from EVSE" UBYTE CU_V2GRXMSGAUTHTRG 1 100 0.0 1.0 ECU_ADDRESS 0x70017e92 BYTE_ORDER MSB_LAST /end MEASUREMENT
/begin COMPU_METHOD CU_V2GRXMSGAUTHTRG "Conversion method for V2gRxMsgAuthTrg" RAT_FUNC "%10.0" "b" COEFFS 0.000000 1.000000 -0.000000 0.000000 0.000000 1.000000 /end COMPU_METHOD
/* Scalar measurable for DDE 'V2gRxMsgPmtSelNotif'. */
/begin MEASUREMENT V2gRxMsgPmtSelNotif "The arbitrated Notification Max Delay parameter in the received message from EVSE" SLONG CU_V2GRXMSGPMTSELNOTIF 1 100 -2147483648.0 2147483647.0 ECU_ADDRESS 0x70017d98 BYTE_ORDER MSB_LAST /end MEASUREMENT
/begin COMPU_METHOD CU_V2GRXMSGPMTSELNOTIF "Conversion method for V2gRxMsgPmtSelNotif" TAB_VERB "%12.0" "1" COMPU_TAB_REF CT_V2GRXMSGPMTSELNOTIF /end COMPU_METHOD
/begin COMPU_VTAB CT_V2GRXMSGPMTSELNOTIF "Conversion method for V2gRxMsgPmtSelNotif" TAB_VERB 3 0 "NONE" 1 "STOPCHARGING" 2 "RENEGOTIATION" /end COMPU_VTAB
/* Scalar measurable for DDE 'V2gRxMsgPmtSelNotifFlg'. */
/begin MEASUREMENT V2gRxMsgPmtSelNotifFlg "The arbitrated Notification parameter in the received message from EVSE" UBYTE CU_V2GRXMSGPMTSELNOTIFFLG 1 100 0.0 1.0 ECU_ADDRESS 0x70017c84 BYTE_ORDER MSB_LAST /end MEASUREMENT
/begin COMPU_METHOD CU_V2GRXMSGPMTSELNOTIFFLG "Conversion method for V2gRxMsgPmtSelNotifFlg" RAT_FUNC "%10.0" "b" COEFFS 0.000000 1.000000 -0.000000 0.000000 0.000000 1.000000 /end COMPU_METHOD
/* Scalar measurable for DDE 'V2gRxMsgPmtSelNotifMaxDelay'. */
/begin MEASUREMENT V2gRxMsgPmtSelNotifMaxDelay "The arbitrated Notification Max Delay parameter in the received message from EVSE" UWORD CU_V2GRXMSGPMTSELNOTIFMAXDELAY 1 100 0.0 65535.0 ECU_ADDRESS 0x70017e90 BYTE_ORDER MSB_LAST /end MEASUREMENT
/begin COMPU_METHOD CU_V2GRXMSGPMTSELNOTIFMAXDELAY "Conversion method for V2gRxMsgPmtSelNotifMaxDelay" RAT_FUNC "%10.0" "s" COEFFS 0.000000 1.000000 -0.000000 0.000000 0.000000 1.000000 /end COMPU_METHOD
/* Scalar measurable for DDE 'V2gRxMsgPmtSelRescode'. */
/begin MEASUREMENT V2gRxMsgPmtSelRescode "for message Xb: indicates the acknowledgment status of  this V2G messages received by the SECC." UBYTE CU_V2GRXMSGPMTSELRESCODE 1 100 0.0 255.0 ECU_ADDRESS 0x70017dae BYTE_ORDER MSB_LAST /end MEASUREMENT
/begin COMPU_METHOD CU_V2GRXMSGPMTSELRESCODE "Conversion method for V2gRxMsgPmtSelRescode" RAT_FUNC "%10.0" "1" COEFFS 0.000000 1.000000 -0.000000 0.000000 0.000000 1.000000 /end COMPU_METHOD
/* Scalar measurable for DDE 'V2gRxMsgPmtSelTrg'. */
/begin MEASUREMENT V2gRxMsgPmtSelTrg "Trigger falg that on a rising edge indicates the event for receiving the PLC (V2G) message response Xb from EVSE" UBYTE CU_V2GRXMSGPMTSELTRG 1 100 0.0 1.0 ECU_ADDRESS 0x70017f82 BYTE_ORDER MSB_LAST /end MEASUREMENT
/begin COMPU_METHOD CU_V2GRXMSGPMTSELTRG "Conversion method for V2gRxMsgPmtSelTrg" RAT_FUNC "%10.0" "b" COEFFS 0.000000 1.000000 -0.000000 0.000000 0.000000 1.000000 /end COMPU_METHOD
/* Scalar measurable for DDE 'V2gRxMsgSvcDetailNotif'. */
/begin MEASUREMENT V2gRxMsgSvcDetailNotif "The arbitrated Notification parameter in the received message from EVSE" SLONG CU_V2GRXMSGSVCDETAILNOTIF 1 100 -2147483648.0 2147483647.0 ECU_ADDRESS 0x70017c3c BYTE_ORDER MSB_LAST /end MEASUREMENT
/begin COMPU_METHOD CU_V2GRXMSGSVCDETAILNOTIF "Conversion method for V2gRxMsgSvcDetailNotif" TAB_VERB "%12.0" "1" COMPU_TAB_REF CT_V2GRXMSGSVCDETAILNOTIF /end COMPU_METHOD
/begin COMPU_VTAB CT_V2GRXMSGSVCDETAILNOTIF "Conversion method for V2gRxMsgSvcDetailNotif" TAB_VERB 3 0 "NONE" 1 "STOPCHARGING" 2 "RENEGOTIATION" /end COMPU_VTAB
/* Scalar measurable for DDE 'V2gRxMsgSvcDetailNotifFlg'. */
/begin MEASUREMENT V2gRxMsgSvcDetailNotifFlg "The arbitrated Notification parameter in the received message from EVSE" UBYTE CU_V2GRXMSGSVCDETAILNOTIFFLG 1 100 0.0 1.0 ECU_ADDRESS 0x70018348 BYTE_ORDER MSB_LAST /end MEASUREMENT
/begin COMPU_METHOD CU_V2GRXMSGSVCDETAILNOTIFFLG "Conversion method for V2gRxMsgSvcDetailNotifFlg" RAT_FUNC "%10.0" "b" COEFFS 0.000000 1.000000 -0.000000 0.000000 0.000000 1.000000 /end COMPU_METHOD
/* Scalar measurable for DDE 'V2gRxMsgSvcDetailNotifMaxDelay'. */
/begin MEASUREMENT V2gRxMsgSvcDetailNotifMaxDelay "The arbitrated Notification Max Delay parameter in the received message from EVSE" UWORD CU_V2GRXMSGSVCDETAILNOTIFMAXDE0 1 100 0.0 65535.0 ECU_ADDRESS 0x70017d70 BYTE_ORDER MSB_LAST /end MEASUREMENT
/begin COMPU_METHOD CU_V2GRXMSGSVCDETAILNOTIFMAXDE0 "Conversion method for V2gRxMsgSvcDetailNotifMaxDelay" RAT_FUNC "%10.0" "s" COEFFS 0.000000 1.000000 -0.000000 0.000000 0.000000 1.000000 /end COMPU_METHOD
/* Scalar measurable for DDE 'V2gRxMsgSvcDetailParamSetLen'. */
/begin MEASUREMENT V2gRxMsgSvcDetailParamSetLen "The arbitrated Parameter Set Length signal in the received message from EVSE" UBYTE CU_V2GRXMSGSVCDETAILPARAMSETLEN 1 100 0.0 5.0 ECU_ADDRESS 0x70018458 BYTE_ORDER MSB_LAST /end MEASUREMENT
/begin COMPU_METHOD CU_V2GRXMSGSVCDETAILPARAMSETLEN "Conversion method for V2gRxMsgSvcDetailParamSetLen" RAT_FUNC "%10.0" "1" COEFFS 0.000000 1.000000 -0.000000 0.000000 0.000000 1.000000 /end COMPU_METHOD
/* Scalar measurable for DDE 'V2gRxMsgSvcDetailParamSetSizes[0]'. */
/begin MEASUREMENT V2gRxMsgSvcDetailParamSetSizes4 "The arbitrated Parameter Set Sizes signal in the received message from EVSE" UBYTE CU_V2GRXMSGSVCDETAILPARAMSETSI4 1 100 0.0 5.0 ECU_ADDRESS 0x70017e5b BYTE_ORDER MSB_LAST /end MEASUREMENT
/begin COMPU_METHOD CU_V2GRXMSGSVCDETAILPARAMSETSI4 "Conversion method for V2gRxMsgSvcDetailParamSetSizes[0]" RAT_FUNC "%10.0" "1" COEFFS 0.000000 1.000000 -0.000000 0.000000 0.000000 1.000000 /end COMPU_METHOD
/* Scalar measurable for DDE 'V2gRxMsgSvcDetailParamSetSizes[1]'. */
/begin MEASUREMENT V2gRxMsgSvcDetailParamSetSizes3 "The arbitrated Parameter Set Sizes signal in the received message from EVSE" UBYTE CU_V2GRXMSGSVCDETAILPARAMSETSI3 1 100 0.0 5.0 ECU_ADDRESS 0x70017e5c BYTE_ORDER MSB_LAST /end MEASUREMENT
/begin COMPU_METHOD CU_V2GRXMSGSVCDETAILPARAMSETSI3 "Conversion method for V2gRxMsgSvcDetailParamSetSizes[1]" RAT_FUNC "%10.0" "1" COEFFS 0.000000 1.000000 -0.000000 0.000000 0.000000 1.000000 /end COMPU_METHOD
/* Scalar measurable for DDE 'V2gRxMsgSvcDetailParamSetSizes[2]'. */
/begin MEASUREMENT V2gRxMsgSvcDetailParamSetSizes2 "The arbitrated Parameter Set Sizes signal in the received message from EVSE" UBYTE CU_V2GRXMSGSVCDETAILPARAMSETSI2 1 100 0.0 5.0 ECU_ADDRESS 0x70017e5d BYTE_ORDER MSB_LAST /end MEASUREMENT
/begin COMPU_METHOD CU_V2GRXMSGSVCDETAILPARAMSETSI2 "Conversion method for V2gRxMsgSvcDetailParamSetSizes[2]" RAT_FUNC "%10.0" "1" COEFFS 0.000000 1.000000 -0.000000 0.000000 0.000000 1.000000 /end COMPU_METHOD
/* Scalar measurable for DDE 'V2gRxMsgSvcDetailParamSetSizes[3]'. */
/begin MEASUREMENT V2gRxMsgSvcDetailParamSetSizes0 "The arbitrated Parameter Set Sizes signal in the received message from EVSE" UBYTE CU_V2GRXMSGSVCDETAILPARAMSETSI0 1 100 0.0 5.0 ECU_ADDRESS 0x70017e5e BYTE_ORDER MSB_LAST /end MEASUREMENT
/begin COMPU_METHOD CU_V2GRXMSGSVCDETAILPARAMSETSI0 "Conversion method for V2gRxMsgSvcDetailParamSetSizes[3]" RAT_FUNC "%10.0" "1" COEFFS 0.000000 1.000000 -0.000000 0.000000 0.000000 1.000000 /end COMPU_METHOD
/* Scalar measurable for DDE 'V2gRxMsgSvcDetailParamSetSizes[4]'. */
/begin MEASUREMENT V2gRxMsgSvcDetailParamSetSizes1 "The arbitrated Parameter Set Sizes signal in the received message from EVSE" UBYTE CU_V2GRXMSGSVCDETAILPARAMSETSI1 1 100 0.0 5.0 ECU_ADDRESS 0x70017e5f BYTE_ORDER MSB_LAST /end MEASUREMENT
/begin COMPU_METHOD CU_V2GRXMSGSVCDETAILPARAMSETSI1 "Conversion method for V2gRxMsgSvcDetailParamSetSizes[4]" RAT_FUNC "%10.0" "1" COEFFS 0.000000 1.000000 -0.000000 0.000000 0.000000 1.000000 /end COMPU_METHOD
/* Scalar measurable for DDE 'V2gRxMsgSvcDetailRescode'. */
/begin MEASUREMENT V2gRxMsgSvcDetailRescode "for message 10b: indicates the acknowledgment status of  this V2G messages received by the SECC." UBYTE CU_V2GRXMSGSVCDETAILRESCODE 1 100 0.0 255.0 ECU_ADDRESS 0x70017c69 BYTE_ORDER MSB_LAST /end MEASUREMENT
/begin COMPU_METHOD CU_V2GRXMSGSVCDETAILRESCODE "Conversion method for V2gRxMsgSvcDetailRescode" RAT_FUNC "%10.0" "1" COEFFS 0.000000 1.000000 -0.000000 0.000000 0.000000 1.000000 /end COMPU_METHOD
/* Scalar measurable for DDE 'V2gRxMsgSvcDetailSvcId'. */
/begin MEASUREMENT V2gRxMsgSvcDetailSvcId "The arbitrated Service ID signal in the received message from EVSE" UWORD CU_V2GRXMSGSVCDETAILSVCID 1 100 0.0 65535.0 ECU_ADDRESS 0x70018466 BYTE_ORDER MSB_LAST /end MEASUREMENT
/begin COMPU_METHOD CU_V2GRXMSGSVCDETAILSVCID "Conversion method for V2gRxMsgSvcDetailSvcId" RAT_FUNC "%10.0" "1" COEFFS 0.000000 1.000000 -0.000000 0.000000 0.000000 1.000000 /end COMPU_METHOD
/* Scalar measurable for DDE 'V2gRxMsgSvcDetailTrg'. */
/begin MEASUREMENT V2gRxMsgSvcDetailTrg "Trigger falg that on a rising edge indicates the event for receiving the PLC (V2G) message response 10b from EVSE" UBYTE CU_V2GRXMSGSVCDETAILTRG 1 100 0.0 1.0 ECU_ADDRESS 0x70017e37 BYTE_ORDER MSB_LAST /end MEASUREMENT
/begin COMPU_METHOD CU_V2GRXMSGSVCDETAILTRG "Conversion method for V2gRxMsgSvcDetailTrg" RAT_FUNC "%10.0" "b" COEFFS 0.000000 1.000000 -0.000000 0.000000 0.000000 1.000000 /end COMPU_METHOD
/* Scalar measurable for DDE 'Vbat_MaxFlt'. */
/begin MEASUREMENT Vbat_MaxFlt "Vbat above max threshold latched after debounce (CCU pin L2/L3)" UBYTE CU_VBAT_MAXFLT 1 100 0.0 1.0 ECU_ADDRESS 0x7001a10a BYTE_ORDER MSB_LAST /end MEASUREMENT
/begin COMPU_METHOD CU_VBAT_MAXFLT "Conversion method for Vbat_MaxFlt" RAT_FUNC "%10.0" "(not defined)" COEFFS 0.000000 1.000000 -0.000000 0.000000 0.000000 1.000000 /end COMPU_METHOD
/* Scalar measurable for DDE 'Vbat_MaxFltActv'. */
/begin MEASUREMENT Vbat_MaxFltActv "Active fault high L2/L3 (Max fault no latch or debounce)" UBYTE CU_VBAT_MAXFLTACTV 1 100 0.0 1.0 ECU_ADDRESS 0x70019fa1 BYTE_ORDER MSB_LAST /end MEASUREMENT
/begin COMPU_METHOD CU_VBAT_MAXFLTACTV "Conversion method for Vbat_MaxFltActv" RAT_FUNC "%10.0" "(not defined)" COEFFS 0.000000 1.000000 -0.000000 0.000000 0.000000 1.000000 /end COMPU_METHOD
/* Scalar measurable for DDE 'Vbat_MinFlt'. */
/begin MEASUREMENT Vbat_MinFlt "Vbat below min threshold latched after debounce (CCU pin L2/L3)" UBYTE CU_VBAT_MINFLT 1 100 0.0 1.0 ECU_ADDRESS 0x7001a0db BYTE_ORDER MSB_LAST /end MEASUREMENT
/begin COMPU_METHOD CU_VBAT_MINFLT "Conversion method for Vbat_MinFlt" RAT_FUNC "%10.0" "(not defined)" COEFFS 0.000000 1.000000 -0.000000 0.000000 0.000000 1.000000 /end COMPU_METHOD
/* Scalar measurable for DDE 'Vbat_MinFltActv'. */
/begin MEASUREMENT Vbat_MinFltActv "Active fault low L2/L3 (Min fault no latch or debounce)" UBYTE CU_VBAT_MINFLTACTV 1 100 0.0 1.0 ECU_ADDRESS 0x70019f68 BYTE_ORDER MSB_LAST /end MEASUREMENT
/begin COMPU_METHOD CU_VBAT_MINFLTACTV "Conversion method for Vbat_MinFltActv" RAT_FUNC "%10.0" "(not defined)" COEFFS 0.000000 1.000000 -0.000000 0.000000 0.000000 1.000000 /end COMPU_METHOD
/* Scalar measurable for DDE 'VrefA_MaxFlt'. */
/begin MEASUREMENT VrefA_MaxFlt "VrefA above max threshold latched after debounce" UBYTE CU_VREFA_MAXFLT 1 100 0.0 1.0 ECU_ADDRESS 0x7001a0fe BYTE_ORDER MSB_LAST /end MEASUREMENT
/begin COMPU_METHOD CU_VREFA_MAXFLT "Conversion method for VrefA_MaxFlt" RAT_FUNC "%10.0" "(not defined)" COEFFS 0.000000 1.000000 -0.000000 0.000000 0.000000 1.000000 /end COMPU_METHOD
/* Scalar measurable for DDE 'VrefA_MaxFltActv'. */
/begin MEASUREMENT VrefA_MaxFltActv "Active fault high (Max fault no latch or debounce)" UBYTE CU_VREFA_MAXFLTACTV 1 100 0.0 1.0 ECU_ADDRESS 0x7001a01b BYTE_ORDER MSB_LAST /end MEASUREMENT
/begin COMPU_METHOD CU_VREFA_MAXFLTACTV "Conversion method for VrefA_MaxFltActv" RAT_FUNC "%10.0" "(not defined)" COEFFS 0.000000 1.000000 -0.000000 0.000000 0.000000 1.000000 /end COMPU_METHOD
/* Scalar measurable for DDE 'VrefA_MinFlt'. */
/begin MEASUREMENT VrefA_MinFlt "VrefA below min threshold latched after debounce" UBYTE CU_VREFA_MINFLT 1 100 0.0 1.0 ECU_ADDRESS 0x70019eb1 BYTE_ORDER MSB_LAST /end MEASUREMENT
/begin COMPU_METHOD CU_VREFA_MINFLT "Conversion method for VrefA_MinFlt" RAT_FUNC "%10.0" "(not defined)" COEFFS 0.000000 1.000000 -0.000000 0.000000 0.000000 1.000000 /end COMPU_METHOD
/* Scalar measurable for DDE 'VrefA_MinFltActv'. */
/begin MEASUREMENT VrefA_MinFltActv "Active fault low (Min fault no latch or debounce)" UBYTE CU_VREFA_MINFLTACTV 1 100 0.0 1.0 ECU_ADDRESS 0x7001a03e BYTE_ORDER MSB_LAST /end MEASUREMENT
/begin COMPU_METHOD CU_VREFA_MINFLTACTV "Conversion method for VrefA_MinFltActv" RAT_FUNC "%10.0" "(not defined)" COEFFS 0.000000 1.000000 -0.000000 0.000000 0.000000 1.000000 /end COMPU_METHOD
/* Scalar measurable for DDE 'VrefB_MaxFlt'. */
/begin MEASUREMENT VrefB_MaxFlt "VrefB above max threshold latched after debounce" UBYTE CU_VREFB_MAXFLT 1 100 0.0 1.0 ECU_ADDRESS 0x70019ec6 BYTE_ORDER MSB_LAST /end MEASUREMENT
/begin COMPU_METHOD CU_VREFB_MAXFLT "Conversion method for VrefB_MaxFlt" RAT_FUNC "%10.0" "(not defined)" COEFFS 0.000000 1.000000 -0.000000 0.000000 0.000000 1.000000 /end COMPU_METHOD
/* Scalar measurable for DDE 'VrefB_MaxFltActv'. */
/begin MEASUREMENT VrefB_MaxFltActv "Active fault high (Max fault no latch or debounce)" UBYTE CU_VREFB_MAXFLTACTV 1 100 0.0 1.0 ECU_ADDRESS 0x7001a04f BYTE_ORDER MSB_LAST /end MEASUREMENT
/begin COMPU_METHOD CU_VREFB_MAXFLTACTV "Conversion method for VrefB_MaxFltActv" RAT_FUNC "%10.0" "(not defined)" COEFFS 0.000000 1.000000 -0.000000 0.000000 0.000000 1.000000 /end COMPU_METHOD
/* Scalar measurable for DDE 'VrefB_MinFlt'. */
/begin MEASUREMENT VrefB_MinFlt "VrefB below min threshold latched after debounce" UBYTE CU_VREFB_MINFLT 1 100 0.0 1.0 ECU_ADDRESS 0x70019ede BYTE_ORDER MSB_LAST /end MEASUREMENT
/begin COMPU_METHOD CU_VREFB_MINFLT "Conversion method for VrefB_MinFlt" RAT_FUNC "%10.0" "(not defined)" COEFFS 0.000000 1.000000 -0.000000 0.000000 0.000000 1.000000 /end COMPU_METHOD
/* Scalar measurable for DDE 'VrefB_MinFltActv'. */
/begin MEASUREMENT VrefB_MinFltActv "Active fault low (Min fault no latch or debounce)" UBYTE CU_VREFB_MINFLTACTV 1 100 0.0 1.0 ECU_ADDRESS 0x7001a072 BYTE_ORDER MSB_LAST /end MEASUREMENT
/begin COMPU_METHOD CU_VREFB_MINFLTACTV "Conversion method for VrefB_MinFltActv" RAT_FUNC "%10.0" "(not defined)" COEFFS 0.000000 1.000000 -0.000000 0.000000 0.000000 1.000000 /end COMPU_METHOD
/* Scalar measurable for DDE 'ain_3V3io_ext_filt'. */
/begin MEASUREMENT ain_3V3io_ext_filt "Internal 3V3 IO scaled filtered" FLOAT32_IEEE CU_AIN_3V3IO_EXT_FILT 1 100 0.0 5.0 ECU_ADDRESS 0x70019f00 BYTE_ORDER MSB_LAST /end MEASUREMENT
/begin COMPU_METHOD CU_AIN_3V3IO_EXT_FILT "Conversion method for ain_3V3io_ext_filt" RAT_FUNC "%10.3" "V" COEFFS 0.000000 1.000000 -0.000000 0.000000 0.000000 1.000000 /end COMPU_METHOD
/* Scalar measurable for DDE 'ain_3V3io_ext_unfilt'. */
/begin MEASUREMENT ain_3V3io_ext_unfilt "Internal 3V3 IO scaled unfiltered" FLOAT32_IEEE CU_AIN_3V3IO_EXT_UNFILT 1 100 0.0 5.0 ECU_ADDRESS 0x7001a090 BYTE_ORDER MSB_LAST /end MEASUREMENT
/begin COMPU_METHOD CU_AIN_3V3IO_EXT_UNFILT "Conversion method for ain_3V3io_ext_unfilt" RAT_FUNC "%10.3" "V" COEFFS 0.000000 1.000000 -0.000000 0.000000 0.000000 1.000000 /end COMPU_METHOD
/* Scalar measurable for DDE 'ain_3V3io_int_filt'. */
/begin MEASUREMENT ain_3V3io_int_filt "Internal 3V3 IO filtered" FLOAT32_IEEE CU_AIN_3V3IO_INT_FILT 1 100 0.0 5.0 ECU_ADDRESS 0x70019f20 BYTE_ORDER MSB_LAST /end MEASUREMENT
/begin COMPU_METHOD CU_AIN_3V3IO_INT_FILT "Conversion method for ain_3V3io_int_filt" RAT_FUNC "%10.3" "V" COEFFS 0.000000 1.000000 -0.000000 0.000000 0.000000 1.000000 /end COMPU_METHOD
/* Scalar measurable for DDE 'ain_3V3io_int_unfilt'. */
/begin MEASUREMENT ain_3V3io_int_unfilt "Internal 3V3 IO raw unfiltered" FLOAT32_IEEE CU_AIN_3V3IO_INT_UNFILT 1 100 0.0 5.0 ECU_ADDRESS 0x7001a0b4 BYTE_ORDER MSB_LAST /end MEASUREMENT
/begin COMPU_METHOD CU_AIN_3V3IO_INT_UNFILT "Conversion method for ain_3V3io_int_unfilt" RAT_FUNC "%10.3" "V" COEFFS 0.000000 1.000000 -0.000000 0.000000 0.000000 1.000000 /end COMPU_METHOD
/* Scalar measurable for DDE 'ain_3V3qca_ext_filt'. */
/begin MEASUREMENT ain_3V3qca_ext_filt "Internal 3V3 QCA scaled filtered" FLOAT32_IEEE CU_AIN_3V3QCA_EXT_FILT 1 100 0.0 5.0 ECU_ADDRESS 0x70019fb8 BYTE_ORDER MSB_LAST /end MEASUREMENT
/begin COMPU_METHOD CU_AIN_3V3QCA_EXT_FILT "Conversion method for ain_3V3qca_ext_filt" RAT_FUNC "%10.3" "V" COEFFS 0.000000 1.000000 -0.000000 0.000000 0.000000 1.000000 /end COMPU_METHOD
/* Scalar measurable for DDE 'ain_3V3qca_ext_unfilt'. */
/begin MEASUREMENT ain_3V3qca_ext_unfilt "Internal 3V3 QCA scaled unfiltered" FLOAT32_IEEE CU_AIN_3V3QCA_EXT_UNFILT 1 100 0.0 5.0 ECU_ADDRESS 0x7001a154 BYTE_ORDER MSB_LAST /end MEASUREMENT
/begin COMPU_METHOD CU_AIN_3V3QCA_EXT_UNFILT "Conversion method for ain_3V3qca_ext_unfilt" RAT_FUNC "%10.3" "V" COEFFS 0.000000 1.000000 -0.000000 0.000000 0.000000 1.000000 /end COMPU_METHOD
/* Scalar measurable for DDE 'ain_3V3qca_int_filt'. */
/begin MEASUREMENT ain_3V3qca_int_filt "Internal 3V3 QCA filtered" FLOAT32_IEEE CU_AIN_3V3QCA_INT_FILT 1 100 0.0 5.0 ECU_ADDRESS 0x70019fe8 BYTE_ORDER MSB_LAST /end MEASUREMENT
/begin COMPU_METHOD CU_AIN_3V3QCA_INT_FILT "Conversion method for ain_3V3qca_int_filt" RAT_FUNC "%10.3" "V" COEFFS 0.000000 1.000000 -0.000000 0.000000 0.000000 1.000000 /end COMPU_METHOD
/* Scalar measurable for DDE 'ain_3V3qca_int_unfilt'. */
/begin MEASUREMENT ain_3V3qca_int_unfilt "Internal 3V3 QCA raw unfiltered" FLOAT32_IEEE CU_AIN_3V3QCA_INT_UNFILT 1 100 0.0 5.0 ECU_ADDRESS 0x7001a17c BYTE_ORDER MSB_LAST /end MEASUREMENT
/begin COMPU_METHOD CU_AIN_3V3QCA_INT_UNFILT "Conversion method for ain_3V3qca_int_unfilt" RAT_FUNC "%10.3" "V" COEFFS 0.000000 1.000000 -0.000000 0.000000 0.000000 1.000000 /end COMPU_METHOD
/* Scalar measurable for DDE 'ain_3V3uc_ext_filt'. */
/begin MEASUREMENT ain_3V3uc_ext_filt "Internal 3V3 Micro scaled filtered" FLOAT32_IEEE CU_AIN_3V3UC_EXT_FILT 1 100 0.0 5.0 ECU_ADDRESS 0x7001a00c BYTE_ORDER MSB_LAST /end MEASUREMENT
/begin COMPU_METHOD CU_AIN_3V3UC_EXT_FILT "Conversion method for ain_3V3uc_ext_filt" RAT_FUNC "%10.3" "V" COEFFS 0.000000 1.000000 -0.000000 0.000000 0.000000 1.000000 /end COMPU_METHOD
/* Scalar measurable for DDE 'ain_3V3uc_ext_unfilt'. */
/begin MEASUREMENT ain_3V3uc_ext_unfilt "Internal 3V3 Micro scaled unfiltered" FLOAT32_IEEE CU_AIN_3V3UC_EXT_UNFILT 1 100 0.0 5.0 ECU_ADDRESS 0x70019ea0 BYTE_ORDER MSB_LAST /end MEASUREMENT
/begin COMPU_METHOD CU_AIN_3V3UC_EXT_UNFILT "Conversion method for ain_3V3uc_ext_unfilt" RAT_FUNC "%10.3" "V" COEFFS 0.000000 1.000000 -0.000000 0.000000 0.000000 1.000000 /end COMPU_METHOD
/* Scalar measurable for DDE 'ain_3V3uc_int_filt'. */
/begin MEASUREMENT ain_3V3uc_int_filt "Internal 3V3 Micro filtered" FLOAT32_IEEE CU_AIN_3V3UC_INT_FILT 1 100 0.0 5.0 ECU_ADDRESS 0x7001a030 BYTE_ORDER MSB_LAST /end MEASUREMENT
/begin COMPU_METHOD CU_AIN_3V3UC_INT_FILT "Conversion method for ain_3V3uc_int_filt" RAT_FUNC "%10.3" "V" COEFFS 0.000000 1.000000 -0.000000 0.000000 0.000000 1.000000 /end COMPU_METHOD
/* Scalar measurable for DDE 'ain_3V3uc_int_unfilt'. */
/begin MEASUREMENT ain_3V3uc_int_unfilt "Internal 3V3 Micro raw unfiltered" FLOAT32_IEEE CU_AIN_3V3UC_INT_UNFILT 1 100 0.0 5.0 ECU_ADDRESS 0x7001a160 BYTE_ORDER MSB_LAST /end MEASUREMENT
/begin COMPU_METHOD CU_AIN_3V3UC_INT_UNFILT "Conversion method for ain_3V3uc_int_unfilt" RAT_FUNC "%10.3" "V" COEFFS 0.000000 1.000000 -0.000000 0.000000 0.000000 1.000000 /end COMPU_METHOD
/* Scalar measurable for DDE 'ain_5vdd_ext_filt'. */
/begin MEASUREMENT ain_5vdd_ext_filt "Internal 5VDD scaled filtered" FLOAT32_IEEE CU_AIN_5VDD_EXT_FILT 1 100 0.0 20.0 ECU_ADDRESS 0x70019ffc BYTE_ORDER MSB_LAST /end MEASUREMENT
/begin COMPU_METHOD CU_AIN_5VDD_EXT_FILT "Conversion method for ain_5vdd_ext_filt" RAT_FUNC "%10.3" "V" COEFFS 0.000000 1.000000 -0.000000 0.000000 0.000000 1.000000 /end COMPU_METHOD
/* Scalar measurable for DDE 'ain_5vdd_ext_unfilt'. */
/begin MEASUREMENT ain_5vdd_ext_unfilt "Internal 5VDD scaled unfiltered" FLOAT32_IEEE CU_AIN_5VDD_EXT_UNFILT 1 100 0.0 20.0 ECU_ADDRESS 0x7001a1a0 BYTE_ORDER MSB_LAST /end MEASUREMENT
/begin COMPU_METHOD CU_AIN_5VDD_EXT_UNFILT "Conversion method for ain_5vdd_ext_unfilt" RAT_FUNC "%10.3" "V" COEFFS 0.000000 1.000000 -0.000000 0.000000 0.000000 1.000000 /end COMPU_METHOD
/* Scalar measurable for DDE 'ain_5vdd_int_filt'. */
/begin MEASUREMENT ain_5vdd_int_filt "Internal 5VDD filtered" FLOAT32_IEEE CU_AIN_5VDD_INT_FILT 1 100 0.0 5.0 ECU_ADDRESS 0x7001a094 BYTE_ORDER MSB_LAST /end MEASUREMENT
/begin COMPU_METHOD CU_AIN_5VDD_INT_FILT "Conversion method for ain_5vdd_int_filt" RAT_FUNC "%10.3" "V" COEFFS 0.000000 1.000000 -0.000000 0.000000 0.000000 1.000000 /end COMPU_METHOD
/* Scalar measurable for DDE 'ain_5vdd_int_unfilt'. */
/begin MEASUREMENT ain_5vdd_int_unfilt "Internal 5VDD raw unfiltered" FLOAT32_IEEE CU_AIN_5VDD_INT_UNFILT 1 100 0.0 5.0 ECU_ADDRESS 0x70019f24 BYTE_ORDER MSB_LAST /end MEASUREMENT
/begin COMPU_METHOD CU_AIN_5VDD_INT_UNFILT "Conversion method for ain_5vdd_int_unfilt" RAT_FUNC "%10.3" "V" COEFFS 0.000000 1.000000 -0.000000 0.000000 0.000000 1.000000 /end COMPU_METHOD
/* Scalar measurable for DDE 'ain_A2_vproxim_ext_filt'. */
/begin MEASUREMENT ain_A2_vproxim_ext_filt "Proximity scaled filtered (CCU pin A2)" FLOAT32_IEEE CU_AIN_A2_VPROXIM_EXT_FILT 1 100 0.0 40.0 ECU_ADDRESS 0x7001a0b8 BYTE_ORDER MSB_LAST /end MEASUREMENT
/begin COMPU_METHOD CU_AIN_A2_VPROXIM_EXT_FILT "Conversion method for ain_A2_vproxim_ext_filt" RAT_FUNC "%10.3" "V" COEFFS 0.000000 1.000000 -0.000000 0.000000 0.000000 1.000000 /end COMPU_METHOD
/* Scalar measurable for DDE 'ain_A2_vproxim_ext_unfilt'. */
/begin MEASUREMENT ain_A2_vproxim_ext_unfilt "Proximity scaled unfiltered (CCU pin A2)" FLOAT32_IEEE CU_AIN_A2_VPROXIM_EXT_UNFILT 1 100 0.0 40.0 ECU_ADDRESS 0x70019f3c BYTE_ORDER MSB_LAST /end MEASUREMENT
/begin COMPU_METHOD CU_AIN_A2_VPROXIM_EXT_UNFILT "Conversion method for ain_A2_vproxim_ext_unfilt" RAT_FUNC "%10.3" "V" COEFFS 0.000000 1.000000 -0.000000 0.000000 0.000000 1.000000 /end COMPU_METHOD
/* Scalar measurable for DDE 'ain_A2_vproxim_int_filt'. */
/begin MEASUREMENT ain_A2_vproxim_int_filt "Proximity filtered (CCU pin A2)" FLOAT32_IEEE CU_AIN_A2_VPROXIM_INT_FILT 1 100 0.0 5.0 ECU_ADDRESS 0x7001a0d4 BYTE_ORDER MSB_LAST /end MEASUREMENT
/begin COMPU_METHOD CU_AIN_A2_VPROXIM_INT_FILT "Conversion method for ain_A2_vproxim_int_filt" RAT_FUNC "%10.3" "V" COEFFS 0.000000 1.000000 -0.000000 0.000000 0.000000 1.000000 /end COMPU_METHOD
/* Scalar measurable for DDE 'ain_A2_vproxim_int_unfilt'. */
/begin MEASUREMENT ain_A2_vproxim_int_unfilt "Proximity raw unfiltered (CCU pin A2)" FLOAT32_IEEE CU_AIN_A2_VPROXIM_INT_UNFILT 1 100 0.0 5.0 ECU_ADDRESS 0x70019f58 BYTE_ORDER MSB_LAST /end MEASUREMENT
/begin COMPU_METHOD CU_AIN_A2_VPROXIM_INT_UNFILT "Conversion method for ain_A2_vproxim_int_unfilt" RAT_FUNC "%10.3" "V" COEFFS 0.000000 1.000000 -0.000000 0.000000 0.000000 1.000000 /end COMPU_METHOD
/* Scalar measurable for DDE 'ain_A3_vpilot_ext_filt'. */
/begin MEASUREMENT ain_A3_vpilot_ext_filt "Pilot scaled filtered (CCU pin A3)" FLOAT32_IEEE CU_AIN_A3_VPILOT_EXT_FILT 1 100 -15.0 40.0 ECU_ADDRESS 0x7001a0ec BYTE_ORDER MSB_LAST /end MEASUREMENT
/begin COMPU_METHOD CU_AIN_A3_VPILOT_EXT_FILT "Conversion method for ain_A3_vpilot_ext_filt" RAT_FUNC "%10.3" "V" COEFFS 0.000000 1.000000 -0.000000 0.000000 0.000000 1.000000 /end COMPU_METHOD
/* Scalar measurable for DDE 'ain_A3_vpilot_ext_unfilt'. */
/begin MEASUREMENT ain_A3_vpilot_ext_unfilt "Pilot scaled unfiltered (CCU pin A3)" FLOAT32_IEEE CU_AIN_A3_VPILOT_EXT_UNFILT 1 100 -15.0 40.0 ECU_ADDRESS 0x70019f80 BYTE_ORDER MSB_LAST /end MEASUREMENT
/begin COMPU_METHOD CU_AIN_A3_VPILOT_EXT_UNFILT "Conversion method for ain_A3_vpilot_ext_unfilt" RAT_FUNC "%10.3" "V" COEFFS 0.000000 1.000000 -0.000000 0.000000 0.000000 1.000000 /end COMPU_METHOD
/* Scalar measurable for DDE 'ain_A3_vpilot_int_filt'. */
/begin MEASUREMENT ain_A3_vpilot_int_filt "Pilot filtered (CCU pin A3)" FLOAT32_IEEE CU_AIN_A3_VPILOT_INT_FILT 1 100 0.0 5.0 ECU_ADDRESS 0x7001a10c BYTE_ORDER MSB_LAST /end MEASUREMENT
/begin COMPU_METHOD CU_AIN_A3_VPILOT_INT_FILT "Conversion method for ain_A3_vpilot_int_filt" RAT_FUNC "%10.3" "V" COEFFS 0.000000 1.000000 -0.000000 0.000000 0.000000 1.000000 /end COMPU_METHOD
/* Scalar measurable for DDE 'ain_A3_vpilot_int_unfilt'. */
/begin MEASUREMENT ain_A3_vpilot_int_unfilt "Pilot raw unfiltered (CCU pin A3)" FLOAT32_IEEE CU_AIN_A3_VPILOT_INT_UNFILT 1 100 0.0 5.0 ECU_ADDRESS 0x70019fa4 BYTE_ORDER MSB_LAST /end MEASUREMENT
/begin COMPU_METHOD CU_AIN_A3_VPILOT_INT_UNFILT "Conversion method for ain_A3_vpilot_int_unfilt" RAT_FUNC "%10.3" "V" COEFFS 0.000000 1.000000 -0.000000 0.000000 0.000000 1.000000 /end COMPU_METHOD
/* Scalar measurable for DDE 'ain_A3_vpilpeak_ext_filt'. */
/begin MEASUREMENT ain_A3_vpilpeak_ext_filt "Pilot Peak scaled filtered (CCU pin A3)" FLOAT32_IEEE CU_AIN_A3_VPILPEAK_EXT_FILT 1 100 -15.0 40.0 ECU_ADDRESS 0x7001a144 BYTE_ORDER MSB_LAST /end MEASUREMENT
/begin COMPU_METHOD CU_AIN_A3_VPILPEAK_EXT_FILT "Conversion method for ain_A3_vpilpeak_ext_filt" RAT_FUNC "%10.3" "V" COEFFS 0.000000 1.000000 -0.000000 0.000000 0.000000 1.000000 /end COMPU_METHOD
/* Scalar measurable for DDE 'ain_A3_vpilpeak_ext_unfilt'. */
/begin MEASUREMENT ain_A3_vpilpeak_ext_unfilt "Pilot Peak scaled unfiltered (CCU pin A3)" FLOAT32_IEEE CU_AIN_A3_VPILPEAK_EXT_UNFILT 1 100 -15.0 40.0 ECU_ADDRESS 0x7001a048 BYTE_ORDER MSB_LAST /end MEASUREMENT
/begin COMPU_METHOD CU_AIN_A3_VPILPEAK_EXT_UNFILT "Conversion method for ain_A3_vpilpeak_ext_unfilt" RAT_FUNC "%10.3" "V" COEFFS 0.000000 1.000000 -0.000000 0.000000 0.000000 1.000000 /end COMPU_METHOD
/* Scalar measurable for DDE 'ain_A3_vpilpeak_int_filt'. */
/begin MEASUREMENT ain_A3_vpilpeak_int_filt "Pilot Peak filtered (CCU pin A3)" FLOAT32_IEEE CU_AIN_A3_VPILPEAK_INT_FILT 1 100 0.0 5.0 ECU_ADDRESS 0x70019ed0 BYTE_ORDER MSB_LAST /end MEASUREMENT
/begin COMPU_METHOD CU_AIN_A3_VPILPEAK_INT_FILT "Conversion method for ain_A3_vpilpeak_int_filt" RAT_FUNC "%10.3" "V" COEFFS 0.000000 1.000000 -0.000000 0.000000 0.000000 1.000000 /end COMPU_METHOD
/* Scalar measurable for DDE 'ain_A3_vpilpeak_int_preFilt'. */
/begin MEASUREMENT ain_A3_vpilpeak_int_preFilt "VPILPEAK before low pass filter. Will be raw A3_VPILPEAK value if dotc_Enbl_OverrideVpkClr is set to 1." FLOAT32_IEEE CU_AIN_A3_VPILPEAK_INT_PREFILT 1 100 0.0 5.0 ECU_ADDRESS 0x7001a064 BYTE_ORDER MSB_LAST /end MEASUREMENT
/begin COMPU_METHOD CU_AIN_A3_VPILPEAK_INT_PREFILT "Conversion method for ain_A3_vpilpeak_int_preFilt" RAT_FUNC "%10.3" "V" COEFFS 0.000000 1.000000 -0.000000 0.000000 0.000000 1.000000 /end COMPU_METHOD
/* Scalar measurable for DDE 'ain_A3_vpilpeak_int_unfilt'. */
/begin MEASUREMENT ain_A3_vpilpeak_int_unfilt "Pilot Peak raw unfiltered (CCU pin A3)" FLOAT32_IEEE CU_AIN_A3_VPILPEAK_INT_UNFILT 1 100 0.0 5.0 ECU_ADDRESS 0x70019ef4 BYTE_ORDER MSB_LAST /end MEASUREMENT
/begin COMPU_METHOD CU_AIN_A3_VPILPEAK_INT_UNFILT "Conversion method for ain_A3_vpilpeak_int_unfilt" RAT_FUNC "%10.3" "V" COEFFS 0.000000 1.000000 -0.000000 0.000000 0.000000 1.000000 /end COMPU_METHOD
/* Scalar measurable for DDE 'ain_A3_vpilpeak_int_unfilt_held'. */
/begin MEASUREMENT ain_A3_vpilpeak_int_unfilt_held "Pilot peak raw value held during reset." FLOAT32_IEEE CU_AIN_A3_VPILPEAK_INT_UNFILT_0 1 100 0.0 5.0 ECU_ADDRESS 0x7001a084 BYTE_ORDER MSB_LAST /end MEASUREMENT
/begin COMPU_METHOD CU_AIN_A3_VPILPEAK_INT_UNFILT_0 "Conversion method for ain_A3_vpilpeak_int_unfilt_held" RAT_FUNC "%10.3" "V" COEFFS 0.000000 1.000000 -0.000000 0.000000 0.000000 1.000000 /end COMPU_METHOD
/* Scalar measurable for DDE 'ain_B2_vtempa_filt'. */
/begin MEASUREMENT ain_B2_vtempa_filt "Thermistor sensor A filtered (CCU pin B2)" FLOAT32_IEEE CU_AIN_B2_VTEMPA_FILT 1 100 0.0 5.0 ECU_ADDRESS 0x70019f10 BYTE_ORDER MSB_LAST /end MEASUREMENT
/begin COMPU_METHOD CU_AIN_B2_VTEMPA_FILT "Conversion method for ain_B2_vtempa_filt" RAT_FUNC "%10.3" "V" COEFFS 0.000000 1.000000 -0.000000 0.000000 0.000000 1.000000 /end COMPU_METHOD
/* Scalar measurable for DDE 'ain_B2_vtempa_unfilt'. */
/begin MEASUREMENT ain_B2_vtempa_unfilt "Thermistor sensor A raw unfiltered (CCU pin B2)" FLOAT32_IEEE CU_AIN_B2_VTEMPA_UNFILT 1 100 0.0 5.0 ECU_ADDRESS 0x7001a0a4 BYTE_ORDER MSB_LAST /end MEASUREMENT
/begin COMPU_METHOD CU_AIN_B2_VTEMPA_UNFILT "Conversion method for ain_B2_vtempa_unfilt" RAT_FUNC "%10.3" "V" COEFFS 0.000000 1.000000 -0.000000 0.000000 0.000000 1.000000 /end COMPU_METHOD
/* Scalar measurable for DDE 'ain_B3_vtempb_filt'. */
/begin MEASUREMENT ain_B3_vtempb_filt "Thermistor sensor B filtered (CCU pin B3)" FLOAT32_IEEE CU_AIN_B3_VTEMPB_FILT 1 100 0.0 5.0 ECU_ADDRESS 0x70019ee0 BYTE_ORDER MSB_LAST /end MEASUREMENT
/begin COMPU_METHOD CU_AIN_B3_VTEMPB_FILT "Conversion method for ain_B3_vtempb_filt" RAT_FUNC "%10.3" "V" COEFFS 0.000000 1.000000 -0.000000 0.000000 0.000000 1.000000 /end COMPU_METHOD
/* Scalar measurable for DDE 'ain_B3_vtempb_unfilt'. */
/begin MEASUREMENT ain_B3_vtempb_unfilt "Thermistor sensor B raw unfiltered (CCU pin B3)" FLOAT32_IEEE CU_AIN_B3_VTEMPB_UNFILT 1 100 0.0 5.0 ECU_ADDRESS 0x7001a074 BYTE_ORDER MSB_LAST /end MEASUREMENT
/begin COMPU_METHOD CU_AIN_B3_VTEMPB_UNFILT "Conversion method for ain_B3_vtempb_unfilt" RAT_FUNC "%10.3" "V" COEFFS 0.000000 1.000000 -0.000000 0.000000 0.000000 1.000000 /end COMPU_METHOD
/* Scalar measurable for DDE 'ain_B4_vtempc_filt'. */
/begin MEASUREMENT ain_B4_vtempc_filt "Thermistor sensor C filtered (CCU pin B4)" FLOAT32_IEEE CU_AIN_B4_VTEMPC_FILT 1 100 0.0 5.0 ECU_ADDRESS 0x70019ed8 BYTE_ORDER MSB_LAST /end MEASUREMENT
/begin COMPU_METHOD CU_AIN_B4_VTEMPC_FILT "Conversion method for ain_B4_vtempc_filt" RAT_FUNC "%10.3" "V" COEFFS 0.000000 1.000000 -0.000000 0.000000 0.000000 1.000000 /end COMPU_METHOD
/* Scalar measurable for DDE 'ain_B4_vtempc_unfilt'. */
/begin MEASUREMENT ain_B4_vtempc_unfilt "Thermistor sensor C raw unfiltered (CCU pin B4)" FLOAT32_IEEE CU_AIN_B4_VTEMPC_UNFILT 1 100 0.0 5.0 ECU_ADDRESS 0x7001a038 BYTE_ORDER MSB_LAST /end MEASUREMENT
/begin COMPU_METHOD CU_AIN_B4_VTEMPC_UNFILT "Conversion method for ain_B4_vtempc_unfilt" RAT_FUNC "%10.3" "V" COEFFS 0.000000 1.000000 -0.000000 0.000000 0.000000 1.000000 /end COMPU_METHOD
/* Scalar measurable for DDE 'ain_C2_vtempd_filt'. */
/begin MEASUREMENT ain_C2_vtempd_filt "Thermistor sensor D filtered (CCU pin C2)" FLOAT32_IEEE CU_AIN_C2_VTEMPD_FILT 1 100 0.0 5.0 ECU_ADDRESS 0x7001a028 BYTE_ORDER MSB_LAST /end MEASUREMENT
/begin COMPU_METHOD CU_AIN_C2_VTEMPD_FILT "Conversion method for ain_C2_vtempd_filt" RAT_FUNC "%10.3" "V" COEFFS 0.000000 1.000000 -0.000000 0.000000 0.000000 1.000000 /end COMPU_METHOD
/* Scalar measurable for DDE 'ain_C2_vtempd_unfilt'. */
/begin MEASUREMENT ain_C2_vtempd_unfilt "Thermistor sensor D raw unfiltered (CCU pin C2)" FLOAT32_IEEE CU_AIN_C2_VTEMPD_UNFILT 1 100 0.0 5.0 ECU_ADDRESS 0x70019f74 BYTE_ORDER MSB_LAST /end MEASUREMENT
/begin COMPU_METHOD CU_AIN_C2_VTEMPD_UNFILT "Conversion method for ain_C2_vtempd_unfilt" RAT_FUNC "%10.3" "V" COEFFS 0.000000 1.000000 -0.000000 0.000000 0.000000 1.000000 /end COMPU_METHOD
/* Scalar measurable for DDE 'ain_D3_AinE_ext_filt'. */
/begin MEASUREMENT ain_D3_AinE_ext_filt "AinE/ChgLock scaled filtered (CCU pin D3)" FLOAT32_IEEE CU_AIN_D3_AINE_EXT_FILT 1 100 0.0 40.0 ECU_ADDRESS 0x7001a0c8 BYTE_ORDER MSB_LAST /end MEASUREMENT
/begin COMPU_METHOD CU_AIN_D3_AINE_EXT_FILT "Conversion method for ain_D3_AinE_ext_filt" RAT_FUNC "%10.3" "V" COEFFS 0.000000 1.000000 -0.000000 0.000000 0.000000 1.000000 /end COMPU_METHOD
/* Scalar measurable for DDE 'ain_D3_AinE_ext_unfilt'. */
/begin MEASUREMENT ain_D3_AinE_ext_unfilt "AinE/ChgLock scaled unfiltered (CCU pin D3)" FLOAT32_IEEE CU_AIN_D3_AINE_EXT_UNFILT 1 100 0.0 40.0 ECU_ADDRESS 0x7001a040 BYTE_ORDER MSB_LAST /end MEASUREMENT
/begin COMPU_METHOD CU_AIN_D3_AINE_EXT_UNFILT "Conversion method for ain_D3_AinE_ext_unfilt" RAT_FUNC "%10.3" "V" COEFFS 0.000000 1.000000 -0.000000 0.000000 0.000000 1.000000 /end COMPU_METHOD
/* Scalar measurable for DDE 'ain_D3_AinE_int_filt'. */
/begin MEASUREMENT ain_D3_AinE_int_filt "AinE/ChgLock filtered (CCU pin D3)" FLOAT32_IEEE CU_AIN_D3_AINE_INT_FILT 1 100 0.0 5.0 ECU_ADDRESS 0x7001a1a8 BYTE_ORDER MSB_LAST /end MEASUREMENT
/begin COMPU_METHOD CU_AIN_D3_AINE_INT_FILT "Conversion method for ain_D3_AinE_int_filt" RAT_FUNC "%10.3" "V" COEFFS 0.000000 1.000000 -0.000000 0.000000 0.000000 1.000000 /end COMPU_METHOD
/* Scalar measurable for DDE 'ain_D3_AinE_int_unfilt'. */
/begin MEASUREMENT ain_D3_AinE_int_unfilt "AinE/ChgLock raw unfiltered (CCU pin D3)" FLOAT32_IEEE CU_AIN_D3_AINE_INT_UNFILT 1 100 0.0 5.0 ECU_ADDRESS 0x70019fa8 BYTE_ORDER MSB_LAST /end MEASUREMENT
/begin COMPU_METHOD CU_AIN_D3_AINE_INT_UNFILT "Conversion method for ain_D3_AinE_int_unfilt" RAT_FUNC "%10.3" "V" COEFFS 0.000000 1.000000 -0.000000 0.000000 0.000000 1.000000 /end COMPU_METHOD
/* Scalar measurable for DDE 'ain_F2_LedA_ext_filt'. */
/begin MEASUREMENT ain_F2_LedA_ext_filt "LEDA scaled filtered (CCU pin F2)" FLOAT32_IEEE CU_AIN_F2_LEDA_EXT_FILT 1 100 0.0 40.0 ECU_ADDRESS 0x70019f9c BYTE_ORDER MSB_LAST /end MEASUREMENT
/begin COMPU_METHOD CU_AIN_F2_LEDA_EXT_FILT "Conversion method for ain_F2_LedA_ext_filt" RAT_FUNC "%10.3" "V" COEFFS 0.000000 1.000000 -0.000000 0.000000 0.000000 1.000000 /end COMPU_METHOD
/* Scalar measurable for DDE 'ain_F2_LedA_ext_unfilt'. */
/begin MEASUREMENT ain_F2_LedA_ext_unfilt "LEDA scaled unfiltered (CCU pin F2)" FLOAT32_IEEE CU_AIN_F2_LEDA_EXT_UNFILT 1 100 0.0 40.0 ECU_ADDRESS 0x7001a068 BYTE_ORDER MSB_LAST /end MEASUREMENT
/begin COMPU_METHOD CU_AIN_F2_LEDA_EXT_UNFILT "Conversion method for ain_F2_LedA_ext_unfilt" RAT_FUNC "%10.3" "V" COEFFS 0.000000 1.000000 -0.000000 0.000000 0.000000 1.000000 /end COMPU_METHOD
/* Scalar measurable for DDE 'ain_F2_LedA_int_filt'. */
/begin MEASUREMENT ain_F2_LedA_int_filt "LEDA filtered (CCU pin F2)" FLOAT32_IEEE CU_AIN_F2_LEDA_INT_FILT 1 100 0.0 5.0 ECU_ADDRESS 0x7001a054 BYTE_ORDER MSB_LAST /end MEASUREMENT
/begin COMPU_METHOD CU_AIN_F2_LEDA_INT_FILT "Conversion method for ain_F2_LedA_int_filt" RAT_FUNC "%10.3" "V" COEFFS 0.000000 1.000000 -0.000000 0.000000 0.000000 1.000000 /end COMPU_METHOD
/* Scalar measurable for DDE 'ain_F2_LedA_int_unfilt'. */
/begin MEASUREMENT ain_F2_LedA_int_unfilt "LEDA raw unfiltered (CCU pin F2)" FLOAT32_IEEE CU_AIN_F2_LEDA_INT_UNFILT 1 100 0.0 5.0 ECU_ADDRESS 0x70019fb0 BYTE_ORDER MSB_LAST /end MEASUREMENT
/begin COMPU_METHOD CU_AIN_F2_LEDA_INT_UNFILT "Conversion method for ain_F2_LedA_int_unfilt" RAT_FUNC "%10.3" "V" COEFFS 0.000000 1.000000 -0.000000 0.000000 0.000000 1.000000 /end COMPU_METHOD
/* Scalar measurable for DDE 'ain_F3_LedB_ext_filt'. */
/begin MEASUREMENT ain_F3_LedB_ext_filt "LEDB scaled filtered (CCU pin F3)" FLOAT32_IEEE CU_AIN_F3_LEDB_EXT_FILT 1 100 0.0 40.0 ECU_ADDRESS 0x7001a100 BYTE_ORDER MSB_LAST /end MEASUREMENT
/begin COMPU_METHOD CU_AIN_F3_LEDB_EXT_FILT "Conversion method for ain_F3_LedB_ext_filt" RAT_FUNC "%10.3" "V" COEFFS 0.000000 1.000000 -0.000000 0.000000 0.000000 1.000000 /end COMPU_METHOD
/* Scalar measurable for DDE 'ain_F3_LedB_ext_unfilt'. */
/begin MEASUREMENT ain_F3_LedB_ext_unfilt "LEDB scaled unfiltered (CCU pin F3)" FLOAT32_IEEE CU_AIN_F3_LEDB_EXT_UNFILT 1 100 0.0 40.0 ECU_ADDRESS 0x7001a0f8 BYTE_ORDER MSB_LAST /end MEASUREMENT
/begin COMPU_METHOD CU_AIN_F3_LEDB_EXT_UNFILT "Conversion method for ain_F3_LedB_ext_unfilt" RAT_FUNC "%10.3" "V" COEFFS 0.000000 1.000000 -0.000000 0.000000 0.000000 1.000000 /end COMPU_METHOD
/* Scalar measurable for DDE 'ain_F3_LedB_int_filt'. */
/begin MEASUREMENT ain_F3_LedB_int_filt "LEDB filtered (CCU pin F3)" FLOAT32_IEEE CU_AIN_F3_LEDB_INT_FILT 1 100 0.0 5.0 ECU_ADDRESS 0x7001a014 BYTE_ORDER MSB_LAST /end MEASUREMENT
/begin COMPU_METHOD CU_AIN_F3_LEDB_INT_FILT "Conversion method for ain_F3_LedB_int_filt" RAT_FUNC "%10.3" "V" COEFFS 0.000000 1.000000 -0.000000 0.000000 0.000000 1.000000 /end COMPU_METHOD
/* Scalar measurable for DDE 'ain_F3_LedB_int_unfilt'. */
/begin MEASUREMENT ain_F3_LedB_int_unfilt "LEDB raw unfiltered (CCU pin F3)" FLOAT32_IEEE CU_AIN_F3_LEDB_INT_UNFILT 1 100 0.0 5.0 ECU_ADDRESS 0x70019fec BYTE_ORDER MSB_LAST /end MEASUREMENT
/begin COMPU_METHOD CU_AIN_F3_LEDB_INT_UNFILT "Conversion method for ain_F3_LedB_int_unfilt" RAT_FUNC "%10.3" "V" COEFFS 0.000000 1.000000 -0.000000 0.000000 0.000000 1.000000 /end COMPU_METHOD
/* Scalar measurable for DDE 'ain_F4_LedC_ext_filt'. */
/begin MEASUREMENT ain_F4_LedC_ext_filt "LEDC scaled filtered (CCU pin F4)" FLOAT32_IEEE CU_AIN_F4_LEDC_EXT_FILT 1 100 0.0 40.0 ECU_ADDRESS 0x70019fe0 BYTE_ORDER MSB_LAST /end MEASUREMENT
/begin COMPU_METHOD CU_AIN_F4_LEDC_EXT_FILT "Conversion method for ain_F4_LedC_ext_filt" RAT_FUNC "%10.3" "V" COEFFS 0.000000 1.000000 -0.000000 0.000000 0.000000 1.000000 /end COMPU_METHOD
/* Scalar measurable for DDE 'ain_F4_LedC_ext_unfilt'. */
/begin MEASUREMENT ain_F4_LedC_ext_unfilt "LEDC scaled unfiltered (CCU pin F4)" FLOAT32_IEEE CU_AIN_F4_LEDC_EXT_UNFILT 1 100 0.0 40.0 ECU_ADDRESS 0x7001a0a8 BYTE_ORDER MSB_LAST /end MEASUREMENT
/begin COMPU_METHOD CU_AIN_F4_LEDC_EXT_UNFILT "Conversion method for ain_F4_LedC_ext_unfilt" RAT_FUNC "%10.3" "V" COEFFS 0.000000 1.000000 -0.000000 0.000000 0.000000 1.000000 /end COMPU_METHOD
/* Scalar measurable for DDE 'ain_F4_LedC_int_filt'. */
/begin MEASUREMENT ain_F4_LedC_int_filt "LEDC filtered (CCU pin F4)" FLOAT32_IEEE CU_AIN_F4_LEDC_INT_FILT 1 100 0.0 5.0 ECU_ADDRESS 0x7001a09c BYTE_ORDER MSB_LAST /end MEASUREMENT
/begin COMPU_METHOD CU_AIN_F4_LEDC_INT_FILT "Conversion method for ain_F4_LedC_int_filt" RAT_FUNC "%10.3" "V" COEFFS 0.000000 1.000000 -0.000000 0.000000 0.000000 1.000000 /end COMPU_METHOD
/* Scalar measurable for DDE 'ain_F4_LedC_int_unfilt'. */
/begin MEASUREMENT ain_F4_LedC_int_unfilt "LEDC raw unfiltered (CCU pin F4)" FLOAT32_IEEE CU_AIN_F4_LEDC_INT_UNFILT 1 100 0.0 5.0 ECU_ADDRESS 0x7001a07c BYTE_ORDER MSB_LAST /end MEASUREMENT
/begin COMPU_METHOD CU_AIN_F4_LEDC_INT_UNFILT "Conversion method for ain_F4_LedC_int_unfilt" RAT_FUNC "%10.3" "V" COEFFS 0.000000 1.000000 -0.000000 0.000000 0.000000 1.000000 /end COMPU_METHOD
/* Scalar measurable for DDE 'ain_K3_ignition_ext_filt'. */
/begin MEASUREMENT ain_K3_ignition_ext_filt "Ignition scaled filtered (CCU pin K3)" FLOAT32_IEEE CU_AIN_K3_IGNITION_EXT_FILT 1 100 0.0 40.0 ECU_ADDRESS 0x7001a0f0 BYTE_ORDER MSB_LAST /end MEASUREMENT
/begin COMPU_METHOD CU_AIN_K3_IGNITION_EXT_FILT "Conversion method for ain_K3_ignition_ext_filt" RAT_FUNC "%10.3" "V" COEFFS 0.000000 1.000000 -0.000000 0.000000 0.000000 1.000000 /end COMPU_METHOD
/* Scalar measurable for DDE 'ain_K3_ignition_ext_unfilt'. */
/begin MEASUREMENT ain_K3_ignition_ext_unfilt "Ignition scaled unfiltered (CCU pin K3)" FLOAT32_IEEE CU_AIN_K3_IGNITION_EXT_UNFILT 1 100 0.0 5.0 ECU_ADDRESS 0x7001a0e4 BYTE_ORDER MSB_LAST /end MEASUREMENT
/begin COMPU_METHOD CU_AIN_K3_IGNITION_EXT_UNFILT "Conversion method for ain_K3_ignition_ext_unfilt" RAT_FUNC "%10.3" "V" COEFFS 0.000000 1.000000 -0.000000 0.000000 0.000000 1.000000 /end COMPU_METHOD
/* Scalar measurable for DDE 'ain_K3_ignition_int_filt'. */
/begin MEASUREMENT ain_K3_ignition_int_filt "Ignition filtered (CCU pin K3)" FLOAT32_IEEE CU_AIN_K3_IGNITION_INT_FILT 1 100 0.0 40.0 ECU_ADDRESS 0x7001a0cc BYTE_ORDER MSB_LAST /end MEASUREMENT
/begin COMPU_METHOD CU_AIN_K3_IGNITION_INT_FILT "Conversion method for ain_K3_ignition_int_filt" RAT_FUNC "%10.3" "V" COEFFS 0.000000 1.000000 -0.000000 0.000000 0.000000 1.000000 /end COMPU_METHOD
/* Scalar measurable for DDE 'ain_K3_ignition_int_unfilt'. */
/begin MEASUREMENT ain_K3_ignition_int_unfilt "Ignition raw unfiltered (CCU pin K3)" FLOAT32_IEEE CU_AIN_K3_IGNITION_INT_UNFILT 1 100 0.0 5.0 ECU_ADDRESS 0x70019ea4 BYTE_ORDER MSB_LAST /end MEASUREMENT
/begin COMPU_METHOD CU_AIN_K3_IGNITION_INT_UNFILT "Conversion method for ain_K3_ignition_int_unfilt" RAT_FUNC "%10.3" "V" COEFFS 0.000000 1.000000 -0.000000 0.000000 0.000000 1.000000 /end COMPU_METHOD
/* Scalar measurable for DDE 'ain_M2_HbrNVmon_ext_filt'. */
/begin MEASUREMENT ain_M2_HbrNVmon_ext_filt "HbrN Vmon scaled filtered (CCU pin M2)" FLOAT32_IEEE CU_AIN_M2_HBRNVMON_EXT_FILT 1 100 0.0 40.0 ECU_ADDRESS 0x7001a1ac BYTE_ORDER MSB_LAST /end MEASUREMENT
/begin COMPU_METHOD CU_AIN_M2_HBRNVMON_EXT_FILT "Conversion method for ain_M2_HbrNVmon_ext_filt" RAT_FUNC "%10.3" "V" COEFFS 0.000000 1.000000 -0.000000 0.000000 0.000000 1.000000 /end COMPU_METHOD
/* Scalar measurable for DDE 'ain_M2_HbrNVmon_ext_unfilt'. */
/begin MEASUREMENT ain_M2_HbrNVmon_ext_unfilt "HbrN Vmon scaled unfiltered (CCU pin M2)" FLOAT32_IEEE CU_AIN_M2_HBRNVMON_EXT_UNFILT 1 100 0.0 40.0 ECU_ADDRESS 0x70019fdc BYTE_ORDER MSB_LAST /end MEASUREMENT
/begin COMPU_METHOD CU_AIN_M2_HBRNVMON_EXT_UNFILT "Conversion method for ain_M2_HbrNVmon_ext_unfilt" RAT_FUNC "%10.3" "V" COEFFS 0.000000 1.000000 -0.000000 0.000000 0.000000 1.000000 /end COMPU_METHOD
/* Scalar measurable for DDE 'ain_M2_HbrNVmon_int_filt'. */
/begin MEASUREMENT ain_M2_HbrNVmon_int_filt "HbrN Vmon filtered (CCU pin M2)" FLOAT32_IEEE CU_AIN_M2_HBRNVMON_INT_FILT 1 100 0.0 5.0 ECU_ADDRESS 0x7001a06c BYTE_ORDER MSB_LAST /end MEASUREMENT
/begin COMPU_METHOD CU_AIN_M2_HBRNVMON_INT_FILT "Conversion method for ain_M2_HbrNVmon_int_filt" RAT_FUNC "%10.3" "V" COEFFS 0.000000 1.000000 -0.000000 0.000000 0.000000 1.000000 /end COMPU_METHOD
/* Scalar measurable for DDE 'ain_M2_HbrNVmon_int_unfilt'. */
/begin MEASUREMENT ain_M2_HbrNVmon_int_unfilt "HbrN Vmon raw unfiltered (CCU pin M2)" FLOAT32_IEEE CU_AIN_M2_HBRNVMON_INT_UNFILT 1 100 0.0 5.0 ECU_ADDRESS 0x70019ec0 BYTE_ORDER MSB_LAST /end MEASUREMENT
/begin COMPU_METHOD CU_AIN_M2_HBRNVMON_INT_UNFILT "Conversion method for ain_M2_HbrNVmon_int_unfilt" RAT_FUNC "%10.3" "V" COEFFS 0.000000 1.000000 -0.000000 0.000000 0.000000 1.000000 /end COMPU_METHOD
/* Scalar measurable for DDE 'ain_M3_HbrPVmon_ext_filt'. */
/begin MEASUREMENT ain_M3_HbrPVmon_ext_filt "HbrP Vmon scaled filtered (CCU pin M3)" FLOAT32_IEEE CU_AIN_M3_HBRPVMON_EXT_FILT 1 100 0.0 40.0 ECU_ADDRESS 0x70019eb8 BYTE_ORDER MSB_LAST /end MEASUREMENT
/begin COMPU_METHOD CU_AIN_M3_HBRPVMON_EXT_FILT "Conversion method for ain_M3_HbrPVmon_ext_filt" RAT_FUNC "%10.3" "V" COEFFS 0.000000 1.000000 -0.000000 0.000000 0.000000 1.000000 /end COMPU_METHOD
/* Scalar measurable for DDE 'ain_M3_HbrPVmon_ext_unfilt'. */
/begin MEASUREMENT ain_M3_HbrPVmon_ext_unfilt "HbrP Vmon scaled unfiltered (CCU pin M3)" FLOAT32_IEEE CU_AIN_M3_HBRPVMON_EXT_UNFILT 1 100 0.0 40.0 ECU_ADDRESS 0x7001a104 BYTE_ORDER MSB_LAST /end MEASUREMENT
/begin COMPU_METHOD CU_AIN_M3_HBRPVMON_EXT_UNFILT "Conversion method for ain_M3_HbrPVmon_ext_unfilt" RAT_FUNC "%10.3" "V" COEFFS 0.000000 1.000000 -0.000000 0.000000 0.000000 1.000000 /end COMPU_METHOD
/* Scalar measurable for DDE 'ain_M3_HbrPVmon_int_filt'. */
/begin MEASUREMENT ain_M3_HbrPVmon_int_filt "HbrP Vmon filtered (CCU pin M3)" FLOAT32_IEEE CU_AIN_M3_HBRPVMON_INT_FILT 1 100 0.0 5.0 ECU_ADDRESS 0x70019f4c BYTE_ORDER MSB_LAST /end MEASUREMENT
/begin COMPU_METHOD CU_AIN_M3_HBRPVMON_INT_FILT "Conversion method for ain_M3_HbrPVmon_int_filt" RAT_FUNC "%10.3" "V" COEFFS 0.000000 1.000000 -0.000000 0.000000 0.000000 1.000000 /end COMPU_METHOD
/* Scalar measurable for DDE 'ain_M3_HbrPVmon_int_unfilt'. */
/begin MEASUREMENT ain_M3_HbrPVmon_int_unfilt "HbrP Vmon raw unfiltered (CCU pin M3)" FLOAT32_IEEE CU_AIN_M3_HBRPVMON_INT_UNFILT 1 100 0.0 5.0 ECU_ADDRESS 0x70019f44 BYTE_ORDER MSB_LAST /end MEASUREMENT
/begin COMPU_METHOD CU_AIN_M3_HBRPVMON_INT_UNFILT "Conversion method for ain_M3_HbrPVmon_int_unfilt" RAT_FUNC "%10.3" "V" COEFFS 0.000000 1.000000 -0.000000 0.000000 0.000000 1.000000 /end COMPU_METHOD
/* Scalar measurable for DDE 'ain_TempIntDegC'. */
/begin MEASUREMENT ain_TempIntDegC "Temp Internal DegC scaled filtered (CCU pin J3)" FLOAT32_IEEE CU_AIN_TEMPINTDEGC 1 100 -60.0 150.0 ECU_ADDRESS 0x7001a020 BYTE_ORDER MSB_LAST /end MEASUREMENT
/begin COMPU_METHOD CU_AIN_TEMPINTDEGC "Conversion method for ain_TempIntDegC" RAT_FUNC "%10.2" "C" COEFFS 0.000000 1.000000 -0.000000 0.000000 0.000000 1.000000 /end COMPU_METHOD
/* Scalar measurable for DDE 'ain_TempInt_ext_filt'. */
/begin MEASUREMENT ain_TempInt_ext_filt "Internal Temp scaled filtered" FLOAT32_IEEE CU_AIN_TEMPINT_EXT_FILT 1 100 0.0 40.0 ECU_ADDRESS 0x7001a148 BYTE_ORDER MSB_LAST /end MEASUREMENT
/begin COMPU_METHOD CU_AIN_TEMPINT_EXT_FILT "Conversion method for ain_TempInt_ext_filt" RAT_FUNC "%10.3" "V" COEFFS 0.000000 1.000000 -0.000000 0.000000 0.000000 1.000000 /end COMPU_METHOD
/* Scalar measurable for DDE 'ain_TempInt_ext_unfilt'. */
/begin MEASUREMENT ain_TempInt_ext_unfilt "Internal Temp scaled unfiltered" FLOAT32_IEEE CU_AIN_TEMPINT_EXT_UNFILT 1 100 0.0 40.0 ECU_ADDRESS 0x7001a13c BYTE_ORDER MSB_LAST /end MEASUREMENT
/begin COMPU_METHOD CU_AIN_TEMPINT_EXT_UNFILT "Conversion method for ain_TempInt_ext_unfilt" RAT_FUNC "%10.3" "V" COEFFS 0.000000 1.000000 -0.000000 0.000000 0.000000 1.000000 /end COMPU_METHOD
/* Scalar measurable for DDE 'ain_TempInt_int_filt'. */
/begin MEASUREMENT ain_TempInt_int_filt "Internal Temp filtered" FLOAT32_IEEE CU_AIN_TEMPINT_INT_FILT 1 100 0.0 5.0 ECU_ADDRESS 0x70019ef8 BYTE_ORDER MSB_LAST /end MEASUREMENT
/begin COMPU_METHOD CU_AIN_TEMPINT_INT_FILT "Conversion method for ain_TempInt_int_filt" RAT_FUNC "%10.3" "V" COEFFS 0.000000 1.000000 -0.000000 0.000000 0.000000 1.000000 /end COMPU_METHOD
/* Scalar measurable for DDE 'ain_TempInt_int_unfilt'. */
/begin MEASUREMENT ain_TempInt_int_unfilt "Internal Temp raw unfiltered" FLOAT32_IEEE CU_AIN_TEMPINT_INT_UNFILT 1 100 0.0 5.0 ECU_ADDRESS 0x70019ee8 BYTE_ORDER MSB_LAST /end MEASUREMENT
/begin COMPU_METHOD CU_AIN_TEMPINT_INT_UNFILT "Conversion method for ain_TempInt_int_unfilt" RAT_FUNC "%10.3" "V" COEFFS 0.000000 1.000000 -0.000000 0.000000 0.000000 1.000000 /end COMPU_METHOD
/* Scalar measurable for DDE 'ain_Vbat_ext_filt'. */
/begin MEASUREMENT ain_Vbat_ext_filt "Vbat scaled filtered (CCU pin L2/L3)" FLOAT32_IEEE CU_AIN_VBAT_EXT_FILT 1 100 0.0 40.0 ECU_ADDRESS 0x70019ec8 BYTE_ORDER MSB_LAST /end MEASUREMENT
/begin COMPU_METHOD CU_AIN_VBAT_EXT_FILT "Conversion method for ain_Vbat_ext_filt" RAT_FUNC "%10.3" "V" COEFFS 0.000000 1.000000 -0.000000 0.000000 0.000000 1.000000 /end COMPU_METHOD
/* Scalar measurable for DDE 'ain_Vbat_ext_unfilt'. */
/begin MEASUREMENT ain_Vbat_ext_unfilt "Vbat scaled unfiltered (CCU pin L2/L3)" FLOAT32_IEEE CU_AIN_VBAT_EXT_UNFILT 1 100 0.0 40.0 ECU_ADDRESS 0x70019f94 BYTE_ORDER MSB_LAST /end MEASUREMENT
/begin COMPU_METHOD CU_AIN_VBAT_EXT_UNFILT "Conversion method for ain_Vbat_ext_unfilt" RAT_FUNC "%10.3" "V" COEFFS 0.000000 1.000000 -0.000000 0.000000 0.000000 1.000000 /end COMPU_METHOD
/* Scalar measurable for DDE 'ain_Vbat_int_filt'. */
/begin MEASUREMENT ain_Vbat_int_filt "Vbat filtered (CCU pin L2/L3)" FLOAT32_IEEE CU_AIN_VBAT_INT_FILT 1 100 0.0 5.0 ECU_ADDRESS 0x70019f8c BYTE_ORDER MSB_LAST /end MEASUREMENT
/begin COMPU_METHOD CU_AIN_VBAT_INT_FILT "Conversion method for ain_Vbat_int_filt" RAT_FUNC "%10.3" "V" COEFFS 0.000000 1.000000 -0.000000 0.000000 0.000000 1.000000 /end COMPU_METHOD
/* Scalar measurable for DDE 'ain_Vbat_int_unfilt'. */
/begin MEASUREMENT ain_Vbat_int_unfilt "Vbat raw unfiltered (CCU pin L2/L3)" FLOAT32_IEEE CU_AIN_VBAT_INT_UNFILT 1 100 0.0 5.0 ECU_ADDRESS 0x70019f18 BYTE_ORDER MSB_LAST /end MEASUREMENT
/begin COMPU_METHOD CU_AIN_VBAT_INT_UNFILT "Conversion method for ain_Vbat_int_unfilt" RAT_FUNC "%10.3" "V" COEFFS 0.000000 1.000000 -0.000000 0.000000 0.000000 1.000000 /end COMPU_METHOD
/* Scalar measurable for DDE 'ain_VrefA_ext_filt'. */
/begin MEASUREMENT ain_VrefA_ext_filt "VrefA scaled filtered" FLOAT32_IEEE CU_AIN_VREFA_EXT_FILT 1 100 0.0 20.0 ECU_ADDRESS 0x7001a180 BYTE_ORDER MSB_LAST /end MEASUREMENT
/begin COMPU_METHOD CU_AIN_VREFA_EXT_FILT "Conversion method for ain_VrefA_ext_filt" RAT_FUNC "%10.3" "V" COEFFS 0.000000 1.000000 -0.000000 0.000000 0.000000 1.000000 /end COMPU_METHOD
/* Scalar measurable for DDE 'ain_VrefA_ext_unfilt'. */
/begin MEASUREMENT ain_VrefA_ext_unfilt "VrefA scaled unfiltered" FLOAT32_IEEE CU_AIN_VREFA_EXT_UNFILT 1 100 0.0 20.0 ECU_ADDRESS 0x7001a16c BYTE_ORDER MSB_LAST /end MEASUREMENT
/begin COMPU_METHOD CU_AIN_VREFA_EXT_UNFILT "Conversion method for ain_VrefA_ext_unfilt" RAT_FUNC "%10.3" "V" COEFFS 0.000000 1.000000 -0.000000 0.000000 0.000000 1.000000 /end COMPU_METHOD
/* Scalar measurable for DDE 'ain_VrefA_int_filt'. */
/begin MEASUREMENT ain_VrefA_int_filt "VrefA filtered" FLOAT32_IEEE CU_AIN_VREFA_INT_FILT 1 100 0.0 5.0 ECU_ADDRESS 0x70019f34 BYTE_ORDER MSB_LAST /end MEASUREMENT
/begin COMPU_METHOD CU_AIN_VREFA_INT_FILT "Conversion method for ain_VrefA_int_filt" RAT_FUNC "%10.3" "V" COEFFS 0.000000 1.000000 -0.000000 0.000000 0.000000 1.000000 /end COMPU_METHOD
/* Scalar measurable for DDE 'ain_VrefA_int_unfilt'. */
/begin MEASUREMENT ain_VrefA_int_unfilt "VrefA raw unfiltered" FLOAT32_IEEE CU_AIN_VREFA_INT_UNFILT 1 100 0.0 5.0 ECU_ADDRESS 0x70019f2c BYTE_ORDER MSB_LAST /end MEASUREMENT
/begin COMPU_METHOD CU_AIN_VREFA_INT_UNFILT "Conversion method for ain_VrefA_int_unfilt" RAT_FUNC "%10.3" "V" COEFFS 0.000000 1.000000 -0.000000 0.000000 0.000000 1.000000 /end COMPU_METHOD
/* Scalar measurable for DDE 'ain_VrefB_ext_filt'. */
/begin MEASUREMENT ain_VrefB_ext_filt "VrefB scaled filtered" FLOAT32_IEEE CU_AIN_VREFB_EXT_FILT 1 100 0.0 20.0 ECU_ADDRESS 0x70019f08 BYTE_ORDER MSB_LAST /end MEASUREMENT
/begin COMPU_METHOD CU_AIN_VREFB_EXT_FILT "Conversion method for ain_VrefB_ext_filt" RAT_FUNC "%10.3" "V" COEFFS 0.000000 1.000000 -0.000000 0.000000 0.000000 1.000000 /end COMPU_METHOD
/* Scalar measurable for DDE 'ain_VrefB_ext_unfilt'. */
/begin MEASUREMENT ain_VrefB_ext_unfilt "VrefB scaled unfiltered" FLOAT32_IEEE CU_AIN_VREFB_EXT_UNFILT 1 100 0.0 20.0 ECU_ADDRESS 0x70019f84 BYTE_ORDER MSB_LAST /end MEASUREMENT
/begin COMPU_METHOD CU_AIN_VREFB_EXT_UNFILT "Conversion method for ain_VrefB_ext_unfilt" RAT_FUNC "%10.3" "V" COEFFS 0.000000 1.000000 -0.000000 0.000000 0.000000 1.000000 /end COMPU_METHOD
/* Scalar measurable for DDE 'ain_VrefB_int_filt'. */
/begin MEASUREMENT ain_VrefB_int_filt "VrefB filtered" FLOAT32_IEEE CU_AIN_VREFB_INT_FILT 1 100 0.0 5.0 ECU_ADDRESS 0x70019f78 BYTE_ORDER MSB_LAST /end MEASUREMENT
/begin COMPU_METHOD CU_AIN_VREFB_INT_FILT "Conversion method for ain_VrefB_int_filt" RAT_FUNC "%10.3" "V" COEFFS 0.000000 1.000000 -0.000000 0.000000 0.000000 1.000000 /end COMPU_METHOD
/* Scalar measurable for DDE 'ain_VrefB_int_unfilt'. */
/begin MEASUREMENT ain_VrefB_int_unfilt "VrefB raw unfiltered" FLOAT32_IEEE CU_AIN_VREFB_INT_UNFILT 1 100 0.0 5.0 ECU_ADDRESS 0x70019f50 BYTE_ORDER MSB_LAST /end MEASUREMENT
/begin COMPU_METHOD CU_AIN_VREFB_INT_UNFILT "Conversion method for ain_VrefB_int_unfilt" RAT_FUNC "%10.3" "V" COEFFS 0.000000 1.000000 -0.000000 0.000000 0.000000 1.000000 /end COMPU_METHOD
/* Scalar measurable for DDE 'ain_cpilot_dcycle'. */
/begin MEASUREMENT ain_cpilot_dcycle "Frequency for control pilot voltage (CCCU pin A3)" FLOAT32_IEEE CU_AIN_CPILOT_DCYCLE 1 100 0.0 1.0 ECU_ADDRESS 0x7001a034 BYTE_ORDER MSB_LAST /end MEASUREMENT
/begin COMPU_METHOD CU_AIN_CPILOT_DCYCLE "Conversion method for ain_cpilot_dcycle" RAT_FUNC "%10.2" "proportion" COEFFS 0.000000 1.000000 -0.000000 0.000000 0.000000 1.000000 /end COMPU_METHOD
/* Scalar measurable for DDE 'ain_cpilot_freq'. */
/begin MEASUREMENT ain_cpilot_freq "Duty cycle for control pilot voltage (CCCU pin A3)" FLOAT32_IEEE CU_AIN_CPILOT_FREQ 1 100 0.5 10000.0 ECU_ADDRESS 0x70019ed4 BYTE_ORDER MSB_LAST /end MEASUREMENT
/begin COMPU_METHOD CU_AIN_CPILOT_FREQ "Conversion method for ain_cpilot_freq" RAT_FUNC "%10.1" "Hz" COEFFS 0.000000 1.000000 -0.000000 0.000000 0.000000 1.000000 /end COMPU_METHOD
/* Scalar measurable for DDE 'ain_cpilot_state'. */
/begin MEASUREMENT ain_cpilot_state "Pin state for control pilot voltage (CCCU pin A3)" UBYTE CU_AIN_CPILOT_STATE 1 100 0.0 1.0 ECU_ADDRESS 0x70019ff0 BYTE_ORDER MSB_LAST /end MEASUREMENT
/begin COMPU_METHOD CU_AIN_CPILOT_STATE "Conversion method for ain_cpilot_state" RAT_FUNC "%10.0" "(not defined)" COEFFS 0.000000 1.000000 -0.000000 0.000000 0.000000 1.000000 /end COMPU_METHOD
/* Scalar measurable for DDE 'ain_cpilot_timeout'. */
/begin MEASUREMENT ain_cpilot_timeout "Timeout flag for control pilot voltage (CCCU pin A3)" UBYTE CU_AIN_CPILOT_TIMEOUT 1 100 0.0 1.0 ECU_ADDRESS 0x70019f70 BYTE_ORDER MSB_LAST /end MEASUREMENT
/begin COMPU_METHOD CU_AIN_CPILOT_TIMEOUT "Conversion method for ain_cpilot_timeout" RAT_FUNC "%10.0" "(not defined)" COEFFS 0.000000 1.000000 -0.000000 0.000000 0.000000 1.000000 /end COMPU_METHOD
/* Scalar measurable for DDE 'ain_cpilot_timeout_count'. */
/begin MEASUREMENT ain_cpilot_timeout_count "Timeout count for control pilot voltage (CCCU pin A3)" ULONG CU_AIN_CPILOT_TIMEOUT_COUNT 1 100 0.0 100.0 ECU_ADDRESS 0x7001a088 BYTE_ORDER MSB_LAST /end MEASUREMENT
/begin COMPU_METHOD CU_AIN_CPILOT_TIMEOUT_COUNT "Conversion method for ain_cpilot_timeout_count" RAT_FUNC "%10.0" "proportion" COEFFS 0.000000 1.000000 -0.000000 0.000000 0.000000 1.000000 /end COMPU_METHOD
/* Scalar measurable for DDE 'ain_ihbr_ext_filt'. */
/begin MEASUREMENT ain_ihbr_ext_filt "Hbr imon scaled filtered (CCU pin M3/M2)" FLOAT32_IEEE CU_AIN_IHBR_EXT_FILT 1 100 0.0 10.0 ECU_ADDRESS 0x7001a158 BYTE_ORDER MSB_LAST /end MEASUREMENT
/begin COMPU_METHOD CU_AIN_IHBR_EXT_FILT "Conversion method for ain_ihbr_ext_filt" RAT_FUNC "%10.3" "A" COEFFS 0.000000 1.000000 -0.000000 0.000000 0.000000 1.000000 /end COMPU_METHOD
/* Scalar measurable for DDE 'ain_ihbr_ext_unfilt'. */
/begin MEASUREMENT ain_ihbr_ext_unfilt "Hbr imon scaled unfiltered (CCU pin M3/M2)" FLOAT32_IEEE CU_AIN_IHBR_EXT_UNFILT 1 100 0.0 10.0 ECU_ADDRESS 0x7001a134 BYTE_ORDER MSB_LAST /end MEASUREMENT
/begin COMPU_METHOD CU_AIN_IHBR_EXT_UNFILT "Conversion method for ain_ihbr_ext_unfilt" RAT_FUNC "%10.3" "A" COEFFS 0.000000 1.000000 -0.000000 0.000000 0.000000 1.000000 /end COMPU_METHOD
/* Scalar measurable for DDE 'ain_ihbr_int_filt'. */
/begin MEASUREMENT ain_ihbr_int_filt "Hbr imon filtered (CCU pin M3/M2)" FLOAT32_IEEE CU_AIN_IHBR_INT_FILT 1 100 0.0 5.0 ECU_ADDRESS 0x70019f14 BYTE_ORDER MSB_LAST /end MEASUREMENT
/begin COMPU_METHOD CU_AIN_IHBR_INT_FILT "Conversion method for ain_ihbr_int_filt" RAT_FUNC "%10.3" "V" COEFFS 0.000000 1.000000 -0.000000 0.000000 0.000000 1.000000 /end COMPU_METHOD
/* Scalar measurable for DDE 'ain_ihbr_int_unfilt'. */
/begin MEASUREMENT ain_ihbr_int_unfilt "Hbr imon raw unfiltered (CCU pin M3/M2)" FLOAT32_IEEE CU_AIN_IHBR_INT_UNFILT 1 100 0.0 5.0 ECU_ADDRESS 0x7001a0ac BYTE_ORDER MSB_LAST /end MEASUREMENT
/begin COMPU_METHOD CU_AIN_IHBR_INT_UNFILT "Conversion method for ain_ihbr_int_unfilt" RAT_FUNC "%10.3" "V" COEFFS 0.000000 1.000000 -0.000000 0.000000 0.000000 1.000000 /end COMPU_METHOD
/* Scalar measurable for DDE 'din_nHbrFlt'. */
/begin MEASUREMENT din_nHbrFlt "(not defined)" UBYTE CU_DIN_NHBRFLT 1 100 0.0 255.0 ECU_ADDRESS 0x7001a168 BYTE_ORDER MSB_LAST /end MEASUREMENT
/begin COMPU_METHOD CU_DIN_NHBRFLT "Conversion method for din_nHbrFlt" RAT_FUNC "%10.0" "(not defined)" COEFFS 0.000000 1.000000 -0.000000 0.000000 0.000000 1.000000 /end COMPU_METHOD
/* Scalar measurable for DDE 'din_p10_8_nplcirq'. */
/begin MEASUREMENT din_p10_8_nplcirq "NPLCIRQ" UBYTE CU_DIN_P10_8_NPLCIRQ 1 100 0.0 1.0 ECU_ADDRESS 0x7001a0e1 BYTE_ORDER MSB_LAST /end MEASUREMENT
/begin COMPU_METHOD CU_DIN_P10_8_NPLCIRQ "Conversion method for din_p10_8_nplcirq" RAT_FUNC "%10.0" "(not defined)" COEFFS 0.000000 1.000000 -0.000000 0.000000 0.000000 1.000000 /end COMPU_METHOD
/* Scalar measurable for DDE 'din_p15_1_run'. */
/begin MEASUREMENT din_p15_1_run "RUN  (CCU pin K3)" UBYTE CU_DIN_P15_1_RUN 1 100 0.0 1.0 ECU_ADDRESS 0x70019efc BYTE_ORDER MSB_LAST /end MEASUREMENT
/begin COMPU_METHOD CU_DIN_P15_1_RUN "Conversion method for din_p15_1_run" RAT_FUNC "%10.0" "(not defined)" COEFFS 0.000000 1.000000 -0.000000 0.000000 0.000000 1.000000 /end COMPU_METHOD
/* Scalar measurable for DDE 'din_p22_0_qout3'. */
/begin MEASUREMENT din_p22_0_qout3 "QOUT3" UBYTE CU_DIN_P22_0_QOUT3 1 100 0.0 1.0 ECU_ADDRESS 0x70019eb4 BYTE_ORDER MSB_LAST /end MEASUREMENT
/begin COMPU_METHOD CU_DIN_P22_0_QOUT3 "Conversion method for din_p22_0_qout3" RAT_FUNC "%10.0" "(not defined)" COEFFS 0.000000 1.000000 -0.000000 0.000000 0.000000 1.000000 /end COMPU_METHOD
/* Scalar measurable for DDE 'din_p33_0_can_wake'. */
/begin MEASUREMENT din_p33_0_can_wake "CAN_WAKE" UBYTE CU_DIN_P33_0_CAN_WAKE 1 100 0.0 1.0 ECU_ADDRESS 0x7001a044 BYTE_ORDER MSB_LAST /end MEASUREMENT
/begin COMPU_METHOD CU_DIN_P33_0_CAN_WAKE "Conversion method for din_p33_0_can_wake" RAT_FUNC "%10.0" "(not defined)" COEFFS 0.000000 1.000000 -0.000000 0.000000 0.000000 1.000000 /end COMPU_METHOD
/* Scalar measurable for DDE 'din_p33_1_pilwake'. */
/begin MEASUREMENT din_p33_1_pilwake "PILWAKE (CCU pin A3)" UBYTE CU_DIN_P33_1_PILWAKE 1 100 0.0 1.0 ECU_ADDRESS 0x7001a110 BYTE_ORDER MSB_LAST /end MEASUREMENT
/begin COMPU_METHOD CU_DIN_P33_1_PILWAKE "Conversion method for din_p33_1_pilwake" RAT_FUNC "%10.0" "(not defined)" COEFFS 0.000000 1.000000 -0.000000 0.000000 0.000000 1.000000 /end COMPU_METHOD
/* Scalar measurable for DDE 'din_p33_9_ss1'. */
/begin MEASUREMENT din_p33_9_ss1 "SS1" UBYTE CU_DIN_P33_9_SS1 1 100 0.0 1.0 ECU_ADDRESS 0x7001a0e0 BYTE_ORDER MSB_LAST /end MEASUREMENT
/begin COMPU_METHOD CU_DIN_P33_9_SS1 "Conversion method for din_p33_9_ss1" RAT_FUNC "%10.0" "(not defined)" COEFFS 0.000000 1.000000 -0.000000 0.000000 0.000000 1.000000 /end COMPU_METHOD
/* Scalar measurable for DDE 'din_scu_fsp'. */
/begin MEASUREMENT din_scu_fsp "(not defined)" UBYTE CU_DIN_SCU_FSP 1 100 0.0 255.0 ECU_ADDRESS 0x70019ecc BYTE_ORDER MSB_LAST /end MEASUREMENT
/begin COMPU_METHOD CU_DIN_SCU_FSP "Conversion method for din_scu_fsp" RAT_FUNC "%10.0" "(not defined)" COEFFS 0.000000 1.000000 -0.000000 0.000000 0.000000 1.000000 /end COMPU_METHOD
/* Scalar measurable for DDE 'din_ss2_alt'. */
/begin MEASUREMENT din_ss2_alt "(not defined)" UBYTE CU_DIN_SS2_ALT 1 100 0.0 255.0 ECU_ADDRESS 0x70019fbc BYTE_ORDER MSB_LAST /end MEASUREMENT
/begin COMPU_METHOD CU_DIN_SS2_ALT "Conversion method for din_ss2_alt" RAT_FUNC "%10.0" "(not defined)" COEFFS 0.000000 1.000000 -0.000000 0.000000 0.000000 1.000000 /end COMPU_METHOD
/* Scalar measurable for DDE 'din_ss2_scu_stop'. */
/begin MEASUREMENT din_ss2_scu_stop "(not defined)" UBYTE CU_DIN_SS2_SCU_STOP 1 100 0.0 255.0 ECU_ADDRESS 0x7001a108 BYTE_ORDER MSB_LAST /end MEASUREMENT
/begin COMPU_METHOD CU_DIN_SS2_SCU_STOP "Conversion method for din_ss2_scu_stop" RAT_FUNC "%10.0" "(not defined)" COEFFS 0.000000 1.000000 -0.000000 0.000000 0.000000 1.000000 /end COMPU_METHOD
/* Scalar measurable for DDE 'flt_ain_bits'. */
/begin MEASUREMENT flt_ain_bits "Analog faults." UBYTE CU_FLT_AIN_BITS 1 100 0.0 255.0 ECU_ADDRESS 0x7001a001 BYTE_ORDER MSB_LAST /end MEASUREMENT
/begin COMPU_METHOD CU_FLT_AIN_BITS "Conversion method for flt_ain_bits" RAT_FUNC "%10.0" "(not defined)" COEFFS 0.000000 1.000000 -0.000000 0.000000 0.000000 1.000000 /end COMPU_METHOD
/* Scalar measurable for DDE 'ihbr_MaxFlt'. */
/begin MEASUREMENT ihbr_MaxFlt "Hbr imon above max threshold latched after debounce (CCU pin M3/M2)" UBYTE CU_IHBR_MAXFLT 1 100 0.0 1.0 ECU_ADDRESS 0x7001a138 BYTE_ORDER MSB_LAST /end MEASUREMENT
/begin COMPU_METHOD CU_IHBR_MAXFLT "Conversion method for ihbr_MaxFlt" RAT_FUNC "%10.0" "(not defined)" COEFFS 0.000000 1.000000 -0.000000 0.000000 0.000000 1.000000 /end COMPU_METHOD
/* Scalar measurable for DDE 'ihbr_MaxFltActv'. */
/begin MEASUREMENT ihbr_MaxFltActv "Active fault high M3/M2 (Max fault no latch or debounce)" UBYTE CU_IHBR_MAXFLTACTV 1 100 0.0 1.0 ECU_ADDRESS 0x7001a112 BYTE_ORDER MSB_LAST /end MEASUREMENT
/begin COMPU_METHOD CU_IHBR_MAXFLTACTV "Conversion method for ihbr_MaxFltActv" RAT_FUNC "%10.0" "(not defined)" COEFFS 0.000000 1.000000 -0.000000 0.000000 0.000000 1.000000 /end COMPU_METHOD
/* Scalar measurable for DDE 'ihbr_MinFlt'. */
/begin MEASUREMENT ihbr_MinFlt "Hbr imon below min threshold latched after debounce (CCU pin M3/M2)" UBYTE CU_IHBR_MINFLT 1 100 0.0 1.0 ECU_ADDRESS 0x7001a150 BYTE_ORDER MSB_LAST /end MEASUREMENT
/begin COMPU_METHOD CU_IHBR_MINFLT "Conversion method for ihbr_MinFlt" RAT_FUNC "%10.0" "(not defined)" COEFFS 0.000000 1.000000 -0.000000 0.000000 0.000000 1.000000 /end COMPU_METHOD
/* Scalar measurable for DDE 'ihbr_MinFltActv'. */
/begin MEASUREMENT ihbr_MinFltActv "Active fault low M3/M2 (Min fault no latch or debounce)" UBYTE CU_IHBR_MINFLTACTV 1 100 0.0 1.0 ECU_ADDRESS 0x7001a024 BYTE_ORDER MSB_LAST /end MEASUREMENT
/begin COMPU_METHOD CU_IHBR_MINFLTACTV "Conversion method for ihbr_MinFltActv" RAT_FUNC "%10.0" "(not defined)" COEFFS 0.000000 1.000000 -0.000000 0.000000 0.000000 1.000000 /end COMPU_METHOD
/* Scalar measurable for DDE 'out_vpilpeak_reset_output'. */
/begin MEASUREMENT out_vpilpeak_reset_output "Command for pilot peak reset." UBYTE CU_OUT_VPILPEAK_RESET_OUTPUT 1 100 0.0 255.0 ECU_ADDRESS 0x7001a04c BYTE_ORDER MSB_LAST /end MEASUREMENT
/begin COMPU_METHOD CU_OUT_VPILPEAK_RESET_OUTPUT "Conversion method for out_vpilpeak_reset_output" RAT_FUNC "%10.0" "(not defined)" COEFFS 0.000000 1.000000 -0.000000 0.000000 0.000000 1.000000 /end COMPU_METHOD
/* Scalar measurable for DDE 'v3V3io_MaxFlt'. */
/begin MEASUREMENT v3V3io_MaxFlt "Internal 3V3 IO above max threshold latched after debounce" UBYTE CU_V3V3IO_MAXFLT 1 100 0.0 1.0 ECU_ADDRESS 0x7001a0d9 BYTE_ORDER MSB_LAST /end MEASUREMENT
/begin COMPU_METHOD CU_V3V3IO_MAXFLT "Conversion method for v3V3io_MaxFlt" RAT_FUNC "%10.0" "(not defined)" COEFFS 0.000000 1.000000 -0.000000 0.000000 0.000000 1.000000 /end COMPU_METHOD
/* Scalar measurable for DDE 'v3V3io_MaxFltActv'. */
/begin MEASUREMENT v3V3io_MaxFltActv "Active fault high (Max fault no latch or debounce)" UBYTE CU_V3V3IO_MAXFLTACTV 1 100 0.0 1.0 ECU_ADDRESS 0x7001a051 BYTE_ORDER MSB_LAST /end MEASUREMENT
/begin COMPU_METHOD CU_V3V3IO_MAXFLTACTV "Conversion method for v3V3io_MaxFltActv" RAT_FUNC "%10.0" "(not defined)" COEFFS 0.000000 1.000000 -0.000000 0.000000 0.000000 1.000000 /end COMPU_METHOD
/* Scalar measurable for DDE 'v3V3io_MinFlt'. */
/begin MEASUREMENT v3V3io_MinFlt "Internal 3V3 IO below min threshold latched after debounce" UBYTE CU_V3V3IO_MINFLT 1 100 0.0 1.0 ECU_ADDRESS 0x7001a151 BYTE_ORDER MSB_LAST /end MEASUREMENT
/begin COMPU_METHOD CU_V3V3IO_MINFLT "Conversion method for v3V3io_MinFlt" RAT_FUNC "%10.0" "(not defined)" COEFFS 0.000000 1.000000 -0.000000 0.000000 0.000000 1.000000 /end COMPU_METHOD
/* Scalar measurable for DDE 'v3V3io_MinFltActv'. */
/begin MEASUREMENT v3V3io_MinFltActv "Active fault low (Min fault no latch or debounce)" UBYTE CU_V3V3IO_MINFLTACTV 1 100 0.0 1.0 ECU_ADDRESS 0x70019f5c BYTE_ORDER MSB_LAST /end MEASUREMENT
/begin COMPU_METHOD CU_V3V3IO_MINFLTACTV "Conversion method for v3V3io_MinFltActv" RAT_FUNC "%10.0" "(not defined)" COEFFS 0.000000 1.000000 -0.000000 0.000000 0.000000 1.000000 /end COMPU_METHOD
/* Scalar measurable for DDE 'v3V3qca_MaxFlt'. */
/begin MEASUREMENT v3V3qca_MaxFlt "Internal 3V3 QCA above max threshold latched after debounce" UBYTE CU_V3V3QCA_MAXFLT 1 100 0.0 1.0 ECU_ADDRESS 0x7001a099 BYTE_ORDER MSB_LAST /end MEASUREMENT
/begin COMPU_METHOD CU_V3V3QCA_MAXFLT "Conversion method for v3V3qca_MaxFlt" RAT_FUNC "%10.0" "(not defined)" COEFFS 0.000000 1.000000 -0.000000 0.000000 0.000000 1.000000 /end COMPU_METHOD
/* Scalar measurable for DDE 'v3V3qca_MaxFltActv'. */
/begin MEASUREMENT v3V3qca_MaxFltActv "Active fault high (Max fault no latch or debounce)" UBYTE CU_V3V3QCA_MAXFLTACTV 1 100 0.0 1.0 ECU_ADDRESS 0x70019ebd BYTE_ORDER MSB_LAST /end MEASUREMENT
/begin COMPU_METHOD CU_V3V3QCA_MAXFLTACTV "Conversion method for v3V3qca_MaxFltActv" RAT_FUNC "%10.0" "(not defined)" COEFFS 0.000000 1.000000 -0.000000 0.000000 0.000000 1.000000 /end COMPU_METHOD
/* Scalar measurable for DDE 'v3V3qca_MinFlt'. */
/begin MEASUREMENT v3V3qca_MinFlt "Internal 3V3 QCA below min threshold latched after debounce" UBYTE CU_V3V3QCA_MINFLT 1 100 0.0 1.0 ECU_ADDRESS 0x7001a08c BYTE_ORDER MSB_LAST /end MEASUREMENT
/begin COMPU_METHOD CU_V3V3QCA_MINFLT "Conversion method for v3V3qca_MinFlt" RAT_FUNC "%10.0" "(not defined)" COEFFS 0.000000 1.000000 -0.000000 0.000000 0.000000 1.000000 /end COMPU_METHOD
/* Scalar measurable for DDE 'v3V3qca_MinFltActv'. */
/begin MEASUREMENT v3V3qca_MinFltActv "Active fault low (Min fault no latch or debounce)" UBYTE CU_V3V3QCA_MINFLTACTV 1 100 0.0 1.0 ECU_ADDRESS 0x7001a184 BYTE_ORDER MSB_LAST /end MEASUREMENT
/begin COMPU_METHOD CU_V3V3QCA_MINFLTACTV "Conversion method for v3V3qca_MinFltActv" RAT_FUNC "%10.0" "(not defined)" COEFFS 0.000000 1.000000 -0.000000 0.000000 0.000000 1.000000 /end COMPU_METHOD
/* Scalar measurable for DDE 'v3V3uc_MaxFlt'. */
/begin MEASUREMENT v3V3uc_MaxFlt "Internal 3V3 Micro above max threshold latched after debounce" UBYTE CU_V3V3UC_MAXFLT 1 100 0.0 1.0 ECU_ADDRESS 0x7001a080 BYTE_ORDER MSB_LAST /end MEASUREMENT
/begin COMPU_METHOD CU_V3V3UC_MAXFLT "Conversion method for v3V3uc_MaxFlt" RAT_FUNC "%10.0" "(not defined)" COEFFS 0.000000 1.000000 -0.000000 0.000000 0.000000 1.000000 /end COMPU_METHOD
/* Scalar measurable for DDE 'v3V3uc_MaxFltActv'. */
/begin MEASUREMENT v3V3uc_MaxFltActv "Active fault high (Max fault no latch or debounce)" UBYTE CU_V3V3UC_MAXFLTACTV 1 100 0.0 1.0 ECU_ADDRESS 0x7001a010 BYTE_ORDER MSB_LAST /end MEASUREMENT
/begin COMPU_METHOD CU_V3V3UC_MAXFLTACTV "Conversion method for v3V3uc_MaxFltActv" RAT_FUNC "%10.0" "(not defined)" COEFFS 0.000000 1.000000 -0.000000 0.000000 0.000000 1.000000 /end COMPU_METHOD
/* Scalar measurable for DDE 'v3V3uc_MinFlt'. */
/begin MEASUREMENT v3V3uc_MinFlt "Internal 3V3 Micro below min threshold latched after debounce" UBYTE CU_V3V3UC_MINFLT 1 100 0.0 1.0 ECU_ADDRESS 0x70019f38 BYTE_ORDER MSB_LAST /end MEASUREMENT
/begin COMPU_METHOD CU_V3V3UC_MINFLT "Conversion method for v3V3uc_MinFlt" RAT_FUNC "%10.0" "(not defined)" COEFFS 0.000000 1.000000 -0.000000 0.000000 0.000000 1.000000 /end COMPU_METHOD
/* Scalar measurable for DDE 'v3V3uc_MinFltActv'. */
/begin MEASUREMENT v3V3uc_MinFltActv "Active fault low (Min fault no latch or debounce)" UBYTE CU_V3V3UC_MINFLTACTV 1 100 0.0 1.0 ECU_ADDRESS 0x70019f04 BYTE_ORDER MSB_LAST /end MEASUREMENT
/begin COMPU_METHOD CU_V3V3UC_MINFLTACTV "Conversion method for v3V3uc_MinFltActv" RAT_FUNC "%10.0" "(not defined)" COEFFS 0.000000 1.000000 -0.000000 0.000000 0.000000 1.000000 /end COMPU_METHOD
/* Scalar measurable for DDE 'v5vdd_MaxFlt'. */
/begin MEASUREMENT v5vdd_MaxFlt "Internal 5VDD above max threshold latched after debounce" UBYTE CU_V5VDD_MAXFLT 1 100 0.0 1.0 ECU_ADDRESS 0x70019f98 BYTE_ORDER MSB_LAST /end MEASUREMENT
/begin COMPU_METHOD CU_V5VDD_MAXFLT "Conversion method for v5vdd_MaxFlt" RAT_FUNC "%10.0" "(not defined)" COEFFS 0.000000 1.000000 -0.000000 0.000000 0.000000 1.000000 /end COMPU_METHOD
/* Scalar measurable for DDE 'v5vdd_MaxFltActv'. */
/begin MEASUREMENT v5vdd_MaxFltActv "Active fault high (Max fault no latch or debounce)" UBYTE CU_V5VDD_MAXFLTACTV 1 100 0.0 1.0 ECU_ADDRESS 0x70019fb4 BYTE_ORDER MSB_LAST /end MEASUREMENT
/begin COMPU_METHOD CU_V5VDD_MAXFLTACTV "Conversion method for v5vdd_MaxFltActv" RAT_FUNC "%10.0" "(not defined)" COEFFS 0.000000 1.000000 -0.000000 0.000000 0.000000 1.000000 /end COMPU_METHOD
/* Scalar measurable for DDE 'v5vdd_MinFlt'. */
/begin MEASUREMENT v5vdd_MinFlt "Internal 5VDD below min threshold latched after debounce" UBYTE CU_V5VDD_MINFLT 1 100 0.0 1.0 ECU_ADDRESS 0x70019f65 BYTE_ORDER MSB_LAST /end MEASUREMENT
/begin COMPU_METHOD CU_V5VDD_MINFLT "Conversion method for v5vdd_MinFlt" RAT_FUNC "%10.0" "(not defined)" COEFFS 0.000000 1.000000 -0.000000 0.000000 0.000000 1.000000 /end COMPU_METHOD
/* Scalar measurable for DDE 'v5vdd_MinFltActv'. */
/begin MEASUREMENT v5vdd_MinFltActv "Active fault low (Min fault no latch or debounce)" UBYTE CU_V5VDD_MINFLTACTV 1 100 0.0 1.0 ECU_ADDRESS 0x70019f0c BYTE_ORDER MSB_LAST /end MEASUREMENT
/begin COMPU_METHOD CU_V5VDD_MINFLTACTV "Conversion method for v5vdd_MinFltActv" RAT_FUNC "%10.0" "(not defined)" COEFFS 0.000000 1.000000 -0.000000 0.000000 0.000000 1.000000 /end COMPU_METHOD
/begin FUNCTION Analog_Inputs "Group /ByModelHeirarchy/LaforgeTestApp_CCU/Core0-TestApp/Analog_Inputs"
 /begin LOC_MEASUREMENT A2_vproxim_MaxFlt A2_vproxim_MaxFltActv A2_vproxim_MinFlt A2_vproxim_MinFltActv A3_vpilot_MaxFlt A3_vpilot_MaxFltActv A3_vpilot_MinFlt A3_vpilot_MinFltActv A3_vpilpeak_MaxFlt A3_vpilpeak_MaxFltActv A3_vpilpeak_MinFlt A3_vpilpeak_MinFltActv B2_vtempa_MaxFlt B2_vtempa_MaxFltActv B2_vtempa_MinFlt B2_vtempa_MinFltActv B3_vtempb_MaxFlt B3_vtempb_MaxFltActv B3_vtempb_MinFlt B3_vtempb_MinFltActv B4_vtempc_MaxFlt B4_vtempc_MaxFltActv B4_vtempc_MinFlt B4_vtempc_MinFltActv C2_vtempd_MaxFlt C2_vtempd_MaxFltActv C2_vtempd_MinFlt C2_vtempd_MinFltActv CcsPilotClear D3_AinE_MaxFlt D3_AinE_MaxFltActv D3_AinE_MinFlt D3_AinE_MinFltActv F2_LedA_MaxFlt F2_LedA_MaxFltActv F2_LedA_MinFlt F2_LedA_MinFltActv F3_LedB_MaxFlt F3_LedB_MaxFltActv F3_LedB_MinFlt F3_LedB_MinFltActv F4_LedC_MaxFlt F4_LedC_MaxFltActv F4_LedC_MinFlt F4_LedC_MinFltActv K3_ignition_MaxFlt K3_ignition_MaxFltActv K3_ignition_MinFlt K3_ignition_MinFltActv M2_HbrNVmon_MaxFlt M2_HbrNVmon_MaxFltActv M2_HbrNVmon_MinFlt M2_HbrNVmon_MinFltActv M3_HbrPVmon_MaxFlt M3_HbrPVmon_MaxFltActv M3_HbrPVmon_MinFlt M3_HbrPVmon_MinFltActv TempIntDegC_MaxFlt TempIntDegC_MaxFltActv TempIntDegC_MinFlt TempIntDegC_MinFltActv TempInt_MaxFlt TempInt_MaxFltActv TempInt_MinFlt TempInt_MinFltActv Vbat_MaxFlt Vbat_MaxFltActv Vbat_MinFlt Vbat_MinFltActv VrefA_MaxFlt VrefA_MaxFltActv VrefA_MinFlt VrefA_MinFltActv VrefB_MaxFlt VrefB_MaxFltActv VrefB_MinFlt VrefB_MinFltActv ain_3V3io_ext_filt ain_3V3io_ext_unfilt ain_3V3io_int_filt ain_3V3io_int_unfilt ain_3V3qca_ext_filt ain_3V3qca_ext_unfilt ain_3V3qca_int_filt ain_3V3qca_int_unfilt ain_3V3uc_ext_filt ain_3V3uc_ext_unfilt ain_3V3uc_int_filt ain_3V3uc_int_unfilt ain_5vdd_ext_filt ain_5vdd_ext_unfilt ain_5vdd_int_filt ain_5vdd_int_unfilt ain_A2_vproxim_ext_filt ain_A2_vproxim_ext_unfilt ain_A2_vproxim_int_filt ain_A2_vproxim_int_unfilt ain_A3_vpilot_ext_filt ain_A3_vpilot_ext_unfilt ain_A3_vpilot_int_filt ain_A3_vpilot_int_unfilt ain_A3_vpilpeak_ext_filt ain_A3_vpilpeak_ext_unfilt ain_A3_vpilpeak_int_filt ain_A3_vpilpeak_int_preFilt ain_A3_vpilpeak_int_unfilt ain_A3_vpilpeak_int_unfilt_held ain_B2_vtempa_filt ain_B2_vtempa_unfilt ain_B3_vtempb_filt ain_B3_vtempb_unfilt ain_B4_vtempc_filt ain_B4_vtempc_unfilt ain_C2_vtempd_filt ain_C2_vtempd_unfilt ain_D3_AinE_ext_filt ain_D3_AinE_ext_unfilt ain_D3_AinE_int_filt ain_D3_AinE_int_unfilt ain_F2_LedA_ext_filt ain_F2_LedA_ext_unfilt ain_F2_LedA_int_filt ain_F2_LedA_int_unfilt ain_F3_LedB_ext_filt ain_F3_LedB_ext_unfilt ain_F3_LedB_int_filt ain_F3_LedB_int_unfilt ain_F4_LedC_ext_filt ain_F4_LedC_ext_unfilt ain_F4_LedC_int_filt ain_F4_LedC_int_unfilt ain_K3_ignition_ext_filt ain_K3_ignition_ext_unfilt ain_K3_ignition_int_filt ain_K3_ignition_int_unfilt ain_M2_HbrNVmon_ext_filt ain_M2_HbrNVmon_ext_unfilt ain_M2_HbrNVmon_int_filt ain_M2_HbrNVmon_int_unfilt ain_M3_HbrPVmon_ext_filt ain_M3_HbrPVmon_ext_unfilt ain_M3_HbrPVmon_int_filt ain_M3_HbrPVmon_int_unfilt ain_TempIntDegC ain_TempInt_ext_filt ain_TempInt_ext_unfilt ain_TempInt_int_filt ain_TempInt_int_unfilt ain_Vbat_ext_filt ain_Vbat_ext_unfilt ain_Vbat_int_filt ain_Vbat_int_unfilt ain_VrefA_ext_filt ain_VrefA_ext_unfilt ain_VrefA_int_filt ain_VrefA_int_unfilt ain_VrefB_ext_filt ain_VrefB_ext_unfilt ain_VrefB_int_filt ain_VrefB_int_unfilt ain_ihbr_ext_filt ain_ihbr_ext_unfilt ain_ihbr_int_filt ain_ihbr_int_unfilt flt_ain_bits ihbr_MaxFlt ihbr_MaxFltActv ihbr_MinFlt ihbr_MinFltActv out_vpilpeak_reset_output v3V3io_MaxFlt v3V3io_MaxFltActv v3V3io_MinFlt v3V3io_MinFltActv v3V3qca_MaxFlt v3V3qca_MaxFltActv v3V3qca_MinFlt v3V3qca_MinFltActv v3V3uc_MaxFlt v3V3uc_MaxFltActv v3V3uc_MinFlt v3V3uc_MinFltActv v5vdd_MaxFlt v5vdd_MaxFltActv v5vdd_MinFlt v5vdd_MinFltActv /end LOC_MEASUREMENT
 /begin REF_CHARACTERISTIC A2_vproxim_FltMax_C A2_vproxim_FltMin_C A2_vproxim_ScaleFactor_C A3_vpilot_FltMax_C A3_vpilot_FltMin_C A3_vpilot_Offset_C A3_vpilot_ScaleFactor_C A3_vpilpeak_FltMax_C A3_vpilpeak_FltMin_C A3_vpilpeak_Offset_C A3_vpilpeak_ScaleFactor_C B4_vtempc_FltMax_C B4_vtempc_FltMin_C C2_vtempd_FltMax_C C2_vtempd_FltMin_C D3_AinE_FltMax_C D3_AinE_FltMin_C D3_AinE_ScaleFactor_C F2_LedA_FltMax_C F2_LedA_FltMin_C F2_LedA_ScaleFactor_C F3_LedB_FltMax_C F3_LedB_FltMin_C F3_LedB_ScaleFactor_C F4_LedC_FltMax_C F4_LedC_FltMin_C F4_LedC_ScaleFactor_C K3_ignition_FltMax_C K3_ignition_FltMin_C K3_ignition_ScaleFactor_C M2_HbrNVmon_FltMax_C M2_HbrNVmon_FltMin_C M2_HbrNVmon_ScaleFactor_C M3_HbrPVmon_FltMax_C M3_HbrPVmon_FltMin_C M3_HbrPVmon_ScaleFactor_C TempIntDegC_FltMax_C TempIntDegC_FltMin_C TempInt_FltMax_C TempInt_FltMin_C TempInt_ScaleFactor_C Vbat_FltMax_C Vbat_FltMin_C Vbat_ScaleFactor_C VrefA_FltMax_C VrefA_FltMin_C VrefA_ScaleFactor_C VrefB_FltMax_C VrefB_FltMin_C VrefB_ScaleFactor_C ainc_an15_vtempa_a_max ainc_an15_vtempa_a_min ainc_an17_vtempb_a_max ainc_an17_vtempb_a_min dotc_Enbl_OverrideVpkClr dotc_OverrideVpilpeakClear ihbr_FltMax_C ihbr_FltMin_C ihbr_ScaleFactor_C lpfc_tc_3V3io lpfc_tc_3V3qca lpfc_tc_3V3uc lpfc_tc_5vdd lpfc_tc_A2_vproxim lpfc_tc_A3_vpilot lpfc_tc_A3_vpilpeak lpfc_tc_B2_vtempa lpfc_tc_B3_vtempb lpfc_tc_B4_vtempc lpfc_tc_C2_vtempd lpfc_tc_D3_AinE lpfc_tc_F2_VLEDA lpfc_tc_F3_VLEDB lpfc_tc_F4_VLEDC lpfc_tc_K3_ignition lpfc_tc_M2_HbrNVmon lpfc_tc_M3_HbrPVmon lpfc_tc_TempInt lpfc_tc_Vbat lpfc_tc_VrefA lpfc_tc_VrefB lpfc_tc_ihbr mbec_b_clearfault mbec_s_fltdebounce v3V3io_FltMax_C v3V3io_FltMin_C v3V3io_ScaleFactor_C v3V3qca_FltMax_C v3V3qca_FltMin_C v3V3qca_ScaleFactor_C v3V3uc_FltMax_C v3V3uc_FltMin_C v3V3uc_ScaleFactor_C v5vdd_FltMax_C v5vdd_FltMin_C v5vdd_ScaleFactor_C /end REF_CHARACTERISTIC
/end FUNCTION
/begin FUNCTION Tx "Group /ByModelHeirarchy/LaforgeTestApp_CCU/Core0-TestApp/CAN bus loader/0x777 at 0.5ms/Tx" /begin REF_CHARACTERISTIC CANLoadBytes_V /end REF_CHARACTERISTIC /end FUNCTION
/begin FUNCTION _0x777_at_0.5ms "Group /ByModelHeirarchy/LaforgeTestApp_CCU/Core0-TestApp/CAN bus loader/0x777 at 0.5ms" /begin SUB_FUNCTION Tx /end SUB_FUNCTION /end FUNCTION
/begin FUNCTION Tx1 "Group /ByModelHeirarchy/LaforgeTestApp_CCU/Core0-TestApp/CAN bus loader/0x778 at 0.5ms/Tx" /begin REF_CHARACTERISTIC CANLoadBytes_V /end REF_CHARACTERISTIC /end FUNCTION
/begin FUNCTION _0x778_at_0.5ms "Group /ByModelHeirarchy/LaforgeTestApp_CCU/Core0-TestApp/CAN bus loader/0x778 at 0.5ms" /begin SUB_FUNCTION Tx1 /end SUB_FUNCTION /end FUNCTION
/begin FUNCTION Tx2 "Group /ByModelHeirarchy/LaforgeTestApp_CCU/Core0-TestApp/CAN bus loader/0x779 at 0.5ms/Tx" /begin REF_CHARACTERISTIC CANLoadBytes_V /end REF_CHARACTERISTIC /end FUNCTION
/begin FUNCTION _0x779_at_0.5ms "Group /ByModelHeirarchy/LaforgeTestApp_CCU/Core0-TestApp/CAN bus loader/0x779 at 0.5ms" /begin SUB_FUNCTION Tx2 /end SUB_FUNCTION /end FUNCTION
/begin FUNCTION Tx3 "Group /ByModelHeirarchy/LaforgeTestApp_CCU/Core0-TestApp/CAN bus loader/0x77A at 0.5ms/Tx" /begin REF_CHARACTERISTIC CANLoadBytes_V /end REF_CHARACTERISTIC /end FUNCTION
/begin FUNCTION _0x77A_at_0.5ms "Group /ByModelHeirarchy/LaforgeTestApp_CCU/Core0-TestApp/CAN bus loader/0x77A at 0.5ms" /begin SUB_FUNCTION Tx3 /end SUB_FUNCTION /end FUNCTION
/begin FUNCTION Tx4 "Group /ByModelHeirarchy/LaforgeTestApp_CCU/Core0-TestApp/CAN bus loader/0x77B at 0.5ms/Tx" /begin REF_CHARACTERISTIC CANLoadBytes_V /end REF_CHARACTERISTIC /end FUNCTION
/begin FUNCTION _0x77B_at_0.5ms "Group /ByModelHeirarchy/LaforgeTestApp_CCU/Core0-TestApp/CAN bus loader/0x77B at 0.5ms" /begin SUB_FUNCTION Tx4 /end SUB_FUNCTION /end FUNCTION
/begin FUNCTION Tx5 "Group /ByModelHeirarchy/LaforgeTestApp_CCU/Core0-TestApp/CAN bus loader/0x77C at 0.5ms/Tx" /begin REF_CHARACTERISTIC CANLoadBytes_V /end REF_CHARACTERISTIC /end FUNCTION
/begin FUNCTION _0x77C_at_0.5ms "Group /ByModelHeirarchy/LaforgeTestApp_CCU/Core0-TestApp/CAN bus loader/0x77C at 0.5ms" /begin SUB_FUNCTION Tx5 /end SUB_FUNCTION /end FUNCTION
/begin FUNCTION Tx6 "Group /ByModelHeirarchy/LaforgeTestApp_CCU/Core0-TestApp/CAN bus loader/0x77D at 0.5ms/Tx" /begin REF_CHARACTERISTIC CANLoadBytes_V /end REF_CHARACTERISTIC /end FUNCTION
/begin FUNCTION _0x77D_at_0.5ms "Group /ByModelHeirarchy/LaforgeTestApp_CCU/Core0-TestApp/CAN bus loader/0x77D at 0.5ms" /begin SUB_FUNCTION Tx6 /end SUB_FUNCTION /end FUNCTION
/begin FUNCTION Tx7 "Group /ByModelHeirarchy/LaforgeTestApp_CCU/Core0-TestApp/CAN bus loader/0x77E at 0.5ms/Tx" /begin REF_CHARACTERISTIC CANLoadBytes_V /end REF_CHARACTERISTIC /end FUNCTION
/begin FUNCTION _0x77E_at_0.5ms "Group /ByModelHeirarchy/LaforgeTestApp_CCU/Core0-TestApp/CAN bus loader/0x77E at 0.5ms" /begin SUB_FUNCTION Tx7 /end SUB_FUNCTION /end FUNCTION
/begin FUNCTION Tx8 "Group /ByModelHeirarchy/LaforgeTestApp_CCU/Core0-TestApp/CAN bus loader/0x77F at 0.25ms/Tx" /begin REF_CHARACTERISTIC CANLoadBytes_V /end REF_CHARACTERISTIC /end FUNCTION
/begin FUNCTION _0x77F_at_0.25ms "Group /ByModelHeirarchy/LaforgeTestApp_CCU/Core0-TestApp/CAN bus loader/0x77F at 0.25ms" /begin SUB_FUNCTION Tx8 /end SUB_FUNCTION /end FUNCTION
/begin FUNCTION Tx9 "Group /ByModelHeirarchy/LaforgeTestApp_CCU/Core0-TestApp/CAN bus loader/0x780 at 0.25ms/Tx" /begin REF_CHARACTERISTIC CANLoadBytes_V /end REF_CHARACTERISTIC /end FUNCTION
/begin FUNCTION _0x780_at_0.25ms "Group /ByModelHeirarchy/LaforgeTestApp_CCU/Core0-TestApp/CAN bus loader/0x780 at 0.25ms" /begin SUB_FUNCTION Tx9 /end SUB_FUNCTION /end FUNCTION
/begin FUNCTION T00 "Group /ByModelHeirarchy/LaforgeTestApp_CCU/Core0-TestApp/CAN bus loader/0x781 at 0.25ms/Tx" /begin REF_CHARACTERISTIC CANLoadBytes_V /end REF_CHARACTERISTIC /end FUNCTION
/begin FUNCTION _0x781_at_0.25ms "Group /ByModelHeirarchy/LaforgeTestApp_CCU/Core0-TestApp/CAN bus loader/0x781 at 0.25ms" /begin SUB_FUNCTION T00 /end SUB_FUNCTION /end FUNCTION
/begin FUNCTION T01 "Group /ByModelHeirarchy/LaforgeTestApp_CCU/Core0-TestApp/CAN bus loader/0x782 at 0.25ms/Tx" /begin REF_CHARACTERISTIC CANLoadBytes_V /end REF_CHARACTERISTIC /end FUNCTION
/begin FUNCTION _0x782_at_0.25ms "Group /ByModelHeirarchy/LaforgeTestApp_CCU/Core0-TestApp/CAN bus loader/0x782 at 0.25ms" /begin SUB_FUNCTION T01 /end SUB_FUNCTION /end FUNCTION
/begin FUNCTION T02 "Group /ByModelHeirarchy/LaforgeTestApp_CCU/Core0-TestApp/CAN bus loader/0x783 at 0.5ms/Tx" /begin REF_CHARACTERISTIC CANLoadBytes_V /end REF_CHARACTERISTIC /end FUNCTION
/begin FUNCTION _0x783_at_0.5ms "Group /ByModelHeirarchy/LaforgeTestApp_CCU/Core0-TestApp/CAN bus loader/0x783 at 0.5ms" /begin SUB_FUNCTION T02 /end SUB_FUNCTION /end FUNCTION
/begin FUNCTION T03 "Group /ByModelHeirarchy/LaforgeTestApp_CCU/Core0-TestApp/CAN bus loader/0x784 at 0.5ms/Tx" /begin REF_CHARACTERISTIC CANLoadBytes_V /end REF_CHARACTERISTIC /end FUNCTION
/begin FUNCTION _0x784_at_0.5ms "Group /ByModelHeirarchy/LaforgeTestApp_CCU/Core0-TestApp/CAN bus loader/0x784 at 0.5ms" /begin SUB_FUNCTION T03 /end SUB_FUNCTION /end FUNCTION
/begin FUNCTION T04 "Group /ByModelHeirarchy/LaforgeTestApp_CCU/Core0-TestApp/CAN bus loader/0x785 at 0.5ms/Tx" /begin REF_CHARACTERISTIC CANLoadBytes_V /end REF_CHARACTERISTIC /end FUNCTION
/begin FUNCTION _0x785_at_0.5ms "Group /ByModelHeirarchy/LaforgeTestApp_CCU/Core0-TestApp/CAN bus loader/0x785 at 0.5ms" /begin SUB_FUNCTION T04 /end SUB_FUNCTION /end FUNCTION
/begin FUNCTION T05 "Group /ByModelHeirarchy/LaforgeTestApp_CCU/Core0-TestApp/CAN bus loader/0x786 at 0.5ms/Tx" /begin REF_CHARACTERISTIC CANLoadBytes_V /end REF_CHARACTERISTIC /end FUNCTION
/begin FUNCTION _0x786_at_0.5ms "Group /ByModelHeirarchy/LaforgeTestApp_CCU/Core0-TestApp/CAN bus loader/0x786 at 0.5ms" /begin SUB_FUNCTION T05 /end SUB_FUNCTION /end FUNCTION
/begin FUNCTION T06 "Group /ByModelHeirarchy/LaforgeTestApp_CCU/Core0-TestApp/CAN bus loader/0x787 at 0.5ms/Tx" /begin REF_CHARACTERISTIC CANLoadBytes_V /end REF_CHARACTERISTIC /end FUNCTION
/begin FUNCTION _0x787_at_0.5ms "Group /ByModelHeirarchy/LaforgeTestApp_CCU/Core0-TestApp/CAN bus loader/0x787 at 0.5ms" /begin SUB_FUNCTION T06 /end SUB_FUNCTION /end FUNCTION
/begin FUNCTION T07 "Group /ByModelHeirarchy/LaforgeTestApp_CCU/Core0-TestApp/CAN bus loader/0x788 at 0.5ms/Tx" /begin REF_CHARACTERISTIC CANLoadBytes_V /end REF_CHARACTERISTIC /end FUNCTION
/begin FUNCTION _0x788_at_0.5ms "Group /ByModelHeirarchy/LaforgeTestApp_CCU/Core0-TestApp/CAN bus loader/0x788 at 0.5ms" /begin SUB_FUNCTION T07 /end SUB_FUNCTION /end FUNCTION
/begin FUNCTION T08 "Group /ByModelHeirarchy/LaforgeTestApp_CCU/Core0-TestApp/CAN bus loader/0x789 at 0.5ms/Tx" /begin REF_CHARACTERISTIC CANLoadBytes_V /end REF_CHARACTERISTIC /end FUNCTION
/begin FUNCTION _0x789_at_0.5ms "Group /ByModelHeirarchy/LaforgeTestApp_CCU/Core0-TestApp/CAN bus loader/0x789 at 0.5ms" /begin SUB_FUNCTION T08 /end SUB_FUNCTION /end FUNCTION
/begin FUNCTION T09 "Group /ByModelHeirarchy/LaforgeTestApp_CCU/Core0-TestApp/CAN bus loader/0x78A at 0.5ms/Tx" /begin REF_CHARACTERISTIC CANLoadBytes_V /end REF_CHARACTERISTIC /end FUNCTION
/begin FUNCTION _0x78A_at_0.5ms "Group /ByModelHeirarchy/LaforgeTestApp_CCU/Core0-TestApp/CAN bus loader/0x78A at 0.5ms" /begin SUB_FUNCTION T09 /end SUB_FUNCTION /end FUNCTION
/begin FUNCTION T10 "Group /ByModelHeirarchy/LaforgeTestApp_CCU/Core0-TestApp/CAN bus loader/0x78B at 0.5ms/Tx" /begin REF_CHARACTERISTIC CANLoadBytes_V /end REF_CHARACTERISTIC /end FUNCTION
/begin FUNCTION _0x78B_at_0.5ms "Group /ByModelHeirarchy/LaforgeTestApp_CCU/Core0-TestApp/CAN bus loader/0x78B at 0.5ms" /begin SUB_FUNCTION T10 /end SUB_FUNCTION /end FUNCTION
/begin FUNCTION T11 "Group /ByModelHeirarchy/LaforgeTestApp_CCU/Core0-TestApp/CAN bus loader/0x78C at 0.5ms/Tx" /begin REF_CHARACTERISTIC CANLoadBytes_V /end REF_CHARACTERISTIC /end FUNCTION
/begin FUNCTION _0x78C_at_0.5ms "Group /ByModelHeirarchy/LaforgeTestApp_CCU/Core0-TestApp/CAN bus loader/0x78C at 0.5ms" /begin SUB_FUNCTION T11 /end SUB_FUNCTION /end FUNCTION
/begin FUNCTION T12 "Group /ByModelHeirarchy/LaforgeTestApp_CCU/Core0-TestApp/CAN bus loader/0x78D at 0.5ms/Tx" /begin REF_CHARACTERISTIC CANLoadBytes_V /end REF_CHARACTERISTIC /end FUNCTION
/begin FUNCTION _0x78D_at_0.5ms "Group /ByModelHeirarchy/LaforgeTestApp_CCU/Core0-TestApp/CAN bus loader/0x78D at 0.5ms" /begin SUB_FUNCTION T12 /end SUB_FUNCTION /end FUNCTION
/begin FUNCTION T13 "Group /ByModelHeirarchy/LaforgeTestApp_CCU/Core0-TestApp/CAN bus loader/0x78E at 0.5ms/Tx" /begin REF_CHARACTERISTIC CANLoadBytes_V /end REF_CHARACTERISTIC /end FUNCTION
/begin FUNCTION _0x78E_at_0.5ms "Group /ByModelHeirarchy/LaforgeTestApp_CCU/Core0-TestApp/CAN bus loader/0x78E at 0.5ms" /begin SUB_FUNCTION T13 /end SUB_FUNCTION /end FUNCTION
/begin FUNCTION T14 "Group /ByModelHeirarchy/LaforgeTestApp_CCU/Core0-TestApp/CAN bus loader/0x78F at 0.5ms/Tx" /begin REF_CHARACTERISTIC CANLoadBytes_V /end REF_CHARACTERISTIC /end FUNCTION
/begin FUNCTION _0x78F_at_0.5ms "Group /ByModelHeirarchy/LaforgeTestApp_CCU/Core0-TestApp/CAN bus loader/0x78F at 0.5ms" /begin SUB_FUNCTION T14 /end SUB_FUNCTION /end FUNCTION
/begin FUNCTION T15 "Group /ByModelHeirarchy/LaforgeTestApp_CCU/Core0-TestApp/CAN bus loader/0x790 at 0.5ms/Tx" /begin REF_CHARACTERISTIC CANLoadBytes_V /end REF_CHARACTERISTIC /end FUNCTION
/begin FUNCTION _0x790_at_0.5ms "Group /ByModelHeirarchy/LaforgeTestApp_CCU/Core0-TestApp/CAN bus loader/0x790 at 0.5ms" /begin SUB_FUNCTION T15 /end SUB_FUNCTION /end FUNCTION
/begin FUNCTION T16 "Group /ByModelHeirarchy/LaforgeTestApp_CCU/Core0-TestApp/CAN bus loader/0x791 at 0.5ms/Tx" /begin REF_CHARACTERISTIC CANLoadBytes_V /end REF_CHARACTERISTIC /end FUNCTION
/begin FUNCTION _0x791_at_0.5ms "Group /ByModelHeirarchy/LaforgeTestApp_CCU/Core0-TestApp/CAN bus loader/0x791 at 0.5ms" /begin SUB_FUNCTION T16 /end SUB_FUNCTION /end FUNCTION
/begin FUNCTION T17 "Group /ByModelHeirarchy/LaforgeTestApp_CCU/Core0-TestApp/CAN bus loader/0x792 at 0.5ms/Tx" /begin REF_CHARACTERISTIC CANLoadBytes_V /end REF_CHARACTERISTIC /end FUNCTION
/begin FUNCTION _0x792_at_0.5ms "Group /ByModelHeirarchy/LaforgeTestApp_CCU/Core0-TestApp/CAN bus loader/0x792 at 0.5ms" /begin SUB_FUNCTION T17 /end SUB_FUNCTION /end FUNCTION
/begin FUNCTION T18 "Group /ByModelHeirarchy/LaforgeTestApp_CCU/Core0-TestApp/CAN bus loader/0x793 at 0.5ms/Tx" /begin REF_CHARACTERISTIC CANLoadBytes_V /end REF_CHARACTERISTIC /end FUNCTION
/begin FUNCTION _0x793_at_0.5ms "Group /ByModelHeirarchy/LaforgeTestApp_CCU/Core0-TestApp/CAN bus loader/0x793 at 0.5ms" /begin SUB_FUNCTION T18 /end SUB_FUNCTION /end FUNCTION
/begin FUNCTION T19 "Group /ByModelHeirarchy/LaforgeTestApp_CCU/Core0-TestApp/CAN bus loader/0x794 at 0.5ms/Tx" /begin REF_CHARACTERISTIC CANLoadBytes_V /end REF_CHARACTERISTIC /end FUNCTION
/begin FUNCTION _0x794_at_0.5ms "Group /ByModelHeirarchy/LaforgeTestApp_CCU/Core0-TestApp/CAN bus loader/0x794 at 0.5ms" /begin SUB_FUNCTION T19 /end SUB_FUNCTION /end FUNCTION
/begin FUNCTION T20 "Group /ByModelHeirarchy/LaforgeTestApp_CCU/Core0-TestApp/CAN bus loader/0x795 at 0.25ms/Tx" /begin REF_CHARACTERISTIC CANLoadBytes_V /end REF_CHARACTERISTIC /end FUNCTION
/begin FUNCTION _0x795_at_0.25ms "Group /ByModelHeirarchy/LaforgeTestApp_CCU/Core0-TestApp/CAN bus loader/0x795 at 0.25ms" /begin SUB_FUNCTION T20 /end SUB_FUNCTION /end FUNCTION
/begin FUNCTION T21 "Group /ByModelHeirarchy/LaforgeTestApp_CCU/Core0-TestApp/CAN bus loader/0x796 at 0.25ms/Tx" /begin REF_CHARACTERISTIC CANLoadBytes_V /end REF_CHARACTERISTIC /end FUNCTION
/begin FUNCTION _0x796_at_0.25ms "Group /ByModelHeirarchy/LaforgeTestApp_CCU/Core0-TestApp/CAN bus loader/0x796 at 0.25ms" /begin SUB_FUNCTION T21 /end SUB_FUNCTION /end FUNCTION
/begin FUNCTION T22 "Group /ByModelHeirarchy/LaforgeTestApp_CCU/Core0-TestApp/CAN bus loader/0x797 at 0.25ms/Tx" /begin REF_CHARACTERISTIC CANLoadBytes_V /end REF_CHARACTERISTIC /end FUNCTION
/begin FUNCTION _0x797_at_0.25ms "Group /ByModelHeirarchy/LaforgeTestApp_CCU/Core0-TestApp/CAN bus loader/0x797 at 0.25ms" /begin SUB_FUNCTION T22 /end SUB_FUNCTION /end FUNCTION
/begin FUNCTION T23 "Group /ByModelHeirarchy/LaforgeTestApp_CCU/Core0-TestApp/CAN bus loader/0x798 at 0.25ms/Tx" /begin REF_CHARACTERISTIC CANLoadBytes_V /end REF_CHARACTERISTIC /end FUNCTION
/begin FUNCTION _0x798_at_0.25ms "Group /ByModelHeirarchy/LaforgeTestApp_CCU/Core0-TestApp/CAN bus loader/0x798 at 0.25ms" /begin SUB_FUNCTION T23 /end SUB_FUNCTION /end FUNCTION
/begin FUNCTION T24 "Group /ByModelHeirarchy/LaforgeTestApp_CCU/Core0-TestApp/CAN bus loader/0x799 at 0.5ms/Tx" /begin REF_CHARACTERISTIC CANLoadBytes_V /end REF_CHARACTERISTIC /end FUNCTION
/begin FUNCTION _0x799_at_0.5ms "Group /ByModelHeirarchy/LaforgeTestApp_CCU/Core0-TestApp/CAN bus loader/0x799 at 0.5ms" /begin SUB_FUNCTION T24 /end SUB_FUNCTION /end FUNCTION
/begin FUNCTION T25 "Group /ByModelHeirarchy/LaforgeTestApp_CCU/Core0-TestApp/CAN bus loader/0x79A at 0.5ms/Tx" /begin REF_CHARACTERISTIC CANLoadBytes_V /end REF_CHARACTERISTIC /end FUNCTION
/begin FUNCTION _0x79A_at_0.5ms "Group /ByModelHeirarchy/LaforgeTestApp_CCU/Core0-TestApp/CAN bus loader/0x79A at 0.5ms" /begin SUB_FUNCTION T25 /end SUB_FUNCTION /end FUNCTION
/begin FUNCTION T26 "Group /ByModelHeirarchy/LaforgeTestApp_CCU/Core0-TestApp/CAN bus loader/0x79B at 0.5ms/Tx" /begin REF_CHARACTERISTIC CANLoadBytes_V /end REF_CHARACTERISTIC /end FUNCTION
/begin FUNCTION _0x79B_at_0.5ms "Group /ByModelHeirarchy/LaforgeTestApp_CCU/Core0-TestApp/CAN bus loader/0x79B at 0.5ms" /begin SUB_FUNCTION T26 /end SUB_FUNCTION /end FUNCTION
/begin FUNCTION T27 "Group /ByModelHeirarchy/LaforgeTestApp_CCU/Core0-TestApp/CAN bus loader/0x79C at 0.5ms/Tx" /begin REF_CHARACTERISTIC CANLoadBytes_V /end REF_CHARACTERISTIC /end FUNCTION
/begin FUNCTION _0x79C_at_0.5ms "Group /ByModelHeirarchy/LaforgeTestApp_CCU/Core0-TestApp/CAN bus loader/0x79C at 0.5ms" /begin SUB_FUNCTION T27 /end SUB_FUNCTION /end FUNCTION
/begin FUNCTION T28 "Group /ByModelHeirarchy/LaforgeTestApp_CCU/Core0-TestApp/CAN bus loader/0x79D at 0.5ms/Tx" /begin REF_CHARACTERISTIC CANLoadBytes_V /end REF_CHARACTERISTIC /end FUNCTION
/begin FUNCTION _0x79D_at_0.5ms "Group /ByModelHeirarchy/LaforgeTestApp_CCU/Core0-TestApp/CAN bus loader/0x79D at 0.5ms" /begin SUB_FUNCTION T28 /end SUB_FUNCTION /end FUNCTION
/begin FUNCTION T29 "Group /ByModelHeirarchy/LaforgeTestApp_CCU/Core0-TestApp/CAN bus loader/0x79E at 0.5ms/Tx" /begin REF_CHARACTERISTIC CANLoadBytes_V /end REF_CHARACTERISTIC /end FUNCTION
/begin FUNCTION _0x79E_at_0.5ms "Group /ByModelHeirarchy/LaforgeTestApp_CCU/Core0-TestApp/CAN bus loader/0x79E at 0.5ms" /begin SUB_FUNCTION T29 /end SUB_FUNCTION /end FUNCTION
/begin FUNCTION T30 "Group /ByModelHeirarchy/LaforgeTestApp_CCU/Core0-TestApp/CAN bus loader/0x79F at 0.5ms/Tx" /begin REF_CHARACTERISTIC CANLoadBytes_V /end REF_CHARACTERISTIC /end FUNCTION
/begin FUNCTION _0x79F_at_0.5ms "Group /ByModelHeirarchy/LaforgeTestApp_CCU/Core0-TestApp/CAN bus loader/0x79F at 0.5ms" /begin SUB_FUNCTION T30 /end SUB_FUNCTION /end FUNCTION
/begin FUNCTION T31 "Group /ByModelHeirarchy/LaforgeTestApp_CCU/Core0-TestApp/CAN bus loader/0x7A0 at 0.5ms/Tx" /begin REF_CHARACTERISTIC CANLoadBytes_V /end REF_CHARACTERISTIC /end FUNCTION
/begin FUNCTION _0x7A0_at_0.5ms "Group /ByModelHeirarchy/LaforgeTestApp_CCU/Core0-TestApp/CAN bus loader/0x7A0 at 0.5ms" /begin SUB_FUNCTION T31 /end SUB_FUNCTION /end FUNCTION
/begin FUNCTION T32 "Group /ByModelHeirarchy/LaforgeTestApp_CCU/Core0-TestApp/CAN bus loader/0x7A1 at 0.5ms/Tx" /begin REF_CHARACTERISTIC CANLoadBytes_V /end REF_CHARACTERISTIC /end FUNCTION
/begin FUNCTION _0x7A1_at_0.5ms "Group /ByModelHeirarchy/LaforgeTestApp_CCU/Core0-TestApp/CAN bus loader/0x7A1 at 0.5ms" /begin SUB_FUNCTION T32 /end SUB_FUNCTION /end FUNCTION
/begin FUNCTION T33 "Group /ByModelHeirarchy/LaforgeTestApp_CCU/Core0-TestApp/CAN bus loader/0x7A2 at 0.5ms/Tx" /begin REF_CHARACTERISTIC CANLoadBytes_V /end REF_CHARACTERISTIC /end FUNCTION
/begin FUNCTION _0x7A2_at_0.5ms "Group /ByModelHeirarchy/LaforgeTestApp_CCU/Core0-TestApp/CAN bus loader/0x7A2 at 0.5ms" /begin SUB_FUNCTION T33 /end SUB_FUNCTION /end FUNCTION
/begin FUNCTION CAN_bus_loader "Group /ByModelHeirarchy/LaforgeTestApp_CCU/Core0-TestApp/CAN bus loader"
 /begin SUB_FUNCTION _0x777_at_0.5ms _0x778_at_0.5ms _0x779_at_0.5ms _0x77A_at_0.5ms _0x77B_at_0.5ms _0x77C_at_0.5ms _0x77D_at_0.5ms _0x77E_at_0.5ms _0x77F_at_0.25ms _0x780_at_0.25ms _0x781_at_0.25ms _0x782_at_0.25ms _0x783_at_0.5ms _0x784_at_0.5ms _0x785_at_0.5ms _0x786_at_0.5ms _0x787_at_0.5ms _0x788_at_0.5ms _0x789_at_0.5ms _0x78A_at_0.5ms _0x78B_at_0.5ms _0x78C_at_0.5ms _0x78D_at_0.5ms _0x78E_at_0.5ms _0x78F_at_0.5ms _0x790_at_0.5ms _0x791_at_0.5ms _0x792_at_0.5ms _0x793_at_0.5ms _0x794_at_0.5ms _0x795_at_0.25ms _0x796_at_0.25ms _0x797_at_0.25ms _0x798_at_0.25ms _0x799_at_0.5ms _0x79A_at_0.5ms _0x79B_at_0.5ms _0x79C_at_0.5ms _0x79D_at_0.5ms _0x79E_at_0.5ms _0x79F_at_0.5ms _0x7A0_at_0.5ms _0x7A1_at_0.5ms _0x7A2_at_0.5ms /end SUB_FUNCTION
 /begin REF_CHARACTERISTIC CANLoad10_C CANLoad11_C CANLoad12_C CANLoad13_C CANLoad14_C CANLoad15_C CANLoad16_C CANLoad17_C CANLoad18_C CANLoad19_C CANLoad1_C CANLoad20_C CANLoad21_C CANLoad22_C CANLoad23_C CANLoad24_C CANLoad25_C CANLoad26_C CANLoad27_C CANLoad28_C CANLoad29_C CANLoad2_C CANLoad30_C CANLoad31_C CANLoad32_C CANLoad33_C CANLoad34_C CANLoad35_C CANLoad36_C CANLoad37_C CANLoad38_C CANLoad39_C CANLoad3_C CANLoad40_C CANLoad41_C CANLoad42_C CANLoad43_C CANLoad44_C CANLoad4_C CANLoad5_C CANLoad6_C CANLoad7_C CANLoad8_C CANLoad9_C /end REF_CHARACTERISTIC
/end FUNCTION
/begin FUNCTION Compare_payloads "Group /ByModelHeirarchy/LaforgeTestApp_CCU/Core0-TestApp/CAN_FD_Msgs/Compare payloads"
 /begin LOC_MEASUREMENT CANFDRxTxCompare[0] CANFDRxTxCompare[1] CANFDRxTxCompare[2] CANFDRxTxCompare[3] CANFDRxTxCompare[4] CANFDRxTxCompare[5] CANFDRxTxCompare[6] CANFDRxTxCompare[7] /end LOC_MEASUREMENT
/end FUNCTION
/begin FUNCTION Subsystem1 "Group /ByModelHeirarchy/LaforgeTestApp_CCU/Core0-TestApp/CAN_FD_Msgs/FD TX/Subsystem1" /begin LOC_MEASUREMENT CANFDCounter /end LOC_MEASUREMENT /begin REF_CHARACTERISTIC CANFDInitCount_C /end REF_CHARACTERISTIC /end FUNCTION
/begin FUNCTION FD_TX "Group /ByModelHeirarchy/LaforgeTestApp_CCU/Core0-TestApp/CAN_FD_Msgs/FD TX" /begin SUB_FUNCTION Subsystem1 /end SUB_FUNCTION /begin LOC_MEASUREMENT CANFDTxAckCnt /end LOC_MEASUREMENT /end FUNCTION
/begin FUNCTION CAN_FD_Msgs "Group /ByModelHeirarchy/LaforgeTestApp_CCU/Core0-TestApp/CAN_FD_Msgs" /begin SUB_FUNCTION Compare_payloads FD_TX /end SUB_FUNCTION
 /begin LOC_MEASUREMENT CANFDRxErr CANFDRxOverrun CANFDRxTrig CANFDRxTxFault CANFDRx[0] CANFDRx[1] CANFDRx[2] CANFDRx[3] CANFDRx[4] CANFDRx[5] CANFDRx[6] CANFDRx[7] CANFDTrig CANFDTxData[0] CANFDTxData[1] CANFDTxData[2] CANFDTxData[3] CANFDTxData[4] CANFDTxData[5] CANFDTxData[6] CANFDTxData[7] CANFDTxErrFlg CANFDTxTimeout /end LOC_MEASUREMENT
 /begin REF_CHARACTERISTIC CANFDData_C CANFDData_override_C CANFDIncrement_C CANFDResetCounter_C CANFDTrig_C CANFDTrig_override_C CANFDTxTimeoutDur_C /end REF_CHARACTERISTIC
/end FUNCTION
/begin FUNCTION Charge_Pilot "Group /ByModelHeirarchy/LaforgeTestApp_CCU/Core0-TestApp/Charge_Pilot"
 /begin LOC_MEASUREMENT ain_cpilot_dcycle ain_cpilot_freq ain_cpilot_state ain_cpilot_timeout ain_cpilot_timeout_count /end LOC_MEASUREMENT
/end FUNCTION
/begin FUNCTION Digital_Inputs "Group /ByModelHeirarchy/LaforgeTestApp_CCU/Core0-TestApp/Digital_Inputs"
 /begin LOC_MEASUREMENT din_nHbrFlt din_p10_8_nplcirq din_p15_1_run din_p22_0_qout3 din_p33_0_can_wake din_p33_1_pilwake din_p33_9_ss1 din_scu_fsp din_ss2_alt din_ss2_scu_stop /end LOC_MEASUREMENT
/end FUNCTION
/begin FUNCTION Digital_Outputs "Group /ByModelHeirarchy/LaforgeTestApp_CCU/Core0-TestApp/Digital_Outputs"
 /begin REF_CHARACTERISTIC dotc_leda_dcycle dotc_leda_freq dotc_ledb_dcycle dotc_ledb_freq dotc_ledc_dcycle dotc_ledc_freq dotc_p22_1_qbootsel dotc_p22_2_qspisel /end REF_CHARACTERISTIC
/end FUNCTION
/begin FUNCTION HBridge_Outputs "Group /ByModelHeirarchy/LaforgeTestApp_CCU/Core0-TestApp/HBridge_Outputs"
 /begin REF_CHARACTERISTIC outc_hbrcmd1_dcycle outc_hbrcmd1_freq outc_hbrcmd2_dcycle outc_hbrcmd2_freq outc_p11_7_sleep outc_p14_7_hbrmode /end REF_CHARACTERISTIC
/end FUNCTION
/begin FUNCTION CmdDEVCTRL "Group /ByModelHeirarchy/LaforgeTestApp_CCU/Core0-TestApp/PSU Control/CmdDEVCTRL"
 /begin REF_CHARACTERISTIC TLF35584DEVCTRLCmdB0_C TLF35584DEVCTRLCmdB1_C TLF35584DEVCTRLCmdB2_C TLF35584DEVCTRLCmdB3_C TLF35584DEVCTRLCmdB4_C /end REF_CHARACTERISTIC
/end FUNCTION
/begin FUNCTION CmdStartup_BCK "Group /ByModelHeirarchy/LaforgeTestApp_CCU/Core0-TestApp/PSU Control/CmdStartup-BCK"
 /begin REF_CHARACTERISTIC TLF35584StartupCmdB0_C TLF35584StartupCmdB1_C TLF35584StartupCmdB2_C TLF35584StartupCmdB3_C TLF35584StartupCmdB4_C /end REF_CHARACTERISTIC
/end FUNCTION
/begin FUNCTION DataSpreadSpectrum "Group /ByModelHeirarchy/LaforgeTestApp_CCU/Core0-TestApp/PSU Control/DataSpreadSpectrum"
 /begin REF_CHARACTERISTIC TLF35584StartupDataB0_C TLF35584StartupDataB1_C TLF35584StartupDataB2_C TLF35584StartupDataB3_C TLF35584StartupDataB4_C /end REF_CHARACTERISTIC
/end FUNCTION
/begin FUNCTION PSU_Control "Group /ByModelHeirarchy/LaforgeTestApp_CCU/Core0-TestApp/PSU Control" /begin SUB_FUNCTION CmdDEVCTRL CmdStartup_BCK DataSpreadSpectrum /end SUB_FUNCTION
 /begin LOC_MEASUREMENT TLF35584DataFrom[0] TLF35584DataFrom[10] TLF35584DataFrom[11] TLF35584DataFrom[12] TLF35584DataFrom[13] TLF35584DataFrom[14] TLF35584DataFrom[15] TLF35584DataFrom[16] TLF35584DataFrom[17] TLF35584DataFrom[18] TLF35584DataFrom[19] TLF35584DataFrom[1] TLF35584DataFrom[20] TLF35584DataFrom[21] TLF35584DataFrom[22] TLF35584DataFrom[23] TLF35584DataFrom[24] TLF35584DataFrom[2] TLF35584DataFrom[3] TLF35584DataFrom[4] TLF35584DataFrom[5] TLF35584DataFrom[6] TLF35584DataFrom[7] TLF35584DataFrom[8] TLF35584DataFrom[9] TLF35584GetJobResult TLF35584JobResult TLF35584RqstdCmd[0] TLF35584RqstdCmd[10] TLF35584RqstdCmd[11] TLF35584RqstdCmd[12] TLF35584RqstdCmd[13] TLF35584RqstdCmd[14] TLF35584RqstdCmd[15] TLF35584RqstdCmd[16] TLF35584RqstdCmd[17] TLF35584RqstdCmd[18] TLF35584RqstdCmd[19] TLF35584RqstdCmd[1] TLF35584RqstdCmd[20] TLF35584RqstdCmd[21] TLF35584RqstdCmd[22] TLF35584RqstdCmd[23] TLF35584RqstdCmd[24] TLF35584RqstdCmd[2] TLF35584RqstdCmd[3] TLF35584RqstdCmd[4] TLF35584RqstdCmd[5] TLF35584RqstdCmd[6] TLF35584RqstdCmd[7] TLF35584RqstdCmd[8] TLF35584RqstdCmd[9] TLF35584Send TLF35584Size TLF35584UserData[0] TLF35584UserData[10] TLF35584UserData[11] TLF35584UserData[12] TLF35584UserData[13] TLF35584UserData[14] TLF35584UserData[15] TLF35584UserData[16] TLF35584UserData[17] TLF35584UserData[18] TLF35584UserData[19] TLF35584UserData[1] TLF35584UserData[20] TLF35584UserData[21] TLF35584UserData[22] TLF35584UserData[23] TLF35584UserData[24] TLF35584UserData[2] TLF35584UserData[3] TLF35584UserData[4] TLF35584UserData[5] TLF35584UserData[6] TLF35584UserData[7] TLF35584UserData[8] TLF35584UserData[9] /end LOC_MEASUREMENT
 /begin REF_CHARACTERISTIC TLF35584CmdOvrdFlg_C TLF35584DataStartupOvrdFlg_C TLF35584DataVrefOffOvrdFlg_C TLF35584DefaultSize_C TLF35584GetJobResultOvrdFlg_C TLF35584GetJobResult_C TLF35584RqstCmdDEVCTRLOvrdFlg_C TLF35584RqstCmd_C TLF35584SendOvrdFlg_C TLF35584Send_C TLF35584Size_C TLF35584UserData_C /end REF_CHARACTERISTIC
/end FUNCTION
/begin FUNCTION OVR_AndExport1 "Group /ByModelHeirarchy/LaforgeTestApp_CCU/Core0-TestApp/V2G/BatteryModel/OVR_AndExport1" /begin LOC_MEASUREMENT SimRessVolt /end LOC_MEASUREMENT /begin REF_CHARACTERISTIC SimRessVoltOf_C SimRessVoltOv_C /end REF_CHARACTERISTIC /end FUNCTION
/begin FUNCTION OVR_AndExport13 "Group /ByModelHeirarchy/LaforgeTestApp_CCU/Core0-TestApp/V2G/BatteryModel/OVR_AndExport13" /begin LOC_MEASUREMENT SimRessSoc /end LOC_MEASUREMENT /begin REF_CHARACTERISTIC SimRessSocOf_C SimRessSocOv_C /end REF_CHARACTERISTIC /end FUNCTION
/begin FUNCTION BatteryModel "Group /ByModelHeirarchy/LaforgeTestApp_CCU/Core0-TestApp/V2G/BatteryModel" /begin SUB_FUNCTION OVR_AndExport1 OVR_AndExport13 /end SUB_FUNCTION
 /begin REF_CHARACTERISTIC SimRessCapacity_C SimRessChgCrntMax_C SimRessChgVoltMax_C SimRessFullSoc_C SimRessInitSoc_C SimRessProfileSoc_Ax SimRessProfileVolt_Ay /end REF_CHARACTERISTIC
/end FUNCTION
/begin FUNCTION CtlEcu "Group /ByModelHeirarchy/LaforgeTestApp_CCU/Core0-TestApp/V2G/CtlEcu" /begin LOC_MEASUREMENT CtlEcuPsuPowerHold /end LOC_MEASUREMENT /end FUNCTION
/begin FUNCTION DigitalDebounce1 "Group /ByModelHeirarchy/LaforgeTestApp_CCU/Core0-TestApp/V2G/DigitalDebounce1" /begin REF_CHARACTERISTIC HostChgRlyWeldCheckDoneDelay_C /end REF_CHARACTERISTIC /end FUNCTION
/begin FUNCTION DigitalDebounce2 "Group /ByModelHeirarchy/LaforgeTestApp_CCU/Core0-TestApp/V2G/DigitalDebounce2" /begin REF_CHARACTERISTIC HostAllChargeRelaysClosedDelay0 /end REF_CHARACTERISTIC /end FUNCTION
/begin FUNCTION DigitalDebounce3 "Group /ByModelHeirarchy/LaforgeTestApp_CCU/Core0-TestApp/V2G/DigitalDebounce3" /begin REF_CHARACTERISTIC HostChargeInletLockStatusDelay0 /end REF_CHARACTERISTIC /end FUNCTION
/begin FUNCTION DigitalDebounce4 "Group /ByModelHeirarchy/LaforgeTestApp_CCU/Core0-TestApp/V2G/DigitalDebounce4" /begin REF_CHARACTERISTIC HostEvIsolCheckDisabledDelay_C /end REF_CHARACTERISTIC /end FUNCTION
/begin FUNCTION EVSE_OutInterface "Group /ByModelHeirarchy/LaforgeTestApp_CCU/Core0-TestApp/V2G/EVSE_OutInterface"
 /begin REF_CHARACTERISTIC dotc_p11_1_pilots2 dotc_p11_9_hpenab dotc_p33_2_pilwkclr dotc_p33_3_pilwkdis dotc_qca_enable /end REF_CHARACTERISTIC
/end FUNCTION
/begin FUNCTION InpDigital1 "Group /ByModelHeirarchy/LaforgeTestApp_CCU/Core0-TestApp/V2G/InpDigital1"
 /begin LOC_MEASUREMENT ain_cpilot_dcycle ain_cpilot_freq ain_cpilot_state ain_cpilot_timeout ain_cpilot_timeout_count /end LOC_MEASUREMENT
/end FUNCTION
/begin FUNCTION PayloadArbitration "Group /ByModelHeirarchy/LaforgeTestApp_CCU/Core0-TestApp/V2G/OE_CCS/Arbitration/Arbit_V2gRxMsg_Authentication/PayloadArbitration"
 /begin LOC_MEASUREMENT V2gRxMsgAuthEvseProcessing V2gRxMsgAuthNotif V2gRxMsgAuthNotifFlg V2gRxMsgAuthNotifMaxDelay V2gRxMsgAuthRescode /end LOC_MEASUREMENT
/end FUNCTION
/begin FUNCTION Arbit_V2gRxMsg_Authentication "Group /ByModelHeirarchy/LaforgeTestApp_CCU/Core0-TestApp/V2G/OE_CCS/Arbitration/Arbit_V2gRxMsg_Authentication" /begin SUB_FUNCTION PayloadArbitration /end SUB_FUNCTION /begin LOC_MEASUREMENT V2gRxMsgAuthTrg /end LOC_MEASUREMENT /end FUNCTION
/begin FUNCTION PayloadArbitration1 "Group /ByModelHeirarchy/LaforgeTestApp_CCU/Core0-TestApp/V2G/OE_CCS/Arbitration/Arbit_V2gRxMsg_PaymentSelection/PayloadArbitration"
 /begin LOC_MEASUREMENT V2gRxMsgPmtSelNotif V2gRxMsgPmtSelNotifFlg V2gRxMsgPmtSelNotifMaxDelay V2gRxMsgPmtSelRescode /end LOC_MEASUREMENT
/end FUNCTION
/begin FUNCTION Arbit_V2gRxMsg_PaymentSelection "Group /ByModelHeirarchy/LaforgeTestApp_CCU/Core0-TestApp/V2G/OE_CCS/Arbitration/Arbit_V2gRxMsg_PaymentSelection" /begin SUB_FUNCTION PayloadArbitration1 /end SUB_FUNCTION /begin LOC_MEASUREMENT V2gRxMsgPmtSelTrg /end LOC_MEASUREMENT /end FUNCTION
/begin FUNCTION PayloadArbitration2 "Group /ByModelHeirarchy/LaforgeTestApp_CCU/Core0-TestApp/V2G/OE_CCS/Arbitration/Arbit_V2gRxMsg_ServiceDetail/PayloadArbitration"
 /begin LOC_MEASUREMENT V2gRxMsgSvcDetailNotif V2gRxMsgSvcDetailNotifFlg V2gRxMsgSvcDetailNotifMaxDelay V2gRxMsgSvcDetailParamSetLen V2gRxMsgSvcDetailParamSetSizes4 V2gRxMsgSvcDetailParamSetSizes3 V2gRxMsgSvcDetailParamSetSizes2 V2gRxMsgSvcDetailParamSetSizes0 V2gRxMsgSvcDetailParamSetSizes1 V2gRxMsgSvcDetailRescode V2gRxMsgSvcDetailSvcId /end LOC_MEASUREMENT
/end FUNCTION
/begin FUNCTION Arbit_V2gRxMsg_ServiceDetail "Group /ByModelHeirarchy/LaforgeTestApp_CCU/Core0-TestApp/V2G/OE_CCS/Arbitration/Arbit_V2gRxMsg_ServiceDetail" /begin SUB_FUNCTION PayloadArbitration2 /end SUB_FUNCTION /begin LOC_MEASUREMENT V2gRxMsgSvcDetailTrg /end LOC_MEASUREMENT /end FUNCTION
/begin FUNCTION OVR_AndExport6 "Group /ByModelHeirarchy/LaforgeTestApp_CCU/Core0-TestApp/V2G/OE_CCS/Arbitration/Arbit_V2gRxMsg_ServiceDetailParser/OVR_AndExport6" /begin LOC_MEASUREMENT SvcSearchSt /end LOC_MEASUREMENT /begin REF_CHARACTERISTIC SvcSearchStOf_C SvcSearchStOv_C /end REF_CHARACTERISTIC /end FUNCTION
/begin FUNCTION Arbit_V2gRxMsg_ServiceDetailPa0 "Group /ByModelHeirarchy/LaforgeTestApp_CCU/Core0-TestApp/V2G/OE_CCS/Arbitration/Arbit_V2gRxMsg_ServiceDetailParser" /begin SUB_FUNCTION OVR_AndExport6 /end SUB_FUNCTION /begin LOC_MEASUREMENT DynamicModeEn ParamSetIdSelected ServiceIdSelected /end LOC_MEASUREMENT /end FUNCTION
/end MODULE
/end PROJECT
